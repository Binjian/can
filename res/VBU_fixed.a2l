ASAP2_VERSION 1 31
/begin PROJECT ProjectName "Project Comment Goes Here"
/begin HEADER "Header Comments go here" /end HEADER
/begin MODULE ModuleName "Module Comment Goes Here"
/begin MOD_COMMON "Mod Common Comment Here" ALIGNMENT_WORD 1 ALIGNMENT_LONG 1 ALIGNMENT_FLOAT32_IEEE 1 ALIGNMENT_FLOAT64_IEEE 1 BYTE_ORDER MSB_LAST /end MOD_COMMON
/begin RECORD_LAYOUT Scalar_BOOLEAN FNC_VALUES 1 UBYTE COLUMN_DIR DIRECT /end RECORD_LAYOUT
/begin RECORD_LAYOUT Scalar_UBYTE FNC_VALUES 1 UBYTE COLUMN_DIR DIRECT /end RECORD_LAYOUT
/begin RECORD_LAYOUT Scalar_UWORD FNC_VALUES 1 UWORD COLUMN_DIR DIRECT /end RECORD_LAYOUT
/begin RECORD_LAYOUT Scalar_ULONG FNC_VALUES 1 ULONG COLUMN_DIR DIRECT /end RECORD_LAYOUT
/begin RECORD_LAYOUT Scalar_FLOAT32_IEEE FNC_VALUES 1 FLOAT32_IEEE COLUMN_DIR DIRECT /end RECORD_LAYOUT
/begin RECORD_LAYOUT Lookup1D_X_UWORD AXIS_PTS_X 1 UWORD INDEX_INCR DIRECT /end RECORD_LAYOUT
/begin RECORD_LAYOUT Lookup1D_FLOAT32_IEEE FNC_VALUES 1 FLOAT32_IEEE COLUMN_DIR DIRECT /end RECORD_LAYOUT
/begin RECORD_LAYOUT Lookup1D_X_FLOAT32_IEEE AXIS_PTS_X 1 FLOAT32_IEEE INDEX_INCR DIRECT /end RECORD_LAYOUT
/begin RECORD_LAYOUT Lookup2D_X_UWORD AXIS_PTS_X 1 UWORD INDEX_INCR DIRECT /end RECORD_LAYOUT
/begin RECORD_LAYOUT Lookup2D_X_ULONG AXIS_PTS_X 1 ULONG INDEX_INCR DIRECT /end RECORD_LAYOUT
/begin RECORD_LAYOUT Lookup2D_LONG FNC_VALUES 1 SLONG COLUMN_DIR DIRECT /end RECORD_LAYOUT
/begin RECORD_LAYOUT Lookup2D_X_LONG AXIS_PTS_X 1 SLONG INDEX_INCR DIRECT /end RECORD_LAYOUT
/begin RECORD_LAYOUT Lookup2D_FLOAT32_IEEE FNC_VALUES 1 FLOAT32_IEEE COLUMN_DIR DIRECT /end RECORD_LAYOUT
/begin RECORD_LAYOUT Lookup2D_X_FLOAT32_IEEE AXIS_PTS_X 1 FLOAT32_IEEE INDEX_INCR DIRECT /end RECORD_LAYOUT
/begin RECORD_LAYOUT Lookup2D_X_FLOAT64_IEEE AXIS_PTS_X 1 FLOAT64_IEEE INDEX_INCR DIRECT /end RECORD_LAYOUT
/begin AXIS_PTS CaSOC_FastChargeCCTempX_C "" 0xFFFFFFFF NO_INPUT_QUANTITY Lookup2D_X_FLOAT32_IEEE 0 VBU0706_CM_single_cnt 9 -3.4028234663852886E+38 3.4028234663852886E+38 /end AXIS_PTS
/begin AXIS_PTS CaSOC_FastChargeCCRateY_n "" 0xFFFFFFFF NO_INPUT_QUANTITY Lookup2D_X_FLOAT32_IEEE 0 VBU0706_CM_single_cnt 11 -3.4028234663852886E+38 3.4028234663852886E+38 /end AXIS_PTS
/begin AXIS_PTS TQD_phiCrpCtrlSlp_MAP_x "" 0xFFFFFFFF NO_INPUT_QUANTITY Lookup2D_X_FLOAT32_IEEE 0 VBU0706_CM_single_phi 11 0.0 360.0 /end AXIS_PTS
/begin AXIS_PTS TQD_vCrpCtrlSlp_MAP_y "" 0xFFFFFFFF TQD_vVehSpd Lookup2D_X_FLOAT32_IEEE 0 VBU0706_CM_single_kph 9 -250.0 250.0 /end AXIS_PTS
/begin CHARACTERISTIC TQCMP_trqPulse_CUR_v "" CURVE 0x70001c3e Lookup1D_FLOAT32_IEEE 0 VBU0706_CM_single_cnt -3.4028234663852886E+38 3.4028234663852886E+38
 /begin AXIS_DESCR COM_AXIS NO_INPUT_QUANTITY VBU0706_CM_single_cnt 6 -3.4028234663852886E+38 3.4028234663852886E+38 AXIS_PTS_REF TQCMP_tiPulse_CUR_x /end AXIS_DESCR
/end CHARACTERISTIC
/begin AXIS_PTS TQCMP_tiPulse_CUR_x "" 0x70001c26 NO_INPUT_QUANTITY Lookup1D_X_FLOAT32_IEEE 0 VBU0706_CM_single_cnt 6 -3.4028234663852886E+38 3.4028234663852886E+38 /end AXIS_PTS
/begin CHARACTERISTIC TQCMP_stPulseRAEna_CUR_v "" CURVE 0x7000153c Lookup1D_FLOAT32_IEEE 0 VBU0706_CM_single_cnt -3.4028234663852886E+38 3.4028234663852886E+38
 /begin AXIS_DESCR COM_AXIS NO_INPUT_QUANTITY VBU0706_CM_single_cnt 3 -3.4028234663852886E+38 3.4028234663852886E+38 AXIS_PTS_REF TQCMP_stDrvMode_CUR_x /end AXIS_DESCR
/end CHARACTERISTIC
/begin AXIS_PTS TQCMP_stDrvMode_CUR_x "" 0x70001530 NO_INPUT_QUANTITY Lookup1D_X_FLOAT32_IEEE 0 VBU0706_CM_single_cnt 3 -3.4028234663852886E+38 3.4028234663852886E+38 /end AXIS_PTS
/begin CHARACTERISTIC TQDIS_facAccDmpFilterRA_MAP_v "" MAP 0x70003c0c Lookup2D_FLOAT32_IEEE 0 VBU0706_CM_single_pct 0.0 1.0
 /begin AXIS_DESCR COM_AXIS APD_pctAccPedPos VBU0706_CM_single_pct 5 0.0 100.0 AXIS_PTS_REF TQDIS_pctDmpFilter_MAP_y /end AXIS_DESCR
 /begin AXIS_DESCR COM_AXIS NO_INPUT_QUANTITY VBU0706_CM_single_cnt 4 0.0 3.0 AXIS_PTS_REF TQDIS_stDmpFilter_MAP_x /end AXIS_DESCR
/end CHARACTERISTIC
/begin AXIS_PTS TQDIS_stDmpFilter_MAP_x "" 0x70001726 NO_INPUT_QUANTITY Lookup2D_X_FLOAT32_IEEE 0 VBU0706_CM_single_cnt 4 0.0 3.0 /end AXIS_PTS
/begin AXIS_PTS TQDIS_pctDmpFilter_MAP_y "" 0x7000193a APD_pctAccPedPos Lookup2D_X_FLOAT32_IEEE 0 VBU0706_CM_single_pct 5 0.0 100.0 /end AXIS_PTS
/begin CHARACTERISTIC TQDIS_facSpdDmpFilterRA_MAP_v "" MAP 0x70003c5c Lookup2D_FLOAT32_IEEE 0 VBU0706_CM_single_cnt -3.4028234663852886E+38 3.4028234663852886E+38
 /begin AXIS_DESCR COM_AXIS SPD_vVehSpd VBU0706_CM_single_cnt 5 -3.4028234663852886E+38 3.4028234663852886E+38 AXIS_PTS_REF TQDIS_vDmpFilter_MAP_y /end AXIS_DESCR
 /begin AXIS_DESCR COM_AXIS NO_INPUT_QUANTITY VBU0706_CM_single_cnt 4 0.0 3.0 AXIS_PTS_REF TQDIS_stDmpFilter_MAP_x /end AXIS_DESCR
/end CHARACTERISTIC
/begin AXIS_PTS TQDIS_vDmpFilter_MAP_y "" 0x7000194e SPD_vVehSpd Lookup2D_X_FLOAT32_IEEE 0 VBU0706_CM_single_cnt 5 -3.4028234663852886E+38 3.4028234663852886E+38 /end AXIS_PTS
/begin CHARACTERISTIC TQO_facShftChangeHi_CUR_v "" CURVE 0x70001cce Lookup1D_FLOAT32_IEEE 0 VBU0706_CM_single_cnt -3.4028234663852886E+38 3.4028234663852886E+38
 /begin AXIS_DESCR COM_AXIS NO_INPUT_QUANTITY VBU0706_CM_single_cnt 6 -3.4028234663852886E+38 3.4028234663852886E+38 AXIS_PTS_REF TQO_trqShftChange_CUR_x /end AXIS_DESCR
/end CHARACTERISTIC
/begin AXIS_PTS TQO_trqShftChange_CUR_x "" 0x70001d16 NO_INPUT_QUANTITY Lookup1D_X_FLOAT32_IEEE 0 VBU0706_CM_single_cnt 6 -3.4028234663852886E+38 3.4028234663852886E+38 /end AXIS_PTS
/begin CHARACTERISTIC TQO_facShftChangeLo_CUR_v "" CURVE 0x70001ce6 Lookup1D_FLOAT32_IEEE 0 VBU0706_CM_single_cnt -3.4028234663852886E+38 3.4028234663852886E+38
 /begin AXIS_DESCR COM_AXIS NO_INPUT_QUANTITY VBU0706_CM_single_cnt 6 -3.4028234663852886E+38 3.4028234663852886E+38 AXIS_PTS_REF TQO_trqShftChange_CUR_x /end AXIS_DESCR
/end CHARACTERISTIC
/begin CHARACTERISTIC TQO_facShftChangeSlope_CUR_v "" CURVE 0x70001cfe Lookup1D_FLOAT32_IEEE 0 VBU0706_CM_single_cnt -3.4028234663852886E+38 3.4028234663852886E+38
 /begin AXIS_DESCR COM_AXIS NO_INPUT_QUANTITY VBU0706_CM_single_cnt 6 -3.4028234663852886E+38 3.4028234663852886E+38 AXIS_PTS_REF TQO_trqShftChange_CUR_x /end AXIS_DESCR
/end CHARACTERISTIC
/begin CHARACTERISTIC TQO_trqBrk_MAP_v "" MAP 0x70006d00 Lookup2D_FLOAT32_IEEE 0 VBU0706_CM_single_cnt -3.4028234663852886E+38 3.4028234663852886E+38
 /begin AXIS_DESCR COM_AXIS SPD_vVehSpd VBU0706_CM_single_cnt 13 -3.4028234663852886E+38 3.4028234663852886E+38 AXIS_PTS_REF TQO_vBrk_MAP_y /end AXIS_DESCR
 /begin AXIS_DESCR COM_AXIS NO_INPUT_QUANTITY VBU0706_CM_single_cnt 11 -3.4028234663852886E+38 3.4028234663852886E+38 AXIS_PTS_REF TQO_pctBrk_MAP_x /end AXIS_DESCR
/end CHARACTERISTIC
/begin AXIS_PTS TQO_pctBrk_MAP_x "" 0x7000287a NO_INPUT_QUANTITY Lookup2D_X_FLOAT32_IEEE 0 VBU0706_CM_single_cnt 11 -3.4028234663852886E+38 3.4028234663852886E+38 /end AXIS_PTS
/begin AXIS_PTS TQO_vBrk_MAP_y "" 0x70003070 SPD_vVehSpd Lookup2D_X_FLOAT32_IEEE 0 VBU0706_CM_single_cnt 13 -3.4028234663852886E+38 3.4028234663852886E+38 /end AXIS_PTS
/begin CHARACTERISTIC MTQL_trqVehSpdLimNormRMot_MAP_v "" MAP 0x70004e04 Lookup2D_FLOAT32_IEEE 0 VBU0706_CM_single_cnt -3.4028234663852886E+38 3.4028234663852886E+38
 /begin AXIS_DESCR COM_AXIS NO_INPUT_QUANTITY VBU0706_CM_single_cnt 15 -3.4028234663852886E+38 3.4028234663852886E+38 AXIS_PTS_REF MTQL_stVehSpdLim_MAP_y /end AXIS_DESCR
 /begin AXIS_DESCR FIX_AXIS NO_INPUT_QUANTITY VBU0706_CM_uint8 4 0 3 FIX_AXIS_PAR_DIST 0 1 4 /end AXIS_DESCR
/end CHARACTERISTIC
/begin AXIS_PTS MTQL_stVehSpdLim_MAP_y "" 0x70003554 NO_INPUT_QUANTITY Lookup2D_X_FLOAT32_IEEE 0 VBU0706_CM_single_cnt 15 -3.4028234663852886E+38 3.4028234663852886E+38 /end AXIS_PTS
/begin CHARACTERISTIC MTQL_trqWhlRLim_CUR_v "" CURVE 0x7000223a Lookup1D_FLOAT32_IEEE 0 VBU0706_CM_single_cnt -3.4028234663852886E+38 3.4028234663852886E+38
 /begin AXIS_DESCR COM_AXIS NO_INPUT_QUANTITY VBU0706_CM_single_cnt 9 -3.4028234663852886E+38 3.4028234663852886E+38 AXIS_PTS_REF MTQL_dnWhlRLim_CUR_x /end AXIS_DESCR
/end CHARACTERISTIC
/begin AXIS_PTS MTQL_dnWhlRLim_CUR_x "" 0x70002216 NO_INPUT_QUANTITY Lookup1D_X_FLOAT32_IEEE 0 VBU0706_CM_single_cnt 9 -3.4028234663852886E+38 3.4028234663852886E+38 /end AXIS_PTS
/begin CHARACTERISTIC VTQA_facMtrDrvPwrUpLim_MAP_v "" MAP 0x70004ffc Lookup2D_FLOAT32_IEEE 0 VBU0706_CM_single_cnt -3.4028234663852886E+38 3.4028234663852886E+38
 /begin AXIS_DESCR COM_AXIS NO_INPUT_QUANTITY VBU0706_CM_single_cnt 9 -3.4028234663852886E+38 3.4028234663852886E+38 AXIS_PTS_REF VTQA_nMtrDrvPwrUpLim_MAP_y /end AXIS_DESCR
 /begin AXIS_DESCR COM_AXIS NO_INPUT_QUANTITY VBU0706_CM_single_cnt 8 -3.4028234663852886E+38 3.4028234663852886E+38 AXIS_PTS_REF VTQA_pwrMtrDrvPwrUpLim_MAP_x /end AXIS_DESCR
/end CHARACTERISTIC
/begin AXIS_PTS VTQA_pwrMtrDrvPwrUpLim_MAP_x "" 0x700020fa NO_INPUT_QUANTITY Lookup2D_X_FLOAT32_IEEE 0 VBU0706_CM_single_cnt 8 -3.4028234663852886E+38 3.4028234663852886E+38 /end AXIS_PTS
/begin AXIS_PTS VTQA_nMtrDrvPwrUpLim_MAP_y "" 0x700022ca NO_INPUT_QUANTITY Lookup2D_X_FLOAT32_IEEE 0 VBU0706_CM_single_cnt 9 -3.4028234663852886E+38 3.4028234663852886E+38 /end AXIS_PTS
/begin CHARACTERISTIC VTQA_pwrRMtrRgnPwrLoss_MAP_v "" MAP 0x70005734 Lookup2D_FLOAT32_IEEE 0 VBU0706_CM_single_cnt -3.4028234663852886E+38 3.4028234663852886E+38
 /begin AXIS_DESCR COM_AXIS NO_INPUT_QUANTITY VBU0706_CM_single_cnt 9 -3.4028234663852886E+38 3.4028234663852886E+38 AXIS_PTS_REF VTQA_nRMtrRgnPwrLoss_MAP_y /end AXIS_DESCR
 /begin AXIS_DESCR COM_AXIS VTQA_trqRMotrNeg VBU0706_CM_single_cnt 12 -3.4028234663852886E+38 3.4028234663852886E+38 AXIS_PTS_REF VTQA_trqRMtrRgnPwrLoss_MAP_x /end AXIS_DESCR
/end CHARACTERISTIC
/begin AXIS_PTS VTQA_trqRMtrRgnPwrLoss_MAP_x "" 0x70002b94 VTQA_trqRMotrNeg Lookup2D_X_FLOAT32_IEEE 0 VBU0706_CM_single_cnt 12 -3.4028234663852886E+38 3.4028234663852886E+38 /end AXIS_PTS
/begin AXIS_PTS VTQA_nRMtrRgnPwrLoss_MAP_y "" 0x70002312 NO_INPUT_QUANTITY Lookup2D_X_FLOAT32_IEEE 0 VBU0706_CM_single_cnt 9 -3.4028234663852886E+38 3.4028234663852886E+38 /end AXIS_PTS
/begin CHARACTERISTIC VTQA_pwrRMtrDrvPwrLoss_MAP_v "" MAP 0x70005584 Lookup2D_FLOAT32_IEEE 0 VBU0706_CM_single_cnt -3.4028234663852886E+38 3.4028234663852886E+38
 /begin AXIS_DESCR COM_AXIS NO_INPUT_QUANTITY VBU0706_CM_single_cnt 9 -3.4028234663852886E+38 3.4028234663852886E+38 AXIS_PTS_REF VTQA_nRMtrDrvPwrLoss_MAP_y /end AXIS_DESCR
 /begin AXIS_DESCR COM_AXIS VTQA_trqRMotrPos VBU0706_CM_single_cnt 12 -3.4028234663852886E+38 3.4028234663852886E+38 AXIS_PTS_REF VTQA_trqRMtrDrvPwrLoss_MAP_x /end AXIS_DESCR
/end CHARACTERISTIC
/begin AXIS_PTS VTQA_trqRMtrDrvPwrLoss_MAP_x "" 0x70002b64 VTQA_trqRMotrPos Lookup2D_X_FLOAT32_IEEE 0 VBU0706_CM_single_cnt 12 -3.4028234663852886E+38 3.4028234663852886E+38 /end AXIS_PTS
/begin AXIS_PTS VTQA_nRMtrDrvPwrLoss_MAP_y "" 0x700022ee NO_INPUT_QUANTITY Lookup2D_X_FLOAT32_IEEE 0 VBU0706_CM_single_cnt 9 -3.4028234663852886E+38 3.4028234663852886E+38 /end AXIS_PTS
/begin CHARACTERISTIC VTQA_trqAxleMax_CUR_v "" CURVE 0x700028d2 Lookup1D_FLOAT32_IEEE 0 VBU0706_CM_single_cnt -3.4028234663852886E+38 3.4028234663852886E+38
 /begin AXIS_DESCR COM_AXIS SPD_vVehSpd VBU0706_CM_single_cnt 11 -3.4028234663852886E+38 3.4028234663852886E+38 AXIS_PTS_REF VTQA_vAxleMax_CUR_x /end AXIS_DESCR
/end CHARACTERISTIC
/begin AXIS_PTS VTQA_vAxleMax_CUR_x "" 0x700028fe SPD_vVehSpd Lookup1D_X_FLOAT32_IEEE 0 VBU0706_CM_single_cnt 11 -3.4028234663852886E+38 3.4028234663852886E+38 /end AXIS_PTS
/begin CHARACTERISTIC VTQA_trqBrk_MAP_v "" MAP 0x70005e28 Lookup2D_FLOAT32_IEEE 0 VBU0706_CM_single_cnt -3.4028234663852886E+38 3.4028234663852886E+38
 /begin AXIS_DESCR COM_AXIS SPD_vVehSpd VBU0706_CM_single_cnt 11 -3.4028234663852886E+38 3.4028234663852886E+38 AXIS_PTS_REF VTQA_vBrk_MAP_y /end AXIS_DESCR
 /begin AXIS_DESCR COM_AXIS BPD_pctBrkPos VBU0706_CM_single_cnt 11 -3.4028234663852886E+38 3.4028234663852886E+38 AXIS_PTS_REF VTQA_pctBrk_MAP_x /end AXIS_DESCR
/end CHARACTERISTIC
/begin AXIS_PTS VTQA_pctBrk_MAP_x "" 0x700028a6 BPD_pctBrkPos Lookup2D_X_FLOAT32_IEEE 0 VBU0706_CM_single_cnt 11 -3.4028234663852886E+38 3.4028234663852886E+38 /end AXIS_PTS
/begin AXIS_PTS VTQA_vBrk_MAP_y "" 0x7000292a SPD_vVehSpd Lookup2D_X_FLOAT32_IEEE 0 VBU0706_CM_single_cnt 11 -3.4028234663852886E+38 3.4028234663852886E+38 /end AXIS_PTS
/begin CHARACTERISTIC CaSOF_VoltageCorrectFactorRegenMapY_n "" CURVE 0x700017fa Lookup1D_FLOAT32_IEEE 0 VBU0706_CM_single_cnt -3.4028234663852886E+38 3.4028234663852886E+38
 /begin AXIS_DESCR COM_AXIS NO_INPUT_QUANTITY VBU0706_CM_uint16_cnt 5 0.0 65535.0 AXIS_PTS_REF CaSOF_VoltageCorrectFactorRegenMapX_mV /end AXIS_DESCR
/end CHARACTERISTIC
/begin AXIS_PTS CaSOF_VoltageCorrectFactorRegenMapX_mV "" 0x700014ea NO_INPUT_QUANTITY Lookup1D_X_UWORD 0 VBU0706_CM_uint16_cnt 5 0.0 65535.0 /end AXIS_PTS
/begin CHARACTERISTIC CaSOF_VoltageCorrectFactorDischargeMapY_n "" CURVE 0x700017e6 Lookup1D_FLOAT32_IEEE 0 VBU0706_CM_single_cnt -3.4028234663852886E+38 3.4028234663852886E+38
 /begin AXIS_DESCR COM_AXIS NO_INPUT_QUANTITY VBU0706_CM_uint16_cnt 5 0.0 65535.0 AXIS_PTS_REF CaSOF_VoltageCorrectFactorDischargeMapX_mV /end AXIS_DESCR
/end CHARACTERISTIC
/begin AXIS_PTS CaSOF_VoltageCorrectFactorDischargeMapX_mV "" 0x700014e0 NO_INPUT_QUANTITY Lookup1D_X_UWORD 0 VBU0706_CM_uint16_cnt 5 0.0 65535.0 /end AXIS_PTS
/begin CHARACTERISTIC CaSOF_LowTempDischargeVoltageCorrectFactorMapY_n "" CURVE 0x7000146e Lookup1D_FLOAT32_IEEE 0 VBU0706_CM_single_cnt -3.4028234663852886E+38 3.4028234663852886E+38
 /begin AXIS_DESCR COM_AXIS CTM_tCellTempMin VBU0706_CM_single_cnt 2 -3.4028234663852886E+38 3.4028234663852886E+38 AXIS_PTS_REF CaSOF_LowTempDischargeVoltageCorrectFactorMapX_C /end AXIS_DESCR
/end CHARACTERISTIC
/begin AXIS_PTS CaSOF_LowTempDischargeVoltageCorrectFactorMapX_C "" 0x70001466 CTM_tCellTempMin Lookup1D_X_FLOAT32_IEEE 0 VBU0706_CM_single_cnt 2 -3.4028234663852886E+38 3.4028234663852886E+38 /end AXIS_PTS
/begin CHARACTERISTIC CaSOF_VoltageCorrectFactorChargeMapY_n "" CURVE 0x700017d2 Lookup1D_FLOAT32_IEEE 0 VBU0706_CM_single_cnt -3.4028234663852886E+38 3.4028234663852886E+38
 /begin AXIS_DESCR COM_AXIS NO_INPUT_QUANTITY VBU0706_CM_uint16_cnt 5 0.0 65535.0 AXIS_PTS_REF CaSOF_VoltageCorrectFactorChargeMapX_mV /end AXIS_DESCR
/end CHARACTERISTIC
/begin AXIS_PTS CaSOF_VoltageCorrectFactorChargeMapX_mV "" 0x700014d6 NO_INPUT_QUANTITY Lookup1D_X_UWORD 0 VBU0706_CM_uint16_cnt 5 0.0 65535.0 /end AXIS_PTS
/begin CHARACTERISTIC CaSOF_VoltageCorrectCellVoltMinMapY_V "" CURVE 0x70001686 Lookup1D_FLOAT32_IEEE 0 VBU0706_CM_single_cnt -3.4028234663852886E+38 3.4028234663852886E+38
 /begin AXIS_DESCR COM_AXIS CTM_tCellTempMin VBU0706_CM_single_cnt 4 -3.4028234663852886E+38 3.4028234663852886E+38 AXIS_PTS_REF CaSOF_VoltageCorrectCellVoltMinMapX_C /end AXIS_DESCR
/end CHARACTERISTIC
/begin AXIS_PTS CaSOF_VoltageCorrectCellVoltMinMapX_C "" 0x70001676 CTM_tCellTempMin Lookup1D_X_FLOAT32_IEEE 0 VBU0706_CM_single_cnt 4 -3.4028234663852886E+38 3.4028234663852886E+38 /end AXIS_PTS
/begin CHARACTERISTIC CaSOF_DischargeOcvSocTempMapZ_V "" MAP 0x70008a54 Lookup2D_FLOAT32_IEEE 0 VBU0706_CM_single_cnt -3.4028234663852886E+38 3.4028234663852886E+38
 /begin AXIS_DESCR COM_AXIS SOC_pctCellSocMin VBU0706_CM_single_cnt 21 -3.4028234663852886E+38 3.4028234663852886E+38 AXIS_PTS_REF CaSOF_DischargeOcvSocTempMapY_pct /end AXIS_DESCR
 /begin AXIS_DESCR COM_AXIS CTM_tCellTempMin VBU0706_CM_single_cnt 9 -3.4028234663852886E+38 3.4028234663852886E+38 AXIS_PTS_REF CaSOF_DischargeOcvSocTempMapX_C /end AXIS_DESCR
/end CHARACTERISTIC
/begin AXIS_PTS CaSOF_DischargeOcvSocTempMapX_C "" 0x70002186 CTM_tCellTempMin Lookup2D_X_FLOAT32_IEEE 0 VBU0706_CM_single_cnt 9 -3.4028234663852886E+38 3.4028234663852886E+38 /end AXIS_PTS
/begin AXIS_PTS CaSOF_DischargeOcvSocTempMapY_pct "" 0x70003da8 SOC_pctCellSocMin Lookup2D_X_FLOAT32_IEEE 0 VBU0706_CM_single_cnt 21 -3.4028234663852886E+38 3.4028234663852886E+38 /end AXIS_PTS
/begin CHARACTERISTIC CaSOF_DischargeDcirSocTempMapZ_mOhm "" MAP 0x70004ef4 Lookup2D_FLOAT32_IEEE 0 VBU0706_CM_single_cnt -3.4028234663852886E+38 3.4028234663852886E+38
 /begin AXIS_DESCR COM_AXIS SOC_pctCellSocMin VBU0706_CM_single_cnt 11 -3.4028234663852886E+38 3.4028234663852886E+38 AXIS_PTS_REF CaSOF_DischargeDcirSocTempMapY_pct /end AXIS_DESCR
 /begin AXIS_DESCR COM_AXIS CTM_tCellTempMin VBU0706_CM_single_cnt 6 -3.4028234663852886E+38 3.4028234663852886E+38 AXIS_PTS_REF CaSOF_DischargeDcirSocTempMapX_C /end AXIS_DESCR
/end CHARACTERISTIC
/begin AXIS_PTS CaSOF_DischargeDcirSocTempMapX_C "" 0x70001a46 CTM_tCellTempMin Lookup2D_X_FLOAT32_IEEE 0 VBU0706_CM_single_cnt 6 -3.4028234663852886E+38 3.4028234663852886E+38 /end AXIS_PTS
/begin AXIS_PTS CaSOF_DischargeDcirSocTempMapY_pct "" 0x70002696 SOC_pctCellSocMin Lookup2D_X_FLOAT32_IEEE 0 VBU0706_CM_single_cnt 11 -3.4028234663852886E+38 3.4028234663852886E+38 /end AXIS_PTS
/begin CHARACTERISTIC CaSOH_UdResisMapZ_mohm "" MAP 0x7000641c Lookup2D_FLOAT32_IEEE 0 VBU0706_CM_single_cnt -3.4028234663852886E+38 3.4028234663852886E+38
 /begin AXIS_DESCR COM_AXIS NO_INPUT_QUANTITY VBU0706_CM_uint16_cnt 20 0.0 65535.0 AXIS_PTS_REF CaSOH_UdResisMapY_mV /end AXIS_DESCR
 /begin AXIS_DESCR COM_AXIS NO_INPUT_QUANTITY VBU0706_CM_single_cnt 7 -3.4028234663852886E+38 3.4028234663852886E+38 AXIS_PTS_REF CaSOH_UdResisMapX_C /end AXIS_DESCR
/end CHARACTERISTIC
/begin AXIS_PTS CaSOH_UdResisMapX_C "" 0x70001dc6 NO_INPUT_QUANTITY Lookup2D_X_FLOAT32_IEEE 0 VBU0706_CM_single_cnt 7 -3.4028234663852886E+38 3.4028234663852886E+38 /end AXIS_PTS
/begin AXIS_PTS CaSOH_UdResisMapY_mV "" 0x70002336 NO_INPUT_QUANTITY Lookup2D_X_UWORD 0 VBU0706_CM_uint16_cnt 20 0.0 65535.0 /end AXIS_PTS
/begin CHARACTERISTIC CaSOH_OcvSocMapZ_pct "" MAP 0x70009fa8 Lookup2D_FLOAT32_IEEE 0 VBU0706_CM_single_cnt -3.4028234663852886E+38 3.4028234663852886E+38
 /begin AXIS_DESCR COM_AXIS NO_INPUT_QUANTITY VBU0706_CM_uint16_cnt 23 0.0 65535.0 AXIS_PTS_REF CaSOH_OcvSocMapY_mV /end AXIS_DESCR
 /begin AXIS_DESCR COM_AXIS NO_INPUT_QUANTITY VBU0706_CM_single_cnt 9 -3.4028234663852886E+38 3.4028234663852886E+38 AXIS_PTS_REF CaSOH_OcvSocMapX_C /end AXIS_DESCR
/end CHARACTERISTIC
/begin AXIS_PTS CaSOH_OcvSocMapX_C "" 0x700021f2 NO_INPUT_QUANTITY Lookup2D_X_FLOAT32_IEEE 0 VBU0706_CM_single_cnt 9 -3.4028234663852886E+38 3.4028234663852886E+38 /end AXIS_PTS
/begin AXIS_PTS CaSOH_OcvSocMapY_mV "" 0x70002956 NO_INPUT_QUANTITY Lookup2D_X_UWORD 0 VBU0706_CM_uint16_cnt 23 0.0 65535.0 /end AXIS_PTS
/begin CHARACTERISTIC DSPL_facEnergyFactorSOCUpdate_CUR_v "" CURVE 0x70001dfe Lookup1D_FLOAT32_IEEE 0 VBU0706_CM_single_fac 0.0 10.0
 /begin AXIS_DESCR COM_AXIS NO_INPUT_QUANTITY VBU0706_CM_single_fac 7 0.0 100.0 AXIS_PTS_REF DSPL_facEnergyFactorSOCUpdate_CUR_x /end AXIS_DESCR
/end CHARACTERISTIC
/begin AXIS_PTS DSPL_facEnergyFactorSOCUpdate_CUR_x "" 0x70001e1a NO_INPUT_QUANTITY Lookup1D_X_FLOAT32_IEEE 0 VBU0706_CM_single_fac 7 0.0 100.0 /end AXIS_PTS
/begin CHARACTERISTIC EDIS_pwrDecGradSprt_MAP_v "" MAP 0x7000a658 Lookup2D_FLOAT32_IEEE 0 VBU0706_CM_single_cnt -3.4028234663852886E+38 3.4028234663852886E+38
 /begin AXIS_DESCR COM_AXIS TQO_trqRMotr VBU0706_CM_single_cnt 13 -3.4028234663852886E+38 3.4028234663852886E+38 AXIS_PTS_REF EDIS_trqDecGradSprt_MAP_y /end AXIS_DESCR
 /begin AXIS_DESCR COM_AXIS SPD_vVehSpd VBU0706_CM_single_cnt 17 -3.4028234663852886E+38 3.4028234663852886E+38 AXIS_PTS_REF EDIS_vDecGradSprt_MAP_x /end AXIS_DESCR
/end CHARACTERISTIC
/begin AXIS_PTS EDIS_vDecGradSprt_MAP_x "" 0x7000374c SPD_vVehSpd Lookup2D_X_FLOAT32_IEEE 0 VBU0706_CM_single_cnt 17 -3.4028234663852886E+38 3.4028234663852886E+38 /end AXIS_PTS
/begin AXIS_PTS EDIS_trqDecGradSprt_MAP_y "" 0x70002fd4 TQO_trqRMotr Lookup2D_X_FLOAT32_IEEE 0 VBU0706_CM_single_cnt 13 -3.4028234663852886E+38 3.4028234663852886E+38 /end AXIS_PTS
/begin CHARACTERISTIC EDIS_facMaxBMSDisCh_CUR_v "" CURVE 0x70002426 Lookup1D_FLOAT32_IEEE 0 VBU0706_CM_single_cnt -3.4028234663852886E+38 3.4028234663852886E+38
 /begin AXIS_DESCR COM_AXIS NO_INPUT_QUANTITY VBU0706_CM_single_cnt 10 -3.4028234663852886E+38 3.4028234663852886E+38 AXIS_PTS_REF EDIS_tMaxBMSDisCh_CUR_x /end AXIS_DESCR
/end CHARACTERISTIC
/begin AXIS_PTS EDIS_tMaxBMSDisCh_CUR_x "" 0x700024c6 NO_INPUT_QUANTITY Lookup1D_X_FLOAT32_IEEE 0 VBU0706_CM_single_cnt 10 -3.4028234663852886E+38 3.4028234663852886E+38 /end AXIS_PTS
/begin CHARACTERISTIC EDIS_facMinBMSDisCh_CUR_v "" CURVE 0x70002476 Lookup1D_FLOAT32_IEEE 0 VBU0706_CM_single_cnt -3.4028234663852886E+38 3.4028234663852886E+38
 /begin AXIS_DESCR COM_AXIS NO_INPUT_QUANTITY VBU0706_CM_single_cnt 10 -3.4028234663852886E+38 3.4028234663852886E+38 AXIS_PTS_REF EDIS_tMinBMSDisCh_CUR_x /end AXIS_DESCR
/end CHARACTERISTIC
/begin AXIS_PTS EDIS_tMinBMSDisCh_CUR_x "" 0x70002516 NO_INPUT_QUANTITY Lookup1D_X_FLOAT32_IEEE 0 VBU0706_CM_single_cnt 10 -3.4028234663852886E+38 3.4028234663852886E+38 /end AXIS_PTS
/begin CHARACTERISTIC EDIS_facBMSSOCDisCh_CUR_v "" CURVE 0x70002746 Lookup1D_FLOAT32_IEEE 0 VBU0706_CM_single_cnt -3.4028234663852886E+38 3.4028234663852886E+38
 /begin AXIS_DESCR COM_AXIS NO_INPUT_QUANTITY VBU0706_CM_single_cnt 11 -3.4028234663852886E+38 3.4028234663852886E+38 AXIS_PTS_REF EDIS_pctBMSSOCDisCh_CUR_x /end AXIS_DESCR
/end CHARACTERISTIC
/begin AXIS_PTS EDIS_pctBMSSOCDisCh_CUR_x "" 0x70002822 NO_INPUT_QUANTITY Lookup1D_X_FLOAT32_IEEE 0 VBU0706_CM_single_cnt 11 -3.4028234663852886E+38 3.4028234663852886E+38 /end AXIS_PTS
/begin CHARACTERISTIC EDIS_facDisChPwrDeltaBaseDiff_CUR_v "" CURVE 0x70003ad8 Lookup1D_FLOAT32_IEEE 0 VBU0706_CM_single_cnt -3.4028234663852886E+38 3.4028234663852886E+38
 /begin AXIS_DESCR COM_AXIS NO_INPUT_QUANTITY VBU0706_CM_single_cnt 19 -3.4028234663852886E+38 3.4028234663852886E+38 AXIS_PTS_REF EDIS_pwrDisChPwrDeltaBaseDiff_CUR_x /end AXIS_DESCR
/end CHARACTERISTIC
/begin AXIS_PTS EDIS_pwrDisChPwrDeltaBaseDiff_CUR_x "" 0x70003b70 NO_INPUT_QUANTITY Lookup1D_X_FLOAT32_IEEE 0 VBU0706_CM_single_cnt 19 -3.4028234663852886E+38 3.4028234663852886E+38 /end AXIS_PTS
/begin CHARACTERISTIC EDIS_pwrSpBaseDchDyn_CUR_v "" CURVE 0x700016b6 Lookup1D_FLOAT32_IEEE 0 VBU0706_CM_single_cnt -3.4028234663852886E+38 3.4028234663852886E+38
 /begin AXIS_DESCR COM_AXIS EDIS_pwrDisChLimDynST VBU0706_CM_single_cnt 4 -3.4028234663852886E+38 3.4028234663852886E+38 AXIS_PTS_REF EDIS_pwrSpBaseDchDyn_CUR_x /end AXIS_DESCR
/end CHARACTERISTIC
/begin AXIS_PTS EDIS_pwrSpBaseDchDyn_CUR_x "" 0x700016c6 EDIS_pwrDisChLimDynST Lookup1D_X_FLOAT32_IEEE 0 VBU0706_CM_single_cnt 4 -3.4028234663852886E+38 3.4028234663852886E+38 /end AXIS_PTS
/begin CHARACTERISTIC TQDIS_pctShftChngLimThres_CUR_v "" CURVE 0x70001c6e Lookup1D_FLOAT32_IEEE 0 VBU0706_CM_single_cnt -3.4028234663852886E+38 3.4028234663852886E+38
 /begin AXIS_DESCR COM_AXIS SPD_vVehSpd VBU0706_CM_single_cnt 6 -3.4028234663852886E+38 3.4028234663852886E+38 AXIS_PTS_REF TQDIS_vShftChngLimThres_CUR_x /end AXIS_DESCR
/end CHARACTERISTIC
/begin AXIS_PTS TQDIS_vShftChngLimThres_CUR_x "" 0x70001c86 SPD_vVehSpd Lookup1D_X_FLOAT32_IEEE 0 VBU0706_CM_single_cnt 6 -3.4028234663852886E+38 3.4028234663852886E+38 /end AXIS_PTS
/begin CHARACTERISTIC TQDIS_facShftChngLim_CUR_v "" CURVE 0x70001c56 Lookup1D_FLOAT32_IEEE 0 VBU0706_CM_single_cnt -3.4028234663852886E+38 3.4028234663852886E+38
 /begin AXIS_DESCR COM_AXIS SPD_vVehSpd VBU0706_CM_single_cnt 6 -3.4028234663852886E+38 3.4028234663852886E+38 AXIS_PTS_REF TQDIS_vShftChngLim_CUR_x /end AXIS_DESCR
/end CHARACTERISTIC
/begin AXIS_PTS TQDIS_vShftChngLim_CUR_x "" 0x70001c9e SPD_vVehSpd Lookup1D_X_FLOAT32_IEEE 0 VBU0706_CM_single_cnt 6 -3.4028234663852886E+38 3.4028234663852886E+38 /end AXIS_PTS
/begin CHARACTERISTIC TQDIS_facShftDR_CUR_v "" CURVE 0x70002aa4 Lookup1D_FLOAT32_IEEE 0 VBU0706_CM_single_pct 0.0 20.0
 /begin AXIS_DESCR COM_AXIS NO_INPUT_QUANTITY VBU0706_CM_single_Nm 12 0.0 1000.0 AXIS_PTS_REF TQDIS_trqShftDR_CUR_x /end AXIS_DESCR
/end CHARACTERISTIC
/begin AXIS_PTS TQDIS_trqShftDR_CUR_x "" 0x70002b34 NO_INPUT_QUANTITY Lookup1D_X_FLOAT32_IEEE 0 VBU0706_CM_single_Nm 12 0.0 1000.0 /end AXIS_PTS
/begin CHARACTERISTIC TQDIS_facAccPedFilter_CUR_v "" CURVE 0x70001912 Lookup1D_FLOAT32_IEEE 0 VBU0706_CM_single_cnt -3.4028234663852886E+38 3.4028234663852886E+38
 /begin AXIS_DESCR COM_AXIS APD_pctAccPedPos VBU0706_CM_single_cnt 5 -3.4028234663852886E+38 3.4028234663852886E+38 AXIS_PTS_REF TQDIS_pctAccPedFilter_CUR_x /end AXIS_DESCR
/end CHARACTERISTIC
/begin AXIS_PTS TQDIS_pctAccPedFilter_CUR_x "" 0x70001926 APD_pctAccPedPos Lookup1D_X_FLOAT32_IEEE 0 VBU0706_CM_single_cnt 5 -3.4028234663852886E+38 3.4028234663852886E+38 /end AXIS_PTS
/begin CHARACTERISTIC TQDIS_facDrvLo_CUR_y "" CURVE 0x700016d6 Lookup1D_FLOAT32_IEEE 0 VBU0706_CM_single_pct 0.0 1.0
 /begin AXIS_DESCR COM_AXIS NO_INPUT_QUANTITY VBU0706_CM_single_kw 4 0.0 150.0 AXIS_PTS_REF TQDIS_pwrDrvLo_CUR_x /end AXIS_DESCR
/end CHARACTERISTIC
/begin AXIS_PTS TQDIS_pwrDrvLo_CUR_x "" 0x70001706 NO_INPUT_QUANTITY Lookup1D_X_FLOAT32_IEEE 0 VBU0706_CM_single_kw 4 0.0 150.0 /end AXIS_PTS
/begin CHARACTERISTIC TQDIS_facRgnLo_CUR_y "" CURVE 0x700016e6 Lookup1D_FLOAT32_IEEE 0 VBU0706_CM_single_pct 0.0 1.0
 /begin AXIS_DESCR COM_AXIS NO_INPUT_QUANTITY VBU0706_CM_single_kw 4 0.0 150.0 AXIS_PTS_REF TQDIS_pwrRgnLo_CUR_x /end AXIS_DESCR
/end CHARACTERISTIC
/begin AXIS_PTS TQDIS_pwrRgnLo_CUR_x "" 0x70001716 NO_INPUT_QUANTITY Lookup1D_X_FLOAT32_IEEE 0 VBU0706_CM_single_kw 4 0.0 150.0 /end AXIS_PTS
/begin CHARACTERISTIC TQDIS_facBrkSlpCrp_MAP_v "" MAP 0x70002a74 Lookup2D_FLOAT32_IEEE 0 VBU0706_CM_single_cnt -3.4028234663852886E+38 3.4028234663852886E+38
 /begin AXIS_DESCR COM_AXIS SPD_pctSlope VBU0706_CM_single_cnt 3 -3.4028234663852886E+38 3.4028234663852886E+38 AXIS_PTS_REF TQDIS_facSlpCrp_MAP_y /end AXIS_DESCR
 /begin AXIS_DESCR COM_AXIS BPD_pctBrkPos VBU0706_CM_single_cnt 4 -3.4028234663852886E+38 3.4028234663852886E+38 AXIS_PTS_REF TQDIS_pctBrkCrp_MAP_x /end AXIS_DESCR
/end CHARACTERISTIC
/begin AXIS_PTS TQDIS_pctBrkCrp_MAP_x "" 0x700016f6 BPD_pctBrkPos Lookup2D_X_FLOAT32_IEEE 0 VBU0706_CM_single_cnt 4 -3.4028234663852886E+38 3.4028234663852886E+38 /end AXIS_PTS
/begin AXIS_PTS TQDIS_facSlpCrp_MAP_y "" 0x70001578 SPD_pctSlope Lookup2D_X_FLOAT32_IEEE 0 VBU0706_CM_single_cnt 3 -3.4028234663852886E+38 3.4028234663852886E+38 /end AXIS_PTS
/begin CHARACTERISTIC TQDIS_facBrkDec_MAP_v "" MAP 0x70006ac4 Lookup2D_FLOAT32_IEEE 0 VBU0706_CM_single_cnt -3.4028234663852886E+38 3.4028234663852886E+38
 /begin AXIS_DESCR COM_AXIS SPD_vVehSpd VBU0706_CM_single_cnt 13 -3.4028234663852886E+38 3.4028234663852886E+38 AXIS_PTS_REF TQDIS_vBrkDec_MAP_y /end AXIS_DESCR
 /begin AXIS_DESCR COM_AXIS BPD_pctBrkPos VBU0706_CM_single_cnt 11 -3.4028234663852886E+38 3.4028234663852886E+38 AXIS_PTS_REF TQDIS_pctBrkDec_MAP_x /end AXIS_DESCR
/end CHARACTERISTIC
/begin AXIS_PTS TQDIS_pctBrkDec_MAP_x "" 0x7000284e BPD_pctBrkPos Lookup2D_X_FLOAT32_IEEE 0 VBU0706_CM_single_cnt 11 -3.4028234663852886E+38 3.4028234663852886E+38 /end AXIS_PTS
/begin AXIS_PTS TQDIS_vBrkDec_MAP_y "" 0x70003008 SPD_vVehSpd Lookup2D_X_FLOAT32_IEEE 0 VBU0706_CM_single_cnt 13 -3.4028234663852886E+38 3.4028234663852886E+38 /end AXIS_PTS
/begin CHARACTERISTIC TQDIS_trqCrpBase_MAP_v "" MAP 0x70002ad4 Lookup2D_FLOAT32_IEEE 0 VBU0706_CM_single_cnt -3.4028234663852886E+38 3.4028234663852886E+38
 /begin AXIS_DESCR COM_AXIS NO_INPUT_QUANTITY VBU0706_CM_single_cnt 3 -3.4028234663852886E+38 3.4028234663852886E+38 AXIS_PTS_REF TQDIS_stCrpBase_MAP_y /end AXIS_DESCR
 /begin AXIS_DESCR COM_AXIS SPD_vVehSpd VBU0706_CM_single_cnt 4 -3.4028234663852886E+38 3.4028234663852886E+38 AXIS_PTS_REF TQDIS_vCrpBase_MAP_x /end AXIS_DESCR
/end CHARACTERISTIC
/begin AXIS_PTS TQDIS_vCrpBase_MAP_x "" 0x70001736 SPD_vVehSpd Lookup2D_X_FLOAT32_IEEE 0 VBU0706_CM_single_cnt 4 -3.4028234663852886E+38 3.4028234663852886E+38 /end AXIS_PTS
/begin AXIS_PTS TQDIS_stCrpBase_MAP_y "" 0x70001584 NO_INPUT_QUANTITY Lookup2D_X_FLOAT32_IEEE 0 VBU0706_CM_single_cnt 3 -3.4028234663852886E+38 3.4028234663852886E+38 /end AXIS_PTS
/begin CHARACTERISTIC TQDIS_trqDecGradECORA_MAP_v "" MAP 0x7000511c Lookup2D_FLOAT32_IEEE 0 VBU0706_CM_single_Nm -500.0 500.0
 /begin AXIS_DESCR COM_AXIS NO_INPUT_QUANTITY VBU0706_CM_single_Nm 12 -3000.0 5000.0 AXIS_PTS_REF TQDIS_trqDecGrad_MAP_y /end AXIS_DESCR
 /begin AXIS_DESCR COM_AXIS SPD_vVehSpd VBU0706_CM_single_kph 7 0.0 140.0 AXIS_PTS_REF TQDIS_vDecGrad_MAP_x /end AXIS_DESCR
/end CHARACTERISTIC
/begin AXIS_PTS TQDIS_vDecGrad_MAP_x "" 0x70001ede SPD_vVehSpd Lookup2D_X_FLOAT32_IEEE 0 VBU0706_CM_single_kph 7 0.0 140.0 /end AXIS_PTS
/begin AXIS_PTS TQDIS_trqDecGrad_MAP_y "" 0x70002b04 NO_INPUT_QUANTITY Lookup2D_X_FLOAT32_IEEE 0 VBU0706_CM_single_Nm 12 -3000.0 5000.0 /end AXIS_PTS
/begin CHARACTERISTIC TQDIS_facAccPdlECORA_MAP_v "" MAP 0x7000a9cc Lookup2D_FLOAT32_IEEE 0 VBU0706_CM_single_cnt -3.4028234663852886E+38 3.4028234663852886E+38
 /begin AXIS_DESCR COM_AXIS SPD_vVehSpd VBU0706_CM_single_cnt 15 -3.4028234663852886E+38 3.4028234663852886E+38 AXIS_PTS_REF TQDIS_vVehAccPdl_MAP_y /end AXIS_DESCR
 /begin AXIS_DESCR COM_AXIS APD_pctAccPedPos VBU0706_CM_single_cnt 15 -3.4028234663852886E+38 3.4028234663852886E+38 AXIS_PTS_REF TQDIS_pctAccPdl_MAP_x /end AXIS_DESCR
/end CHARACTERISTIC
/begin AXIS_PTS TQDIS_pctAccPdl_MAP_x "" 0x700035cc APD_pctAccPedPos Lookup2D_X_FLOAT32_IEEE 0 VBU0706_CM_single_cnt 15 -3.4028234663852886E+38 3.4028234663852886E+38 /end AXIS_PTS
/begin AXIS_PTS TQDIS_vVehAccPdl_MAP_y "" 0x70003608 SPD_vVehSpd Lookup2D_X_FLOAT32_IEEE 0 VBU0706_CM_single_cnt 15 -3.4028234663852886E+38 3.4028234663852886E+38 /end AXIS_PTS
/begin CHARACTERISTIC TQDIS_facAPDTrqECORA_MAP_v "" MAP 0x7000e924 Lookup2D_FLOAT32_IEEE 0 VBU0706_CM_single_cnt -3.4028234663852886E+38 3.4028234663852886E+38
 /begin AXIS_DESCR COM_AXIS APD_pctAccPedPos VBU0706_CM_single_cnt 15 -3.4028234663852886E+38 3.4028234663852886E+38 AXIS_PTS_REF TQDIS_pctAPDTrq_MAP_y /end AXIS_DESCR
 /begin AXIS_DESCR COM_AXIS NO_INPUT_QUANTITY VBU0706_CM_single_cnt 31 -3.4028234663852886E+38 3.4028234663852886E+38 AXIS_PTS_REF TQDIS_trqAPDTrq_MAP_x /end AXIS_DESCR
/end CHARACTERISTIC
/begin AXIS_PTS TQDIS_trqAPDTrq_MAP_x "" 0x70004810 NO_INPUT_QUANTITY Lookup2D_X_FLOAT32_IEEE 0 VBU0706_CM_single_cnt 31 -3.4028234663852886E+38 3.4028234663852886E+38 /end AXIS_PTS
/begin AXIS_PTS TQDIS_pctAPDTrq_MAP_y "" 0x70003590 APD_pctAccPedPos Lookup2D_X_FLOAT32_IEEE 0 VBU0706_CM_single_cnt 15 -3.4028234663852886E+38 3.4028234663852886E+38 /end AXIS_PTS
/begin CHARACTERISTIC TQDIS_trqIncGradECORA_MAP_v "" MAP 0x7000c044 Lookup2D_FLOAT32_IEEE 0 VBU0706_CM_single_cnt -3.4028234663852886E+38 3.4028234663852886E+38
 /begin AXIS_DESCR COM_AXIS NO_INPUT_QUANTITY VBU0706_CM_single_cnt 41 -3.4028234663852886E+38 3.4028234663852886E+38 AXIS_PTS_REF TQDIS_trqIncGrad_MAP_y /end AXIS_DESCR
 /begin AXIS_DESCR COM_AXIS SPD_vVehSpd VBU0706_CM_single_cnt 9 -3.4028234663852886E+38 3.4028234663852886E+38 AXIS_PTS_REF TQDIS_vIncGrad_MAP_x /end AXIS_DESCR
/end CHARACTERISTIC
/begin AXIS_PTS TQDIS_vIncGrad_MAP_x "" 0x7000225e SPD_vVehSpd Lookup2D_X_FLOAT32_IEEE 0 VBU0706_CM_single_cnt 9 -3.4028234663852886E+38 3.4028234663852886E+38 /end AXIS_PTS
/begin AXIS_PTS TQDIS_trqIncGrad_MAP_y "" 0x70004918 NO_INPUT_QUANTITY Lookup2D_X_FLOAT32_IEEE 0 VBU0706_CM_single_cnt 41 -3.4028234663852886E+38 3.4028234663852886E+38 /end AXIS_PTS
/begin CHARACTERISTIC TQDMP_facDeltaRPMFAC1_CUR_v "" CURVE 0x70001962 Lookup1D_FLOAT32_IEEE 0 VBU0706_CM_single_cnt -3.4028234663852886E+38 3.4028234663852886E+38
 /begin AXIS_DESCR COM_AXIS NO_INPUT_QUANTITY VBU0706_CM_single_cnt 5 -3.4028234663852886E+38 3.4028234663852886E+38 AXIS_PTS_REF TQDMP_facDeltaRPMFAC1_CUR_x /end AXIS_DESCR
/end CHARACTERISTIC
/begin AXIS_PTS TQDMP_facDeltaRPMFAC1_CUR_x "" 0x70001976 NO_INPUT_QUANTITY Lookup1D_X_FLOAT32_IEEE 0 VBU0706_CM_single_cnt 5 -3.4028234663852886E+38 3.4028234663852886E+38 /end AXIS_PTS
/begin CHARACTERISTIC CaSOF_ChargeCurrentLimitBufferTimeSocTempMapZ_s "" MAP 0x70007944 Lookup2D_FLOAT32_IEEE 0 VBU0706_CM_single_cnt -3.4028234663852886E+38 3.4028234663852886E+38
 /begin AXIS_DESCR COM_AXIS SOC_pctCellSocMax VBU0706_CM_single_cnt 13 -3.4028234663852886E+38 3.4028234663852886E+38 AXIS_PTS_REF CaSOF_ChargeCurrentLimitBufferTimeSocTempMapY_pct /end AXIS_DESCR
 /begin AXIS_DESCR COM_AXIS NO_INPUT_QUANTITY VBU0706_CM_single_cnt 14 -3.4028234663852886E+38 3.4028234663852886E+38 AXIS_PTS_REF CaSOF_ChargeCurrentLimitBufferTimeSocTempMapX_C /end AXIS_DESCR
/end CHARACTERISTIC
/begin AXIS_PTS CaSOF_ChargeCurrentLimitBufferTimeSocTempMapX_C "" 0x700030a4 NO_INPUT_QUANTITY Lookup2D_X_FLOAT32_IEEE 0 VBU0706_CM_single_cnt 14 -3.4028234663852886E+38 3.4028234663852886E+38 /end AXIS_PTS
/begin AXIS_PTS CaSOF_ChargeCurrentLimitBufferTimeSocTempMapY_pct "" 0x70002c60 SOC_pctCellSocMax Lookup2D_X_FLOAT32_IEEE 0 VBU0706_CM_single_cnt 13 -3.4028234663852886E+38 3.4028234663852886E+38 /end AXIS_PTS
/begin CHARACTERISTIC CaSOF_DischargeCurrentLimitBufferTimeSocTempMapZ_s "" MAP 0x700081cc Lookup2D_FLOAT32_IEEE 0 VBU0706_CM_single_cnt -3.4028234663852886E+38 3.4028234663852886E+38
 /begin AXIS_DESCR COM_AXIS SOC_pctCellSocMin VBU0706_CM_single_cnt 13 -3.4028234663852886E+38 3.4028234663852886E+38 AXIS_PTS_REF CaSOF_DischargeCurrentLimitBufferTimeSocTempMapY_pct /end AXIS_DESCR
 /begin AXIS_DESCR COM_AXIS NO_INPUT_QUANTITY VBU0706_CM_single_cnt 14 -3.4028234663852886E+38 3.4028234663852886E+38 AXIS_PTS_REF CaSOF_DischargeCurrentLimitBufferTimeSocTempMapX_C /end AXIS_DESCR
/end CHARACTERISTIC
/begin AXIS_PTS CaSOF_DischargeCurrentLimitBufferTimeSocTempMapX_C "" 0x7000314c NO_INPUT_QUANTITY Lookup2D_X_FLOAT32_IEEE 0 VBU0706_CM_single_cnt 14 -3.4028234663852886E+38 3.4028234663852886E+38 /end AXIS_PTS
/begin AXIS_PTS CaSOF_DischargeCurrentLimitBufferTimeSocTempMapY_pct "" 0x70002d64 SOC_pctCellSocMin Lookup2D_X_FLOAT32_IEEE 0 VBU0706_CM_single_cnt 13 -3.4028234663852886E+38 3.4028234663852886E+38 /end AXIS_PTS
/begin CHARACTERISTIC CaSOF_BuffUseFactorCurrtLTCurrtMapZ_n "" MAP 0x7000740c Lookup2D_FLOAT32_IEEE 0 VBU0706_CM_single_cnt -3.4028234663852886E+38 3.4028234663852886E+38
 /begin AXIS_DESCR COM_AXIS NO_INPUT_QUANTITY VBU0706_CM_single_cnt 11 -3.4028234663852886E+38 3.4028234663852886E+38 AXIS_PTS_REF CaSOF_BuffUseFactorCurrtLTCurrtMapY_A /end AXIS_DESCR
 /begin AXIS_DESCR COM_AXIS NO_INPUT_QUANTITY VBU0706_CM_single_cnt 15 -3.4028234663852886E+38 3.4028234663852886E+38 AXIS_PTS_REF CaSOF_BuffUseFactorCurrtLTCurrtMapX_A /end AXIS_DESCR
/end CHARACTERISTIC
/begin AXIS_PTS CaSOF_BuffUseFactorCurrtLTCurrtMapX_A "" 0x700033ec NO_INPUT_QUANTITY Lookup2D_X_FLOAT32_IEEE 0 VBU0706_CM_single_cnt 15 -3.4028234663852886E+38 3.4028234663852886E+38 /end AXIS_PTS
/begin AXIS_PTS CaSOF_BuffUseFactorCurrtLTCurrtMapY_A "" 0x7000266a NO_INPUT_QUANTITY Lookup2D_X_FLOAT32_IEEE 0 VBU0706_CM_single_cnt 11 -3.4028234663852886E+38 3.4028234663852886E+38 /end AXIS_PTS
/begin CHARACTERISTIC CaSOF_BuffUseFactorSocTempMapZ_n "" MAP 0x70005c54 Lookup2D_FLOAT32_IEEE 0 VBU0706_CM_single_cnt -3.4028234663852886E+38 3.4028234663852886E+38
 /begin AXIS_DESCR COM_AXIS SOC_pctCellSocMin VBU0706_CM_single_cnt 13 -3.4028234663852886E+38 3.4028234663852886E+38 AXIS_PTS_REF CaSOF_BuffUseFactorSocTempMapY_pct /end AXIS_DESCR
 /begin AXIS_DESCR COM_AXIS NO_INPUT_QUANTITY VBU0706_CM_single_cnt 9 -3.4028234663852886E+38 3.4028234663852886E+38 AXIS_PTS_REF CaSOF_BuffUseFactorSocTempMapX_C /end AXIS_DESCR
/end CHARACTERISTIC
/begin AXIS_PTS CaSOF_BuffUseFactorSocTempMapX_C "" 0x70002162 NO_INPUT_QUANTITY Lookup2D_X_FLOAT32_IEEE 0 VBU0706_CM_single_cnt 9 -3.4028234663852886E+38 3.4028234663852886E+38 /end AXIS_PTS
/begin AXIS_PTS CaSOF_BuffUseFactorSocTempMapY_pct "" 0x70002c2c SOC_pctCellSocMin Lookup2D_X_FLOAT32_IEEE 0 VBU0706_CM_single_cnt 13 -3.4028234663852886E+38 3.4028234663852886E+38 /end AXIS_PTS
/begin CHARACTERISTIC APD_facRecoveryFillter_C "" VALUE 0x70000128 Scalar_FLOAT32_IEEE 0 VBU0706_CM_single_cnt -3.4028234663852886E+38 3.4028234663852886E+38 /end CHARACTERISTIC
/begin CHARACTERISTIC APD_pctIdlePedal_C "" VALUE 0x70000144 Scalar_FLOAT32_IEEE 0 VBU0706_CM_single_cnt -3.4028234663852886E+38 3.4028234663852886E+38 /end CHARACTERISTIC
/begin CHARACTERISTIC CcCTD_MaxAccumulatedHeadLoad_J "" VALUE 0x700003e0 Scalar_FLOAT32_IEEE 0 VBU0706_CM_single_cnt -3.4028234663852886E+38 3.4028234663852886E+38 /end CHARACTERISTIC
/begin CHARACTERISTIC CcSOC_FastChargePreCorrectionDeltaVolSOC_pct "" VALUE 0x7000061c Scalar_FLOAT32_IEEE 0 VBU0706_CM_single_cnt -3.4028234663852886E+38 3.4028234663852886E+38 /end CHARACTERISTIC
/begin CHARACTERISTIC CcSOF_BatteryCurrentLow_A "" VALUE 0x70000698 Scalar_FLOAT32_IEEE 0 VBU0706_CM_single_cnt -3.4028234663852886E+38 3.4028234663852886E+38 /end CHARACTERISTIC
/begin CHARACTERISTIC CcSOF_BolSoh_pct "" VALUE 0x700006a8 Scalar_FLOAT32_IEEE 0 VBU0706_CM_single_cnt -3.4028234663852886E+38 3.4028234663852886E+38 /end CHARACTERISTIC
/begin CHARACTERISTIC CcSOF_CellDischargeDcirMax_mOhm "" VALUE 0x700006b0 Scalar_FLOAT32_IEEE 0 VBU0706_CM_single_cnt -3.4028234663852886E+38 3.4028234663852886E+38 /end CHARACTERISTIC
/begin CHARACTERISTIC CcSOF_CellDischargeDcirMin_mOhm "" VALUE 0x700006b4 Scalar_FLOAT32_IEEE 0 VBU0706_CM_single_cnt -3.4028234663852886E+38 3.4028234663852886E+38 /end CHARACTERISTIC
/begin CHARACTERISTIC CcSOF_ChargeCurrentLimitViolateBuffer_A "" VALUE 0x700006b8 Scalar_FLOAT32_IEEE 0 VBU0706_CM_single_cnt -3.4028234663852886E+38 3.4028234663852886E+38 /end CHARACTERISTIC
/begin CHARACTERISTIC CcSOF_ChargeVoltageCorrectSlope_n "" VALUE 0x700006c8 Scalar_FLOAT32_IEEE 0 VBU0706_CM_single_cnt -3.4028234663852886E+38 3.4028234663852886E+38 /end CHARACTERISTIC
/begin CHARACTERISTIC CcSOF_DcirDeltaCurrentMin_A "" VALUE 0x70000710 Scalar_FLOAT32_IEEE 0 VBU0706_CM_single_cnt -3.4028234663852886E+38 3.4028234663852886E+38 /end CHARACTERISTIC
/begin CHARACTERISTIC CcSOF_DischaOverCurFactorSlopeDec_n "" VALUE 0x70000714 Scalar_FLOAT32_IEEE 0 VBU0706_CM_single_cnt -3.4028234663852886E+38 3.4028234663852886E+38 /end CHARACTERISTIC
/begin CHARACTERISTIC CcSOF_DischaOverCurFactorSlopeInc_n "" VALUE 0x70000718 Scalar_FLOAT32_IEEE 0 VBU0706_CM_single_cnt -3.4028234663852886E+38 3.4028234663852886E+38 /end CHARACTERISTIC
/begin CHARACTERISTIC CcSOF_DischargeOverCurrentLimitFactor_n "" VALUE 0x70000728 Scalar_FLOAT32_IEEE 0 VBU0706_CM_single_cnt -3.4028234663852886E+38 3.4028234663852886E+38 /end CHARACTERISTIC
/begin CHARACTERISTIC CcSOF_DischargeOverCurrentThresholdDec_As "" VALUE 0x7000072c Scalar_FLOAT32_IEEE 0 VBU0706_CM_single_cnt -3.4028234663852886E+38 3.4028234663852886E+38 /end CHARACTERISTIC
/begin CHARACTERISTIC CcSOF_DischargeOverCurrentThresholdInc_As "" VALUE 0x70000730 Scalar_FLOAT32_IEEE 0 VBU0706_CM_single_cnt -3.4028234663852886E+38 3.4028234663852886E+38 /end CHARACTERISTIC
/begin CHARACTERISTIC CcSOF_DischargeVolCorCurrentSlopeDec_A "" VALUE 0x70000738 Scalar_FLOAT32_IEEE 0 VBU0706_CM_single_cnt -3.4028234663852886E+38 3.4028234663852886E+38 /end CHARACTERISTIC
/begin CHARACTERISTIC CcSOF_DischargeVolCorCurrentSlopeInc_A "" VALUE 0x7000073c Scalar_FLOAT32_IEEE 0 VBU0706_CM_single_cnt -3.4028234663852886E+38 3.4028234663852886E+38 /end CHARACTERISTIC
/begin CHARACTERISTIC CcSOF_DischargeVoltageCorrectSlopeDec_n "" VALUE 0x70000740 Scalar_FLOAT32_IEEE 0 VBU0706_CM_single_cnt -3.4028234663852886E+38 3.4028234663852886E+38 /end CHARACTERISTIC
/begin CHARACTERISTIC CcSOF_DischargeVoltageCorrectSlopeInc_n "" VALUE 0x70000744 Scalar_FLOAT32_IEEE 0 VBU0706_CM_single_cnt -3.4028234663852886E+38 3.4028234663852886E+38 /end CHARACTERISTIC
/begin CHARACTERISTIC CcSOF_DischargeVoltageCorrectSlope_n "" VALUE 0x70000748 Scalar_FLOAT32_IEEE 0 VBU0706_CM_single_cnt -3.4028234663852886E+38 3.4028234663852886E+38 /end CHARACTERISTIC
/begin CHARACTERISTIC CcSOF_EolSoh_pct "" VALUE 0x70000754 Scalar_FLOAT32_IEEE 0 VBU0706_CM_single_cnt -3.4028234663852886E+38 3.4028234663852886E+38 /end CHARACTERISTIC
/begin CHARACTERISTIC CcSOF_FastChargeCurrentStep1_A "" VALUE 0x7000075c Scalar_FLOAT32_IEEE 0 VBU0706_CM_single_cnt -3.4028234663852886E+38 3.4028234663852886E+38 /end CHARACTERISTIC
/begin CHARACTERISTIC CcSOF_FastChargeCurrentStep2_A "" VALUE 0x70000760 Scalar_FLOAT32_IEEE 0 VBU0706_CM_single_cnt -3.4028234663852886E+38 3.4028234663852886E+38 /end CHARACTERISTIC
/begin CHARACTERISTIC CcSOF_FastChargeDisableTempLowerLimit_C "" VALUE 0x70000764 Scalar_FLOAT32_IEEE 0 VBU0706_CM_single_cnt -3.4028234663852886E+38 3.4028234663852886E+38 /end CHARACTERISTIC
/begin CHARACTERISTIC CcSOF_FastChargeDisableTempUpperLimit_C "" VALUE 0x70000768 Scalar_FLOAT32_IEEE 0 VBU0706_CM_single_cnt -3.4028234663852886E+38 3.4028234663852886E+38 /end CHARACTERISTIC
/begin CHARACTERISTIC CcSOF_FastChargeEnableSocLowerLimit_pct "" VALUE 0x7000076c Scalar_FLOAT32_IEEE 0 VBU0706_CM_single_cnt -3.4028234663852886E+38 3.4028234663852886E+38 /end CHARACTERISTIC
/begin CHARACTERISTIC CcSOF_FastChargeEnableSocUpperLimit_pct "" VALUE 0x70000770 Scalar_FLOAT32_IEEE 0 VBU0706_CM_single_cnt -3.4028234663852886E+38 3.4028234663852886E+38 /end CHARACTERISTIC
/begin CHARACTERISTIC CcSOF_FastChargeEnableTempLowerLimit_C "" VALUE 0x70000774 Scalar_FLOAT32_IEEE 0 VBU0706_CM_single_cnt -3.4028234663852886E+38 3.4028234663852886E+38 /end CHARACTERISTIC
/begin CHARACTERISTIC CcSOF_FastChargeRecoverTempUpperLimit_C "" VALUE 0x70000778 Scalar_FLOAT32_IEEE 0 VBU0706_CM_single_cnt -3.4028234663852886E+38 3.4028234663852886E+38 /end CHARACTERISTIC
/begin CHARACTERISTIC CcSOF_FastChargeSocStep1_pct "" VALUE 0x70000780 Scalar_FLOAT32_IEEE 0 VBU0706_CM_single_cnt -3.4028234663852886E+38 3.4028234663852886E+38 /end CHARACTERISTIC
/begin CHARACTERISTIC CcSOF_OriginalDcirDispersion_pct "" VALUE 0x700007c8 Scalar_FLOAT32_IEEE 0 VBU0706_CM_single_cnt -3.4028234663852886E+38 3.4028234663852886E+38 /end CHARACTERISTIC
/begin CHARACTERISTIC CcSOF_UseCalculatedDcirTemp_C "" VALUE 0x700007f4 Scalar_FLOAT32_IEEE 0 VBU0706_CM_single_cnt -3.4028234663852886E+38 3.4028234663852886E+38 /end CHARACTERISTIC
/begin CHARACTERISTIC CcSOF_VoltageCorrectFactor0_n "" VALUE 0x70000818 Scalar_FLOAT32_IEEE 0 VBU0706_CM_single_cnt -3.4028234663852886E+38 3.4028234663852886E+38 /end CHARACTERISTIC
/begin CHARACTERISTIC CcSOF_VoltageCorrectFactor1_n "" VALUE 0x7000081c Scalar_FLOAT32_IEEE 0 VBU0706_CM_single_cnt -3.4028234663852886E+38 3.4028234663852886E+38 /end CHARACTERISTIC
/begin CHARACTERISTIC CcSOF_VoltageCorrectFactor2_n "" VALUE 0x70000820 Scalar_FLOAT32_IEEE 0 VBU0706_CM_single_cnt -3.4028234663852886E+38 3.4028234663852886E+38 /end CHARACTERISTIC
/begin CHARACTERISTIC CcSOF_VoltageCorrectFactor3_n "" VALUE 0x70000824 Scalar_FLOAT32_IEEE 0 VBU0706_CM_single_cnt -3.4028234663852886E+38 3.4028234663852886E+38 /end CHARACTERISTIC
/begin CHARACTERISTIC CcSOF_VoltageCorrectFactor4_n "" VALUE 0x70000828 Scalar_FLOAT32_IEEE 0 VBU0706_CM_single_cnt -3.4028234663852886E+38 3.4028234663852886E+38 /end CHARACTERISTIC
/begin CHARACTERISTIC CcSOH_ChargeResisLowerLimit_mohm "" VALUE 0x70000848 Scalar_FLOAT32_IEEE 0 VBU0706_CM_single_cnt -3.4028234663852886E+38 3.4028234663852886E+38 /end CHARACTERISTIC
/begin CHARACTERISTIC DIAGS_stPsvResp_SY "" VALUE 0x70000b54 Scalar_FLOAT32_IEEE 0 VBU0706_CM_single_cnt -3.4028234663852886E+38 3.4028234663852886E+38 /end CHARACTERISTIC
/begin CHARACTERISTIC DSPL_facEnergyFactorInit_C "" VALUE 0x70000b74 Scalar_FLOAT32_IEEE 0 VBU0706_CM_single_fac 0.0 1.0 /end CHARACTERISTIC
/begin CHARACTERISTIC DSPL_facEnergyFactorSelfLearnInit_C "" VALUE 0x70000b78 Scalar_FLOAT32_IEEE 0 VBU0706_CM_single_fac 0.0 1.0 /end CHARACTERISTIC
/begin CHARACTERISTIC DSPL_facEnergyFactorUpdateStep_C "" VALUE 0x70000b7c Scalar_FLOAT32_IEEE 0 VBU0706_CM_single_fac 0.0 1.0 /end CHARACTERISTIC
/begin CHARACTERISTIC DSPL_pctBMSSOCUpdateStep_C "" VALUE 0x70000bb8 Scalar_FLOAT32_IEEE 0 VBU0706_CM_single_pct 0.0 100.0 /end CHARACTERISTIC
/begin CHARACTERISTIC DSPL_pctEnergySOCLearnMax_C "" VALUE 0x70000bbc Scalar_FLOAT32_IEEE 0 VBU0706_CM_single_pct 0.0 500.0 /end CHARACTERISTIC
/begin CHARACTERISTIC EDIS_facDecGradSprt_C "" VALUE 0x70000c28 Scalar_FLOAT32_IEEE 0 VBU0706_CM_single_cnt -3.4028234663852886E+38 3.4028234663852886E+38 /end CHARACTERISTIC
/begin CHARACTERISTIC EDIS_numCurrentOverDisChDyn_C "" VALUE 0x70000c40 Scalar_FLOAT32_IEEE 0 VBU0706_CM_single_cnt -3.4028234663852886E+38 3.4028234663852886E+38 /end CHARACTERISTIC
/begin CHARACTERISTIC EDIS_numDisChDyn_C "" VALUE 0x70000c44 Scalar_FLOAT32_IEEE 0 VBU0706_CM_single_cnt -3.4028234663852886E+38 3.4028234663852886E+38 /end CHARACTERISTIC
/begin CHARACTERISTIC EDIS_numDisChOverLim_C "" VALUE 0x70000c48 Scalar_FLOAT32_IEEE 0 VBU0706_CM_single_cnt -3.4028234663852886E+38 3.4028234663852886E+38 /end CHARACTERISTIC
/begin CHARACTERISTIC EDIS_numDisChPwrOverCntEEPROMInit_SY "" VALUE 0x70000c4c Scalar_FLOAT32_IEEE 0 VBU0706_CM_single_cnt -3.4028234663852886E+38 3.4028234663852886E+38 /end CHARACTERISTIC
/begin CHARACTERISTIC EDIS_pctAccPedlDchaLo_C "" VALUE 0x70000c50 Scalar_FLOAT32_IEEE 0 VBU0706_CM_single_cnt -3.4028234663852886E+38 3.4028234663852886E+38 /end CHARACTERISTIC
/begin CHARACTERISTIC EDIS_pctAccPedlDchaUp_C "" VALUE 0x70000c54 Scalar_FLOAT32_IEEE 0 VBU0706_CM_single_cnt -3.4028234663852886E+38 3.4028234663852886E+38 /end CHARACTERISTIC
/begin CHARACTERISTIC EDIS_pctSocDchaLo_C "" VALUE 0x70000c68 Scalar_FLOAT32_IEEE 0 VBU0706_CM_single_cnt -3.4028234663852886E+38 3.4028234663852886E+38 /end CHARACTERISTIC
/begin CHARACTERISTIC EDIS_pctSocDchaUp_C "" VALUE 0x70000c6c Scalar_FLOAT32_IEEE 0 VBU0706_CM_single_cnt -3.4028234663852886E+38 3.4028234663852886E+38 /end CHARACTERISTIC
/begin CHARACTERISTIC EDIS_pwrBmsDynLTDeltaHi_C "" VALUE 0x70000c80 Scalar_FLOAT32_IEEE 0 VBU0706_CM_single_cnt -3.4028234663852886E+38 3.4028234663852886E+38 /end CHARACTERISTIC
/begin CHARACTERISTIC EDIS_pwrBmsDynLTDeltaLo_C "" VALUE 0x70000c84 Scalar_FLOAT32_IEEE 0 VBU0706_CM_single_cnt -3.4028234663852886E+38 3.4028234663852886E+38 /end CHARACTERISTIC
/begin CHARACTERISTIC EDIS_pwrDisChDynMore_C "" VALUE 0x70000ca8 Scalar_FLOAT32_IEEE 0 VBU0706_CM_single_cnt -3.4028234663852886E+38 3.4028234663852886E+38 /end CHARACTERISTIC
/begin CHARACTERISTIC EDIS_pwrDisChOverLim_C "" VALUE 0x70000cac Scalar_FLOAT32_IEEE 0 VBU0706_CM_single_kW 0.0 1000.0 /end CHARACTERISTIC
/begin CHARACTERISTIC EDIS_pwrDisChRed40vLim_C "" VALUE 0x70000cb0 Scalar_FLOAT32_IEEE 0 VBU0706_CM_single_cnt -3.4028234663852886E+38 3.4028234663852886E+38 /end CHARACTERISTIC
/begin CHARACTERISTIC EDIS_pwrDisChaFilterHi_C "" VALUE 0x70000cb4 Scalar_FLOAT32_IEEE 0 VBU0706_CM_single_cnt -3.4028234663852886E+38 3.4028234663852886E+38 /end CHARACTERISTIC
/begin CHARACTERISTIC EDIS_pwrDisChaFilterLo_C "" VALUE 0x70000cb8 Scalar_FLOAT32_IEEE 0 VBU0706_CM_single_cnt -3.4028234663852886E+38 3.4028234663852886E+38 /end CHARACTERISTIC
/begin CHARACTERISTIC EDIS_tBmsMaxTempHi_C "" VALUE 0x70000cec Scalar_FLOAT32_IEEE 0 VBU0706_CM_single_cnt -3.4028234663852886E+38 3.4028234663852886E+38 /end CHARACTERISTIC
/begin CHARACTERISTIC EDIS_tBmsMaxTempLo_C "" VALUE 0x70000cf0 Scalar_FLOAT32_IEEE 0 VBU0706_CM_single_cnt -3.4028234663852886E+38 3.4028234663852886E+38 /end CHARACTERISTIC
/begin CHARACTERISTIC EDIS_tBmsMinTempHi_C "" VALUE 0x70000cf4 Scalar_FLOAT32_IEEE 0 VBU0706_CM_single_cnt -3.4028234663852886E+38 3.4028234663852886E+38 /end CHARACTERISTIC
/begin CHARACTERISTIC EDIS_tBmsMinTempLo_C "" VALUE 0x70000cf8 Scalar_FLOAT32_IEEE 0 VBU0706_CM_single_cnt -3.4028234663852886E+38 3.4028234663852886E+38 /end CHARACTERISTIC
/begin CHARACTERISTIC EDIS_tiOverDisCha_C "" VALUE 0x70000d08 Scalar_FLOAT32_IEEE 0 VBU0706_CM_single_cnt -3.4028234663852886E+38 3.4028234663852886E+38 /end CHARACTERISTIC
/begin CHARACTERISTIC EDIS_vVehSpdDchaLo_C "" VALUE 0x70000d14 Scalar_FLOAT32_IEEE 0 VBU0706_CM_single_cnt -3.4028234663852886E+38 3.4028234663852886E+38 /end CHARACTERISTIC
/begin CHARACTERISTIC EDIS_vVehSpdDchaUp_C "" VALUE 0x70000d18 Scalar_FLOAT32_IEEE 0 VBU0706_CM_single_cnt -3.4028234663852886E+38 3.4028234663852886E+38 /end CHARACTERISTIC
/begin CHARACTERISTIC Gear_cntGearPTimeOut_C "" VALUE 0x70000d4c Scalar_FLOAT32_IEEE 0 VBU0706_CM_single_cnt -3.4028234663852886E+38 3.4028234663852886E+38 /end CHARACTERISTIC
/begin CHARACTERISTIC Gear_cntGearPlausibilityDigitalDetect_C "" VALUE 0x70000d50 Scalar_FLOAT32_IEEE 0 VBU0706_CM_single_cnt -3.4028234663852886E+38 3.4028234663852886E+38 /end CHARACTERISTIC
/begin CHARACTERISTIC Gear_cntGearPlausibilityDigitalShiftFast_C "" VALUE 0x70000d54 Scalar_FLOAT32_IEEE 0 VBU0706_CM_single_cnt -3.4028234663852886E+38 3.4028234663852886E+38 /end CHARACTERISTIC
/begin CHARACTERISTIC Gear_tiDefaultGear2NTime_C "" VALUE 0x70000d5c Scalar_FLOAT32_IEEE 0 VBU0706_CM_single_cnt -3.4028234663852886E+38 3.4028234663852886E+38 /end CHARACTERISTIC
/begin CHARACTERISTIC Gear_tiDefaultGear2PTime_C "" VALUE 0x70000d60 Scalar_FLOAT32_IEEE 0 VBU0706_CM_single_cnt -3.4028234663852886E+38 3.4028234663852886E+38 /end CHARACTERISTIC
/begin CHARACTERISTIC Gear_tiGearDSustain_C "" VALUE 0x70000d64 Scalar_FLOAT32_IEEE 0 VBU0706_CM_single_cnt -3.4028234663852886E+38 3.4028234663852886E+38 /end CHARACTERISTIC
/begin CHARACTERISTIC Gear_tiGearES6DebounceCnt_C "" VALUE 0x70000d6c Scalar_FLOAT32_IEEE 0 VBU0706_CM_single_cnt -3.4028234663852886E+38 3.4028234663852886E+38 /end CHARACTERISTIC
/begin CHARACTERISTIC Gear_tiGearInitSustain_C "" VALUE 0x70000d70 Scalar_FLOAT32_IEEE 0 VBU0706_CM_single_cnt -3.4028234663852886E+38 3.4028234663852886E+38 /end CHARACTERISTIC
/begin CHARACTERISTIC Gear_tiGearInitTime_C "" VALUE 0x70000d74 Scalar_FLOAT32_IEEE 0 VBU0706_CM_single_cnt -3.4028234663852886E+38 3.4028234663852886E+38 /end CHARACTERISTIC
/begin CHARACTERISTIC Gear_tiGearPSustain_C "" VALUE 0x70000d78 Scalar_FLOAT32_IEEE 0 VBU0706_CM_single_cnt -3.4028234663852886E+38 3.4028234663852886E+38 /end CHARACTERISTIC
/begin CHARACTERISTIC Gear_tiGearRSustain_C "" VALUE 0x70000d80 Scalar_FLOAT32_IEEE 0 VBU0706_CM_single_cnt -3.4028234663852886E+38 3.4028234663852886E+38 /end CHARACTERISTIC
/begin CHARACTERISTIC Gear_tiGearResetHold_C "" VALUE 0x70000d84 Scalar_FLOAT32_IEEE 0 VBU0706_CM_single_cnt -3.4028234663852886E+38 3.4028234663852886E+38 /end CHARACTERISTIC
/begin CHARACTERISTIC Gear_tiGearWarningLTES6DebounceCnt_C "" VALUE 0x70000d88 Scalar_FLOAT32_IEEE 0 VBU0706_CM_single_cnt -3.4028234663852886E+38 3.4028234663852886E+38 /end CHARACTERISTIC
/begin CHARACTERISTIC Gear_tiGearWarningSTES6DebounceCnt_C "" VALUE 0x70000d8c Scalar_FLOAT32_IEEE 0 VBU0706_CM_single_cnt -3.4028234663852886E+38 3.4028234663852886E+38 /end CHARACTERISTIC
/begin CHARACTERISTIC Gear_tiInitGear2NTime_C "" VALUE 0x70000d90 Scalar_FLOAT32_IEEE 0 VBU0706_CM_single_cnt -3.4028234663852886E+38 3.4028234663852886E+38 /end CHARACTERISTIC
/begin CHARACTERISTIC Gear_tiInitGear2PTime_C "" VALUE 0x70000d94 Scalar_FLOAT32_IEEE 0 VBU0706_CM_single_cnt -3.4028234663852886E+38 3.4028234663852886E+38 /end CHARACTERISTIC
/begin CHARACTERISTIC LVC_stDcDcFailure_SY "" VALUE 0x70000e44 Scalar_FLOAT32_IEEE 0 VBU0706_CM_single_cnt -3.4028234663852886E+38 3.4028234663852886E+38 /end CHARACTERISTIC
/begin CHARACTERISTIC LVC_tiWaitForOk_C "" VALUE 0x70000e58 Scalar_FLOAT32_IEEE 0 VBU0706_CM_single_cnt -3.4028234663852886E+38 3.4028234663852886E+38 /end CHARACTERISTIC
/begin CHARACTERISTIC PMM_iCtlShtDwnOffLoad_C "" VALUE 0x70000f14 Scalar_FLOAT32_IEEE 0 VBU0706_CM_single_cnt -400.0 400.0 /end CHARACTERISTIC
/begin CHARACTERISTIC PMM_iEmgShtDwnOffLoad_C "" VALUE 0x70000f18 Scalar_FLOAT32_IEEE 0 VBU0706_CM_single_cnt -400.0 400.0 /end CHARACTERISTIC
/begin CHARACTERISTIC PMM_iNrmlShtDwnOffLoad_C "" VALUE 0x70000f1c Scalar_FLOAT32_IEEE 0 VBU0706_CM_single_cnt -400.0 400.0 /end CHARACTERISTIC
/begin CHARACTERISTIC PMM_pctBrkPos4HV_C "" VALUE 0x70000f20 Scalar_FLOAT32_IEEE 0 VBU0706_CM_single_cnt 0.0 100.0 /end CHARACTERISTIC
/begin CHARACTERISTIC PMM_tiCtlShtDwnOffLoad_C "" VALUE 0x70000f28 Scalar_FLOAT32_IEEE 0 VBU0706_CM_single_cnt 0.0 100.0 /end CHARACTERISTIC
/begin CHARACTERISTIC PMM_tiDCHShtDwnOffLoad_C "" VALUE 0x70000f30 Scalar_FLOAT32_IEEE 0 VBU0706_CM_single_cnt 0.0 100.0 /end CHARACTERISTIC
/begin CHARACTERISTIC PMM_tiDlyHVClReqSrcOff_C "" VALUE 0x70000f34 Scalar_FLOAT32_IEEE 0 VBU0706_CM_single_cnt -3.4028234663852886E+38 3.4028234663852886E+38 /end CHARACTERISTIC
/begin CHARACTERISTIC PMM_tiDlyHVRlyReqCC2_C "" VALUE 0x70000f38 Scalar_FLOAT32_IEEE 0 VBU0706_CM_single_cnt -3.4028234663852886E+38 3.4028234663852886E+38 /end CHARACTERISTIC
/begin CHARACTERISTIC PMM_tiDlyIgnOnHVReq_C "" VALUE 0x70000f3c Scalar_FLOAT32_IEEE 0 VBU0706_CM_single_cnt 0.0 10.0 /end CHARACTERISTIC
/begin CHARACTERISTIC PMM_tiDlyNMWkup_C "" VALUE 0x70000f44 Scalar_FLOAT32_IEEE 0 VBU0706_CM_single_cnt -3.4028234663852886E+38 3.4028234663852886E+38 /end CHARACTERISTIC
/begin CHARACTERISTIC PMM_tiDlyOffLoadCnfrm_C "" VALUE 0x70000f48 Scalar_FLOAT32_IEEE 0 VBU0706_CM_single_cnt -3.4028234663852886E+38 3.4028234663852886E+38 /end CHARACTERISTIC
/begin CHARACTERISTIC PMM_tiDlyPEUDCVltg_C "" VALUE 0x70000f4c Scalar_FLOAT32_IEEE 0 VBU0706_CM_single_cnt -3.4028234663852886E+38 3.4028234663852886E+38 /end CHARACTERISTIC
/begin CHARACTERISTIC PMM_tiDlyPwrUpNokResp_C "" VALUE 0x70000f54 Scalar_FLOAT32_IEEE 0 VBU0706_CM_single_cnt -3.4028234663852886E+38 3.4028234663852886E+38 /end CHARACTERISTIC
/begin CHARACTERISTIC PMM_tiDlyVCUSwtOff_C "" VALUE 0x70000f60 Scalar_FLOAT32_IEEE 0 VBU0706_CM_single_cnt -3.4028234663852886E+38 3.4028234663852886E+38 /end CHARACTERISTIC
/begin CHARACTERISTIC PMM_tiDlyWkup1Cmd_SY "" VALUE 0x70000f64 Scalar_FLOAT32_IEEE 0 VBU0706_CM_single_cnt -3.4028234663852886E+38 3.4028234663852886E+38 /end CHARACTERISTIC
/begin CHARACTERISTIC PMM_tiEmgShtDwnOffLoad_C "" VALUE 0x70000f68 Scalar_FLOAT32_IEEE 0 VBU0706_CM_single_cnt 0.0 100.0 /end CHARACTERISTIC
/begin CHARACTERISTIC PMM_tiInitToHVRlyClReq_C "" VALUE 0x70000f74 Scalar_FLOAT32_IEEE 0 VBU0706_CM_single_cnt -3.4028234663852886E+38 3.4028234663852886E+38 /end CHARACTERISTIC
/begin CHARACTERISTIC PMM_tiNrmlShtDwnOffLoad_C "" VALUE 0x70000f78 Scalar_FLOAT32_IEEE 0 VBU0706_CM_single_cnt 0.0 100.0 /end CHARACTERISTIC
/begin CHARACTERISTIC PMM_uActvDisChVltg_C "" VALUE 0x70000f84 Scalar_FLOAT32_IEEE 0 VBU0706_CM_single_cnt 0.0 1000.0 /end CHARACTERISTIC
/begin CHARACTERISTIC PMM_vMaxSpdShtDwn_C "" VALUE 0x70000f88 Scalar_FLOAT32_IEEE 0 VBU0706_CM_single_cnt 0.0 255.0 /end CHARACTERISTIC
/begin CHARACTERISTIC PMM_vMinSpdShtDwn_C "" VALUE 0x70000f8c Scalar_FLOAT32_IEEE 0 VBU0706_CM_single_cnt 0.0 255.0 /end CHARACTERISTIC
/begin CHARACTERISTIC TQCMP_pBrkCrpOffThd_C "" VALUE 0x700010fc Scalar_FLOAT32_IEEE 0 VBU0706_CM_single_cnt -3.4028234663852886E+38 3.4028234663852886E+38 /end CHARACTERISTIC
/begin CHARACTERISTIC TQCMP_tiPulseThd_C "" VALUE 0x70001100 Scalar_FLOAT32_IEEE 0 VBU0706_CM_single_cnt -3.4028234663852886E+38 3.4028234663852886E+38 /end CHARACTERISTIC
/begin CHARACTERISTIC TQDIS_facDenRA2_CUR_x "" VAL_BLK 0x70001548 Scalar_FLOAT32_IEEE 0 VBU0706_CM_single_cnt -3.4028234663852886E+38 3.4028234663852886E+38 NUMBER 3 /end CHARACTERISTIC
/begin CHARACTERISTIC TQDIS_facDenRA_CUR_x "" VAL_BLK 0x70001554 Scalar_FLOAT32_IEEE 0 VBU0706_CM_single_cnt -3.4028234663852886E+38 3.4028234663852886E+38 NUMBER 3 /end CHARACTERISTIC
/begin CHARACTERISTIC TQDIS_facNumRA2_CUR_x "" VAL_BLK 0x70001560 Scalar_FLOAT32_IEEE 0 VBU0706_CM_single_cnt -3.4028234663852886E+38 3.4028234663852886E+38 NUMBER 3 /end CHARACTERISTIC
/begin CHARACTERISTIC TQDIS_facNumRA_CUR_x "" VAL_BLK 0x7000156c Scalar_FLOAT32_IEEE 0 VBU0706_CM_single_cnt -3.4028234663852886E+38 3.4028234663852886E+38 NUMBER 3 /end CHARACTERISTIC
/begin CHARACTERISTIC TQDIS_pctShftChngFullAcc_C "" VALUE 0x700011f0 Scalar_FLOAT32_IEEE 0 VBU0706_CM_single_cnt -3.4028234663852886E+38 3.4028234663852886E+38 /end CHARACTERISTIC
/begin CHARACTERISTIC TQDIS_tiShftChngDly_C "" VALUE 0x700011f4 Scalar_FLOAT32_IEEE 0 VBU0706_CM_single_cnt -3.4028234663852886E+38 3.4028234663852886E+38 /end CHARACTERISTIC
/begin CHARACTERISTIC TQDIS_trqCreepThd_C "" VALUE 0x700011f8 Scalar_FLOAT32_IEEE 0 VBU0706_CM_single_cnt -3.4028234663852886E+38 3.4028234663852886E+38 /end CHARACTERISTIC
/begin CHARACTERISTIC TQDIS_trqDmpDeadZone_C "" VALUE 0x700011fc Scalar_FLOAT32_IEEE 0 VBU0706_CM_single_cnt -3.4028234663852886E+38 3.4028234663852886E+38 /end CHARACTERISTIC
/begin CHARACTERISTIC TQDIS_trqNumDenThdRA_C "" VALUE 0x70001200 Scalar_FLOAT32_IEEE 0 VBU0706_CM_single_cnt -3.4028234663852886E+38 3.4028234663852886E+38 /end CHARACTERISTIC
/begin CHARACTERISTIC TQDIS_trqRADecMax_C "" VALUE 0x70001204 Scalar_FLOAT32_IEEE 0 VBU0706_CM_single_cnt -3.4028234663852886E+38 3.4028234663852886E+38 /end CHARACTERISTIC
/begin CHARACTERISTIC TQDIS_trqRADecMin_C "" VALUE 0x70001208 Scalar_FLOAT32_IEEE 0 VBU0706_CM_single_cnt -3.4028234663852886E+38 3.4028234663852886E+38 /end CHARACTERISTIC
/begin CHARACTERISTIC TQDIS_trqRAIncMax_C "" VALUE 0x7000120c Scalar_FLOAT32_IEEE 0 VBU0706_CM_single_cnt -3.4028234663852886E+38 3.4028234663852886E+38 /end CHARACTERISTIC
/begin CHARACTERISTIC TQDIS_trqRAIncMin_C "" VALUE 0x70001210 Scalar_FLOAT32_IEEE 0 VBU0706_CM_single_cnt -3.4028234663852886E+38 3.4028234663852886E+38 /end CHARACTERISTIC
/begin CHARACTERISTIC TQDIS_trqShftChngLimThres_C "" VALUE 0x70001214 Scalar_FLOAT32_IEEE 0 VBU0706_CM_single_cnt -3.4028234663852886E+38 3.4028234663852886E+38 /end CHARACTERISTIC
/begin CHARACTERISTIC TQDIS_vVehFilterThd_C "" VALUE 0x70001218 Scalar_FLOAT32_IEEE 0 VBU0706_CM_single_cnt -3.4028234663852886E+38 3.4028234663852886E+38 /end CHARACTERISTIC
/begin CHARACTERISTIC TQDMP_facDenRA_CUR_x "" VAL_BLK 0x70001590 Scalar_FLOAT32_IEEE 0 VBU0706_CM_single_cnt -3.4028234663852886E+38 3.4028234663852886E+38 NUMBER 3 /end CHARACTERISTIC
/begin CHARACTERISTIC TQDMP_facNumRA_CUR_x "" VAL_BLK 0x7000159c Scalar_FLOAT32_IEEE 0 VBU0706_CM_single_cnt -3.4028234663852886E+38 3.4028234663852886E+38 NUMBER 3 /end CHARACTERISTIC
/begin CHARACTERISTIC TQDMP_facPhaseSclRA_C "" VALUE 0x7000121c Scalar_FLOAT32_IEEE 0 VBU0706_CM_single_cnt -3.4028234663852886E+38 3.4028234663852886E+38 /end CHARACTERISTIC
/begin CHARACTERISTIC TQDMP_facPhsCmpDenRA_C "" VALUE 0x70001220 Scalar_FLOAT32_IEEE 0 VBU0706_CM_single_cnt -3.4028234663852886E+38 3.4028234663852886E+38 /end CHARACTERISTIC
/begin CHARACTERISTIC TQDMP_facPhsCmpK1RA_C "" VALUE 0x70001224 Scalar_FLOAT32_IEEE 0 VBU0706_CM_single_cnt -3.4028234663852886E+38 3.4028234663852886E+38 /end CHARACTERISTIC
/begin CHARACTERISTIC TQDMP_facPhsCmpNumRA_C "" VALUE 0x70001228 Scalar_FLOAT32_IEEE 0 VBU0706_CM_single_cnt -3.4028234663852886E+38 3.4028234663852886E+38 /end CHARACTERISTIC
/begin CHARACTERISTIC TQDMP_facRAV2N_C "" VALUE 0x7000122c Scalar_FLOAT32_IEEE 0 VBU0706_CM_single_cnt -3.4028234663852886E+38 3.4028234663852886E+38 /end CHARACTERISTIC
/begin CHARACTERISTIC TQDMP_nRPMHysRA_C "" VALUE 0x70001230 Scalar_FLOAT32_IEEE 0 VBU0706_CM_single_cnt -3.4028234663852886E+38 3.4028234663852886E+38 /end CHARACTERISTIC
/begin CHARACTERISTIC TQDMP_nSpdHldMax2FA_C "" VALUE 0x70001234 Scalar_FLOAT32_IEEE 0 VBU0706_CM_single_cnt -3.4028234663852886E+38 3.4028234663852886E+38 /end CHARACTERISTIC
/begin CHARACTERISTIC TQDMP_nSpdHldMaxFA_C "" VALUE 0x70001238 Scalar_FLOAT32_IEEE 0 VBU0706_CM_single_cnt -3.4028234663852886E+38 3.4028234663852886E+38 /end CHARACTERISTIC
/begin CHARACTERISTIC TQDMP_nSpdHldMin2FA_C "" VALUE 0x7000123c Scalar_FLOAT32_IEEE 0 VBU0706_CM_single_cnt -3.4028234663852886E+38 3.4028234663852886E+38 /end CHARACTERISTIC
/begin CHARACTERISTIC TQDMP_nSpdHldMinFA_C "" VALUE 0x70001240 Scalar_FLOAT32_IEEE 0 VBU0706_CM_single_cnt -3.4028234663852886E+38 3.4028234663852886E+38 /end CHARACTERISTIC
/begin CHARACTERISTIC TQDMP_pctDmpDisbThd_C "" VALUE 0x70001244 Scalar_FLOAT32_IEEE 0 VBU0706_CM_single_cnt -3.4028234663852886E+38 3.4028234663852886E+38 /end CHARACTERISTIC
/begin CHARACTERISTIC TQDMP_pctTipInAccPedChgThd_C "" VALUE 0x70001248 Scalar_FLOAT32_IEEE 0 VBU0706_CM_single_cnt -3.4028234663852886E+38 3.4028234663852886E+38 /end CHARACTERISTIC
/begin CHARACTERISTIC TQDMP_pctTipInAccPedEnThdHi_C "" VALUE 0x7000124c Scalar_FLOAT32_IEEE 0 VBU0706_CM_single_cnt -3.4028234663852886E+38 3.4028234663852886E+38 /end CHARACTERISTIC
/begin CHARACTERISTIC TQDMP_pctTipInAccPedEnThdLo_C "" VALUE 0x70001250 Scalar_FLOAT32_IEEE 0 VBU0706_CM_single_cnt -3.4028234663852886E+38 3.4028234663852886E+38 /end CHARACTERISTIC
/begin CHARACTERISTIC TQDMP_pctTipInAccPedTrgThd_C "" VALUE 0x70001254 Scalar_FLOAT32_IEEE 0 VBU0706_CM_single_cnt -3.4028234663852886E+38 3.4028234663852886E+38 /end CHARACTERISTIC
/begin CHARACTERISTIC TQDMP_pctTipOutAccPedChgThd_C "" VALUE 0x70001258 Scalar_FLOAT32_IEEE 0 VBU0706_CM_single_cnt -3.4028234663852886E+38 3.4028234663852886E+38 /end CHARACTERISTIC
/begin CHARACTERISTIC TQDMP_pctTipOutAccPedEnThdHi_C "" VALUE 0x7000125c Scalar_FLOAT32_IEEE 0 VBU0706_CM_single_cnt -3.4028234663852886E+38 3.4028234663852886E+38 /end CHARACTERISTIC
/begin CHARACTERISTIC TQDMP_pctTipOutAccPedEnThdLo_C "" VALUE 0x70001260 Scalar_FLOAT32_IEEE 0 VBU0706_CM_single_cnt -3.4028234663852886E+38 3.4028234663852886E+38 /end CHARACTERISTIC
/begin CHARACTERISTIC TQDMP_pctTipOutAccPedTrgThd_C "" VALUE 0x70001264 Scalar_FLOAT32_IEEE 0 VBU0706_CM_single_cnt -3.4028234663852886E+38 3.4028234663852886E+38 /end CHARACTERISTIC
/begin CHARACTERISTIC TQDMP_tiCalcChgLeadFilRA_C "" VALUE 0x70001268 Scalar_FLOAT32_IEEE 0 VBU0706_CM_single_cnt -3.4028234663852886E+38 3.4028234663852886E+38 /end CHARACTERISTIC
/begin CHARACTERISTIC TQDMP_tiTipInAct_C "" VALUE 0x7000126c Scalar_FLOAT32_IEEE 0 VBU0706_CM_single_cnt -3.4028234663852886E+38 3.4028234663852886E+38 /end CHARACTERISTIC
/begin CHARACTERISTIC TQDMP_tiTipInDly_C "" VALUE 0x70001270 Scalar_FLOAT32_IEEE 0 VBU0706_CM_single_cnt -3.4028234663852886E+38 3.4028234663852886E+38 /end CHARACTERISTIC
/begin CHARACTERISTIC TQDMP_tiTipOutAct_C "" VALUE 0x70001274 Scalar_FLOAT32_IEEE 0 VBU0706_CM_single_cnt -3.4028234663852886E+38 3.4028234663852886E+38 /end CHARACTERISTIC
/begin CHARACTERISTIC TQDMP_tiTipOutDly_C "" VALUE 0x70001278 Scalar_FLOAT32_IEEE 0 VBU0706_CM_single_cnt -3.4028234663852886E+38 3.4028234663852886E+38 /end CHARACTERISTIC
/begin CHARACTERISTIC TQDMP_tiTrqZeroDly_C "" VALUE 0x7000127c Scalar_FLOAT32_IEEE 0 VBU0706_CM_single_cnt -3.4028234663852886E+38 3.4028234663852886E+38 /end CHARACTERISTIC
/begin CHARACTERISTIC TQDMP_trqAxleMaxRA_C "" VALUE 0x70001280 Scalar_FLOAT32_IEEE 0 VBU0706_CM_single_cnt -3.4028234663852886E+38 3.4028234663852886E+38 /end CHARACTERISTIC
/begin CHARACTERISTIC TQDMP_trqDeadZoneMaxRA_C "" VALUE 0x70001284 Scalar_FLOAT32_IEEE 0 VBU0706_CM_single_cnt -3.4028234663852886E+38 3.4028234663852886E+38 /end CHARACTERISTIC
/begin CHARACTERISTIC TQDMP_trqDeadZoneMinRA_C "" VALUE 0x70001288 Scalar_FLOAT32_IEEE 0 VBU0706_CM_single_cnt -3.4028234663852886E+38 3.4028234663852886E+38 /end CHARACTERISTIC
/begin CHARACTERISTIC TQDMP_trqDmpEnaThdRA_C "" VALUE 0x7000128c Scalar_FLOAT32_IEEE 0 VBU0706_CM_single_cnt -3.4028234663852886E+38 3.4028234663852886E+38 /end CHARACTERISTIC
/begin CHARACTERISTIC TQDMP_trqMaxRA_C "" VALUE 0x70001290 Scalar_FLOAT32_IEEE 0 VBU0706_CM_single_cnt -3.4028234663852886E+38 3.4028234663852886E+38 /end CHARACTERISTIC
/begin CHARACTERISTIC TQDMP_trqMinRA_C "" VALUE 0x70001294 Scalar_FLOAT32_IEEE 0 VBU0706_CM_single_cnt -3.4028234663852886E+38 3.4028234663852886E+38 /end CHARACTERISTIC
/begin CHARACTERISTIC TQDMP_trqNumDenThdRA_C "" VALUE 0x70001298 Scalar_FLOAT32_IEEE 0 VBU0706_CM_single_cnt -3.4028234663852886E+38 3.4028234663852886E+38 /end CHARACTERISTIC
/begin CHARACTERISTIC TQO_ti10ms_SY "" VALUE 0x700012d8 Scalar_FLOAT32_IEEE 0 VBU0706_CM_single_cnt -3.4028234663852886E+38 3.4028234663852886E+38 /end CHARACTERISTIC
/begin CHARACTERISTIC TQO_trqPTMax_C "" VALUE 0x700012e4 Scalar_FLOAT32_IEEE 0 VBU0706_CM_single_cnt -3.4028234663852886E+38 3.4028234663852886E+38 /end CHARACTERISTIC
/begin CHARACTERISTIC TQO_trqRARgnMin_C "" VALUE 0x700012e8 Scalar_FLOAT32_IEEE 0 VBU0706_CM_single_cnt -3.4028234663852886E+38 0.0 /end CHARACTERISTIC
/begin CHARACTERISTIC TQO_trqSftyDec_C "" VALUE 0x700012f0 Scalar_FLOAT32_IEEE 0 VBU0706_CM_single_cnt -3.4028234663852886E+38 3.4028234663852886E+38 /end CHARACTERISTIC
/begin CHARACTERISTIC VTQA_facActDrvPwrFltr_C "" VALUE 0x70001334 Scalar_FLOAT32_IEEE 0 VBU0706_CM_single_cnt 0.0 1.0 /end CHARACTERISTIC
/begin CHARACTERISTIC VTQA_facActRgnPwrFltr_C "" VALUE 0x70001338 Scalar_FLOAT32_IEEE 0 VBU0706_CM_single_cnt 0.0 1.0 /end CHARACTERISTIC
/begin CHARACTERISTIC VTQA_facMotorAvgFltr_C "" VALUE 0x7000133c Scalar_FLOAT32_IEEE 0 VBU0706_CM_single_cnt 0.0 1.0 /end CHARACTERISTIC
/begin CHARACTERISTIC VTQA_facVehSpd2MotSpd_C "" VALUE 0x70001340 Scalar_FLOAT32_IEEE 0 VBU0706_CM_single_cnt 0.0 1000.0 /end CHARACTERISTIC
/begin CHARACTERISTIC VTQA_trqABSFailMin_C "" VALUE 0x70001344 Scalar_FLOAT32_IEEE 0 VBU0706_CM_single_cnt -10000.0 10000.0 /end CHARACTERISTIC
/begin CHARACTERISTIC VTQA_trqActDrvLoLim_C "" VALUE 0x70001348 Scalar_FLOAT32_IEEE 0 VBU0706_CM_single_cnt -10000.0 10000.0 /end CHARACTERISTIC
/begin CHARACTERISTIC VTQA_trqActDrvTrqLimORV "" VALUE 0x7000134c Scalar_FLOAT32_IEEE 0 VBU0706_CM_single_cnt -3.4028234663852886E+38 3.4028234663852886E+38 /end CHARACTERISTIC
/begin CHARACTERISTIC VTQA_trqActDrvUpLim_C "" VALUE 0x70001350 Scalar_FLOAT32_IEEE 0 VBU0706_CM_single_cnt -10000.0 10000.0 /end CHARACTERISTIC
/begin CHARACTERISTIC VTQA_trqActRgnLoLim_C "" VALUE 0x70001354 Scalar_FLOAT32_IEEE 0 VBU0706_CM_single_cnt -10000.0 10000.0 /end CHARACTERISTIC
/begin CHARACTERISTIC VTQA_trqActRgnTrqLimORV "" VALUE 0x70001358 Scalar_FLOAT32_IEEE 0 VBU0706_CM_single_cnt -3.4028234663852886E+38 3.4028234663852886E+38 /end CHARACTERISTIC
/begin CHARACTERISTIC VTQA_trqActRgnUpLim_C "" VALUE 0x7000135c Scalar_FLOAT32_IEEE 0 VBU0706_CM_single_cnt -10000.0 10000.0 /end CHARACTERISTIC
/begin CHARACTERISTIC VTQA_trqAxleMaxLimit_C "" VALUE 0x70001360 Scalar_FLOAT32_IEEE 0 VBU0706_CM_single_cnt -3.4028234663852886E+38 3.4028234663852886E+38 /end CHARACTERISTIC
/begin CHARACTERISTIC VTQA_trqAxleMaxORV "" VALUE 0x70001364 Scalar_FLOAT32_IEEE 0 VBU0706_CM_single_cnt -3.4028234663852886E+38 3.4028234663852886E+38 /end CHARACTERISTIC
/begin CHARACTERISTIC VTQA_trqAxleMinORV "" VALUE 0x70001368 Scalar_FLOAT32_IEEE 0 VBU0706_CM_single_cnt -3.4028234663852886E+38 3.4028234663852886E+38 /end CHARACTERISTIC
/begin CHARACTERISTIC VTQA_trqAxleMin_C "" VALUE 0x7000136c Scalar_FLOAT32_IEEE 0 VBU0706_CM_single_cnt -10000.0 10000.0 /end CHARACTERISTIC
/begin CHARACTERISTIC VTQA_trqBrkSwtTrqLim_C "" VALUE 0x70001370 Scalar_FLOAT32_IEEE 0 VBU0706_CM_single_cnt -10000.0 10000.0 /end CHARACTERISTIC
/begin CHARACTERISTIC Veh_fHVILLe_C "" VALUE 0x70001378 Scalar_FLOAT32_IEEE 0 VBU0706_CM_single_cnt -3.4028234663852886E+38 3.4028234663852886E+38 /end CHARACTERISTIC
/begin CHARACTERISTIC Veh_fHVILRi_C "" VALUE 0x7000137c Scalar_FLOAT32_IEEE 0 VBU0706_CM_single_cnt -3.4028234663852886E+38 3.4028234663852886E+38 /end CHARACTERISTIC
/begin CHARACTERISTIC Veh_pctHVILLe_C "" VALUE 0x70001390 Scalar_FLOAT32_IEEE 0 VBU0706_CM_single_cnt -3.4028234663852886E+38 3.4028234663852886E+38 /end CHARACTERISTIC
/begin CHARACTERISTIC Veh_pctHVILRi_C "" VALUE 0x70001394 Scalar_FLOAT32_IEEE 0 VBU0706_CM_single_cnt -3.4028234663852886E+38 3.4028234663852886E+38 /end CHARACTERISTIC
/begin CHARACTERISTIC Veh_tiSampleTime_C "" VALUE 0x700013a0 Scalar_FLOAT32_IEEE 0 VBU0706_CM_single_cnt -3.4028234663852886E+38 3.4028234663852886E+38 /end CHARACTERISTIC
/begin CHARACTERISTIC Veh_tiVCUHVILDebounceCnt_C "" VALUE 0x700013a4 Scalar_FLOAT32_IEEE 0 VBU0706_CM_single_cnt -3.4028234663852886E+38 3.4028234663852886E+38 /end CHARACTERISTIC
/begin CHARACTERISTIC Veh_tiVehHVILDebounceCnt_C "" VALUE 0x700013a8 Scalar_FLOAT32_IEEE 0 VBU0706_CM_single_cnt -3.4028234663852886E+38 3.4028234663852886E+38 /end CHARACTERISTIC
/begin CHARACTERISTIC Veh_vVehHVILDefaultSpd_C "" VALUE 0x700013ac Scalar_FLOAT32_IEEE 0 VBU0706_CM_single_cnt -3.4028234663852886E+38 3.4028234663852886E+38 /end CHARACTERISTIC
/begin CHARACTERISTIC Veh_vVehHVILDft_C "" VALUE 0x700013b0 Scalar_FLOAT32_IEEE 0 VBU0706_CM_single_cnt -3.4028234663852886E+38 3.4028234663852886E+38 /end CHARACTERISTIC
/begin CHARACTERISTIC CaSOF_BuffUseFactorCurrtLTCurrtMapDimension_n "" VAL_BLK 0x700013f6 Scalar_ULONG 0 VBU0706_CM_uint32_cnt 0.0 4.294967295E+9 NUMBER 2 /end CHARACTERISTIC
/begin CHARACTERISTIC CaSOF_BuffUseFactorSocTempMapDimension_n "" VAL_BLK 0x700013fe Scalar_ULONG 0 VBU0706_CM_uint32_cnt 0.0 4.294967295E+9 NUMBER 2 /end CHARACTERISTIC
/begin CHARACTERISTIC CaSOF_ChargeCurrentLimitBufferTimeSocTempMapDimension_n "" VAL_BLK 0x70001406 Scalar_ULONG 0 VBU0706_CM_uint32_cnt 0.0 4.294967295E+9 NUMBER 2 /end CHARACTERISTIC
/begin CHARACTERISTIC CaSOF_DischargeCurrentLimitBufferTimeSocTempMapDimension_n "" VAL_BLK 0x7000142e Scalar_ULONG 0 VBU0706_CM_uint32_cnt 0.0 4.294967295E+9 NUMBER 2 /end CHARACTERISTIC
/begin CHARACTERISTIC CaSOF_DischargeDcirSocTempMapDimension_n "" VAL_BLK 0x70001436 Scalar_ULONG 0 VBU0706_CM_uint32_cnt 0.0 4.294967295E+9 NUMBER 2 /end CHARACTERISTIC
/begin CHARACTERISTIC CaSOF_DischargeOcvSocTempMapDimension_n "" VAL_BLK 0x7000143e Scalar_ULONG 0 VBU0706_CM_uint32_cnt 0.0 4.294967295E+9 NUMBER 2 /end CHARACTERISTIC
/begin CHARACTERISTIC CaSOH_OcvSocMapDimension_n "" VAL_BLK 0x700014a6 Scalar_ULONG 0 VBU0706_CM_uint32_cnt 0.0 4.294967295E+9 NUMBER 2 /end CHARACTERISTIC
/begin CHARACTERISTIC CaSOH_UdResisMapDimension_n "" VAL_BLK 0x700014ae Scalar_ULONG 0 VBU0706_CM_uint32_cnt 0.0 4.294967295E+9 NUMBER 2 /end CHARACTERISTIC
/begin CHARACTERISTIC CcSOF_VoltageCorrectCheckInc1_n "" VALUE 0x700007f8 Scalar_ULONG 0 VBU0706_CM_uint32_cnt 0.0 4.294967295E+9 /end CHARACTERISTIC
/begin CHARACTERISTIC CcSOF_VoltageCorrectCheckInc2_n "" VALUE 0x700007fc Scalar_ULONG 0 VBU0706_CM_uint32_cnt 0.0 4.294967295E+9 /end CHARACTERISTIC
/begin CHARACTERISTIC CcSOF_VoltageCorrectCheckInc3_n "" VALUE 0x70000800 Scalar_ULONG 0 VBU0706_CM_uint32_cnt 0.0 4.294967295E+9 /end CHARACTERISTIC
/begin CHARACTERISTIC CcSOF_VoltageCorrectCheckInc4_n "" VALUE 0x70000804 Scalar_ULONG 0 VBU0706_CM_uint32_cnt 0.0 4.294967295E+9 /end CHARACTERISTIC
/begin CHARACTERISTIC CcSOF_VoltageCorrectEnableInc1_n "" VALUE 0x70000808 Scalar_ULONG 0 VBU0706_CM_uint32_cnt 0.0 4.294967295E+9 /end CHARACTERISTIC
/begin CHARACTERISTIC CcSOF_VoltageCorrectEnableInc2_n "" VALUE 0x7000080c Scalar_ULONG 0 VBU0706_CM_uint32_cnt 0.0 4.294967295E+9 /end CHARACTERISTIC
/begin CHARACTERISTIC CcSOF_VoltageCorrectEnableInc3_n "" VALUE 0x70000810 Scalar_ULONG 0 VBU0706_CM_uint32_cnt 0.0 4.294967295E+9 /end CHARACTERISTIC
/begin CHARACTERISTIC CcSOF_VoltageCorrectEnableInc4_n "" VALUE 0x70000814 Scalar_ULONG 0 VBU0706_CM_uint32_cnt 0.0 4.294967295E+9 /end CHARACTERISTIC
/begin CHARACTERISTIC CcSOC_FastChargePreCorrectionDeltaVolMax_mV "" VALUE 0x7000009e Scalar_UWORD 0 VBU0706_CM_uint16_cnt 0.0 65535.0 /end CHARACTERISTIC
/begin CHARACTERISTIC CcSOF_CellVoltageHigh1_mV "" VALUE 0x700000bc Scalar_UWORD 0 VBU0706_CM_uint16_cnt 0.0 65535.0 /end CHARACTERISTIC
/begin CHARACTERISTIC CcSOF_CellVoltageHigh2_mV "" VALUE 0x700000be Scalar_UWORD 0 VBU0706_CM_uint16_cnt 0.0 65535.0 /end CHARACTERISTIC
/begin CHARACTERISTIC CcSOF_CellVoltageHigh3_mV "" VALUE 0x700000c0 Scalar_UWORD 0 VBU0706_CM_uint16_cnt 0.0 65535.0 /end CHARACTERISTIC
/begin CHARACTERISTIC CcSOF_CellVoltageHigh4_mV "" VALUE 0x700000c2 Scalar_UWORD 0 VBU0706_CM_uint16_cnt 0.0 65535.0 /end CHARACTERISTIC
/begin CHARACTERISTIC CcSOF_CellVoltageLow1_mV "" VALUE 0x700000c4 Scalar_UWORD 0 VBU0706_CM_uint16_cnt 0.0 65535.0 /end CHARACTERISTIC
/begin CHARACTERISTIC CcSOF_CellVoltageLow2_mV "" VALUE 0x700000c6 Scalar_UWORD 0 VBU0706_CM_uint16_cnt 0.0 65535.0 /end CHARACTERISTIC
/begin CHARACTERISTIC CcSOF_CellVoltageLow3_mV "" VALUE 0x700000c8 Scalar_UWORD 0 VBU0706_CM_uint16_cnt 0.0 65535.0 /end CHARACTERISTIC
/begin CHARACTERISTIC CcSOF_CellVoltageLow4_mV "" VALUE 0x700000ca Scalar_UWORD 0 VBU0706_CM_uint16_cnt 0.0 65535.0 /end CHARACTERISTIC
/begin CHARACTERISTIC CcSOF_PowerOnOverCurFacSloDelay_ms "" VALUE 0x700000dc Scalar_UWORD 0 VBU0706_CM_uint16_cnt 0.0 65535.0 /end CHARACTERISTIC
/begin CHARACTERISTIC CcSOF_PowerOnVolCorCurtSloDelay_ms "" VALUE 0x700000de Scalar_UWORD 0 VBU0706_CM_uint16_cnt 0.0 65535.0 /end CHARACTERISTIC
/begin CHARACTERISTIC CcSOF_PowerOnVolCorFacSloDelay_ms "" VALUE 0x700000e0 Scalar_UWORD 0 VBU0706_CM_uint16_cnt 0.0 65535.0 /end CHARACTERISTIC
/begin CHARACTERISTIC APD_flgSelectPedalORF "" VALUE 0x70010721 Scalar_BOOLEAN 0 VBU0706_CM_boolean_cnt 0.0 1.0 /end CHARACTERISTIC
/begin CHARACTERISTIC CbSOF_VoltageCorrectLevelEnable_flg "" VALUE 0x70010878 Scalar_BOOLEAN 0 VBU0706_CM_boolean_cnt 0.0 1.0 /end CHARACTERISTIC
/begin CHARACTERISTIC CbSOF_VoltageTableCorrectUsePredictedCellVoltage_flg "" VALUE 0x70010879 Scalar_BOOLEAN 0 VBU0706_CM_boolean_cnt 0.0 1.0 /end CHARACTERISTIC
/begin CHARACTERISTIC CcSOF_EnableCalculatedDcir_flg "" VALUE 0x7001095a Scalar_BOOLEAN 0 VBU0706_CM_boolean_cnt 0.0 1.0 /end CHARACTERISTIC
/begin CHARACTERISTIC DSPL_flgEnergyFactorSelfLearnEn_C "" VALUE 0x70010a76 Scalar_BOOLEAN 0 VBU0706_CM_boolean_flg 0.0 1.0 /end CHARACTERISTIC
/begin CHARACTERISTIC EDIS_flgDisChDynMore_C "" VALUE 0x70010a80 Scalar_BOOLEAN 0 VBU0706_CM_boolean_cnt 0.0 1.0 /end CHARACTERISTIC
/begin CHARACTERISTIC EDIS_flgDisChDynOverride_C "" VALUE 0x70010a81 Scalar_BOOLEAN 0 VBU0706_CM_boolean_cnt 0.0 1.0 /end CHARACTERISTIC
/begin CHARACTERISTIC PMM_flgVCUShtDwnOvrdSwt_C "" VALUE 0x70010b4e Scalar_BOOLEAN 0 VBU0706_CM_boolean_cnt 0.0 1.0 /end CHARACTERISTIC
/begin CHARACTERISTIC PMM_flgVCUShtDwnOvrdVal_C "" VALUE 0x70010b4f Scalar_BOOLEAN 0 VBU0706_CM_boolean_cnt 0.0 1.0 /end CHARACTERISTIC
/begin CHARACTERISTIC PMM_flgWkup1CmdOvrdSwt_C "" VALUE 0x70010b53 Scalar_BOOLEAN 0 VBU0706_CM_boolean_cnt 0.0 1.0 /end CHARACTERISTIC
/begin CHARACTERISTIC PMM_flgWkup1CmdOvrdVal_C "" VALUE 0x70010b54 Scalar_BOOLEAN 0 VBU0706_CM_boolean_cnt 0.0 1.0 /end CHARACTERISTIC
/begin CHARACTERISTIC TQARB_flgTrqCompSwitch_C "" VALUE 0x70010bb3 Scalar_BOOLEAN 0 VBU0706_CM_boolean_cnt 0.0 1.0 /end CHARACTERISTIC
/begin CHARACTERISTIC TQDIS_flgDMPByPass_C "" VALUE 0x70010bba Scalar_BOOLEAN 0 VBU0706_CM_boolean_cnt 0.0 1.0 /end CHARACTERISTIC
/begin CHARACTERISTIC TQDIS_flgDmpFilterRA2_C "" VALUE 0x70010bbb Scalar_BOOLEAN 0 VBU0706_CM_boolean_cnt 0.0 1.0 /end CHARACTERISTIC
/begin CHARACTERISTIC TQDMP_flgLowFilterDnRA_C "" VALUE 0x70010bbc Scalar_BOOLEAN 0 VBU0706_CM_boolean_cnt 0.0 1.0 /end CHARACTERISTIC
/begin CHARACTERISTIC TQDMP_flgRAVCUDmpEna_C "" VALUE 0x70010bbd Scalar_BOOLEAN 0 VBU0706_CM_boolean_cnt 0.0 1.0 /end CHARACTERISTIC
/begin CHARACTERISTIC TQDMP_flgROTCEnRA_C "" VALUE 0x70010bc0 Scalar_BOOLEAN 0 VBU0706_CM_boolean_cnt 0.0 1.0 /end CHARACTERISTIC
/begin CHARACTERISTIC TQDMP_flgSpdHldOn_C "" VALUE 0x70010bc1 Scalar_BOOLEAN 0 VBU0706_CM_boolean_cnt 0.0 1.0 /end CHARACTERISTIC
/begin CHARACTERISTIC TQDMP_flgTipInEnaRvs_C "" VALUE 0x70010bc2 Scalar_BOOLEAN 0 VBU0706_CM_boolean_cnt 0.0 1.0 /end CHARACTERISTIC
/begin CHARACTERISTIC TQDMP_flgTipOutEnaRvs_C "" VALUE 0x70010bc3 Scalar_BOOLEAN 0 VBU0706_CM_boolean_cnt 0.0 1.0 /end CHARACTERISTIC
/begin CHARACTERISTIC VTQA_flgActDrvTrqLimORF "" VALUE 0x70010bde Scalar_BOOLEAN 0 VBU0706_CM_boolean_cnt 0.0 1.0 /end CHARACTERISTIC
/begin CHARACTERISTIC VTQA_flgActRgnTrqLimORF "" VALUE 0x70010bdf Scalar_BOOLEAN 0 VBU0706_CM_boolean_cnt 0.0 1.0 /end CHARACTERISTIC
/begin CHARACTERISTIC VTQA_flgAxleMaxORF "" VALUE 0x70010be0 Scalar_BOOLEAN 0 VBU0706_CM_boolean_cnt 0.0 1.0 /end CHARACTERISTIC
/begin CHARACTERISTIC VTQA_flgAxleMinORF "" VALUE 0x70010be1 Scalar_BOOLEAN 0 VBU0706_CM_boolean_cnt 0.0 1.0 /end CHARACTERISTIC
/begin CHARACTERISTIC Veh_flgHVILCaliOvrdVal_C "" VALUE 0x70010be3 Scalar_BOOLEAN 0 VBU0706_CM_boolean_cnt 0.0 1.0 /end CHARACTERISTIC
/begin CHARACTERISTIC Veh_flgHVILCaliOvrd_C "" VALUE 0x70010be4 Scalar_BOOLEAN 0 VBU0706_CM_boolean_cnt 0.0 1.0 /end CHARACTERISTIC
/begin CHARACTERISTIC Veh_flgLowSpdGearChange_C "" VALUE 0x70010be6 Scalar_BOOLEAN 0 VBU0706_CM_boolean_cnt 0.0 1.0 /end CHARACTERISTIC
/begin CHARACTERISTIC APD_stSelectPedal1_C "" VALUE 0x70010724 Scalar_UBYTE 0 VBU0706_CM_uint8_cnt 0.0 15.0 /end CHARACTERISTIC
/begin CHARACTERISTIC APD_stSelectPedal2_C "" VALUE 0x70010725 Scalar_UBYTE 0 VBU0706_CM_uint8_cnt 0.0 15.0 /end CHARACTERISTIC
/begin CHARACTERISTIC APD_stSelectPedalDefault_C "" VALUE 0x70010726 Scalar_UBYTE 0 VBU0706_CM_uint8_cnt 0.0 15.0 /end CHARACTERISTIC
/begin CHARACTERISTIC APD_stSelectPedalMin_C "" VALUE 0x70010727 Scalar_UBYTE 0 VBU0706_CM_uint8_cnt 0.0 15.0 /end CHARACTERISTIC
/begin CHARACTERISTIC APD_stSelectPedalORV "" VALUE 0x70010728 Scalar_UBYTE 0 VBU0706_CM_uint8_cnt 0.0 255.0 /end CHARACTERISTIC
/begin CHARACTERISTIC CcSOF_DcirDelayTimes_n "" VALUE 0x70010957 Scalar_UBYTE 0 VBU0706_CM_uint8_cnt 0.0 255.0 /end CHARACTERISTIC
/begin CHARACTERISTIC DIAGS_stPsvRespAlreadyOk_SY "" VALUE 0x70010a72 Scalar_UBYTE 0 VBU0706_CM_uint8_cnt 0.0 255.0 /end CHARACTERISTIC
/begin CHARACTERISTIC EDIS_stCurrentGearD_C "" VALUE 0x70010a8a Scalar_UBYTE 0 VBU0706_CM_uint8_cnt 0.0 15.0 /end CHARACTERISTIC
/begin CHARACTERISTIC EPB_CompleteTight "" VALUE 0x70010a8e Scalar_UBYTE 0 VBU0706_CM_uint8_cnt 0.0 255.0 /end CHARACTERISTIC
/begin CHARACTERISTIC EPB_stApplying "" VALUE 0x70010a91 Scalar_UBYTE 0 VBU0706_CM_uint8_cnt 0.0 255.0 /end CHARACTERISTIC
/begin CHARACTERISTIC Gear_stCurrentGearN_C "" VALUE 0x70010ac7 Scalar_UBYTE 0 VBU0706_CM_uint8_cnt 0.0 15.0 /end CHARACTERISTIC
/begin CHARACTERISTIC Gear_stCurrentGearP_C "" VALUE 0x70010ac8 Scalar_UBYTE 0 VBU0706_CM_uint8_cnt 0.0 255.0 /end CHARACTERISTIC
/begin CHARACTERISTIC Gear_stDriveIntendGearD_C "" VALUE 0x70010aca Scalar_UBYTE 0 VBU0706_CM_uint8_cnt 0.0 15.0 /end CHARACTERISTIC
/begin CHARACTERISTIC Gear_stDriveIntendGearInvalid_C "" VALUE 0x70010acb Scalar_UBYTE 0 VBU0706_CM_uint8_cnt 0.0 15.0 /end CHARACTERISTIC
/begin CHARACTERISTIC Gear_stDriveIntendGearNeutral_C "" VALUE 0x70010acc Scalar_UBYTE 0 VBU0706_CM_uint8_cnt 0.0 15.0 /end CHARACTERISTIC
/begin CHARACTERISTIC Gear_stDriveIntendGearR_C "" VALUE 0x70010acd Scalar_UBYTE 0 VBU0706_CM_uint8_cnt 0.0 15.0 /end CHARACTERISTIC
/begin CHARACTERISTIC Gear_stGearDValidBit1_C "" VALUE 0x70010ad3 Scalar_UBYTE 0 VBU0706_CM_uint8_cnt 0.0 255.0 /end CHARACTERISTIC
/begin CHARACTERISTIC Gear_stGearNValid_C "" VALUE 0x70010ad4 Scalar_UBYTE 0 VBU0706_CM_uint8_cnt 0.0 255.0 /end CHARACTERISTIC
/begin CHARACTERISTIC Gear_stGearRValidBit1_C "" VALUE 0x70010ad5 Scalar_UBYTE 0 VBU0706_CM_uint8_cnt 0.0 255.0 /end CHARACTERISTIC
/begin CHARACTERISTIC Gear_stIntendGearD_C "" VALUE 0x70010ad7 Scalar_UBYTE 0 VBU0706_CM_uint8_cnt 0.0 15.0 /end CHARACTERISTIC
/begin CHARACTERISTIC Gear_stIntendGearN_C "" VALUE 0x70010ad8 Scalar_UBYTE 0 VBU0706_CM_uint8_cnt 0.0 15.0 /end CHARACTERISTIC
/begin CHARACTERISTIC Gear_stIntendGearR_C "" VALUE 0x70010ada Scalar_UBYTE 0 VBU0706_CM_uint8_cnt 0.0 15.0 /end CHARACTERISTIC
/begin CHARACTERISTIC PMM_stAPlushld_SY "" VALUE 0x70010b56 Scalar_UBYTE 0 VBU0706_CM_uint8_cnt 0.0 255.0 /end CHARACTERISTIC
/begin CHARACTERISTIC PMM_stDCDCWrking_SY "" VALUE 0x70010b5a Scalar_UBYTE 0 VBU0706_CM_uint8_cnt 0.0 255.0 /end CHARACTERISTIC
/begin CHARACTERISTIC PMM_stDCHInitSts_SY "" VALUE 0x70010b5b Scalar_UBYTE 0 VBU0706_CM_uint8_cnt 0.0 255.0 /end CHARACTERISTIC
/begin CHARACTERISTIC PMM_stDCHShtDwnSts_SY "" VALUE 0x70010b5c Scalar_UBYTE 0 VBU0706_CM_uint8_cnt 0.0 255.0 /end CHARACTERISTIC
/begin CHARACTERISTIC SOF_VOLTAGE_CORRECT_LEVEL1 "" VALUE 0x70010b84 Scalar_UBYTE 0 VBU0706_CM_uint8_cnt 0.0 255.0 /end CHARACTERISTIC
/begin CHARACTERISTIC SOF_VOLTAGE_CORRECT_LEVEL2 "" VALUE 0x70010b85 Scalar_UBYTE 0 VBU0706_CM_uint8_cnt 0.0 255.0 /end CHARACTERISTIC
/begin CHARACTERISTIC SOF_VOLTAGE_CORRECT_LEVEL3 "" VALUE 0x70010b86 Scalar_UBYTE 0 VBU0706_CM_uint8_cnt 0.0 255.0 /end CHARACTERISTIC
/begin CHARACTERISTIC SOF_VOLTAGE_CORRECT_LEVEL4 "" VALUE 0x70010b87 Scalar_UBYTE 0 VBU0706_CM_uint8_cnt 0.0 255.0 /end CHARACTERISTIC
/begin CHARACTERISTIC SOF_VOLTAGE_CORRECT_NONE "" VALUE 0x70010b88 Scalar_UBYTE 0 VBU0706_CM_uint8_cnt 0.0 255.0 /end CHARACTERISTIC
/begin CHARACTERISTIC SYS_stHMIDrvModeSport_SY "" VALUE 0x70010b91 Scalar_UBYTE 0 VBU0706_CM_uint8_cnt 0.0 255.0 /end CHARACTERISTIC
/begin CHARACTERISTIC SYS_stMCUErr_SY "" VALUE 0x70010b93 Scalar_UBYTE 0 VBU0706_CM_uint8_cnt 0.0 255.0 /end CHARACTERISTIC
/begin CHARACTERISTIC Veh_stErr_C "" VALUE 0x70010be9 Scalar_UBYTE 0 VBU0706_CM_uint8_cnt 0.0 15.0 /end CHARACTERISTIC
/begin CHARACTERISTIC Veh_stNoErr_C "" VALUE 0x70010bed Scalar_UBYTE 0 VBU0706_CM_uint8_cnt 0.0 15.0 /end CHARACTERISTIC
/begin MEASUREMENT Gear_stHWSensor "" ULONG VBU0706_CM_uint32 0 0 0.0 15.0 ECU_ADDRESS 0x70011662 /end MEASUREMENT
/begin MEASUREMENT SOH_AhCellCapacityMin "" FLOAT32_IEEE VBU0706_CM_single 0 0 -3.4E+38 3.4E+38 ECU_ADDRESS 0x700118f2 /end MEASUREMENT
/begin MEASUREMENT SOH_AhCellCapacityMax "" FLOAT32_IEEE VBU0706_CM_single 0 0 -3.4E+38 3.4E+38 ECU_ADDRESS 0x700118ee /end MEASUREMENT
/begin MEASUREMENT SOH_AhCellCapacityAve "" FLOAT32_IEEE VBU0706_CM_single 0 0 -3.4E+38 3.4E+38 ECU_ADDRESS 0x700118ea /end MEASUREMENT
/begin MEASUREMENT SOF_pctCurrentSOH "" FLOAT32_IEEE VBU0706_CM_single 0 0 -3.4E+38 3.4E+38 ECU_ADDRESS 0x700118de /end MEASUREMENT
/begin MEASUREMENT SOF_iAContinuousChargeCurrentLimitFastChrgChk "" FLOAT32_IEEE VBU0706_CM_single 0 0 -3.4E+38 3.4E+38 ECU_ADDRESS 0x70011812 /end MEASUREMENT
/begin MEASUREMENT SOF_mohmCellDischargeDcirCalc "" FLOAT32_IEEE VBU0706_CM_single 0 0 -3.4E+38 3.4E+38 ECU_ADDRESS 0x700118da /end MEASUREMENT
/begin MEASUREMENT SOF_iAShortPulseChargeCurrentLimitVltgTarget "" FLOAT32_IEEE VBU0706_CM_single 0 0 -3.4E+38 3.4E+38 ECU_ADDRESS 0x70011872 /end MEASUREMENT
/begin MEASUREMENT SOF_iAContinuousChargeCurrentLimitVltgTarget "" FLOAT32_IEEE VBU0706_CM_single 0 0 -3.4E+38 3.4E+38 ECU_ADDRESS 0x70011822 /end MEASUREMENT
/begin MEASUREMENT SOF_iADynamicChargeCurrentLimitVltgTarget "" FLOAT32_IEEE VBU0706_CM_single 0 0 -3.4E+38 3.4E+38 ECU_ADDRESS 0x70011842 /end MEASUREMENT
/begin MEASUREMENT SOF_iAShortPulseDischargeCurrentLimitVltgTarget "" FLOAT32_IEEE VBU0706_CM_single 0 0 -3.4E+38 3.4E+38 ECU_ADDRESS 0x70011886 /end MEASUREMENT
/begin MEASUREMENT SOF_iAContinuousDischargeCurrentLimitVltgTarget "" FLOAT32_IEEE VBU0706_CM_single 0 0 -3.4E+38 3.4E+38 ECU_ADDRESS 0x7001182e /end MEASUREMENT
/begin MEASUREMENT SOF_iADynamicDischargeCurrentLimitVltgBefoTarget "" FLOAT32_IEEE VBU0706_CM_single 0 0 -3.4E+38 3.4E+38 ECU_ADDRESS 0x7001184e /end MEASUREMENT
/begin MEASUREMENT SOF_iADynamicDischargeCurrentLimitVltgTarget "" FLOAT32_IEEE VBU0706_CM_single 0 0 -3.4E+38 3.4E+38 ECU_ADDRESS 0x70011856 /end MEASUREMENT
/begin MEASUREMENT SOF_iADynamicDischargeCurrentLimitVltgDcirTarget "" FLOAT32_IEEE VBU0706_CM_single 0 0 -3.4E+38 3.4E+38 ECU_ADDRESS 0x70011852 /end MEASUREMENT
/begin MEASUREMENT SOF_AsChargeCurrentLimitBufferFull "" FLOAT32_IEEE VBU0706_CM_single 0 0 -3.4E+38 3.4E+38 ECU_ADDRESS 0x700117ea /end MEASUREMENT
/begin MEASUREMENT SOF_AsChargeCurrentLimitBufferUse "" FLOAT32_IEEE VBU0706_CM_single 0 0 -3.4E+38 3.4E+38 ECU_ADDRESS 0x700117ee /end MEASUREMENT
/begin MEASUREMENT SOF_iADynamicChargeCurrentLimitFastChrgChk "" FLOAT32_IEEE VBU0706_CM_single 0 0 -3.4E+38 3.4E+38 ECU_ADDRESS 0x7001183a /end MEASUREMENT
/begin MEASUREMENT SOF_iACalDynamicChgCurLimitFCCChk "" FLOAT32_IEEE VBU0706_CM_single 0 0 -3.4E+38 3.4E+38 ECU_ADDRESS 0x700117fe /end MEASUREMENT
/begin MEASUREMENT SOF_AsDischargeCurrentLimitBufferFull "" FLOAT32_IEEE VBU0706_CM_single 0 0 -3.4E+38 3.4E+38 ECU_ADDRESS 0x700117f2 /end MEASUREMENT
/begin MEASUREMENT SOF_AsDischargeCurrentLimitBufferUse "" FLOAT32_IEEE VBU0706_CM_single 0 0 -3.4E+38 3.4E+38 ECU_ADDRESS 0x700117f6 /end MEASUREMENT
/begin MEASUREMENT SOF_iADynamicDischargeCurrentLimitFastChrgChk "" FLOAT32_IEEE VBU0706_CM_single 0 0 -3.4E+38 3.4E+38 ECU_ADDRESS 0x70011846 /end MEASUREMENT
/begin MEASUREMENT CTD_jAccumulatedAvaliableHeat "" FLOAT32_IEEE VBU0706_CM_single 0 0 -3.4E+38 3.4E+38 ECU_ADDRESS 0x700114b2 /end MEASUREMENT
/begin MEASUREMENT INP_uBrkPresFlt1 "" FLOAT32_IEEE VBU0706_CM_single 0 0 -3.4E+38 3.4E+38 ECU_ADDRESS 0x700116c6 /end MEASUREMENT
/begin MEASUREMENT SPD_vFA "" FLOAT32_IEEE VBU0706_CM_single 0 0 -3.4E+38 3.4E+38 ECU_ADDRESS 0x7001191e /end MEASUREMENT
/begin MEASUREMENT SPD_vRA "" FLOAT32_IEEE VBU0706_CM_single 0 0 -3.4E+38 3.4E+38 ECU_ADDRESS 0x70011926 /end MEASUREMENT
/begin MEASUREMENT SPD_vVehSpd "" FLOAT32_IEEE VBU0706_CM_single 0 0 -3.4E+38 3.4E+38 ECU_ADDRESS 0x7001192a /end MEASUREMENT
/begin MEASUREMENT APD_pctAPDbasic "" FLOAT32_IEEE VBU0706_CM_single 0 0 -3.4E+38 3.4E+38 ECU_ADDRESS 0x7001141e /end MEASUREMENT
/begin MEASUREMENT VTQA_trqBrkTrqMax "" FLOAT32_IEEE VBU0706_CM_single 0 0 -10000.0 10000.0 ECU_ADDRESS 0x70011c0a /end MEASUREMENT
/begin MEASUREMENT VTQA_trqBcuTrqMax "" FLOAT32_IEEE VBU0706_CM_single 0 0 -10000.0 10000.0 ECU_ADDRESS 0x70011c06 /end MEASUREMENT
/begin MEASUREMENT VTQA_trqBattTrqMax "" FLOAT32_IEEE VBU0706_CM_single 0 0 -10000.0 10000.0 ECU_ADDRESS 0x70011bfe /end MEASUREMENT
/begin MEASUREMENT VTQA_trqMotTrqMax "" FLOAT32_IEEE VBU0706_CM_single 0 0 -10000.0 10000.0 ECU_ADDRESS 0x70011c1e /end MEASUREMENT
/begin MEASUREMENT VTQA_trqLimpTrqMax "" FLOAT32_IEEE VBU0706_CM_single 0 0 -10000.0 10000.0 ECU_ADDRESS 0x70011c1a /end MEASUREMENT
/begin MEASUREMENT VTQA_trqLimpByPmpTrqMax "" FLOAT32_IEEE VBU0706_CM_single 0 0 -10000.0 10000.0 ECU_ADDRESS 0x70011c16 /end MEASUREMENT
/begin MEASUREMENT VTQA_trqAxleMax "" FLOAT32_IEEE VBU0706_CM_single 0 0 -10000.0 10000.0 ECU_ADDRESS 0x70011bf6 /end MEASUREMENT
/begin MEASUREMENT VTQA_trqBattTrqMin "" FLOAT32_IEEE VBU0706_CM_single 0 0 -10000.0 10000.0 ECU_ADDRESS 0x70011c02 /end MEASUREMENT
/begin MEASUREMENT VTQA_trqMotTrqMin "" FLOAT32_IEEE VBU0706_CM_single 0 0 -10000.0 10000.0 ECU_ADDRESS 0x70011c22 /end MEASUREMENT
/begin MEASUREMENT VTQA_trqActvLimpLimit "" FLOAT32_IEEE VBU0706_CM_single 0 0 -3.4E+38 3.4E+38 ECU_ADDRESS 0x70011bf2 /end MEASUREMENT
/begin MEASUREMENT VTQA_trqInhibRegenLimit "" FLOAT32_IEEE VBU0706_CM_single 0 0 -3.4E+38 3.4E+38 ECU_ADDRESS 0x70011c12 /end MEASUREMENT
/begin MEASUREMENT VTQA_trqABSFailLimit "" FLOAT32_IEEE VBU0706_CM_single 0 0 -3.4E+38 3.4E+38 ECU_ADDRESS 0x70011be6 /end MEASUREMENT
/begin MEASUREMENT VTQA_trqAxleMin "" FLOAT32_IEEE VBU0706_CM_single 0 0 -10000.0 10000.0 ECU_ADDRESS 0x70011bfa /end MEASUREMENT
/begin MEASUREMENT VTQA_trqDes "" FLOAT32_IEEE VBU0706_CM_single 0 0 -3.4E+38 3.4E+38 ECU_ADDRESS 0x70011c0e /end MEASUREMENT
/begin MEASUREMENT VTQA_trqRMotrPos "" FLOAT32_IEEE VBU0706_CM_single 0 0 -10000.0 10000.0 ECU_ADDRESS 0x70011c2a /end MEASUREMENT
/begin MEASUREMENT VTQA_trqRMotrNeg "" FLOAT32_IEEE VBU0706_CM_single 0 0 -10000.0 10000.0 ECU_ADDRESS 0x70011c26 /end MEASUREMENT
/begin MEASUREMENT VTQA_pwrRMotActRgnLoss "" FLOAT32_IEEE VBU0706_CM_single 0 0 0.0 100.0 ECU_ADDRESS 0x70011be2 /end MEASUREMENT
/begin MEASUREMENT VTQA_pwrRMotActDrvLoss "" FLOAT32_IEEE VBU0706_CM_single 0 0 0.0 100.0 ECU_ADDRESS 0x70011bde /end MEASUREMENT
/begin MEASUREMENT VTQA_trqActRgnTrqLim "" FLOAT32_IEEE VBU0706_CM_single 0 0 -2000.0 2000.0 ECU_ADDRESS 0x70011bee /end MEASUREMENT
/begin MEASUREMENT VTQA_trqActDrvTrqLim "" FLOAT32_IEEE VBU0706_CM_single 0 0 -2000.0 2000.0 ECU_ADDRESS 0x70011bea /end MEASUREMENT
/begin MEASUREMENT MTQL_trqDnAbsLimR "" FLOAT32_IEEE VBU0706_CM_single 0 0 -3.4E+38 3.4E+38 ECU_ADDRESS 0x70011726 /end MEASUREMENT
/begin MEASUREMENT MTQL_trqVehSpdDrvLimR "" FLOAT32_IEEE VBU0706_CM_single 0 0 -10000.0 10000.0 ECU_ADDRESS 0x70011746 /end MEASUREMENT
/begin MEASUREMENT MTQL_trqRMotrFIDDrvLim "" FLOAT32_IEEE VBU0706_CM_single 0 0 -10000.0 10000.0 ECU_ADDRESS 0x7001173a /end MEASUREMENT
/begin MEASUREMENT TQDMP_trqDmpRA "" FLOAT32_IEEE VBU0706_CM_single 0 0 -10000.0 10000.0 ECU_ADDRESS 0x70011a26 /end MEASUREMENT
/begin MEASUREMENT TQDMP_pctAccPdlVrtlRA "" FLOAT32_IEEE VBU0706_CM_single 0 0 -3.4E+38 3.4E+38 ECU_ADDRESS 0x70011a0e /end MEASUREMENT
/begin MEASUREMENT TQDMP_dnMotrR "" FLOAT32_IEEE VBU0706_CM_single 0 0 -3.4E+38 3.4E+38 ECU_ADDRESS 0x70011a0a /end MEASUREMENT
/begin MEASUREMENT TQDMP_trqDeltaLPFR "" FLOAT32_IEEE VBU0706_CM_single 0 0 -10000.0 10000.0 ECU_ADDRESS 0x70011a1e /end MEASUREMENT
/begin MEASUREMENT TQDMP_trqDeltaR "" FLOAT32_IEEE VBU0706_CM_single 0 0 -10000.0 10000.0 ECU_ADDRESS 0x70011a22 /end MEASUREMENT
/begin MEASUREMENT TQDMP_trqROTCRA "" FLOAT32_IEEE VBU0706_CM_single 0 0 -10000.0 10000.0 ECU_ADDRESS 0x70011a2a /end MEASUREMENT
/begin MEASUREMENT TQDMP_trqBumpRA "" FLOAT32_IEEE VBU0706_CM_single 0 0 -10000.0 10000.0 ECU_ADDRESS 0x70011a12 /end MEASUREMENT
/begin MEASUREMENT TQDMP_trqCompRA0 "" FLOAT32_IEEE VBU0706_CM_single 0 0 -10000.0 10000.0 ECU_ADDRESS 0x70011a1a /end MEASUREMENT
/begin MEASUREMENT TQO_trqBrkLim "" FLOAT32_IEEE VBU0706_CM_single 0 0 -10000.0 10000.0 ECU_ADDRESS 0x70011a8e /end MEASUREMENT
/begin MEASUREMENT TQO_trqSftyRA "" FLOAT32_IEEE VBU0706_CM_single 0 0 -10000.0 10000.0 ECU_ADDRESS 0x70011a96 /end MEASUREMENT
/begin MEASUREMENT TQO_facShftChangeLo "" FLOAT32_IEEE VBU0706_CM_single 0 0 0.0 1.0 ECU_ADDRESS 0x70011a8a /end MEASUREMENT
/begin MEASUREMENT TQO_facShft "" FLOAT32_IEEE VBU0706_CM_single 0 0 -3.4E+38 3.4E+38 ECU_ADDRESS 0x70011a86 /end MEASUREMENT
/begin MEASUREMENT TQDIS_trqRMotrDir "" FLOAT32_IEEE VBU0706_CM_single 0 0 -10000.0 10000.0 ECU_ADDRESS 0x70011a06 /end MEASUREMENT
/begin MEASUREMENT TQO_trqRMotr "" FLOAT32_IEEE VBU0706_CM_single 0 0 -10000.0 10000.0 ECU_ADDRESS 0x70011a92 /end MEASUREMENT
/begin MEASUREMENT TQARB_trqPreFnlRA "" FLOAT32_IEEE VBU0706_CM_single 0 0 -10000.0 10000.0 ECU_ADDRESS 0x7001199e /end MEASUREMENT
/begin MEASUREMENT TQARB_trqPreDisPropRA "" FLOAT32_IEEE VBU0706_CM_single 0 0 -10000.0 10000.0 ECU_ADDRESS 0x70011996 /end MEASUREMENT
/begin MEASUREMENT TQARB_trqPreDisRgnRA "" FLOAT32_IEEE VBU0706_CM_single 0 0 -10000.0 10000.0 ECU_ADDRESS 0x7001199a /end MEASUREMENT
/begin MEASUREMENT TQDIS_trqCrpBase "" FLOAT32_IEEE VBU0706_CM_single 0 0 -10000.0 10000.0 ECU_ADDRESS 0x700119d2 /end MEASUREMENT
/begin MEASUREMENT TQDIS_facBrkSlpCrp "" FLOAT32_IEEE VBU0706_CM_single 0 0 -3.4E+38 3.4E+38 ECU_ADDRESS 0x700119ba /end MEASUREMENT
/begin MEASUREMENT TQDIS_trqCrpIncFilter "" FLOAT32_IEEE VBU0706_CM_single 0 0 -10000.0 10000.0 ECU_ADDRESS 0x700119da /end MEASUREMENT
/begin MEASUREMENT TQDIS_trqIncBase "" FLOAT32_IEEE VBU0706_CM_single 0 0 -3.4E+38 3.4E+38 ECU_ADDRESS 0x700119e6 /end MEASUREMENT
/begin MEASUREMENT TQDIS_facIncGain "" FLOAT32_IEEE VBU0706_CM_single 0 0 -3.4E+38 3.4E+38 ECU_ADDRESS 0x700119be /end MEASUREMENT
/begin MEASUREMENT TQDIS_trqBase1RADrvIncLim "" FLOAT32_IEEE VBU0706_CM_single 0 0 -3.4E+38 3.4E+38 ECU_ADDRESS 0x700119ca /end MEASUREMENT
/begin MEASUREMENT TQDIS_facAccPedFilter "" FLOAT32_IEEE VBU0706_CM_single 0 0 -3.4E+38 3.4E+38 ECU_ADDRESS 0x700119ae /end MEASUREMENT
/begin MEASUREMENT TQDIS_facUnintdAcc "" FLOAT32_IEEE VBU0706_CM_single 0 0 -3.4E+38 3.4E+38 ECU_ADDRESS 0x700119c6 /end MEASUREMENT
/begin MEASUREMENT TQDIS_trqBase2RADrvIncLim "" FLOAT32_IEEE VBU0706_CM_single 0 0 -3.4E+38 3.4E+38 ECU_ADDRESS 0x700119ce /end MEASUREMENT
/begin MEASUREMENT TQDIS_facPwrLo "" FLOAT32_IEEE VBU0706_CM_single 0 0 -3.4E+38 3.4E+38 ECU_ADDRESS 0x700119c2 /end MEASUREMENT
/begin MEASUREMENT TQDIS_trqRADrvIncLim "" FLOAT32_IEEE VBU0706_CM_single 0 0 -10000.0 10000.0 ECU_ADDRESS 0x700119f2 /end MEASUREMENT
/begin MEASUREMENT TQDIS_trqRAIncLim "" FLOAT32_IEEE VBU0706_CM_single 0 0 -10000.0 10000.0 ECU_ADDRESS 0x700119f6 /end MEASUREMENT
/begin MEASUREMENT TQDIS_trqCrpDecFilter "" FLOAT32_IEEE VBU0706_CM_single 0 0 -10000.0 10000.0 ECU_ADDRESS 0x700119d6 /end MEASUREMENT
/begin MEASUREMENT TQDIS_facBrkDec "" FLOAT32_IEEE VBU0706_CM_single 0 0 -3.4E+38 3.4E+38 ECU_ADDRESS 0x700119b6 /end MEASUREMENT
/begin MEASUREMENT TQDIS_facBase2RADrvDecLim "" FLOAT32_IEEE VBU0706_CM_single 0 0 -3.4E+38 3.4E+38 ECU_ADDRESS 0x700119b2 /end MEASUREMENT
/begin MEASUREMENT TQDIS_trqRADrvDecLim "" FLOAT32_IEEE VBU0706_CM_single 0 0 -10000.0 10000.0 ECU_ADDRESS 0x700119ee /end MEASUREMENT
/begin MEASUREMENT TQDIS_trqRADecLim "" FLOAT32_IEEE VBU0706_CM_single 0 0 -10000.0 10000.0 ECU_ADDRESS 0x700119ea /end MEASUREMENT
/begin MEASUREMENT TQDIS_trqFltRA "" FLOAT32_IEEE VBU0706_CM_single 0 0 -10000.0 10000.0 ECU_ADDRESS 0x700119e2 /end MEASUREMENT
/begin MEASUREMENT TQDIS_trqDmpRA "" FLOAT32_IEEE VBU0706_CM_single 0 0 -3.4E+38 3.4E+38 ECU_ADDRESS 0x700119de /end MEASUREMENT
/begin MEASUREMENT EDIS_pwrDisChLimDynRaw "" FLOAT32_IEEE VBU0706_CM_single 0 0 0.0 1000.0 ECU_ADDRESS 0x70011592 /end MEASUREMENT
/begin MEASUREMENT EDIS_pwrDisChLimSTRaw "" FLOAT32_IEEE VBU0706_CM_single 0 0 0.0 1000.0 ECU_ADDRESS 0x7001159e /end MEASUREMENT
/begin MEASUREMENT EDIS_pwrDisChaDynCold "" FLOAT32_IEEE VBU0706_CM_single 0 0 0.0 1000.0 ECU_ADDRESS 0x700115a6 /end MEASUREMENT
/begin MEASUREMENT EDIS_pwrDisChaDynHot "" FLOAT32_IEEE VBU0706_CM_single 0 0 -3.4E+38 3.4E+38 ECU_ADDRESS 0x700115aa /end MEASUREMENT
/begin MEASUREMENT EDIS_pwrDisChaDynTempCorr "" FLOAT32_IEEE VBU0706_CM_single 0 0 0.0 1000.0 ECU_ADDRESS 0x700115ae /end MEASUREMENT
/begin MEASUREMENT EDIS_pwrDisChLimDynOvrride "" FLOAT32_IEEE VBU0706_CM_single 0 0 -3.4E+38 3.4E+38 ECU_ADDRESS 0x7001158e /end MEASUREMENT
/begin MEASUREMENT EDIS_pwrDisChLimDynST "" FLOAT32_IEEE VBU0706_CM_single 0 0 -3.4E+38 3.4E+38 ECU_ADDRESS 0x70011596 /end MEASUREMENT
/begin MEASUREMENT EDIS_facDchDynSp "" FLOAT32_IEEE VBU0706_CM_single 0 0 -3.4E+38 3.4E+38 ECU_ADDRESS 0x7001155e /end MEASUREMENT
/begin MEASUREMENT EDIS_pwrDisChSp "" FLOAT32_IEEE VBU0706_CM_single 0 0 0.0 1000.0 ECU_ADDRESS 0x700115a2 /end MEASUREMENT
/begin MEASUREMENT EDIS_pwrChLimLTRaw "" FLOAT32_IEEE VBU0706_CM_single 0 0 0.0 1000.0 ECU_ADDRESS 0x7001157e /end MEASUREMENT
/begin MEASUREMENT EDIS_pwrChLimDynRaw "" FLOAT32_IEEE VBU0706_CM_single 0 0 -3.4E+38 3.4E+38 ECU_ADDRESS 0x7001157a /end MEASUREMENT
/begin MEASUREMENT EDIS_pwrDisChLimLTRaw "" FLOAT32_IEEE VBU0706_CM_single 0 0 0.0 1000.0 ECU_ADDRESS 0x7001159a /end MEASUREMENT
/begin MEASUREMENT SOF_nbrDischargeVoltageCorrectLevel "" UBYTE VBU0706_CM_uint8 0 0 0 255 ECU_ADDRESS 0x70011eeb /end MEASUREMENT
/begin MEASUREMENT SOF_nbrChargeVoltageCorrectLevel "" UBYTE VBU0706_CM_uint8 0 0 0 255 ECU_ADDRESS 0x70011eea /end MEASUREMENT
/begin MEASUREMENT APD_stPedalSelect "" UBYTE VBU0706_CM_uint8 0 0 0.0 15.0 ECU_ADDRESS 0x70011cdd /end MEASUREMENT
/begin MEASUREMENT CGW_stVehCreepMode "" UBYTE VBU0706_CM_uint8 0 0 0.0 15.0 ECU_ADDRESS 0x70011d27 /end MEASUREMENT
/begin MEASUREMENT Gear_stCurrentGear "" UBYTE VBU0706_CM_uint8 0 0 0.0 15.0 ECU_ADDRESS 0x70011e13 /end MEASUREMENT
/begin MEASUREMENT Gear_stTargetGear "" UBYTE VBU0706_CM_uint8 0 0 0.0 15.0 ECU_ADDRESS 0x70011e15 /end MEASUREMENT
/begin MEASUREMENT Gear_stDriveIntendGearRawDigital "" UBYTE VBU0706_CM_uint8 0 0 0.0 15.0 ECU_ADDRESS 0x70011e14 /end MEASUREMENT
/begin MEASUREMENT LVC_stDCDCEnaResp "" UBYTE VBU0706_CM_uint8 0 0 0.0 255.0 ECU_ADDRESS 0x70011e4e /end MEASUREMENT
/begin MEASUREMENT LVC_stDCDCDisblResp "" UBYTE VBU0706_CM_uint8 0 0 0.0 255.0 ECU_ADDRESS 0x70011e4d /end MEASUREMENT
/begin MEASUREMENT SOF_flgCellDischargeDcirCalcValid "" UBYTE VBU0706_CM_boolean 0 0 0 1 ECU_ADDRESS 0x70011ee6 /end MEASUREMENT
/begin MEASUREMENT LbSOC_FastChargeCurrentStable_flg "" UBYTE VBU0706_CM_boolean 0 0 0 1 ECU_ADDRESS 0x70011e59 /end MEASUREMENT
/begin MEASUREMENT SPD_flgRARvs "" UBYTE VBU0706_CM_boolean 0 0 0.0 1.0 ECU_ADDRESS 0x70011ef0 /end MEASUREMENT
/begin MEASUREMENT Gear_flgSensorRawReqGearR "" UBYTE VBU0706_CM_boolean 0 0 0.0 1.0 ECU_ADDRESS 0x70011e10 /end MEASUREMENT
/begin MEASUREMENT Gear_flgSensorRawReqGearD "" UBYTE VBU0706_CM_boolean 0 0 0.0 1.0 ECU_ADDRESS 0x70011e0e /end MEASUREMENT
/begin MEASUREMENT Gear_flgSensorRawReqGearN "" UBYTE VBU0706_CM_boolean 0 0 0.0 1.0 ECU_ADDRESS 0x70011e0f /end MEASUREMENT
/begin MEASUREMENT Gear_flgRGearReqRawDigitalAction "" UBYTE VBU0706_CM_boolean 0 0 0.0 1.0 ECU_ADDRESS 0x70011e0d /end MEASUREMENT
/begin MEASUREMENT Gear_flgRGearReqRawDigital "" UBYTE VBU0706_CM_boolean 0 0 0.0 1.0 ECU_ADDRESS 0x70011e0c /end MEASUREMENT
/begin MEASUREMENT Gear_flgDGearReqRawDigitalAction "" UBYTE VBU0706_CM_boolean 0 0 0.0 1.0 ECU_ADDRESS 0x70011dfb /end MEASUREMENT
/begin MEASUREMENT Gear_flgDGearReqRawDigital "" UBYTE VBU0706_CM_boolean 0 0 0.0 1.0 ECU_ADDRESS 0x70011dfa /end MEASUREMENT
/begin MEASUREMENT Gear_flgNGearReqRawDigitalAction "" UBYTE VBU0706_CM_boolean 0 0 0 1 ECU_ADDRESS 0x70011e0a /end MEASUREMENT
/begin MEASUREMENT Gear_flgNGearReqRawDigital "" UBYTE VBU0706_CM_boolean 0 0 0 1 ECU_ADDRESS 0x70011e09 /end MEASUREMENT
/begin MEASUREMENT Gear_flgSensorWarningLT "" UBYTE VBU0706_CM_boolean 0 0 0.0 1.0 ECU_ADDRESS 0x70011e11 /end MEASUREMENT
/begin MEASUREMENT Gear_flgSensorWarningST "" UBYTE VBU0706_CM_boolean 0 0 0.0 1.0 ECU_ADDRESS 0x70011e12 /end MEASUREMENT
/begin MEASUREMENT Gear_flgGearWarningST "" UBYTE VBU0706_CM_boolean 0 0 0.0 1.0 ECU_ADDRESS 0x70011e07 /end MEASUREMENT
/begin MEASUREMENT Gear_flgGearWarningLT "" UBYTE VBU0706_CM_boolean 0 0 0.0 1.0 ECU_ADDRESS 0x70011e06 /end MEASUREMENT
/begin MEASUREMENT Gear_flgDftGearWarningDigital "" UBYTE VBU0706_CM_boolean 0 0 0.0 1.0 ECU_ADDRESS 0x70011dfd /end MEASUREMENT
/begin MEASUREMENT Gear_flgDftGearPlausibilityDigital "" UBYTE VBU0706_CM_boolean 0 0 0.0 1.0 ECU_ADDRESS 0x70011dfc /end MEASUREMENT
/begin MEASUREMENT Gear_flgPlausibilityForce2NDigital "" UBYTE VBU0706_CM_boolean 0 0 0.0 1.0 ECU_ADDRESS 0x70011e0b /end MEASUREMENT
/begin MEASUREMENT Gear_flgNGearReq "" UBYTE VBU0706_CM_boolean 0 0 0 1 ECU_ADDRESS 0x70011e08 /end MEASUREMENT
/begin MEASUREMENT Gear_flgBrkPressed4GearR "" UBYTE VBU0706_CM_boolean 0 0 0.0 1.0 ECU_ADDRESS 0x70011df8 /end MEASUREMENT
/begin MEASUREMENT Gear_flgGearWarnRNoBrake "" UBYTE VBU0706_CM_boolean 0 0 0.0 1.0 ECU_ADDRESS 0x70011e04 /end MEASUREMENT
/begin MEASUREMENT Gear_flgGearWarnRNoReady "" UBYTE VBU0706_CM_boolean 0 0 0.0 1.0 ECU_ADDRESS 0x70011e05 /end MEASUREMENT
/begin MEASUREMENT Gear_flgGearWarnD2RFailure "" UBYTE VBU0706_CM_boolean 0 0 0.0 1.0 ECU_ADDRESS 0x70011e01 /end MEASUREMENT
/begin MEASUREMENT Gear_flgGearRShiftReq "" UBYTE VBU0706_CM_boolean 0 0 0.0 1.0 ECU_ADDRESS 0x70011dff /end MEASUREMENT
/begin MEASUREMENT Gear_flgGearWarnDNoReady "" UBYTE VBU0706_CM_boolean 0 0 0.0 1.0 ECU_ADDRESS 0x70011e02 /end MEASUREMENT
/begin MEASUREMENT Gear_flgGearWarnR2DFailure "" UBYTE VBU0706_CM_boolean 0 0 0.0 1.0 ECU_ADDRESS 0x70011e03 /end MEASUREMENT
/begin MEASUREMENT Gear_flgBrkPressed4GearD "" UBYTE VBU0706_CM_boolean 0 0 0.0 1.0 ECU_ADDRESS 0x70011df7 /end MEASUREMENT
/begin MEASUREMENT Gear_flgGearDShiftReq "" UBYTE VBU0706_CM_boolean 0 0 0.0 1.0 ECU_ADDRESS 0x70011dfe /end MEASUREMENT
/begin MEASUREMENT MTQL_flgRMotrInhbt "" UBYTE VBU0706_CM_boolean 0 0 0.0 1.0 ECU_ADDRESS 0x70011e73 /end MEASUREMENT
/begin MEASUREMENT TQDMP_flgTipInEnaRA "" UBYTE VBU0706_CM_boolean 0 0 0.0 1.0 ECU_ADDRESS 0x70011f10 /end MEASUREMENT
/begin MEASUREMENT TQDMP_flgTipOutEnaRA "" UBYTE VBU0706_CM_boolean 0 0 0.0 1.0 ECU_ADDRESS 0x70011f11 /end MEASUREMENT
/begin MEASUREMENT TQDMP_flgSpdHldR "" UBYTE VBU0706_CM_boolean 0 0 0.0 1.0 ECU_ADDRESS 0x70011f0f /end MEASUREMENT
/begin MEASUREMENT TQDMP_flgROTCActRA "" UBYTE VBU0706_CM_boolean 0 0 0.0 1.0 ECU_ADDRESS 0x70011f0e /end MEASUREMENT
/begin MEASUREMENT TQO_flgShftRD "" UBYTE VBU0706_CM_boolean 0 0 0.0 1.0 ECU_ADDRESS 0x70011f18 /end MEASUREMENT
/begin MEASUREMENT TQCMP_flgPulseTrig "" UBYTE VBU0706_CM_boolean 0 0 0.0 1.0 ECU_ADDRESS 0x70011f0b /end MEASUREMENT
/begin MEASUREMENT TQCMP_flgShftOn "" UBYTE VBU0706_CM_boolean 0 0 0.0 1.0 ECU_ADDRESS 0x70011f0c /end MEASUREMENT
/begin MEASUREMENT TQDIS_flgCrp "" UBYTE VBU0706_CM_boolean 0 0 0.0 1.0 ECU_ADDRESS 0x70011f0d /end MEASUREMENT
/begin MEASUREMENT PMM_flgHVClReqSrcRising "" UBYTE VBU0706_CM_boolean 0 0 0 1 ECU_ADDRESS 0x70011e9c /end MEASUREMENT
/begin MEASUREMENT PMM_flgCtlSht "" UBYTE VBU0706_CM_boolean 0 0 0 1 ECU_ADDRESS 0x70011e98 /end MEASUREMENT
/begin MEASUREMENT PMM_flgRutnOffReq "" UBYTE VBU0706_CM_boolean 0 0 0 1 ECU_ADDRESS 0x70011eb1 /end MEASUREMENT
/begin MEASUREMENT PMM_flgVehAllwOp "" UBYTE VBU0706_CM_boolean 0 0 0 1 ECU_ADDRESS 0x70011eb6 /end MEASUREMENT
/begin MEASUREMENT PMM_flgHVRly "" UBYTE VBU0706_CM_boolean 0 0 0 1 ECU_ADDRESS 0x70011ea3 /end MEASUREMENT
/begin MEASUREMENT PMM_flgInhinPwrUp "" UBYTE VBU0706_CM_boolean 0 0 0 1 ECU_ADDRESS 0x70011eaa /end MEASUREMENT
/begin MEASUREMENT PMM_flgHVRlyOpReqToHVRlyClReq "" UBYTE VBU0706_CM_boolean 0 0 0 1 ECU_ADDRESS 0x70011ea8 /end MEASUREMENT
/begin MEASUREMENT PMM_flgHVClReqOn "" UBYTE VBU0706_CM_boolean 0 0 0 1 ECU_ADDRESS 0x70011e9b /end MEASUREMENT
/begin MEASUREMENT PMM_flgDCDCDisblToHVRlyOpReq "" UBYTE VBU0706_CM_boolean 0 0 0 1 ECU_ADDRESS 0x70011e99 /end MEASUREMENT
/begin MEASUREMENT PMM_flgOffLoadToHVRlyCld "" UBYTE VBU0706_CM_boolean 0 0 0 1 ECU_ADDRESS 0x70011ead /end MEASUREMENT
/begin MEASUREMENT PMM_flgHVRlyOpReqToActvDisCh "" UBYTE VBU0706_CM_boolean 0 0 0 1 ECU_ADDRESS 0x70011ea7 /end MEASUREMENT
/begin MEASUREMENT PMM_flgHVRlyClReqToActvDisCh "" UBYTE VBU0706_CM_boolean 0 0 0 1 ECU_ADDRESS 0x70011ea4 /end MEASUREMENT
/begin MEASUREMENT PMM_flgHVRlyCldToOffLoad "" UBYTE VBU0706_CM_boolean 0 0 0 1 ECU_ADDRESS 0x70011ea6 /end MEASUREMENT
/begin MEASUREMENT PMM_flgHVRlyClReqToHVRlyCld "" UBYTE VBU0706_CM_boolean 0 0 0 1 ECU_ADDRESS 0x70011ea5 /end MEASUREMENT
/begin MEASUREMENT PMM_flgActvDisChToHVRlyClReq "" UBYTE VBU0706_CM_boolean 0 0 0 1 ECU_ADDRESS 0x70011e96 /end MEASUREMENT
/begin MEASUREMENT PMM_flgShtDwnToInit "" UBYTE VBU0706_CM_boolean 0 0 0 1 ECU_ADDRESS 0x70011eb4 /end MEASUREMENT
/begin MEASUREMENT PMM_flgInitToHVRlyClReq "" UBYTE VBU0706_CM_boolean 0 0 0 1 ECU_ADDRESS 0x70011eab /end MEASUREMENT
/begin MEASUREMENT PMM_flgOffLoadToHVRlyOpReq "" UBYTE VBU0706_CM_boolean 0 0 0 1 ECU_ADDRESS 0x70011eae /end MEASUREMENT
/begin MEASUREMENT PMM_flgActvDisChToShtDwn "" UBYTE VBU0706_CM_boolean 0 0 0 1 ECU_ADDRESS 0x70011e97 /end MEASUREMENT
/begin MEASUREMENT PMM_flgWkup1Cmd "" UBYTE VBU0706_CM_boolean 0 0 0 1 ECU_ADDRESS 0x70011eb8 /end MEASUREMENT
/begin MEASUREMENT PMM_flgVCUShtDwn "" UBYTE VBU0706_CM_boolean 0 0 0 1 ECU_ADDRESS 0x70011eb5 /end MEASUREMENT
/begin MEASUREMENT EDIS_flgVehSpdLow "" UBYTE VBU0706_CM_boolean 0 0 0.0 1.0 ECU_ADDRESS 0x70011db0 /end MEASUREMENT
/begin MEASUREMENT EDIS_flgPowDisChToSTLim "" UBYTE VBU0706_CM_boolean 0 0 0.0 1.0 ECU_ADDRESS 0x70011daf /end MEASUREMENT
/begin MEASUREMENT EcSOF_LowVoltageState_flg "" UBYTE VBU0706_CM_boolean 0 0 0 1 ECU_ADDRESS 0x70011dd7 /end MEASUREMENT
/begin COMPU_METHOD VBU0706_CM_single_cnt "Q = V" RAT_FUNC "%8.6" "cnt" COEFFS 0 1 0 0 0 1 /end COMPU_METHOD
/begin COMPU_METHOD VBU0706_CM_uint16_cnt "Q = V" RAT_FUNC "%5.0" "cnt" COEFFS 0 1 0 0 0 1 /end COMPU_METHOD
/begin COMPU_METHOD VBU0706_CM_single_Nm "Q = V" RAT_FUNC "%8.6" "Nm" COEFFS 0 1 0 0 0 1 /end COMPU_METHOD
/begin COMPU_METHOD VBU0706_CM_single_kph "Q = V" RAT_FUNC "%8.6" "kph" COEFFS 0 1 0 0 0 1 /end COMPU_METHOD
/begin COMPU_METHOD VBU0706_CM_single_pct "Q = V" RAT_FUNC "%8.6" "pct" COEFFS 0 1 0 0 0 1 /end COMPU_METHOD
/begin COMPU_METHOD VBU0706_CM_single_fac "Q = V" RAT_FUNC "%8.6" "fac" COEFFS 0 1 0 0 0 1 /end COMPU_METHOD
/begin COMPU_METHOD VBU0706_CM_single_phi "Q = V" RAT_FUNC "%8.6" "phi" COEFFS 0 1 0 0 0 1 /end COMPU_METHOD
/begin COMPU_METHOD VBU0706_CM_uint8 "Q = V" RAT_FUNC "%3.0" "" COEFFS 0 1 0 0 0 1 /end COMPU_METHOD
/begin COMPU_METHOD VBU0706_CM_single_kw "Q = V" RAT_FUNC "%8.6" "kw" COEFFS 0 1 0 0 0 1 /end COMPU_METHOD
/begin COMPU_METHOD VBU0706_CM_single "Q = V" RAT_FUNC "%8.6" "" COEFFS 0 1 0 0 0 1 /end COMPU_METHOD
/begin COMPU_METHOD VBU0706_CM_single_kW "Q = V" RAT_FUNC "%8.6" "kW" COEFFS 0 1 0 0 0 1 /end COMPU_METHOD
/begin COMPU_METHOD VBU0706_CM_uint32_cnt "Q = V" RAT_FUNC "%10.0" "cnt" COEFFS 0 1 0 0 0 1 /end COMPU_METHOD
/begin COMPU_METHOD VBU0706_CM_boolean_flg "Q = V" RAT_FUNC "%1.0" "flg" COEFFS 0 1 0 0 0 1 /end COMPU_METHOD
/begin COMPU_METHOD VBU0706_CM_boolean "Q = V" RAT_FUNC "%1.0" "" COEFFS 0 1 0 0 0 1 /end COMPU_METHOD
/begin COMPU_METHOD VBU0706_CM_boolean_cnt "Q = V" RAT_FUNC "%1.0" "cnt" COEFFS 0 1 0 0 0 1 /end COMPU_METHOD
/begin COMPU_METHOD VBU0706_CM_uint8_cnt "Q = V" RAT_FUNC "%3.0" "cnt" COEFFS 0 1 0 0 0 1 /end COMPU_METHOD
/begin COMPU_METHOD VBU0706_CM_uint32 "Q = V" RAT_FUNC "%10.0" "" COEFFS 0 1 0 0 0 1 /end COMPU_METHOD
/begin GROUP S3607_Wakeup "VBU0706/Task_10ms/Subsystem/VCU /PMM/PMM_Ctrl/PMM/LvWakeUp_Ctrl/LvWakeUp_State_Calc/Wakeup"
 /begin REF_CHARACTERISTIC PMM_flgVCUShtDwnOvrdSwt_C PMM_flgVCUShtDwnOvrdVal_C PMM_flgWkup1CmdOvrdSwt_C PMM_flgWkup1CmdOvrdVal_C PMM_tiDlyVCUSwtOff_C PMM_tiDlyWkup1Cmd_SY /end REF_CHARACTERISTIC
 /begin REF_MEASUREMENT PMM_flgVCUShtDwn PMM_flgWkup1Cmd /end REF_MEASUREMENT
/end GROUP
/begin GROUP S3656_CtrlSht "VBU0706/Task_10ms/Subsystem/VCU /PMM/PMM_Ctrl/PMM/PwrMod_Ctrl/PwrMod_PowerUp/CtrlSht" /begin REF_MEASUREMENT PMM_flgCtlSht /end REF_MEASUREMENT /end GROUP
/begin GROUP S3656_HVClReqSrc "VBU0706/Task_10ms/Subsystem/VCU /PMM/PMM_Ctrl/PMM/PwrMod_Ctrl/PwrMod_PowerUp/HVClReqSrc"
 /begin REF_CHARACTERISTIC PMM_pctBrkPos4HV_C PMM_stDCHInitSts_SY PMM_stDCHShtDwnSts_SY PMM_tiDlyHVRlyReqCC2_C PMM_tiDlyIgnOnHVReq_C /end REF_CHARACTERISTIC
 /begin REF_MEASUREMENT PMM_flgHVClReqSrcRising /end REF_MEASUREMENT
/end GROUP
/begin GROUP S3656_OllLoad "VBU0706/Task_10ms/Subsystem/VCU /PMM/PMM_Ctrl/PMM/PwrMod_Ctrl/PwrMod_PowerUp/OllLoad"
 /begin REF_CHARACTERISTIC PMM_iCtlShtDwnOffLoad_C PMM_iEmgShtDwnOffLoad_C PMM_iNrmlShtDwnOffLoad_C PMM_tiCtlShtDwnOffLoad_C PMM_tiDCHShtDwnOffLoad_C PMM_tiEmgShtDwnOffLoad_C PMM_tiNrmlShtDwnOffLoad_C /end REF_CHARACTERISTIC
/end GROUP
/begin GROUP S3656_VehStsJudgement "VBU0706/Task_10ms/Subsystem/VCU /PMM/PMM_Ctrl/PMM/PwrMod_Ctrl/PwrMod_PowerUp/VehStsJudgement" /begin REF_CHARACTERISTIC PMM_vMaxSpdShtDwn_C PMM_vMinSpdShtDwn_C /end REF_CHARACTERISTIC
 /begin REF_MEASUREMENT PMM_flgHVRly PMM_flgInhinPwrUp PMM_flgRutnOffReq PMM_flgVehAllwOp /end REF_MEASUREMENT
/end GROUP
/begin GROUP S3656_stateflowcondition "VBU0706/Task_10ms/Subsystem/VCU /PMM/PMM_Ctrl/PMM/PwrMod_Ctrl/PwrMod_PowerUp/stateflowcondition" /begin SUB_GROUP S3666_Turn_On_Delay_Time S3666_Turn_On_Delay_Time1 /end SUB_GROUP
 /begin REF_CHARACTERISTIC PMM_stDCDCWrking_SY PMM_tiDlyHVClReqSrcOff_C PMM_tiDlyOffLoadCnfrm_C PMM_tiInitToHVRlyClReq_C PMM_uActvDisChVltg_C /end REF_CHARACTERISTIC
 /begin REF_MEASUREMENT PMM_flgActvDisChToHVRlyClReq PMM_flgActvDisChToShtDwn PMM_flgDCDCDisblToHVRlyOpReq PMM_flgHVClReqOn PMM_flgHVRlyClReqToActvDisCh PMM_flgHVRlyClReqToHVRlyCld PMM_flgHVRlyCldToOffLoad PMM_flgHVRlyOpReqToActvDisCh PMM_flgHVRlyOpReqToHVRlyClReq PMM_flgOffLoadToHVRlyCld PMM_flgShtDwnToInit /end REF_MEASUREMENT
/end GROUP
/begin GROUP S3658_PwrUpRoutine "VBU0706/Task_10ms/Subsystem/VCU /PMM/PMM_Ctrl/PMM/PwrMod_Ctrl/Routine/PwrUpRoutine" /begin REF_CHARACTERISTIC DIAGS_stPsvRespAlreadyOk_SY PMM_tiDlyPwrUpNokResp_C /end REF_CHARACTERISTIC /end GROUP
/begin GROUP S3658_Routine_PwrDwn "VBU0706/Task_10ms/Subsystem/VCU /PMM/PMM_Ctrl/PMM/PwrMod_Ctrl/Routine/Routine_PwrDwn" /begin REF_CHARACTERISTIC DIAGS_stPsvRespAlreadyOk_SY PMM_uActvDisChVltg_C /end REF_CHARACTERISTIC /end GROUP
/begin GROUP S3727_Front "VBU0706/Task_10ms/Subsystem/VCU /SPD/SPD/SignalProcessing_10ms/Subsystem1/v_Axle/Front" /begin REF_MEASUREMENT SPD_vFA /end REF_MEASUREMENT /end GROUP
/begin GROUP S3727_Rear "VBU0706/Task_10ms/Subsystem/VCU /SPD/SPD/SignalProcessing_10ms/Subsystem1/v_Axle/Rear" /begin REF_MEASUREMENT SPD_vRA /end REF_MEASUREMENT /end GROUP
/begin GROUP S3730_SR_Flip_Flop "VBU0706/Task_10ms/Subsystem/VCU /SPD/SPD/SignalProcessing_10ms/VehDir/RearWhl/SR_Flip_Flop" /begin REF_MEASUREMENT SPD_flgRARvs /end REF_MEASUREMENT /end GROUP
/begin GROUP S3732_First_Order_Low_Pass_Filter "VBU0706/Task_10ms/Subsystem/VCU /SPD/SPD/SignalProcessing_10ms/VehSpdNorm/Normal_VehSpdCal/First_Order_Low_Pass_Filter" /begin REF_MEASUREMENT SPD_vVehSpd /end REF_MEASUREMENT /end GROUP
/begin GROUP S3898_SignalProcess "VBU0706/Task_10ms/Subsystem/VCU /TQO/TQOAll/TQARB/TQARB/TrqArb/SignalProcess" /begin REF_CHARACTERISTIC TQARB_flgTrqCompSwitch_C /end REF_CHARACTERISTIC
 /begin REF_MEASUREMENT TQARB_trqPreDisPropRA TQARB_trqPreDisRgnRA TQARB_trqPreFnlRA /end REF_MEASUREMENT
/end GROUP
/begin GROUP S3903_PulseTime "VBU0706/Task_10ms/Subsystem/VCU /TQO/TQOAll/TQCMP/TQCMP/TrqPulse/PulseTime" /begin REF_CHARACTERISTIC TQCMP_tiPulseThd_C /end REF_CHARACTERISTIC /end GROUP
/begin GROUP S3903_PulseTrig "VBU0706/Task_10ms/Subsystem/VCU /TQO/TQOAll/TQCMP/TQCMP/TrqPulse/PulseTrig" /begin REF_CHARACTERISTIC TQCMP_pBrkCrpOffThd_C /end REF_CHARACTERISTIC /begin REF_MEASUREMENT TQCMP_flgPulseTrig TQCMP_flgShftOn /end REF_MEASUREMENT /end GROUP
/begin GROUP S3903_PulseTrq "VBU0706/Task_10ms/Subsystem/VCU /TQO/TQOAll/TQCMP/TQCMP/TrqPulse/PulseTrq" /begin REF_CHARACTERISTIC TQCMP_stPulseRAEna_CUR_v TQCMP_trqPulse_CUR_v /end REF_CHARACTERISTIC /end GROUP
/begin GROUP S3912_DmpFilter "VBU0706/Task_10ms/Subsystem/VCU /TQO/TQOAll/TQDIS/TQDIS/Dmp/DmpFilter"
 /begin REF_CHARACTERISTIC TQDIS_facAccDmpFilterRA_MAP_v TQDIS_facDenRA2_CUR_x TQDIS_facDenRA_CUR_x TQDIS_facNumRA2_CUR_x TQDIS_facNumRA_CUR_x TQDIS_facSpdDmpFilterRA_MAP_v TQDIS_flgDMPByPass_C TQDIS_flgDmpFilterRA2_C TQDIS_trqDmpDeadZone_C TQDIS_trqNumDenThdRA_C /end REF_CHARACTERISTIC
 /begin REF_MEASUREMENT TQDIS_trqDmpRA /end REF_MEASUREMENT
/end GROUP
/begin GROUP S3913_Arb "VBU0706/Task_10ms/Subsystem/VCU /TQO/TQOAll/TQDIS/TQDIS/TrqFilter/Arb"
 /begin REF_CHARACTERISTIC TQDIS_trqRADecMax_C TQDIS_trqRADecMin_C TQDIS_trqRAIncMax_C TQDIS_trqRAIncMin_C /end REF_CHARACTERISTIC
 /begin REF_MEASUREMENT TQDIS_trqRADecLim TQDIS_trqRAIncLim /end REF_MEASUREMENT
/end GROUP
/begin GROUP S3913_DrvLim "VBU0706/Task_10ms/Subsystem/VCU /TQO/TQOAll/TQDIS/TQDIS/TrqFilter/DrvLim" /begin SUB_GROUP S3926_AccPdlIdl S3926_Creep S3926_RADrvDec S3926_RADrvInc /end SUB_GROUP /end GROUP
/begin GROUP S3913_Subsystem "VBU0706/Task_10ms/Subsystem/VCU /TQO/TQOAll/TQDIS/TQDIS/TrqFilter/Subsystem" /begin REF_MEASUREMENT TQDIS_trqFltRA /end REF_MEASUREMENT /end GROUP
/begin GROUP S3949_CalcSpdHiFre "VBU0706/Task_10ms/Subsystem/VCU /TQO/TQOAll/TQDMP/TQDMP/RAROTC/CalcSpdHiFre"
 /begin REF_CHARACTERISTIC TQDMP_facRAV2N_C TQDMP_flgLowFilterDnRA_C TQDMP_nRPMHysRA_C TQDMP_tiCalcChgLeadFilRA_C TQO_ti10ms_SY /end REF_CHARACTERISTIC
 /begin REF_MEASUREMENT TQDMP_dnMotrR /end REF_MEASUREMENT
/end GROUP
/begin GROUP S3949_Foreback "VBU0706/Task_10ms/Subsystem/VCU /TQO/TQOAll/TQDMP/TQDMP/RAROTC/Foreback"
 /begin REF_CHARACTERISTIC TQDMP_facDenRA_CUR_x TQDMP_facNumRA_CUR_x TQDMP_pctDmpDisbThd_C TQDMP_trqDmpEnaThdRA_C TQDMP_trqNumDenThdRA_C /end REF_CHARACTERISTIC
 /begin REF_MEASUREMENT TQDMP_trqDmpRA /end REF_MEASUREMENT
/end GROUP
/begin GROUP S3949_ROTCArbRA "VBU0706/Task_10ms/Subsystem/VCU /TQO/TQOAll/TQDMP/TQDMP/RAROTC/ROTCArbRA" /begin REF_CHARACTERISTIC TQDMP_flgRAVCUDmpEna_C /end REF_CHARACTERISTIC /begin REF_MEASUREMENT TQDMP_trqCompRA0 /end REF_MEASUREMENT /end GROUP
/begin GROUP S3949_ROTCConidtion "VBU0706/Task_10ms/Subsystem/VCU /TQO/TQOAll/TQDMP/TQDMP/RAROTC/ROTCConidtion"
 /begin SUB_GROUP S3955_ConditionRAArb S3955_SpeedHoldEnableRA S3955_TipInRA S3955_TipOutRA S3955_TipinEnaRA S3955_TipoutEnaRA S3955_VrtlRA /end SUB_GROUP
/end GROUP
/begin GROUP S3949_TorqueCal "VBU0706/Task_10ms/Subsystem/VCU /TQO/TQOAll/TQDMP/TQDMP/RAROTC/TorqueCal" /begin SUB_GROUP S3956_CompensationPhase S3956_DeltaTrqArb S3956_TorqueLim /end SUB_GROUP /end GROUP
/begin GROUP S3990_ShftChange "VBU0706/Task_10ms/Subsystem/VCU /TQO/TQOAll/TQO/TQO/MotorTorque/ShftChange"
 /begin REF_CHARACTERISTIC TQO_facShftChangeHi_CUR_v TQO_facShftChangeLo_CUR_v TQO_facShftChangeSlope_CUR_v /end REF_CHARACTERISTIC
 /begin REF_MEASUREMENT TQO_facShftChangeLo TQO_flgShftRD /end REF_MEASUREMENT
/end GROUP
/begin GROUP S3990_Subsystem "VBU0706/Task_10ms/Subsystem/VCU /TQO/TQOAll/TQO/TQO/MotorTorque/Subsystem" /begin SUB_GROUP S3995_GradientLimiter /end SUB_GROUP /begin REF_MEASUREMENT TQDIS_trqRMotrDir TQO_trqRMotr /end REF_MEASUREMENT /end GROUP
/begin GROUP S3991_VirtualAPD "VBU0706/Task_10ms/Subsystem/VCU /TQO/TQOAll/TQO/TQO/Subsystem/VirtualAPD" /begin REF_CHARACTERISTIC TQO_trqPTMax_C /end REF_CHARACTERISTIC /end GROUP
/begin GROUP S3992_TrqProtect "VBU0706/Task_10ms/Subsystem/VCU /TQO/TQOAll/TQO/TQO/Trq/TrqProtect" /begin SUB_GROUP S3998_DecGradienLimiter /end SUB_GROUP
 /begin REF_CHARACTERISTIC TQO_trqBrk_MAP_v TQO_trqPTMax_C TQO_trqRARgnMin_C TQO_trqSftyDec_C /end REF_CHARACTERISTIC
 /begin REF_MEASUREMENT TQO_trqSftyRA /end REF_MEASUREMENT
/end GROUP
/begin GROUP S4008_FIDTrqLim "VBU0706/Task_10ms/Subsystem/VCU /VTQA/Subsystem/Subsystem/MTrqLim/TrqCapacityLim/FIDTrqLim" /begin REF_MEASUREMENT MTQL_trqRMotrFIDDrvLim /end REF_MEASUREMENT /end GROUP
/begin GROUP S4008_Motor_Inhibit "VBU0706/Task_10ms/Subsystem/VCU /VTQA/Subsystem/Subsystem/MTrqLim/TrqCapacityLim/Motor_Inhibit" /begin REF_CHARACTERISTIC SYS_stMCUErr_SY /end REF_CHARACTERISTIC /begin REF_MEASUREMENT MTQL_flgRMotrInhbt /end REF_MEASUREMENT /end GROUP
/begin GROUP S4008_VehicleSpeedLim "VBU0706/Task_10ms/Subsystem/VCU /VTQA/Subsystem/Subsystem/MTrqLim/TrqCapacityLim/VehicleSpeedLim" /begin REF_CHARACTERISTIC MTQL_trqVehSpdLimNormRMot_MAP_v /end REF_CHARACTERISTIC /begin REF_MEASUREMENT MTQL_trqVehSpdDrvLimR /end REF_MEASUREMENT /end GROUP
/begin GROUP S4008_dnLim "VBU0706/Task_10ms/Subsystem/VCU /VTQA/Subsystem/Subsystem/MTrqLim/TrqCapacityLim/dnLim" /begin REF_CHARACTERISTIC MTQL_trqWhlRLim_CUR_v /end REF_CHARACTERISTIC /begin REF_MEASUREMENT MTQL_trqDnAbsLimR /end REF_MEASUREMENT /end GROUP
/begin GROUP S4017_AxleTrq_Limit_Calc "VBU0706/Task_10ms/Subsystem/VCU /VTQA/Subsystem/Subsystem/VehTrqArb/BattLim_Transfer/AxleTrq_Limit_Calc"
 /begin REF_CHARACTERISTIC VTQA_facActDrvPwrFltr_C VTQA_facActRgnPwrFltr_C VTQA_facMotorAvgFltr_C VTQA_facMtrDrvPwrUpLim_MAP_v VTQA_flgActDrvTrqLimORF VTQA_flgActRgnTrqLimORF VTQA_trqActDrvLoLim_C VTQA_trqActDrvTrqLimORV VTQA_trqActDrvUpLim_C VTQA_trqActRgnLoLim_C VTQA_trqActRgnTrqLimORV VTQA_trqActRgnUpLim_C /end REF_CHARACTERISTIC
 /begin REF_MEASUREMENT VTQA_trqActDrvTrqLim VTQA_trqActRgnTrqLim /end REF_MEASUREMENT
/end GROUP
/begin GROUP S4017_Motor_PwrLoss_Calc "VBU0706/Task_10ms/Subsystem/VCU /VTQA/Subsystem/Subsystem/VehTrqArb/BattLim_Transfer/Motor_PwrLoss_Calc"
 /begin REF_CHARACTERISTIC VTQA_facVehSpd2MotSpd_C VTQA_pwrRMtrDrvPwrLoss_MAP_v VTQA_pwrRMtrRgnPwrLoss_MAP_v /end REF_CHARACTERISTIC
 /begin REF_MEASUREMENT VTQA_pwrRMotActDrvLoss VTQA_pwrRMotActRgnLoss VTQA_trqRMotrNeg VTQA_trqRMotrPos /end REF_MEASUREMENT
/end GROUP
/begin GROUP S4018_AlxeMax "VBU0706/Task_10ms/Subsystem/VCU /VTQA/Subsystem/Subsystem/VehTrqArb/Trq_Arb/AlxeMax"
 /begin REF_CHARACTERISTIC EPB_CompleteTight EPB_stApplying VTQA_flgAxleMaxORF VTQA_trqAxleMaxLimit_C VTQA_trqAxleMaxORV VTQA_trqAxleMax_CUR_v VTQA_trqBrkSwtTrqLim_C VTQA_trqBrk_MAP_v /end REF_CHARACTERISTIC
 /begin REF_MEASUREMENT VTQA_trqAxleMax VTQA_trqBattTrqMax VTQA_trqBcuTrqMax VTQA_trqBrkTrqMax VTQA_trqLimpByPmpTrqMax VTQA_trqLimpTrqMax VTQA_trqMotTrqMax /end REF_MEASUREMENT
/end GROUP
/begin GROUP S4018_AlxeMin "VBU0706/Task_10ms/Subsystem/VCU /VTQA/Subsystem/Subsystem/VehTrqArb/Trq_Arb/AlxeMin"
 /begin REF_CHARACTERISTIC VTQA_flgAxleMinORF VTQA_trqABSFailMin_C VTQA_trqAxleMinORV VTQA_trqAxleMin_C /end REF_CHARACTERISTIC
 /begin REF_MEASUREMENT VTQA_trqABSFailLimit VTQA_trqActvLimpLimit VTQA_trqAxleMin VTQA_trqBattTrqMin VTQA_trqInhibRegenLimit VTQA_trqMotTrqMin /end REF_MEASUREMENT
/end GROUP
/begin GROUP S4018_Arb "VBU0706/Task_10ms/Subsystem/VCU /VTQA/Subsystem/Subsystem/VehTrqArb/Trq_Arb/Arb" /begin REF_MEASUREMENT VTQA_trqDes /end REF_MEASUREMENT /end GROUP
/begin GROUP S4054_PedalPercentSelection "VBU0706/Task_10ms/Subsystem/VCU /VehINP/VehINP_Logic/APD/APD/Value_Selection/PedalPercentSelection"
 /begin REF_CHARACTERISTIC APD_facRecoveryFillter_C APD_pctIdlePedal_C APD_stSelectPedal1_C APD_stSelectPedal2_C APD_stSelectPedalDefault_C APD_stSelectPedalMin_C /end REF_CHARACTERISTIC
 /begin REF_MEASUREMENT APD_pctAPDbasic /end REF_MEASUREMENT
/end GROUP
/begin GROUP S4054_PedalSelection "VBU0706/Task_10ms/Subsystem/VCU /VehINP/VehINP_Logic/APD/APD/Value_Selection/PedalSelection"
 /begin REF_CHARACTERISTIC APD_flgSelectPedalORF APD_stSelectPedal1_C APD_stSelectPedal2_C APD_stSelectPedalDefault_C APD_stSelectPedalMin_C APD_stSelectPedalORV /end REF_CHARACTERISTIC
 /begin REF_MEASUREMENT APD_stPedalSelect /end REF_MEASUREMENT
/end GROUP
/begin GROUP S4088_Gear4DriveIntend "VBU0706/Task_10ms/Subsystem/VCU /VehINP/VehINP_Logic/GearShift/Gear1/Digital_Gear_D_R/Gear4DriveIntend"
 /begin REF_CHARACTERISTIC Gear_stDriveIntendGearD_C Gear_stDriveIntendGearInvalid_C Gear_stDriveIntendGearNeutral_C Gear_stDriveIntendGearR_C /end REF_CHARACTERISTIC
 /begin REF_MEASUREMENT Gear_stDriveIntendGearRawDigital /end REF_MEASUREMENT
/end GROUP
/begin GROUP S4088_Gear_Bit "VBU0706/Task_10ms/Subsystem/VCU /VehINP/VehINP_Logic/GearShift/Gear1/Digital_Gear_D_R/Gear_Bit" /begin SUB_GROUP S4101_SetBit2 /end SUB_GROUP /end GROUP
/begin GROUP S4088_Gear_DR_Req "VBU0706/Task_10ms/Subsystem/VCU /VehINP/VehINP_Logic/GearShift/Gear1/Digital_Gear_D_R/Gear_DR_Req"
 /begin SUB_GROUP S4102_Turn_On_Delay_Time S4102_Turn_On_Delay_Time1 S4102_Turn_On_Delay_Time2 /end SUB_GROUP
 /begin REF_CHARACTERISTIC Gear_tiGearES6DebounceCnt_C /end REF_CHARACTERISTIC
 /begin REF_MEASUREMENT Gear_flgDGearReqRawDigital Gear_flgNGearReqRawDigital Gear_flgRGearReqRawDigital /end REF_MEASUREMENT
/end GROUP
/begin GROUP S4088_Gear_DR_Warning "VBU0706/Task_10ms/Subsystem/VCU /VehINP/VehINP_Logic/GearShift/Gear1/Digital_Gear_D_R/Gear_DR_Warning" /begin SUB_GROUP S4103_Turn_On_Delay_Time S4103_Turn_On_Delay_Time1 /end SUB_GROUP
 /begin REF_CHARACTERISTIC Gear_tiGearWarningLTES6DebounceCnt_C Gear_tiGearWarningSTES6DebounceCnt_C /end REF_CHARACTERISTIC
 /begin REF_MEASUREMENT Gear_flgDftGearWarningDigital /end REF_MEASUREMENT
/end GROUP
/begin GROUP S4088_Gear_RawReq "VBU0706/Task_10ms/Subsystem/VCU /VehINP/VehINP_Logic/GearShift/Gear1/Digital_Gear_D_R/Gear_RawReq"
 /begin REF_CHARACTERISTIC Gear_stGearDValidBit1_C Gear_stGearNValid_C Gear_stGearRValidBit1_C /end REF_CHARACTERISTIC
 /begin REF_MEASUREMENT Gear_flgSensorRawReqGearD Gear_flgSensorRawReqGearN Gear_flgSensorRawReqGearR Gear_flgSensorWarningLT Gear_flgSensorWarningST /end REF_MEASUREMENT
/end GROUP
/begin GROUP S4088_Gear_Warning "VBU0706/Task_10ms/Subsystem/VCU /VehINP/VehINP_Logic/GearShift/Gear1/Digital_Gear_D_R/Gear_Warning" /begin SUB_GROUP S4105_SR_Flip_Flop1 /end SUB_GROUP
 /begin REF_CHARACTERISTIC Gear_cntGearPlausibilityDigitalDetect_C Gear_cntGearPlausibilityDigitalShiftFast_C /end REF_CHARACTERISTIC
 /begin REF_MEASUREMENT Gear_flgPlausibilityForce2NDigital /end REF_MEASUREMENT
/end GROUP
/begin GROUP S4096_Gear4Reset "VBU0706/Task_10ms/Subsystem/VCU /VehINP/VehINP_Logic/GearShift/Gear1/Gear_Status/Gear4Reset"
 /begin REF_CHARACTERISTIC Gear_stCurrentGearN_C Gear_stCurrentGearP_C Gear_tiGearResetHold_C /end REF_CHARACTERISTIC
/end GROUP
/begin GROUP S4096_Gear_DGear "VBU0706/Task_10ms/Subsystem/VCU /VehINP/VehINP_Logic/GearShift/Gear1/Gear_Status/Gear_DGear" /begin REF_CHARACTERISTIC Gear_stIntendGearD_C /end REF_CHARACTERISTIC /end GROUP
/begin GROUP S4096_Gear_DefaultGear "VBU0706/Task_10ms/Subsystem/VCU /VehINP/VehINP_Logic/GearShift/Gear1/Gear_Status/Gear_DefaultGear"
 /begin REF_CHARACTERISTIC Gear_stCurrentGearN_C Gear_stCurrentGearP_C Gear_tiDefaultGear2NTime_C Gear_tiDefaultGear2PTime_C /end REF_CHARACTERISTIC
/end GROUP
/begin GROUP S4096_Gear_DriverShiftDReq "VBU0706/Task_10ms/Subsystem/VCU /VehINP/VehINP_Logic/GearShift/Gear1/Gear_Status/Gear_DriverShiftDReq"
 /begin REF_CHARACTERISTIC Gear_stCurrentGearN_C Gear_stCurrentGearP_C Veh_flgLowSpdGearChange_C /end REF_CHARACTERISTIC
 /begin REF_MEASUREMENT Gear_flgBrkPressed4GearD Gear_flgGearDShiftReq Gear_flgGearWarnDNoReady Gear_flgGearWarnR2DFailure /end REF_MEASUREMENT
/end GROUP
/begin GROUP S4096_Gear_DriverShiftRReq "VBU0706/Task_10ms/Subsystem/VCU /VehINP/VehINP_Logic/GearShift/Gear1/Gear_Status/Gear_DriverShiftRReq"
 /begin REF_CHARACTERISTIC Gear_stCurrentGearN_C Gear_stCurrentGearP_C Veh_flgLowSpdGearChange_C /end REF_CHARACTERISTIC
 /begin REF_MEASUREMENT Gear_flgBrkPressed4GearR Gear_flgGearRShiftReq Gear_flgGearWarnD2RFailure Gear_flgGearWarnRNoBrake Gear_flgGearWarnRNoReady /end REF_MEASUREMENT
/end GROUP
/begin GROUP S4096_Gear_GearReq "VBU0706/Task_10ms/Subsystem/VCU /VehINP/VehINP_Logic/GearShift/Gear1/Gear_Status/Gear_GearReq" /begin SUB_GROUP S4149_SR_Flip_Flop2 /end SUB_GROUP
 /begin REF_CHARACTERISTIC Gear_tiGearDSustain_C Gear_tiGearInitSustain_C Gear_tiGearPSustain_C Gear_tiGearRSustain_C /end REF_CHARACTERISTIC
/end GROUP
/begin GROUP S4096_Gear_InitGear "VBU0706/Task_10ms/Subsystem/VCU /VehINP/VehINP_Logic/GearShift/Gear1/Gear_Status/Gear_InitGear"
 /begin REF_CHARACTERISTIC Gear_stCurrentGearN_C Gear_stCurrentGearP_C Gear_tiGearInitTime_C Gear_tiInitGear2NTime_C Gear_tiInitGear2PTime_C /end REF_CHARACTERISTIC
/end GROUP
/begin GROUP S4096_Gear_PGear "VBU0706/Task_10ms/Subsystem/VCU /VehINP/VehINP_Logic/GearShift/Gear1/Gear_Status/Gear_PGear"
 /begin REF_CHARACTERISTIC Gear_cntGearPTimeOut_C Gear_stCurrentGearN_C Gear_stCurrentGearP_C /end REF_CHARACTERISTIC
/end GROUP
/begin GROUP S4096_Gear_PGear1 "VBU0706/Task_10ms/Subsystem/VCU /VehINP/VehINP_Logic/GearShift/Gear1/Gear_Status/Gear_PGear1"
 /begin REF_CHARACTERISTIC Gear_stCurrentGearN_C Gear_stCurrentGearP_C Gear_stIntendGearN_C /end REF_CHARACTERISTIC
/end GROUP
/begin GROUP S4096_Gear_Powertrain "VBU0706/Task_10ms/Subsystem/VCU /VehINP/VehINP_Logic/GearShift/Gear1/Gear_Status/Gear_Powertrain" /begin REF_MEASUREMENT Gear_stCurrentGear Gear_stTargetGear /end REF_MEASUREMENT /end GROUP
/begin GROUP S4096_Gear_RGear "VBU0706/Task_10ms/Subsystem/VCU /VehINP/VehINP_Logic/GearShift/Gear1/Gear_Status/Gear_RGear" /begin REF_CHARACTERISTIC Gear_stIntendGearR_C /end REF_CHARACTERISTIC /end GROUP
/begin GROUP S4207_override_signal1 "VBU0706/Task_10ms/Subsystem/VCU /VehINP/VehINP_Logic/Mode/VehMode/Veh_CreepMode/override_signal1" /begin REF_MEASUREMENT CGW_stVehCreepMode /end REF_MEASUREMENT /end GROUP
/begin GROUP S4253_First_Order_Low_Pass_Filter "VBU0706/Task_10ms/Subsystem/VCU /VehINP/VehINP_Logic/VehINP_BPD/BPD_BrakePercent/BPD_PressBrake/First_Order_Low_Pass_Filter" /begin REF_MEASUREMENT INP_uBrkPresFlt1 /end REF_MEASUREMENT /end GROUP
/begin GROUP S4269_Veh_HVILCheck "VBU0706/Task_10ms/Subsystem/VCU /VehINP/VehINP_Logic/Veh_Status/VehHVIL/HVIL/Veh_HVILCheck"
 /begin REF_CHARACTERISTIC Veh_flgHVILCaliOvrdVal_C Veh_flgHVILCaliOvrd_C Veh_tiSampleTime_C Veh_tiVehHVILDebounceCnt_C Veh_vVehHVILDefaultSpd_C Veh_vVehHVILDft_C /end REF_CHARACTERISTIC
/end GROUP
/begin GROUP S4269_Veh_VCUHVIL "VBU0706/Task_10ms/Subsystem/VCU /VehINP/VehINP_Logic/Veh_Status/VehHVIL/HVIL/Veh_VCUHVIL"
 /begin REF_CHARACTERISTIC Veh_fHVILLe_C Veh_fHVILRi_C Veh_pctHVILLe_C Veh_pctHVILRi_C Veh_stErr_C Veh_stNoErr_C Veh_tiSampleTime_C Veh_tiVCUHVILDebounceCnt_C /end REF_CHARACTERISTIC
/end GROUP
/begin GROUP S339_Enabled_Subsystem "VBU0706/Function-Call Subsystem/Subsystem1/BCV/BCV/Subsystem/Calculate_BatteryCurrent/Correct_BatteryCurrent/Calculate_BatteryCurrent_ZeroDrift/Calculate_ExtremeData/Enabled_Subsystem" /begin SUB_GROUP S344_Calculate_Current_Sum /end SUB_GROUP /end GROUP
/begin GROUP S736_Determine_Accumulated_RemainingHeat "VBU0706/Function-Call Subsystem/Subsystem1/CTD/Subsystem/Subsystem4/PrechrgProcessMonitoring/Precharge_Thermal_Management/Determine_Precharge_JouleHeat/Determine_Accumulated_RemainingHeat/Determine_Accumulated_RemainingHeat" /begin REF_CHARACTERISTIC CcCTD_MaxAccumulatedHeadLoad_J /end REF_CHARACTERISTIC /begin REF_MEASUREMENT CTD_jAccumulatedAvaliableHeat /end REF_MEASUREMENT /end GROUP
/begin GROUP S1590_Delay_RisingEdge "VBU0706/Function-Call Subsystem/Subsystem1/SOC/Subsystem5/Subsystem/Determine_FastChargeCorrection_Soc/FastCharge_DynamicCorrection/FastCharge_DynamicCorrection_Enable/Determine_CurrentStable_Condition/Delay_RisingEdge" /begin REF_MEASUREMENT LbSOC_FastChargeCurrentStable_flg /end REF_MEASUREMENT /end GROUP
/begin GROUP S1604_FastCharge_TOCAdjustAllSOC "VBU0706/Function-Call Subsystem/Subsystem1/SOC/Subsystem5/Subsystem/Determine_FastChargeCorrection_Soc/FastCharge_PreCorrection/FastCharge_PreCorrectionMain/FastCharge_PreCorrectionVoltage/FastCharge_TOCAdjustAllSOC"
 /begin REF_CHARACTERISTIC CcSOC_FastChargePreCorrectionDeltaVolMax_mV CcSOC_FastChargePreCorrectionDeltaVolSOC_pct /end REF_CHARACTERISTIC
/end GROUP
/begin GROUP S1769_Calculate_SOH_Current_Limit "VBU0706/Function-Call Subsystem/Subsystem1/SOF/Subsystem6/Subsystem/Determine_Currentlimit_Target/Calculate_CurrentLimit_Target/Calculate_CurrentLimit_Base/Calculate_ContinuousChargeCurrent/Calculate_SOH_Current_Limit" /begin REF_CHARACTERISTIC CcSOF_BolSoh_pct CcSOF_EolSoh_pct /end REF_CHARACTERISTIC /begin REF_MEASUREMENT SOF_pctCurrentSOH /end REF_MEASUREMENT /end GROUP
/begin GROUP S1770_Calculate_SOH_Current_Limit "VBU0706/Function-Call Subsystem/Subsystem1/SOF/Subsystem6/Subsystem/Determine_Currentlimit_Target/Calculate_CurrentLimit_Target/Calculate_CurrentLimit_Base/Calculate_ContinuousDischargeCurrent/Calculate_SOH_Current_Limit" /begin REF_CHARACTERISTIC CcSOF_BolSoh_pct CcSOF_EolSoh_pct /end REF_CHARACTERISTIC /end GROUP
/begin GROUP S1771_Calculate_SOH_Current_Limit "VBU0706/Function-Call Subsystem/Subsystem1/SOF/Subsystem6/Subsystem/Determine_Currentlimit_Target/Calculate_CurrentLimit_Target/Calculate_CurrentLimit_Base/Calculate_ShortPulseChargeCurrent/Calculate_SOH_Current_Limit" /begin REF_CHARACTERISTIC CcSOF_BolSoh_pct CcSOF_EolSoh_pct /end REF_CHARACTERISTIC /end GROUP
/begin GROUP S1772_Calculate_SOH_Current_Limit "VBU0706/Function-Call Subsystem/Subsystem1/SOF/Subsystem6/Subsystem/Determine_Currentlimit_Target/Calculate_CurrentLimit_Target/Calculate_CurrentLimit_Base/Calculate_ShortPulseDischargeCurrent/Calculate_SOH_Current_Limit" /begin REF_CHARACTERISTIC CcSOF_BolSoh_pct CcSOF_EolSoh_pct /end REF_CHARACTERISTIC /end GROUP
/begin GROUP S1775_RS_FlipFlop_EEPROM "VBU0706/Function-Call Subsystem/Subsystem1/SOF/Subsystem6/Subsystem/Determine_Currentlimit_Target/Calculate_CurrentLimit_Target/Calculate_CurrentLimit_Base/Determine_LowVoltageLimitChargeCurrent/RS_FlipFlop_EEPROM" /begin REF_MEASUREMENT EcSOF_LowVoltageState_flg /end REF_MEASUREMENT /end GROUP
/begin GROUP S1814_Calculate_ChargeCurrentLimit_Buff "VBU0706/Function-Call Subsystem/Subsystem1/SOF/Subsystem6/Subsystem/Determine_Currentlimit_Target/Calculate_CurrentLimit_Target/Calculate_Dynamic_CurrentLimit/Calculate_Dynamic_ChargeCurrentLimit/Calculate_ChargeCurrentLimit_Buff"
 /begin SUB_GROUP S1816_Calculate_ChargeCurrentLimitBuffer_Full S1816_Calculate_ChargeCurrentLimitBuffer_Use /end SUB_GROUP
/end GROUP
/begin GROUP S1814_Calculate_Dynamic_ChargeCurrentLimit "VBU0706/Function-Call Subsystem/Subsystem1/SOF/Subsystem6/Subsystem/Determine_Currentlimit_Target/Calculate_CurrentLimit_Target/Calculate_Dynamic_CurrentLimit/Calculate_Dynamic_ChargeCurrentLimit/Calculate_Dynamic_ChargeCurrentLimit" /begin SUB_GROUP S1817_Buffer_Used /end SUB_GROUP /begin REF_MEASUREMENT SOF_iACalDynamicChgCurLimitFCCChk /end REF_MEASUREMENT /end GROUP
/begin GROUP S1815_Calculate_DischargeCurrentLimit_Buff "VBU0706/Function-Call Subsystem/Subsystem1/SOF/Subsystem6/Subsystem/Determine_Currentlimit_Target/Calculate_CurrentLimit_Target/Calculate_Dynamic_CurrentLimit/Calculate_Dynamic_DischargeCurrentLimit/Calculate_DischargeCurrentLimit_Buff"
 /begin SUB_GROUP S1824_Calculate_DischargeCurrentLimitBuffer_Full S1824_Calculate_DischargeCurrentLimitBuffer_Use /end SUB_GROUP
/end GROUP
/begin GROUP S1815_Calculate_Dynamic_DischargeCurrentLimit "VBU0706/Function-Call Subsystem/Subsystem1/SOF/Subsystem6/Subsystem/Determine_Currentlimit_Target/Calculate_CurrentLimit_Target/Calculate_Dynamic_CurrentLimit/Calculate_Dynamic_DischargeCurrentLimit/Calculate_Dynamic_DischargeCurrentLimit" /begin SUB_GROUP S1825_Rate_Limiter /end SUB_GROUP
 /begin REF_CHARACTERISTIC CcSOF_DischargeOverCurrentLimitFactor_n CcSOF_DischargeOverCurrentThresholdDec_As CcSOF_DischargeOverCurrentThresholdInc_As CcSOF_PowerOnOverCurFacSloDelay_ms /end REF_CHARACTERISTIC
 /begin REF_MEASUREMENT SOF_iADynamicDischargeCurrentLimitFastChrgChk /end REF_MEASUREMENT
/end GROUP
/begin GROUP S1835_Rate_Limiter_Reset "VBU0706/Function-Call Subsystem/Subsystem1/SOF/Subsystem6/Subsystem/Determine_Currentlimit_Target/Calculate_CurrentLimit_Target/CurrentLimit_FastCharge_Check/FastChrgOneThirdRateCurrentLimitCheck/Rate_Limiter_Reset" /begin REF_MEASUREMENT SOF_iAContinuousChargeCurrentLimitFastChrgChk /end REF_MEASUREMENT /end GROUP
/begin GROUP S1836_FastCharge "VBU0706/Function-Call Subsystem/Subsystem1/SOF/Subsystem6/Subsystem/Determine_Currentlimit_Target/Calculate_CurrentLimit_Target/CurrentLimit_FastCharge_Check/SegmentChargeCheck/FastCharge" /begin SUB_GROUP S1844_FastCharge_Calculation /end SUB_GROUP /end GROUP
/begin GROUP S1871_Calculate_CurrentLimit "VBU0706/Function-Call Subsystem/Subsystem1/SOF/Subsystem6/Subsystem/Determine_Currentlimit_Target/Calculate_CurrentLimit_Target/CurrentLimit_Voltage_Correct/Correct_CurrentLimit/Calculate_CurrentLimit"
 /begin SUB_GROUP S1873_BatteryVoltageAveCalculate S1873_Calculate_Cell_Discharge_DCIR S1873_Rate_Limiter1 S1873_Rate_Limiter_Reset /end SUB_GROUP
 /begin REF_CHARACTERISTIC CaSOF_DischargeDcirSocTempMapDimension_n CaSOF_DischargeDcirSocTempMapZ_mOhm CaSOF_DischargeOcvSocTempMapDimension_n CaSOF_DischargeOcvSocTempMapZ_V CaSOF_LowTempDischargeVoltageCorrectFactorMapY_n CaSOF_VoltageCorrectCellVoltMinMapY_V CaSOF_VoltageCorrectFactorChargeMapY_n CaSOF_VoltageCorrectFactorDischargeMapY_n CaSOF_VoltageCorrectFactorRegenMapY_n CbSOF_VoltageCorrectLevelEnable_flg CbSOF_VoltageTableCorrectUsePredictedCellVoltage_flg CcSOF_ChargeVoltageCorrectSlope_n CcSOF_DischargeVolCorCurrentSlopeDec_A CcSOF_DischargeVolCorCurrentSlopeInc_A CcSOF_DischargeVoltageCorrectSlope_n CcSOF_EnableCalculatedDcir_flg CcSOF_PowerOnVolCorCurtSloDelay_ms CcSOF_PowerOnVolCorFacSloDelay_ms CcSOF_UseCalculatedDcirTemp_C CcSOF_VoltageCorrectFactor0_n CcSOF_VoltageCorrectFactor1_n CcSOF_VoltageCorrectFactor2_n CcSOF_VoltageCorrectFactor3_n CcSOF_VoltageCorrectFactor4_n /end REF_CHARACTERISTIC
 /begin REF_MEASUREMENT SOF_iAContinuousChargeCurrentLimitVltgTarget SOF_iAContinuousDischargeCurrentLimitVltgTarget SOF_iADynamicChargeCurrentLimitVltgTarget SOF_iADynamicDischargeCurrentLimitVltgBefoTarget SOF_iADynamicDischargeCurrentLimitVltgTarget SOF_iAShortPulseChargeCurrentLimitVltgTarget SOF_iAShortPulseDischargeCurrentLimitVltgTarget /end REF_MEASUREMENT
/end GROUP
/begin GROUP S1871_Determine_VoltageCorrect_level "VBU0706/Function-Call Subsystem/Subsystem1/SOF/Subsystem6/Subsystem/Determine_Currentlimit_Target/Calculate_CurrentLimit_Target/CurrentLimit_Voltage_Correct/Correct_CurrentLimit/Determine_VoltageCorrect_level"
 /begin SUB_GROUP S1874_Set_ChargeVoltageCorrect_level1 S1874_Set_ChargeVoltageCorrect_level2 S1874_Set_ChargeVoltageCorrect_level3 S1874_Set_ChargeVoltageCorrect_level4 S1874_Set_DischargeVoltageCorrect_level1 S1874_Set_DischargeVoltageCorrect_level2 S1874_Set_DischargeVoltageCorrect_level3 S1874_Set_DischargeVoltageCorrect_level4 /end SUB_GROUP
 /begin REF_MEASUREMENT SOF_nbrChargeVoltageCorrectLevel SOF_nbrDischargeVoltageCorrectLevel /end REF_MEASUREMENT
/end GROUP
/begin GROUP S1982_Update_Max_Min "VBU0706/Function-Call Subsystem/Subsystem1/SOH/Subsystem4/Subsystem1/Calculate_Capacity/Calculate_CellCapacity/Determine_CellCapacity/MMASVC1/Update_Max_Min"
 /begin REF_MEASUREMENT SOH_AhCellCapacityAve SOH_AhCellCapacityMax SOH_AhCellCapacityMin /end REF_MEASUREMENT
/end GROUP
/begin GROUP S2006_Determine_Cell_Balanced_Capacity "VBU0706/Function-Call Subsystem/Subsystem1/SOH/Subsystem4/Subsystem1/Calculate_Capacity/Calculate_CellCapacity_SlowCharge/Determine_AhIntegral_DeltaQ/Determine_AhIntegral_Q/Determine_Cell_Balanced_Capacity" /begin REF_CHARACTERISTIC CcSYS_BalanceResistance_ohm /end REF_CHARACTERISTIC /end GROUP
/begin GROUP S2012_Cal_Resistance "VBU0706/Function-Call Subsystem/Subsystem1/SOH/Subsystem4/Subsystem1/Calculate_Capacity/Calculate_CellCapacity_SlowCharge/Determine_Soc/Lookup_Table_Cal_Soc/Cal_Resistance"
 /begin REF_CHARACTERISTIC CaSOH_UdResisMapDimension_n CaSOH_UdResisMapZ_mohm CcSOH_ChargeResisLowerLimit_mohm /end REF_CHARACTERISTIC
/end GROUP
/begin GROUP S2012_Cal_Soc "VBU0706/Function-Call Subsystem/Subsystem1/SOH/Subsystem4/Subsystem1/Calculate_Capacity/Calculate_CellCapacity_SlowCharge/Determine_Soc/Lookup_Table_Cal_Soc/Cal_Soc" /begin REF_CHARACTERISTIC CaSOH_OcvSocMapDimension_n CaSOH_OcvSocMapZ_pct /end REF_CHARACTERISTIC /end GROUP
/begin GROUP S3353_DSPL_EnergyFactorInit "VBU0706/Task_10ms/Subsystem/VCU /DSPL/DSPL/DriveRange/DSPL_Consumption/DSPL_EnergySelfLearn/DSPL_EnergyFactorCal/DSPL_EnergyFactorInit" /begin REF_CHARACTERISTIC DSPL_facEnergyFactorInit_C /end REF_CHARACTERISTIC /end GROUP
/begin GROUP S3353_DSPL_EnergyFactorUpdate "VBU0706/Task_10ms/Subsystem/VCU /DSPL/DSPL/DriveRange/DSPL_Consumption/DSPL_EnergySelfLearn/DSPL_EnergyFactorCal/DSPL_EnergyFactorUpdate"
 /begin REF_CHARACTERISTIC DSPL_facEnergyFactorSOCUpdate_CUR_v DSPL_facEnergyFactorSelfLearnInit_C DSPL_facEnergyFactorUpdateStep_C DSPL_flgEnergyFactorSelfLearnEn_C DSPL_pctBMSSOCUpdateStep_C DSPL_pctEnergySOCLearnMax_C /end REF_CHARACTERISTIC
/end GROUP
/begin GROUP S3499_GradientLimiter "VBU0706/Task_10ms/Subsystem/VCU /EDIS/EDIS_Ctrl/battery_power_calculate/charge_power_calculate/ChPowSetPoint/fid_action/GradientLimiter" /begin REF_MEASUREMENT EDIS_pwrChLimDynRaw /end REF_MEASUREMENT /end GROUP
/begin GROUP S3499_GradientLimiter1 "VBU0706/Task_10ms/Subsystem/VCU /EDIS/EDIS_Ctrl/battery_power_calculate/charge_power_calculate/ChPowSetPoint/fid_action/GradientLimiter1" /begin REF_MEASUREMENT EDIS_pwrChLimLTRaw /end REF_MEASUREMENT /end GROUP
/begin GROUP S3514_GradientLimiter "VBU0706/Task_10ms/Subsystem/VCU /EDIS/EDIS_Ctrl/battery_power_calculate/discharge_power_calculate/DchPowSetpiont/fid_action/GradientLimiter" /begin REF_MEASUREMENT EDIS_pwrDisChLimDynRaw /end REF_MEASUREMENT /end GROUP
/begin GROUP S3514_GradientLimiter1 "VBU0706/Task_10ms/Subsystem/VCU /EDIS/EDIS_Ctrl/battery_power_calculate/discharge_power_calculate/DchPowSetpiont/fid_action/GradientLimiter1" /begin REF_MEASUREMENT EDIS_pwrDisChLimLTRaw /end REF_MEASUREMENT /end GROUP
/begin GROUP S3514_GradientLimiter2 "VBU0706/Task_10ms/Subsystem/VCU /EDIS/EDIS_Ctrl/battery_power_calculate/discharge_power_calculate/DchPowSetpiont/fid_action/GradientLimiter2" /begin REF_MEASUREMENT EDIS_pwrDisChLimSTRaw /end REF_MEASUREMENT /end GROUP
/begin GROUP S3515_batt_stpower_overrite "VBU0706/Task_10ms/Subsystem/VCU /EDIS/EDIS_Ctrl/battery_power_calculate/discharge_power_calculate/DchPowSetpiont/setpoint/batt_stpower_overrite" /begin SUB_GROUP S3525_GradientLimiter S3525_Hysteresis_LHC_RLC1 /end SUB_GROUP
 /begin REF_CHARACTERISTIC EDIS_facDecGradSprt_C EDIS_flgDisChDynMore_C EDIS_flgDisChDynOverride_C EDIS_numCurrentOverDisChDyn_C EDIS_numDisChDyn_C EDIS_pctAccPedlDchaLo_C EDIS_pctAccPedlDchaUp_C EDIS_pctSocDchaLo_C EDIS_pctSocDchaUp_C EDIS_pwrBmsDynLTDeltaHi_C EDIS_pwrBmsDynLTDeltaLo_C EDIS_pwrDecGradSprt_MAP_v EDIS_pwrDisChDynMore_C EDIS_pwrDisChaFilterHi_C EDIS_pwrDisChaFilterLo_C EDIS_stCurrentGearD_C EDIS_tBmsMaxTempHi_C EDIS_tBmsMaxTempLo_C EDIS_tBmsMinTempHi_C EDIS_tBmsMinTempLo_C EDIS_tiOverDisCha_C EDIS_vVehSpdDchaLo_C EDIS_vVehSpdDchaUp_C SYS_stHMIDrvModeSport_SY /end REF_CHARACTERISTIC
 /begin REF_MEASUREMENT EDIS_flgPowDisChToSTLim EDIS_pwrDisChLimDynOvrride /end REF_MEASUREMENT
/end GROUP
/begin GROUP S3515_discharge_setpoint "VBU0706/Task_10ms/Subsystem/VCU /EDIS/EDIS_Ctrl/battery_power_calculate/discharge_power_calculate/DchPowSetpiont/setpoint/discharge_setpoint"
 /begin REF_CHARACTERISTIC EDIS_facBMSSOCDisCh_CUR_v EDIS_facDisChPwrDeltaBaseDiff_CUR_v EDIS_facMaxBMSDisCh_CUR_v EDIS_facMinBMSDisCh_CUR_v EDIS_numDisChOverLim_C EDIS_numDisChPwrOverCntEEPROMInit_SY EDIS_pwrDisChOverLim_C EDIS_pwrDisChRed40vLim_C EDIS_pwrSpBaseDchDyn_CUR_v /end REF_CHARACTERISTIC
 /begin REF_MEASUREMENT EDIS_facDchDynSp EDIS_pwrDisChSp /end REF_MEASUREMENT
/end GROUP
/begin GROUP S3516_BattDisChaCold "VBU0706/Task_10ms/Subsystem/VCU /EDIS/EDIS_Ctrl/battery_power_calculate/discharge_power_calculate/DchPowSetpiont/temperature_correction/BattDisChaCold" /begin REF_MEASUREMENT EDIS_pwrDisChaDynCold /end REF_MEASUREMENT /end GROUP
/begin GROUP S3516_BattDisChaHot "VBU0706/Task_10ms/Subsystem/VCU /EDIS/EDIS_Ctrl/battery_power_calculate/discharge_power_calculate/DchPowSetpiont/temperature_correction/BattDisChaHot" /begin REF_MEASUREMENT EDIS_pwrDisChaDynHot /end REF_MEASUREMENT /end GROUP
/begin GROUP S3516_MinSel "VBU0706/Task_10ms/Subsystem/VCU /EDIS/EDIS_Ctrl/battery_power_calculate/discharge_power_calculate/DchPowSetpiont/temperature_correction/MinSel" /begin REF_MEASUREMENT EDIS_pwrDisChaDynTempCorr /end REF_MEASUREMENT /end GROUP
/begin GROUP S3587_Disenable "VBU0706/Task_10ms/Subsystem/VCU /PMM/PMM_Ctrl/LVC/LowVoltageBalanceControl/LVC_DcdcStCtl/RoutineControl/Disenable"
 /begin REF_CHARACTERISTIC DIAGS_stPsvRespAlreadyOk_SY DIAGS_stPsvResp_SY LVC_stDcDcFailure_SY LVC_stDcDcStandby_SY LVC_stDcDcWorking_SY LVC_tiWaitForOk_C /end REF_CHARACTERISTIC
 /begin REF_MEASUREMENT LVC_stDCDCDisblResp /end REF_MEASUREMENT
/end GROUP
/begin GROUP S3587_Enable "VBU0706/Task_10ms/Subsystem/VCU /PMM/PMM_Ctrl/LVC/LowVoltageBalanceControl/LVC_DcdcStCtl/RoutineControl/Enable"
 /begin REF_CHARACTERISTIC DIAGS_stPsvRespAlreadyOk_SY DIAGS_stPsvResp_SY LVC_stDcDcFailure_SY LVC_stDcDcStandby_SY LVC_stDcDcWorking_SY LVC_tiWaitForOk_C /end REF_CHARACTERISTIC
 /begin REF_MEASUREMENT LVC_stDCDCEnaResp /end REF_MEASUREMENT
/end GROUP
/begin GROUP S3610_VCUActSrc "VBU0706/Task_10ms/Subsystem/VCU /PMM/PMM_Ctrl/PMM/LvWakeUp_Ctrl/LvWakeUp_State_Calc/LVWSrc/VCUActSrc"
 /begin REF_CHARACTERISTIC PMM_stDCHInitSts_SY PMM_stDCHShtDwnSts_SY PMM_tiDlyHVRlyReqCC2_C PMM_tiDlyPEUDCVltg_C PMM_uActvDisChVltg_C /end REF_CHARACTERISTIC
/end GROUP
/begin GROUP S3610_VCUWakeUp "VBU0706/Task_10ms/Subsystem/VCU /PMM/PMM_Ctrl/PMM/LvWakeUp_Ctrl/LvWakeUp_State_Calc/LVWSrc/VCUWakeUp" /begin REF_CHARACTERISTIC PMM_stAPlushld_SY PMM_tiDlyNMWkup_C /end REF_CHARACTERISTIC /end GROUP
/begin GROUP S3666_Turn_On_Delay_Time "VBU0706/Task_10ms/Subsystem/VCU /PMM/PMM_Ctrl/PMM/PwrMod_Ctrl/PwrMod_PowerUp/stateflowcondition/Turn_On_Delay_Time" /begin REF_MEASUREMENT PMM_flgInitToHVRlyClReq /end REF_MEASUREMENT /end GROUP
/begin GROUP S3666_Turn_On_Delay_Time1 "VBU0706/Task_10ms/Subsystem/VCU /PMM/PMM_Ctrl/PMM/PwrMod_Ctrl/PwrMod_PowerUp/stateflowcondition/Turn_On_Delay_Time1" /begin REF_MEASUREMENT PMM_flgOffLoadToHVRlyOpReq /end REF_MEASUREMENT /end GROUP
/begin GROUP S3926_AccPdlIdl "VBU0706/Task_10ms/Subsystem/VCU /TQO/TQOAll/TQDIS/TQDIS/TrqFilter/DrvLim/AccPdlIdl"
 /begin REF_CHARACTERISTIC TQDIS_facShftChngLim_CUR_v TQDIS_pctShftChngFullAcc_C TQDIS_pctShftChngLimThres_CUR_v TQDIS_tiShftChngDly_C TQDIS_trqShftChngLimThres_C /end REF_CHARACTERISTIC
 /begin REF_MEASUREMENT TQDIS_facUnintdAcc /end REF_MEASUREMENT
/end GROUP
/begin GROUP S3926_Creep "VBU0706/Task_10ms/Subsystem/VCU /TQO/TQOAll/TQDIS/TQDIS/TrqFilter/DrvLim/Creep"
 /begin REF_CHARACTERISTIC TQDIS_facAccPedFilter_CUR_v TQDIS_facBrkDec_MAP_v TQDIS_facBrkSlpCrp_MAP_v TQDIS_facDrvLo_CUR_y TQDIS_facRgnLo_CUR_y TQDIS_facShftDR_CUR_v TQDIS_trqCreepThd_C TQDIS_trqCrpBase_MAP_v TQDIS_vVehFilterThd_C /end REF_CHARACTERISTIC
 /begin REF_MEASUREMENT TQDIS_facAccPedFilter TQDIS_facBrkDec TQDIS_facBrkSlpCrp TQDIS_facPwrLo TQDIS_flgCrp TQDIS_trqCrpBase TQDIS_trqCrpDecFilter TQDIS_trqCrpIncFilter /end REF_MEASUREMENT
/end GROUP
/begin GROUP S3926_RADrvDec "VBU0706/Task_10ms/Subsystem/VCU /TQO/TQOAll/TQDIS/TQDIS/TrqFilter/DrvLim/RADrvDec" /begin REF_CHARACTERISTIC TQDIS_trqDecGradECORA_MAP_v /end REF_CHARACTERISTIC /begin REF_MEASUREMENT TQDIS_facBase2RADrvDecLim TQDIS_trqRADrvDecLim /end REF_MEASUREMENT /end GROUP
/begin GROUP S3926_RADrvInc "VBU0706/Task_10ms/Subsystem/VCU /TQO/TQOAll/TQDIS/TQDIS/TrqFilter/DrvLim/RADrvInc"
 /begin REF_CHARACTERISTIC TQDIS_facAPDTrqECORA_MAP_v TQDIS_facAccPdlECORA_MAP_v TQDIS_trqIncGradECORA_MAP_v /end REF_CHARACTERISTIC
 /begin REF_MEASUREMENT TQDIS_facIncGain TQDIS_trqBase1RADrvIncLim TQDIS_trqBase2RADrvIncLim TQDIS_trqIncBase TQDIS_trqRADrvIncLim /end REF_MEASUREMENT
/end GROUP
/begin GROUP S3955_ConditionRAArb "VBU0706/Task_10ms/Subsystem/VCU /TQO/TQOAll/TQDMP/TQDMP/RAROTC/ROTCConidtion/ConditionRAArb" /begin REF_CHARACTERISTIC TQDMP_flgROTCEnRA_C TQDMP_tiTrqZeroDly_C /end REF_CHARACTERISTIC /begin REF_MEASUREMENT TQDMP_flgROTCActRA /end REF_MEASUREMENT /end GROUP
/begin GROUP S3955_SpeedHoldEnableRA "VBU0706/Task_10ms/Subsystem/VCU /TQO/TQOAll/TQDMP/TQDMP/RAROTC/ROTCConidtion/SpeedHoldEnableRA"
 /begin REF_CHARACTERISTIC TQDMP_flgSpdHldOn_C TQDMP_nSpdHldMax2FA_C TQDMP_nSpdHldMaxFA_C TQDMP_nSpdHldMin2FA_C TQDMP_nSpdHldMinFA_C /end REF_CHARACTERISTIC
 /begin REF_MEASUREMENT TQDMP_flgSpdHldR /end REF_MEASUREMENT
/end GROUP
/begin GROUP S3955_TipInRA "VBU0706/Task_10ms/Subsystem/VCU /TQO/TQOAll/TQDMP/TQDMP/RAROTC/ROTCConidtion/TipInRA"
 /begin REF_CHARACTERISTIC TQDMP_pctTipInAccPedChgThd_C TQDMP_pctTipInAccPedTrgThd_C TQDMP_tiTipInDly_C TQO_ti10ms_SY /end REF_CHARACTERISTIC
/end GROUP
/begin GROUP S3955_TipOutRA "VBU0706/Task_10ms/Subsystem/VCU /TQO/TQOAll/TQDMP/TQDMP/RAROTC/ROTCConidtion/TipOutRA"
 /begin REF_CHARACTERISTIC TQDMP_pctTipOutAccPedChgThd_C TQDMP_pctTipOutAccPedTrgThd_C TQDMP_tiTipOutDly_C TQO_ti10ms_SY /end REF_CHARACTERISTIC
/end GROUP
/begin GROUP S3955_TipinEnaRA "VBU0706/Task_10ms/Subsystem/VCU /TQO/TQOAll/TQDMP/TQDMP/RAROTC/ROTCConidtion/TipinEnaRA" /begin SUB_GROUP S3967_SR_Flip_Flop /end SUB_GROUP
 /begin REF_CHARACTERISTIC TQDMP_flgTipInEnaRvs_C TQDMP_pctTipInAccPedEnThdHi_C TQDMP_pctTipInAccPedEnThdLo_C TQDMP_tiTipInAct_C /end REF_CHARACTERISTIC
/end GROUP
/begin GROUP S3955_TipoutEnaRA "VBU0706/Task_10ms/Subsystem/VCU /TQO/TQOAll/TQDMP/TQDMP/RAROTC/ROTCConidtion/TipoutEnaRA" /begin SUB_GROUP S3968_SR_Flip_Flop /end SUB_GROUP
 /begin REF_CHARACTERISTIC TQDMP_flgTipOutEnaRvs_C TQDMP_pctTipOutAccPedEnThdHi_C TQDMP_pctTipOutAccPedEnThdLo_C TQDMP_tiTipOutAct_C TQO_ti10ms_SY /end REF_CHARACTERISTIC
/end GROUP
/begin GROUP S3955_VrtlRA "VBU0706/Task_10ms/Subsystem/VCU /TQO/TQOAll/TQDMP/TQDMP/RAROTC/ROTCConidtion/VrtlRA" /begin REF_CHARACTERISTIC TQDMP_trqAxleMaxRA_C /end REF_CHARACTERISTIC /begin REF_MEASUREMENT TQDMP_pctAccPdlVrtlRA /end REF_MEASUREMENT /end GROUP
/begin GROUP S3956_CompensationPhase "VBU0706/Task_10ms/Subsystem/VCU /TQO/TQOAll/TQDMP/TQDMP/RAROTC/TorqueCal/CompensationPhase"
 /begin REF_CHARACTERISTIC TQDMP_facPhsCmpDenRA_C TQDMP_facPhsCmpK1RA_C TQDMP_facPhsCmpNumRA_C /end REF_CHARACTERISTIC
 /begin REF_MEASUREMENT TQDMP_trqDeltaLPFR TQDMP_trqDeltaR /end REF_MEASUREMENT
/end GROUP
/begin GROUP S3956_DeltaTrqArb "VBU0706/Task_10ms/Subsystem/VCU /TQO/TQOAll/TQDMP/TQDMP/RAROTC/TorqueCal/DeltaTrqArb" /begin REF_MEASUREMENT TQDMP_trqBumpRA /end REF_MEASUREMENT /end GROUP
/begin GROUP S3956_TorqueLim "VBU0706/Task_10ms/Subsystem/VCU /TQO/TQOAll/TQDMP/TQDMP/RAROTC/TorqueCal/TorqueLim"
 /begin REF_CHARACTERISTIC TQDMP_facDeltaRPMFAC1_CUR_v TQDMP_facPhaseSclRA_C TQDMP_trqDeadZoneMaxRA_C TQDMP_trqDeadZoneMinRA_C TQDMP_trqMaxRA_C TQDMP_trqMinRA_C /end REF_CHARACTERISTIC
 /begin REF_MEASUREMENT TQDMP_trqROTCRA /end REF_MEASUREMENT
/end GROUP
/begin GROUP S3995_GradientLimiter "VBU0706/Task_10ms/Subsystem/VCU /TQO/TQOAll/TQO/TQO/MotorTorque/Subsystem/GradientLimiter" /begin REF_MEASUREMENT TQO_facShft /end REF_MEASUREMENT /end GROUP
/begin GROUP S3998_DecGradienLimiter "VBU0706/Task_10ms/Subsystem/VCU /TQO/TQOAll/TQO/TQO/Trq/TrqProtect/DecGradienLimiter" /begin REF_MEASUREMENT TQO_trqBrkLim /end REF_MEASUREMENT /end GROUP
/begin GROUP S4101_SetBit2 "VBU0706/Task_10ms/Subsystem/VCU /VehINP/VehINP_Logic/GearShift/Gear1/Digital_Gear_D_R/Gear_Bit/SetBit2" /begin REF_MEASUREMENT Gear_stHWSensor /end REF_MEASUREMENT /end GROUP
/begin GROUP S4102_Turn_On_Delay_Time "VBU0706/Task_10ms/Subsystem/VCU /VehINP/VehINP_Logic/GearShift/Gear1/Digital_Gear_D_R/Gear_DR_Req/Turn_On_Delay_Time" /begin REF_MEASUREMENT Gear_flgDGearReqRawDigitalAction /end REF_MEASUREMENT /end GROUP
/begin GROUP S4102_Turn_On_Delay_Time1 "VBU0706/Task_10ms/Subsystem/VCU /VehINP/VehINP_Logic/GearShift/Gear1/Digital_Gear_D_R/Gear_DR_Req/Turn_On_Delay_Time1" /begin REF_MEASUREMENT Gear_flgRGearReqRawDigitalAction /end REF_MEASUREMENT /end GROUP
/begin GROUP S4102_Turn_On_Delay_Time2 "VBU0706/Task_10ms/Subsystem/VCU /VehINP/VehINP_Logic/GearShift/Gear1/Digital_Gear_D_R/Gear_DR_Req/Turn_On_Delay_Time2" /begin REF_MEASUREMENT Gear_flgNGearReqRawDigitalAction /end REF_MEASUREMENT /end GROUP
/begin GROUP S4103_Turn_On_Delay_Time "VBU0706/Task_10ms/Subsystem/VCU /VehINP/VehINP_Logic/GearShift/Gear1/Digital_Gear_D_R/Gear_DR_Warning/Turn_On_Delay_Time" /begin REF_MEASUREMENT Gear_flgGearWarningST /end REF_MEASUREMENT /end GROUP
/begin GROUP S4103_Turn_On_Delay_Time1 "VBU0706/Task_10ms/Subsystem/VCU /VehINP/VehINP_Logic/GearShift/Gear1/Digital_Gear_D_R/Gear_DR_Warning/Turn_On_Delay_Time1" /begin REF_MEASUREMENT Gear_flgGearWarningLT /end REF_MEASUREMENT /end GROUP
/begin GROUP S4105_SR_Flip_Flop1 "VBU0706/Task_10ms/Subsystem/VCU /VehINP/VehINP_Logic/GearShift/Gear1/Digital_Gear_D_R/Gear_Warning/SR_Flip_Flop1" /begin REF_MEASUREMENT Gear_flgDftGearPlausibilityDigital /end REF_MEASUREMENT /end GROUP
/begin GROUP S4149_SR_Flip_Flop2 "VBU0706/Task_10ms/Subsystem/VCU /VehINP/VehINP_Logic/GearShift/Gear1/Gear_Status/Gear_GearReq/SR_Flip_Flop2" /begin REF_MEASUREMENT Gear_flgNGearReq /end REF_MEASUREMENT /end GROUP
/begin GROUP S1816_Calculate_ChargeCurrentLimitBuffer_Full "VBU0706/Function-Call Subsystem/Subsystem1/SOF/Subsystem6/Subsystem/Determine_Currentlimit_Target/Calculate_CurrentLimit_Target/Calculate_Dynamic_CurrentLimit/Calculate_Dynamic_ChargeCurrentLimit/Calculate_ChargeCurrentLimit_Buff/Calculate_ChargeCurrentLimitBuffer_Full"
 /begin REF_CHARACTERISTIC CaSOF_ChargeCurrentLimitBufferTimeSocTempMapDimension_n CaSOF_ChargeCurrentLimitBufferTimeSocTempMapZ_s /end REF_CHARACTERISTIC
 /begin REF_MEASUREMENT SOF_AsChargeCurrentLimitBufferFull /end REF_MEASUREMENT
/end GROUP
/begin GROUP S1816_Calculate_ChargeCurrentLimitBuffer_Use "VBU0706/Function-Call Subsystem/Subsystem1/SOF/Subsystem6/Subsystem/Determine_Currentlimit_Target/Calculate_CurrentLimit_Target/Calculate_Dynamic_CurrentLimit/Calculate_Dynamic_ChargeCurrentLimit/Calculate_ChargeCurrentLimit_Buff/Calculate_ChargeCurrentLimitBuffer_Use" /begin REF_CHARACTERISTIC CcSOF_ChargeCurrentLimitViolateBuffer_A /end REF_CHARACTERISTIC /begin REF_MEASUREMENT SOF_AsChargeCurrentLimitBufferUse /end REF_MEASUREMENT /end GROUP
/begin GROUP S1817_Buffer_Used "VBU0706/Function-Call Subsystem/Subsystem1/SOF/Subsystem6/Subsystem/Determine_Currentlimit_Target/Calculate_CurrentLimit_Target/Calculate_Dynamic_CurrentLimit/Calculate_Dynamic_ChargeCurrentLimit/Calculate_Dynamic_ChargeCurrentLimit/Buffer_Used" /begin REF_MEASUREMENT SOF_iADynamicChargeCurrentLimitFastChrgChk /end REF_MEASUREMENT /end GROUP
/begin GROUP S1824_Calculate_DischargeCurrentLimitBuffer_Full "VBU0706/Function-Call Subsystem/Subsystem1/SOF/Subsystem6/Subsystem/Determine_Currentlimit_Target/Calculate_CurrentLimit_Target/Calculate_Dynamic_CurrentLimit/Calculate_Dynamic_DischargeCurrentLimit/Calculate_DischargeCurrentLimit_Buff/Calculate_DischargeCurrentLimitBuffer_Full"
 /begin REF_CHARACTERISTIC CaSOF_DischargeCurrentLimitBufferTimeSocTempMapDimension_n CaSOF_DischargeCurrentLimitBufferTimeSocTempMapZ_s /end REF_CHARACTERISTIC
 /begin REF_MEASUREMENT SOF_AsDischargeCurrentLimitBufferFull /end REF_MEASUREMENT
/end GROUP
/begin GROUP S1824_Calculate_DischargeCurrentLimitBuffer_Use "VBU0706/Function-Call Subsystem/Subsystem1/SOF/Subsystem6/Subsystem/Determine_Currentlimit_Target/Calculate_CurrentLimit_Target/Calculate_Dynamic_CurrentLimit/Calculate_Dynamic_DischargeCurrentLimit/Calculate_DischargeCurrentLimit_Buff/Calculate_DischargeCurrentLimitBuffer_Use"
 /begin REF_CHARACTERISTIC CaSOF_BuffUseFactorCurrtLTCurrtMapDimension_n CaSOF_BuffUseFactorCurrtLTCurrtMapZ_n CaSOF_BuffUseFactorSocTempMapDimension_n CaSOF_BuffUseFactorSocTempMapZ_n /end REF_CHARACTERISTIC
 /begin REF_MEASUREMENT SOF_AsDischargeCurrentLimitBufferUse /end REF_MEASUREMENT
/end GROUP
/begin GROUP S1825_Rate_Limiter "VBU0706/Function-Call Subsystem/Subsystem1/SOF/Subsystem6/Subsystem/Determine_Currentlimit_Target/Calculate_CurrentLimit_Target/Calculate_Dynamic_CurrentLimit/Calculate_Dynamic_DischargeCurrentLimit/Calculate_Dynamic_DischargeCurrentLimit/Rate_Limiter"
 /begin REF_CHARACTERISTIC CcSOF_DischaOverCurFactorSlopeDec_n CcSOF_DischaOverCurFactorSlopeInc_n /end REF_CHARACTERISTIC
/end GROUP
/begin GROUP S1844_FastCharge_Calculation "VBU0706/Function-Call Subsystem/Subsystem1/SOF/Subsystem6/Subsystem/Determine_Currentlimit_Target/Calculate_CurrentLimit_Target/CurrentLimit_FastCharge_Check/SegmentChargeCheck/FastCharge/FastCharge_Calculation" /begin SUB_GROUP S1846_Determine_FastCharge_Conditions /end SUB_GROUP
 /begin REF_CHARACTERISTIC CcSOF_FastChargeCurrentStep1_A CcSOF_FastChargeCurrentStep2_A CcSOF_FastChargeSocStep1_pct /end REF_CHARACTERISTIC
/end GROUP
/begin GROUP S1873_Calculate_Cell_Discharge_DCIR "VBU0706/Function-Call Subsystem/Subsystem1/SOF/Subsystem6/Subsystem/Determine_Currentlimit_Target/Calculate_CurrentLimit_Target/CurrentLimit_Voltage_Correct/Correct_CurrentLimit/Calculate_CurrentLimit/Calculate_Cell_Discharge_DCIR" /begin SUB_GROUP S1876_Calculate_DCIR_Validation S1876_Calculate_Enable /end SUB_GROUP /end GROUP
/begin GROUP S1873_Rate_Limiter1 "VBU0706/Function-Call Subsystem/Subsystem1/SOF/Subsystem6/Subsystem/Determine_Currentlimit_Target/Calculate_CurrentLimit_Target/CurrentLimit_Voltage_Correct/Correct_CurrentLimit/Calculate_CurrentLimit/Rate_Limiter1"
 /begin REF_CHARACTERISTIC CcSOF_DischargeVoltageCorrectSlopeDec_n CcSOF_DischargeVoltageCorrectSlopeInc_n /end REF_CHARACTERISTIC
/end GROUP
/begin GROUP S1873_Rate_Limiter_Reset "VBU0706/Function-Call Subsystem/Subsystem1/SOF/Subsystem6/Subsystem/Determine_Currentlimit_Target/Calculate_CurrentLimit_Target/CurrentLimit_Voltage_Correct/Correct_CurrentLimit/Calculate_CurrentLimit/Rate_Limiter_Reset" /begin REF_MEASUREMENT SOF_iADynamicDischargeCurrentLimitVltgDcirTarget /end REF_MEASUREMENT /end GROUP
/begin GROUP S1874_Set_ChargeVoltageCorrect_level1 "VBU0706/Function-Call Subsystem/Subsystem1/SOF/Subsystem6/Subsystem/Determine_Currentlimit_Target/Calculate_CurrentLimit_Target/CurrentLimit_Voltage_Correct/Correct_CurrentLimit/Determine_VoltageCorrect_level/Set_ChargeVoltageCorrect_level1"
 /begin REF_CHARACTERISTIC CcSOF_CellVoltageHigh1_mV CcSOF_VoltageCorrectCheckInc1_n CcSOF_VoltageCorrectEnableInc1_n SOF_VOLTAGE_CORRECT_LEVEL1 SOF_VOLTAGE_CORRECT_NONE /end REF_CHARACTERISTIC
/end GROUP
/begin GROUP S1874_Set_ChargeVoltageCorrect_level2 "VBU0706/Function-Call Subsystem/Subsystem1/SOF/Subsystem6/Subsystem/Determine_Currentlimit_Target/Calculate_CurrentLimit_Target/CurrentLimit_Voltage_Correct/Correct_CurrentLimit/Determine_VoltageCorrect_level/Set_ChargeVoltageCorrect_level2"
 /begin REF_CHARACTERISTIC CcSOF_CellVoltageHigh2_mV CcSOF_VoltageCorrectCheckInc2_n CcSOF_VoltageCorrectEnableInc2_n SOF_VOLTAGE_CORRECT_LEVEL2 SOF_VOLTAGE_CORRECT_NONE /end REF_CHARACTERISTIC
/end GROUP
/begin GROUP S1874_Set_ChargeVoltageCorrect_level3 "VBU0706/Function-Call Subsystem/Subsystem1/SOF/Subsystem6/Subsystem/Determine_Currentlimit_Target/Calculate_CurrentLimit_Target/CurrentLimit_Voltage_Correct/Correct_CurrentLimit/Determine_VoltageCorrect_level/Set_ChargeVoltageCorrect_level3"
 /begin REF_CHARACTERISTIC CcSOF_CellVoltageHigh3_mV CcSOF_VoltageCorrectCheckInc3_n CcSOF_VoltageCorrectEnableInc3_n SOF_VOLTAGE_CORRECT_LEVEL3 SOF_VOLTAGE_CORRECT_NONE /end REF_CHARACTERISTIC
/end GROUP
/begin GROUP S1874_Set_ChargeVoltageCorrect_level4 "VBU0706/Function-Call Subsystem/Subsystem1/SOF/Subsystem6/Subsystem/Determine_Currentlimit_Target/Calculate_CurrentLimit_Target/CurrentLimit_Voltage_Correct/Correct_CurrentLimit/Determine_VoltageCorrect_level/Set_ChargeVoltageCorrect_level4"
 /begin REF_CHARACTERISTIC CcSOF_BatteryCurrentLow_A CcSOF_CellVoltageHigh4_mV CcSOF_VoltageCorrectCheckInc4_n CcSOF_VoltageCorrectEnableInc4_n SOF_VOLTAGE_CORRECT_LEVEL4 SOF_VOLTAGE_CORRECT_NONE /end REF_CHARACTERISTIC
/end GROUP
/begin GROUP S1874_Set_DischargeVoltageCorrect_level1 "VBU0706/Function-Call Subsystem/Subsystem1/SOF/Subsystem6/Subsystem/Determine_Currentlimit_Target/Calculate_CurrentLimit_Target/CurrentLimit_Voltage_Correct/Correct_CurrentLimit/Determine_VoltageCorrect_level/Set_DischargeVoltageCorrect_level1"
 /begin REF_CHARACTERISTIC CcSOF_CellVoltageLow1_mV CcSOF_VoltageCorrectCheckInc1_n CcSOF_VoltageCorrectEnableInc1_n SOF_VOLTAGE_CORRECT_LEVEL1 SOF_VOLTAGE_CORRECT_NONE /end REF_CHARACTERISTIC
/end GROUP
/begin GROUP S1874_Set_DischargeVoltageCorrect_level2 "VBU0706/Function-Call Subsystem/Subsystem1/SOF/Subsystem6/Subsystem/Determine_Currentlimit_Target/Calculate_CurrentLimit_Target/CurrentLimit_Voltage_Correct/Correct_CurrentLimit/Determine_VoltageCorrect_level/Set_DischargeVoltageCorrect_level2"
 /begin REF_CHARACTERISTIC CcSOF_CellVoltageLow2_mV CcSOF_VoltageCorrectCheckInc2_n CcSOF_VoltageCorrectEnableInc2_n SOF_VOLTAGE_CORRECT_LEVEL2 SOF_VOLTAGE_CORRECT_NONE /end REF_CHARACTERISTIC
/end GROUP
/begin GROUP S1874_Set_DischargeVoltageCorrect_level3 "VBU0706/Function-Call Subsystem/Subsystem1/SOF/Subsystem6/Subsystem/Determine_Currentlimit_Target/Calculate_CurrentLimit_Target/CurrentLimit_Voltage_Correct/Correct_CurrentLimit/Determine_VoltageCorrect_level/Set_DischargeVoltageCorrect_level3"
 /begin REF_CHARACTERISTIC CcSOF_CellVoltageLow3_mV CcSOF_VoltageCorrectCheckInc3_n CcSOF_VoltageCorrectEnableInc3_n SOF_VOLTAGE_CORRECT_LEVEL3 SOF_VOLTAGE_CORRECT_NONE /end REF_CHARACTERISTIC
/end GROUP
/begin GROUP S1874_Set_DischargeVoltageCorrect_level4 "VBU0706/Function-Call Subsystem/Subsystem1/SOF/Subsystem6/Subsystem/Determine_Currentlimit_Target/Calculate_CurrentLimit_Target/CurrentLimit_Voltage_Correct/Correct_CurrentLimit/Determine_VoltageCorrect_level/Set_DischargeVoltageCorrect_level4"
 /begin REF_CHARACTERISTIC CcSOF_BatteryCurrentLow_A CcSOF_CellVoltageLow4_mV CcSOF_VoltageCorrectCheckInc4_n CcSOF_VoltageCorrectEnableInc4_n SOF_VOLTAGE_CORRECT_LEVEL4 SOF_VOLTAGE_CORRECT_NONE /end REF_CHARACTERISTIC
/end GROUP
/begin GROUP S3525_GradientLimiter "VBU0706/Task_10ms/Subsystem/VCU /EDIS/EDIS_Ctrl/battery_power_calculate/discharge_power_calculate/DchPowSetpiont/setpoint/batt_stpower_overrite/GradientLimiter" /begin REF_MEASUREMENT EDIS_pwrDisChLimDynST /end REF_MEASUREMENT /end GROUP
/begin GROUP S3525_Hysteresis_LHC_RLC1 "VBU0706/Task_10ms/Subsystem/VCU /EDIS/EDIS_Ctrl/battery_power_calculate/discharge_power_calculate/DchPowSetpiont/setpoint/batt_stpower_overrite/Hysteresis_LHC_RLC1" /begin REF_MEASUREMENT EDIS_flgVehSpdLow /end REF_MEASUREMENT /end GROUP
/begin GROUP S3967_SR_Flip_Flop "VBU0706/Task_10ms/Subsystem/VCU /TQO/TQOAll/TQDMP/TQDMP/RAROTC/ROTCConidtion/TipinEnaRA/SR_Flip_Flop" /begin REF_MEASUREMENT TQDMP_flgTipInEnaRA /end REF_MEASUREMENT /end GROUP
/begin GROUP S3968_SR_Flip_Flop "VBU0706/Task_10ms/Subsystem/VCU /TQO/TQOAll/TQDMP/TQDMP/RAROTC/ROTCConidtion/TipoutEnaRA/SR_Flip_Flop" /begin REF_MEASUREMENT TQDMP_flgTipOutEnaRA /end REF_MEASUREMENT /end GROUP
/begin GROUP S1846_Determine_FastCharge_Conditions "VBU0706/Function-Call Subsystem/Subsystem1/SOF/Subsystem6/Subsystem/Determine_Currentlimit_Target/Calculate_CurrentLimit_Target/CurrentLimit_FastCharge_Check/SegmentChargeCheck/FastCharge/FastCharge_Calculation/Determine_FastCharge_Conditions" /begin SUB_GROUP S1847_Condition1 S1847_Condition2 S1847_Condition3 /end SUB_GROUP /end GROUP
/begin GROUP S1876_Calculate_DCIR_Validation "VBU0706/Function-Call Subsystem/Subsystem1/SOF/Subsystem6/Subsystem/Determine_Currentlimit_Target/Calculate_CurrentLimit_Target/CurrentLimit_Voltage_Correct/Correct_CurrentLimit/Calculate_CurrentLimit/Calculate_Cell_Discharge_DCIR/Calculate_DCIR_Validation"
 /begin REF_CHARACTERISTIC CcSOF_CellDischargeDcirMax_mOhm CcSOF_CellDischargeDcirMin_mOhm CcSOF_OriginalDcirDispersion_pct /end REF_CHARACTERISTIC
 /begin REF_MEASUREMENT SOF_flgCellDischargeDcirCalcValid SOF_mohmCellDischargeDcirCalc /end REF_MEASUREMENT
/end GROUP
/begin GROUP S1876_Calculate_Enable "VBU0706/Function-Call Subsystem/Subsystem1/SOF/Subsystem6/Subsystem/Determine_Currentlimit_Target/Calculate_CurrentLimit_Target/CurrentLimit_Voltage_Correct/Correct_CurrentLimit/Calculate_CurrentLimit/Calculate_Cell_Discharge_DCIR/Calculate_Enable" /begin REF_CHARACTERISTIC CcSOF_DcirDelayTimes_n CcSOF_DcirDeltaCurrentMin_A /end REF_CHARACTERISTIC /end GROUP
/begin GROUP S1847_Condition1 "VBU0706/Function-Call Subsystem/Subsystem1/SOF/Subsystem6/Subsystem/Determine_Currentlimit_Target/Calculate_CurrentLimit_Target/CurrentLimit_FastCharge_Check/SegmentChargeCheck/FastCharge/FastCharge_Calculation/Determine_FastCharge_Conditions/Condition1"
 /begin REF_CHARACTERISTIC CcSOF_FastChargeDisableTempUpperLimit_C CcSOF_FastChargeEnableSocLowerLimit_pct CcSOF_FastChargeEnableSocUpperLimit_pct CcSOF_FastChargeEnableTempLowerLimit_C /end REF_CHARACTERISTIC
/end GROUP
/begin GROUP S1847_Condition2 "VBU0706/Function-Call Subsystem/Subsystem1/SOF/Subsystem6/Subsystem/Determine_Currentlimit_Target/Calculate_CurrentLimit_Target/CurrentLimit_FastCharge_Check/SegmentChargeCheck/FastCharge/FastCharge_Calculation/Determine_FastCharge_Conditions/Condition2"
 /begin REF_CHARACTERISTIC CcSOF_FastChargeEnableSocLowerLimit_pct CcSOF_FastChargeEnableSocUpperLimit_pct CcSOF_FastChargeEnableTempLowerLimit_C CcSOF_FastChargeRecoverTempUpperLimit_C /end REF_CHARACTERISTIC
/end GROUP
/begin GROUP S1847_Condition3 "VBU0706/Function-Call Subsystem/Subsystem1/SOF/Subsystem6/Subsystem/Determine_Currentlimit_Target/Calculate_CurrentLimit_Target/CurrentLimit_FastCharge_Check/SegmentChargeCheck/FastCharge/FastCharge_Calculation/Determine_FastCharge_Conditions/Condition3"
 /begin REF_CHARACTERISTIC CcSOF_FastChargeDisableTempLowerLimit_C CcSOF_FastChargeDisableTempUpperLimit_C CcSOF_FastChargeEnableSocLowerLimit_pct CcSOF_FastChargeEnableSocUpperLimit_pct /end REF_CHARACTERISTIC
/end GROUP
/end MODULE
/end PROJECT
