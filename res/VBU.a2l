ASAP2_VERSION 1 31
/begin PROJECT ProjectName "Project Comment Goes Here"
/begin HEADER "Header Comments go here" /end HEADER
/begin MODULE ModuleName "Module Comment Goes Here"
/begin MOD_COMMON "Mod Common Comment Here" ALIGNMENT_WORD 1 ALIGNMENT_LONG 1 ALIGNMENT_FLOAT32_IEEE 1 ALIGNMENT_FLOAT64_IEEE 1 BYTE_ORDER MSB_LAST /end MOD_COMMON
/begin RECORD_LAYOUT Scalar_BOOLEAN FNC_VALUES 1 UBYTE COLUMN_DIR DIRECT /end RECORD_LAYOUT
/begin RECORD_LAYOUT Scalar_UBYTE FNC_VALUES 1 UBYTE COLUMN_DIR DIRECT /end RECORD_LAYOUT
/begin RECORD_LAYOUT Scalar_BYTE FNC_VALUES 1 SBYTE COLUMN_DIR DIRECT /end RECORD_LAYOUT
/begin RECORD_LAYOUT Scalar_UWORD FNC_VALUES 1 UWORD COLUMN_DIR DIRECT /end RECORD_LAYOUT
/begin RECORD_LAYOUT Scalar_ULONG FNC_VALUES 1 ULONG COLUMN_DIR DIRECT /end RECORD_LAYOUT
/begin RECORD_LAYOUT Scalar_FLOAT32_IEEE FNC_VALUES 1 FLOAT32_IEEE COLUMN_DIR DIRECT /end RECORD_LAYOUT
/begin RECORD_LAYOUT Lookup1D_X_BYTE AXIS_PTS_X 1 SBYTE INDEX_INCR DIRECT /end RECORD_LAYOUT
/begin RECORD_LAYOUT Lookup1D_UBYTE FNC_VALUES 1 UBYTE COLUMN_DIR DIRECT /end RECORD_LAYOUT
/begin RECORD_LAYOUT Lookup1D_X_UBYTE AXIS_PTS_X 1 UBYTE INDEX_INCR DIRECT /end RECORD_LAYOUT
/begin RECORD_LAYOUT Lookup2D_FLOAT32_IEEE FNC_VALUES 1 FLOAT32_IEEE COLUMN_DIR DIRECT /end RECORD_LAYOUT
/begin RECORD_LAYOUT Lookup2D_X_FLOAT32_IEEE AXIS_PTS_X 1 FLOAT32_IEEE INDEX_INCR DIRECT /end RECORD_LAYOUT
/begin CHARACTERISTIC CaCVT_CellVoltageOverDeviationCurrentMapZ_A "" MAP 0x70004bc4 Lookup2D_FLOAT32_IEEE 0 VBU0706_CM_single_cnt -3.4028234663852886E+38 3.4028234663852886E+38
 /begin AXIS_DESCR COM_AXIS SOC_pctBatterySoc VBU0706_CM_single_cnt 6 -3.4028234663852886E+38 3.4028234663852886E+38 AXIS_PTS_REF CaCVT_CellVoltageOverDeviationCurrentMapY_pct /end AXIS_DESCR
 /begin AXIS_DESCR COM_AXIS CTM_tCellTempMin VBU0706_CM_single_cnt 8 -3.4028234663852886E+38 3.4028234663852886E+38 AXIS_PTS_REF CaCVT_CellVoltageOverDeviationCurrentMapX_C /end AXIS_DESCR
/end CHARACTERISTIC
/begin AXIS_PTS CaCVT_CellVoltageOverDeviationCurrentMapX_C "" 0x70001f3a CTM_tCellTempMin Lookup2D_X_FLOAT32_IEEE 0 VBU0706_CM_single_cnt 8 -3.4028234663852886E+38 3.4028234663852886E+38 /end AXIS_PTS
/begin AXIS_PTS CaCVT_CellVoltageOverDeviationCurrentMapY_pct "" 0x700019b6 SOC_pctBatterySoc Lookup2D_X_FLOAT32_IEEE 0 VBU0706_CM_single_cnt 6 -3.4028234663852886E+38 3.4028234663852886E+38 /end AXIS_PTS
/begin CHARACTERISTIC CcBCV_HALBatteryVoltageORV_V "" VALUE 0x70000358 Scalar_FLOAT32_IEEE 0 VBU0706_CM_single_cnt -3.4028234663852886E+38 3.4028234663852886E+38 /end CHARACTERISTIC
/begin CHARACTERISTIC CcBCV_HALBusNegativeVoltageORV_V "" VALUE 0x7000035c Scalar_FLOAT32_IEEE 0 VBU0706_CM_single_cnt -3.4028234663852886E+38 3.4028234663852886E+38 /end CHARACTERISTIC
/begin CHARACTERISTIC CcBCV_HALFuseVoltageORV_V "" VALUE 0x70000360 Scalar_FLOAT32_IEEE 0 VBU0706_CM_single_cnt -3.4028234663852886E+38 3.4028234663852886E+38 /end CHARACTERISTIC
/begin CHARACTERISTIC CcBCV_HALPrechargeVoltageORV_V "" VALUE 0x70000364 Scalar_FLOAT32_IEEE 0 VBU0706_CM_single_cnt -3.4028234663852886E+38 3.4028234663852886E+38 /end CHARACTERISTIC
/begin CHARACTERISTIC CcBCV_HALVx2VoltageORV_V "" VALUE 0x70000368 Scalar_FLOAT32_IEEE 0 VBU0706_CM_single_cnt -3.4028234663852886E+38 3.4028234663852886E+38 /end CHARACTERISTIC
/begin CHARACTERISTIC CcBMM_SOCJumpThreshold_pct "" VALUE 0x7000037c Scalar_FLOAT32_IEEE 0 VBU0706_CM_single_cnt -3.4028234663852886E+38 3.4028234663852886E+38 /end CHARACTERISTIC
/begin CHARACTERISTIC CcCBL_BoardTempBalanceStartMaxHysteresis_C "" VALUE 0x70000394 Scalar_FLOAT32_IEEE 0 VBU0706_CM_single_cnt -3.4028234663852886E+38 3.4028234663852886E+38 /end CHARACTERISTIC
/begin CHARACTERISTIC CcCBL_BoardTempBalanceStartMax_C "" VALUE 0x70000398 Scalar_FLOAT32_IEEE 0 VBU0706_CM_single_cnt -3.4028234663852886E+38 3.4028234663852886E+38 /end CHARACTERISTIC
/begin CHARACTERISTIC CcCBL_CTMBoardTempMaxORV_C "" VALUE 0x7000039c Scalar_FLOAT32_IEEE 0 VBU0706_CM_single_cnt -3.4028234663852886E+38 3.4028234663852886E+38 /end CHARACTERISTIC
/begin CHARACTERISTIC CcCTD_HALSystemVoltageLowDelta_V "" VALUE 0x700003d0 Scalar_FLOAT32_IEEE 0 VBU0706_CM_single_cnt -3.4028234663852886E+38 3.4028234663852886E+38 /end CHARACTERISTIC
/begin CHARACTERISTIC CcCTD_HALSystemVoltageLow_V "" VALUE 0x700003d4 Scalar_FLOAT32_IEEE 0 VBU0706_CM_single_cnt -3.4028234663852886E+38 3.4028234663852886E+38 /end CHARACTERISTIC
/begin CHARACTERISTIC CcCTD_MainFuseBlownDeltaVoltage_V "" VALUE 0x700003dc Scalar_FLOAT32_IEEE 0 VBU0706_CM_single_cnt -3.4028234663852886E+38 3.4028234663852886E+38 /end CHARACTERISTIC
/begin CHARACTERISTIC CcCTD_PrechargeResistanceBlownDeltaVoltage_V "" VALUE 0x7000041c Scalar_FLOAT32_IEEE 0 VBU0706_CM_single_cnt -3.4028234663852886E+38 3.4028234663852886E+38 /end CHARACTERISTIC
/begin CHARACTERISTIC CcCTM_CSCSupplyPowerLowHysteresis_V "" VALUE 0x7000043c Scalar_FLOAT32_IEEE 0 VBU0706_CM_single_cnt -3.4028234663852886E+38 3.4028234663852886E+38 /end CHARACTERISTIC
/begin CHARACTERISTIC CcCTM_CSCSupplyPowerLow_V "" VALUE 0x70000440 Scalar_FLOAT32_IEEE 0 VBU0706_CM_single_cnt -3.4028234663852886E+38 3.4028234663852886E+38 /end CHARACTERISTIC
/begin CHARACTERISTIC CcCTM_CellOverTempEVMFault_C "" VALUE 0x70000444 Scalar_FLOAT32_IEEE 0 VBU0706_CM_single_cnt -3.4028234663852886E+38 3.4028234663852886E+38 /end CHARACTERISTIC
/begin CHARACTERISTIC CcCTM_CellOverTempFault_C "" VALUE 0x70000448 Scalar_FLOAT32_IEEE 0 VBU0706_CM_single_cnt -3.4028234663852886E+38 3.4028234663852886E+38 /end CHARACTERISTIC
/begin CHARACTERISTIC CcCTM_CellOverTempLvl2Fault_C "" VALUE 0x7000044c Scalar_FLOAT32_IEEE 0 VBU0706_CM_single_cnt -3.4028234663852886E+38 3.4028234663852886E+38 /end CHARACTERISTIC
/begin CHARACTERISTIC CcCTM_CellOverTempWarningFault_C "" VALUE 0x70000454 Scalar_FLOAT32_IEEE 0 VBU0706_CM_single_cnt -3.4028234663852886E+38 3.4028234663852886E+38 /end CHARACTERISTIC
/begin CHARACTERISTIC CcCTM_CellTempInvalidFaultDelayTime_ms "" VALUE 0x70000458 Scalar_FLOAT32_IEEE 0 VBU0706_CM_single_cnt -3.4028234663852886E+38 3.4028234663852886E+38 /end CHARACTERISTIC
/begin CHARACTERISTIC CcCTM_CellTempOverDeviationEVMFault_C "" VALUE 0x7000045c Scalar_FLOAT32_IEEE 0 VBU0706_CM_single_cnt -3.4028234663852886E+38 3.4028234663852886E+38 /end CHARACTERISTIC
/begin CHARACTERISTIC CcCTM_CellUnderTempFault_C "" VALUE 0x70000464 Scalar_FLOAT32_IEEE 0 VBU0706_CM_single_cnt -3.4028234663852886E+38 3.4028234663852886E+38 /end CHARACTERISTIC
/begin CHARACTERISTIC CcCTM_EnableEVMTempDevDelayTime_ms "" VALUE 0x70000468 Scalar_FLOAT32_IEEE 0 VBU0706_CM_single_cnt -3.4028234663852886E+38 3.4028234663852886E+38 /end CHARACTERISTIC
/begin CHARACTERISTIC CcCTM_EnableEVMTempDevThreshold_A "" VALUE 0x7000046c Scalar_FLOAT32_IEEE 0 VBU0706_CM_single_cnt -3.4028234663852886E+38 3.4028234663852886E+38 /end CHARACTERISTIC
/begin CHARACTERISTIC CcCTS_DeltaVoltagePrecharge_V "" VALUE 0x70000484 Scalar_FLOAT32_IEEE 0 VBU0706_CM_single_cnt 0.0 800.0 /end CHARACTERISTIC
/begin CHARACTERISTIC CcCTS_OpenContactorsDelayTime_ms "" VALUE 0x70000488 Scalar_FLOAT32_IEEE 0 VBU0706_CM_single_cnt -3.4028234663852886E+38 3.4028234663852886E+38 /end CHARACTERISTIC
/begin CHARACTERISTIC CcCTS_PrechargeTimerLimit_ms "" VALUE 0x7000048c Scalar_FLOAT32_IEEE 0 VBU0706_CM_single_cnt -3.4028234663852886E+38 3.4028234663852886E+38 /end CHARACTERISTIC
/begin CHARACTERISTIC CcCTS_PrechargeTimer_ms "" VALUE 0x70000490 Scalar_FLOAT32_IEEE 0 VBU0706_CM_single_cnt -3.4028234663852886E+38 3.4028234663852886E+38 /end CHARACTERISTIC
/begin CHARACTERISTIC CcCVT_CSCSupplyPowerLowHysteresis_V "" VALUE 0x70000498 Scalar_FLOAT32_IEEE 0 VBU0706_CM_single_V -3.4028234663852886E+38 3.4028234663852886E+38 /end CHARACTERISTIC
/begin CHARACTERISTIC CcCVT_CSCSupplyPowerLow_V "" VALUE 0x7000049c Scalar_FLOAT32_IEEE 0 VBU0706_CM_single_V -3.4028234663852886E+38 3.4028234663852886E+38 /end CHARACTERISTIC
/begin CHARACTERISTIC CcCVT_CellUnderVoltageLowTemp_C "" VALUE 0x700004a4 Scalar_FLOAT32_IEEE 0 VBU0706_CM_single_cnt -3.4028234663852886E+38 3.4028234663852886E+38 /end CHARACTERISTIC
/begin CHARACTERISTIC CcCVT_CellVoltageOverDeviationDisableCrrnt_A "" VALUE 0x700004a8 Scalar_FLOAT32_IEEE 0 VBU0706_CM_single_A -3.4028234663852886E+38 3.4028234663852886E+38 /end CHARACTERISTIC
/begin CHARACTERISTIC CaCVT_CellVoltageOverDeviationCurrentMapDimension_n "" VAL_BLK 0x700013d6 Scalar_ULONG 0 VBU0706_CM_uint32_cnt 0.0 4.294967295E+9 NUMBER 2 /end CHARACTERISTIC
/begin CHARACTERISTIC CcCTM_CellOverTempWarningDebounce_ms "" VALUE 0x70000450 Scalar_ULONG 0 VBU0706_CM_uint32_cnt 0.0 4.294967295E+9 /end CHARACTERISTIC
/begin CHARACTERISTIC CcCVT_CellOverVoltageWarningDebounce_ms "" VALUE 0x700004a0 Scalar_ULONG 0 VBU0706_CM_uint32_ms 0.0 4.294967295E+9 /end CHARACTERISTIC
/begin CHARACTERISTIC CTM_CELL_UNDER_TEMP_FAULT "" VALUE 0x7000001c Scalar_UWORD 0 VBU0706_CM_uint16_cnt 0.0 65535.0 /end CHARACTERISTIC
/begin CHARACTERISTIC CcBCV_BDMOutputDelayTime_ms "" VALUE 0x70000022 Scalar_UWORD 0 VBU0706_CM_uint16_cnt 0.0 65535.0 /end CHARACTERISTIC
/begin CHARACTERISTIC CcBMM_MaxAfterrunTime_s "" VALUE 0x70000036 Scalar_UWORD 0 VBU0706_CM_uint16_cnt 0.0 65535.0 /end CHARACTERISTIC
/begin CHARACTERISTIC CcBMM_SOCJumpDelayTime_ms "" VALUE 0x7000003a Scalar_UWORD 0 VBU0706_CM_uint16_cnt 0.0 65535.0 /end CHARACTERISTIC
/begin CHARACTERISTIC CcBMM_SOCJumpPowerOnDelayTime_ms "" VALUE 0x7000003c Scalar_UWORD 0 VBU0706_CM_uint16_cnt 0.0 65535.0 /end CHARACTERISTIC
/begin CHARACTERISTIC CcBMM_WakeupLineFEDebounceTime_ms "" VALUE 0x7000003e Scalar_UWORD 0 VBU0706_CM_uint16_cnt 0.0 65535.0 /end CHARACTERISTIC
/begin CHARACTERISTIC CcCTS_CmdMnPosContactorDelayTime_ms "" VALUE 0x7000004e Scalar_UWORD 0 VBU0706_CM_uint16_cnt 0.0 65535.0 /end CHARACTERISTIC
/begin CHARACTERISTIC CcCTS_DiagnoseMPCWeldCheckDischargeTime_ms "" VALUE 0x70000052 Scalar_UWORD 0 VBU0706_CM_uint16_cnt 0.0 65535.0 /end CHARACTERISTIC
/begin CHARACTERISTIC CcCTS_DiagnoseMPCWeldCheckTime_ms "" VALUE 0x70000054 Scalar_UWORD 0 VBU0706_CM_uint16_cnt 0.0 65535.0 /end CHARACTERISTIC
/begin CHARACTERISTIC CcCTS_MaxCloseAndDiagnoseContactorsTime_ms "" VALUE 0x70000056 Scalar_UWORD 0 VBU0706_CM_uint16_cnt 0.0 65535.0 /end CHARACTERISTIC
/begin CHARACTERISTIC CcCTS_MinOpenAndDiagnoseWeldTime_ms "" VALUE 0x70000058 Scalar_UWORD 0 VBU0706_CM_uint16_cnt 0.0 65535.0 /end CHARACTERISTIC
/begin CHARACTERISTIC CcCTS_PrechargeTimerThreshold1_ms "" VALUE 0x7000005a Scalar_UWORD 0 VBU0706_CM_uint16_cnt 0.0 65535.0 /end CHARACTERISTIC
/begin CHARACTERISTIC CcCTS_PrechargeTimerThreshold2_ms "" VALUE 0x7000005c Scalar_UWORD 0 VBU0706_CM_uint16_cnt 0.0 65535.0 /end CHARACTERISTIC
/begin CHARACTERISTIC CcCTS_PrechargeTimerThreshold3_ms "" VALUE 0x7000005e Scalar_UWORD 0 VBU0706_CM_uint16_cnt 0.0 65535.0 /end CHARACTERISTIC
/begin CHARACTERISTIC CcCVT_CellOverVoltageEVMFault_mV "" VALUE 0x70000060 Scalar_UWORD 0 VBU0706_CM_uint16_mV 0.0 65535.0 /end CHARACTERISTIC
/begin CHARACTERISTIC CcCVT_CellOverVoltageFault_mV "" VALUE 0x70000062 Scalar_UWORD 0 VBU0706_CM_uint16_mV 0.0 65535.0 /end CHARACTERISTIC
/begin CHARACTERISTIC CcCVT_CellOverVoltageWarningFault_mV "" VALUE 0x70000064 Scalar_UWORD 0 VBU0706_CM_uint16_mV 0.0 65535.0 /end CHARACTERISTIC
/begin CHARACTERISTIC CcCVT_CellUnderVoltageEVMFault_mV "" VALUE 0x70000066 Scalar_UWORD 0 VBU0706_CM_uint16_mV 0.0 65535.0 /end CHARACTERISTIC
/begin CHARACTERISTIC CcCVT_CellUnderVoltageFaultLevel2_mV "" VALUE 0x70000068 Scalar_UWORD 0 VBU0706_CM_uint16_mV 0.0 65535.0 /end CHARACTERISTIC
/begin CHARACTERISTIC CcCVT_CellUnderVoltageFault_mV "" VALUE 0x7000006a Scalar_UWORD 0 VBU0706_CM_uint16_mV 0.0 65535.0 /end CHARACTERISTIC
/begin CHARACTERISTIC CcCVT_CellVoltageInvalidFaultDelayTime_ms "" VALUE 0x7000006c Scalar_UWORD 0 VBU0706_CM_uint16_ms 0.0 65535.0 /end CHARACTERISTIC
/begin CHARACTERISTIC CcCVT_CellVoltageOverDeviationCurrentDelay_s "" VALUE 0x7000006e Scalar_UWORD 0 VBU0706_CM_uint16_s 0.0 65535.0 /end CHARACTERISTIC
/begin CHARACTERISTIC CcCVT_CellVoltageOverDeviationEVMFault_mV "" VALUE 0x70000070 Scalar_UWORD 0 VBU0706_CM_uint16_mV 0.0 65535.0 /end CHARACTERISTIC
/begin CHARACTERISTIC CcCVT_CellVoltageOverDeviationFault_mV "" VALUE 0x70000072 Scalar_UWORD 0 VBU0706_CM_uint16_mV 0.0 65535.0 /end CHARACTERISTIC
/begin CHARACTERISTIC CcDSM_DiverCycleflgDelayTime_ms "" VALUE 0x70000074 Scalar_UWORD 0 VBU0706_CM_uint16_cnt 0.0 65535.0 /end CHARACTERISTIC
/begin CHARACTERISTIC CcSYS_SystemMaxInitialTime_ms "" VALUE 0x700000f0 Scalar_UWORD 0 VBU0706_CM_uint16_cnt 0.0 65535.0 /end CHARACTERISTIC
/begin CHARACTERISTIC MILIAMPERES_PER_AMPERE_SY "" VALUE 0x70000106 Scalar_UWORD 0 VBU0706_CM_uint16_cnt 0.0 65535.0 /end CHARACTERISTIC
/begin CHARACTERISTIC SAMPLE_TIME_TASK_D "" VALUE 0x70000114 Scalar_UWORD 0 VBU0706_CM_uint16_cnt 0.0 65535.0 /end CHARACTERISTIC
/begin CHARACTERISTIC CbBCV_HALBatteryVoltageORF_flg "" VALUE 0x7001081d Scalar_BOOLEAN 0 VBU0706_CM_boolean_cnt 0.0 1.0 /end CHARACTERISTIC
/begin CHARACTERISTIC CbBCV_HALBatteryVoltageStatusORF_flg "" VALUE 0x7001081e Scalar_BOOLEAN 0 VBU0706_CM_boolean_cnt 0.0 1.0 /end CHARACTERISTIC
/begin CHARACTERISTIC CbBCV_HALBatteryVoltageStatusORV_flg "" VALUE 0x7001081f Scalar_BOOLEAN 0 VBU0706_CM_boolean_cnt 0.0 1.0 /end CHARACTERISTIC
/begin CHARACTERISTIC CbBCV_HALBusNegativeVoltageORF_flg "" VALUE 0x70010820 Scalar_BOOLEAN 0 VBU0706_CM_boolean_cnt 0.0 1.0 /end CHARACTERISTIC
/begin CHARACTERISTIC CbBCV_HALBusNegativeVoltageStatusORF_flg "" VALUE 0x70010821 Scalar_BOOLEAN 0 VBU0706_CM_boolean_cnt 0.0 1.0 /end CHARACTERISTIC
/begin CHARACTERISTIC CbBCV_HALBusNegativeVoltageStatusORV_flg "" VALUE 0x70010822 Scalar_BOOLEAN 0 VBU0706_CM_boolean_cnt 0.0 1.0 /end CHARACTERISTIC
/begin CHARACTERISTIC CbBCV_HALFuseVoltageORF_flg "" VALUE 0x70010823 Scalar_BOOLEAN 0 VBU0706_CM_boolean_cnt 0.0 1.0 /end CHARACTERISTIC
/begin CHARACTERISTIC CbBCV_HALFuseVoltageStatusORF_flg "" VALUE 0x70010824 Scalar_BOOLEAN 0 VBU0706_CM_boolean_cnt 0.0 1.0 /end CHARACTERISTIC
/begin CHARACTERISTIC CbBCV_HALFuseVoltageStatusORV_flg "" VALUE 0x70010825 Scalar_BOOLEAN 0 VBU0706_CM_boolean_cnt 0.0 1.0 /end CHARACTERISTIC
/begin CHARACTERISTIC CbBCV_HALPrechargeVoltageORF_flg "" VALUE 0x70010826 Scalar_BOOLEAN 0 VBU0706_CM_boolean_cnt 0.0 1.0 /end CHARACTERISTIC
/begin CHARACTERISTIC CbBCV_HALPrechargeVoltageStatusORF_flg "" VALUE 0x70010827 Scalar_BOOLEAN 0 VBU0706_CM_boolean_cnt 0.0 1.0 /end CHARACTERISTIC
/begin CHARACTERISTIC CbBCV_HALPrechargeVoltageStatusORV_flg "" VALUE 0x70010828 Scalar_BOOLEAN 0 VBU0706_CM_boolean_cnt 0.0 1.0 /end CHARACTERISTIC
/begin CHARACTERISTIC CbBCV_HALVx2VoltageORF_flg "" VALUE 0x70010829 Scalar_BOOLEAN 0 VBU0706_CM_boolean_cnt 0.0 1.0 /end CHARACTERISTIC
/begin CHARACTERISTIC CbBCV_HALVx2VoltageStatusORF_flg "" VALUE 0x7001082a Scalar_BOOLEAN 0 VBU0706_CM_boolean_cnt 0.0 1.0 /end CHARACTERISTIC
/begin CHARACTERISTIC CbBCV_HALVx2VoltageStatusORV_flg "" VALUE 0x7001082b Scalar_BOOLEAN 0 VBU0706_CM_boolean_cnt 0.0 1.0 /end CHARACTERISTIC
/begin CHARACTERISTIC CbBMM_DriverIntentionChangeEnable_flg "" VALUE 0x70010830 Scalar_BOOLEAN 0 VBU0706_CM_boolean_cnt 0.0 1.0 /end CHARACTERISTIC
/begin CHARACTERISTIC CbBMM_FastChargeWakeupEnable_flg "" VALUE 0x70010831 Scalar_BOOLEAN 0 VBU0706_CM_boolean_cnt 0.0 1.0 /end CHARACTERISTIC
/begin CHARACTERISTIC CbCBL_CTMBoardTempValidORF_flg "" VALUE 0x70010833 Scalar_BOOLEAN 0 VBU0706_CM_boolean_cnt 0.0 1.0 /end CHARACTERISTIC
/begin CHARACTERISTIC CbCBL_CTMBoardTempValidORV_flg "" VALUE 0x70010834 Scalar_BOOLEAN 0 VBU0706_CM_boolean_cnt 0.0 1.0 /end CHARACTERISTIC
/begin CHARACTERISTIC CbCTD_MainFuseBlownFaultEnable_flg "" VALUE 0x70010839 Scalar_BOOLEAN 0 VBU0706_CM_boolean_cnt 0.0 1.0 /end CHARACTERISTIC
/begin CHARACTERISTIC CbCTD_PrechargeResistanceBlownFaultEnable_flg "" VALUE 0x70010842 Scalar_BOOLEAN 0 VBU0706_CM_boolean_cnt 0.0 1.0 /end CHARACTERISTIC
/begin CHARACTERISTIC CbCTM_CellOverTempEVMFaultEnable_flg "" VALUE 0x70010846 Scalar_BOOLEAN 0 VBU0706_CM_boolean_cnt 0.0 1.0 /end CHARACTERISTIC
/begin CHARACTERISTIC CbCTM_CellOverTempFaultEnable_flg "" VALUE 0x70010847 Scalar_BOOLEAN 0 VBU0706_CM_boolean_cnt 0.0 1.0 /end CHARACTERISTIC
/begin CHARACTERISTIC CbCTM_CellTempOverDeviationEVMFaultEnable_flg "" VALUE 0x70010848 Scalar_BOOLEAN 0 VBU0706_CM_boolean_cnt 0.0 1.0 /end CHARACTERISTIC
/begin CHARACTERISTIC CbCTM_CellUnderTempFaultEnable_flg "" VALUE 0x7001084a Scalar_BOOLEAN 0 VBU0706_CM_boolean_cnt 0.0 1.0 /end CHARACTERISTIC
/begin CHARACTERISTIC CbDSM_AbnormalEventOvrValue_flg "" VALUE 0x70010857 Scalar_BOOLEAN 0 VBU0706_CM_boolean_cnt 0.0 1.0 /end CHARACTERISTIC
/begin CHARACTERISTIC CbDSM_AbnormalEventOvr_flg "" VALUE 0x70010858 Scalar_BOOLEAN 0 VBU0706_CM_boolean_cnt 0.0 1.0 /end CHARACTERISTIC
/begin CHARACTERISTIC CbDSM_ClearFaultData_flg "" VALUE 0x70010859 Scalar_BOOLEAN 0 VBU0706_CM_boolean_cnt 0.0 1.0 /end CHARACTERISTIC
/begin CHARACTERISTIC CbDSM_CscValueUncertainOvrValue_flg "" VALUE 0x7001085a Scalar_BOOLEAN 0 VBU0706_CM_boolean_cnt 0.0 1.0 /end CHARACTERISTIC
/begin CHARACTERISTIC CbDSM_CscValueUncertainOvr_flg "" VALUE 0x7001085b Scalar_BOOLEAN 0 VBU0706_CM_boolean_cnt 0.0 1.0 /end CHARACTERISTIC
/begin CHARACTERISTIC CbDSM_NoChargeOvrValue_flg "" VALUE 0x7001085c Scalar_BOOLEAN 0 VBU0706_CM_boolean_cnt 0.0 1.0 /end CHARACTERISTIC
/begin CHARACTERISTIC CbDSM_NoChargeOvr_flg "" VALUE 0x7001085d Scalar_BOOLEAN 0 VBU0706_CM_boolean_cnt 0.0 1.0 /end CHARACTERISTIC
/begin CHARACTERISTIC CbDSM_NoRestartOverride_flg "" VALUE 0x7001085e Scalar_BOOLEAN 0 VBU0706_CM_boolean_cnt 0.0 1.0 /end CHARACTERISTIC
/begin CHARACTERISTIC CbDSM_NoRestartOvrValue_flg "" VALUE 0x7001085f Scalar_BOOLEAN 0 VBU0706_CM_boolean_cnt 0.0 1.0 /end CHARACTERISTIC
/begin CHARACTERISTIC CcCBL_CTMBoardTempMaxORF_flg "" VALUE 0x70010909 Scalar_BOOLEAN 0 VBU0706_CM_boolean_cnt 0.0 1.0 /end CHARACTERISTIC
/begin CHARACTERISTIC CcCTD_MainFuseBlownFaultFIC_n "" VALUE 0x7001090b Scalar_BYTE 0 VBU0706_CM_int8_cnt -128.0 127.0 /end CHARACTERISTIC
/begin CHARACTERISTIC CcCTD_MainFuseBlownFaultPIC_n "" VALUE 0x7001090c Scalar_BYTE 0 VBU0706_CM_int8_cnt -128.0 127.0 /end CHARACTERISTIC
/begin CHARACTERISTIC CcCTD_PrechargeResistanceBlownFaultFIC_n "" VALUE 0x7001091a Scalar_BYTE 0 VBU0706_CM_int8_cnt -128.0 127.0 /end CHARACTERISTIC
/begin CHARACTERISTIC CcCTD_PrechargeResistanceBlownFaultPIC_n "" VALUE 0x7001091b Scalar_BYTE 0 VBU0706_CM_int8_cnt -128.0 127.0 /end CHARACTERISTIC
/begin CHARACTERISTIC CcCTM_CellOverTempEVMFaultFIC_n "" VALUE 0x70010922 Scalar_BYTE 0 VBU0706_CM_int8_cnt -128.0 127.0 /end CHARACTERISTIC
/begin CHARACTERISTIC CcCTM_CellOverTempEVMFaultPIC_n "" VALUE 0x70010923 Scalar_BYTE 0 VBU0706_CM_int8_cnt -128.0 127.0 /end CHARACTERISTIC
/begin CHARACTERISTIC CcCTM_CellOverTempFaultFIC_n "" VALUE 0x70010924 Scalar_BYTE 0 VBU0706_CM_int8_cnt -128.0 127.0 /end CHARACTERISTIC
/begin CHARACTERISTIC CcCTM_CellOverTempFaultPIC_n "" VALUE 0x70010925 Scalar_BYTE 0 VBU0706_CM_int8_cnt -128.0 127.0 /end CHARACTERISTIC
/begin CHARACTERISTIC CcCTM_CellTempOverDeviationEVMFaultFIC_n "" VALUE 0x70010927 Scalar_BYTE 0 VBU0706_CM_int8_cnt -128.0 127.0 /end CHARACTERISTIC
/begin CHARACTERISTIC CcCTM_CellTempOverDeviationEVMFaultPIC_n "" VALUE 0x70010928 Scalar_BYTE 0 VBU0706_CM_int8_cnt -128.0 127.0 /end CHARACTERISTIC
/begin CHARACTERISTIC CcCTM_CellUnderTempFaultFIC_n "" VALUE 0x7001092b Scalar_BYTE 0 VBU0706_CM_int8_cnt -128.0 127.0 /end CHARACTERISTIC
/begin CHARACTERISTIC CcCTM_CellUnderTempFaultPIC_n "" VALUE 0x7001092c Scalar_BYTE 0 VBU0706_CM_int8_cnt -128.0 127.0 /end CHARACTERISTIC
/begin CHARACTERISTIC CcCVT_CellOverVoltageEVMFaultFIC_n "" VALUE 0x70010937 Scalar_BYTE 0 VBU0706_CM_int8_n -128.0 127.0 /end CHARACTERISTIC
/begin CHARACTERISTIC CcCVT_CellOverVoltageEVMFaultPIC_n "" VALUE 0x70010938 Scalar_BYTE 0 VBU0706_CM_int8_n -128.0 127.0 /end CHARACTERISTIC
/begin CHARACTERISTIC CcCVT_CellOverVoltageFaultPIC_n "" VALUE 0x7001093a Scalar_BYTE 0 VBU0706_CM_int8_n -128.0 127.0 /end CHARACTERISTIC
/begin CHARACTERISTIC CcCVT_CellUnderVoltageEVMFaultFIC_n "" VALUE 0x7001093b Scalar_BYTE 0 VBU0706_CM_int8_n -128.0 127.0 /end CHARACTERISTIC
/begin CHARACTERISTIC CcCVT_CellUnderVoltageEVMFaultPIC_n "" VALUE 0x7001093c Scalar_BYTE 0 VBU0706_CM_int8_n -128.0 127.0 /end CHARACTERISTIC
/begin CHARACTERISTIC CcCVT_CellUnderVoltageFaultFIC_n "" VALUE 0x7001093d Scalar_BYTE 0 VBU0706_CM_int8_n -128.0 127.0 /end CHARACTERISTIC
/begin CHARACTERISTIC CcCVT_CellUnderVoltageFaultPIC_n "" VALUE 0x7001093e Scalar_BYTE 0 VBU0706_CM_int8_n -128.0 127.0 /end CHARACTERISTIC
/begin CHARACTERISTIC CcCVT_CellVoltageOverDeviationEVMFaultFIC_n "" VALUE 0x70010940 Scalar_BYTE 0 VBU0706_CM_int8_n -128.0 127.0 /end CHARACTERISTIC
/begin CHARACTERISTIC CcCVT_CellVoltageOverDeviationEVMFaultPIC_n "" VALUE 0x70010941 Scalar_BYTE 0 VBU0706_CM_int8_n -128.0 127.0 /end CHARACTERISTIC
/begin CHARACTERISTIC CcCVT_CellVoltageOverDeviationFaultFIC_n "" VALUE 0x70010942 Scalar_BYTE 0 VBU0706_CM_int8_n -128.0 127.0 /end CHARACTERISTIC
/begin CHARACTERISTIC CcCVT_CellVoltageOverDeviationFaultPIC_n "" VALUE 0x70010943 Scalar_BYTE 0 VBU0706_CM_int8_n -128.0 127.0 /end CHARACTERISTIC
/begin CHARACTERISTIC BMM_MaxWakeUpCounter_n "" VALUE 0x70010796 Scalar_UBYTE 0 VBU0706_CM_uint8_cnt 0.0 255.0 /end CHARACTERISTIC
/begin CHARACTERISTIC BMM_VEHICLE_WAKEUP_MODE_FAST_CHARGE "" VALUE 0x700107a0 Scalar_UBYTE 0 VBU0706_CM_uint8_cnt 0.0 255.0 /end CHARACTERISTIC
/begin CHARACTERISTIC BMM_VEHICLE_WAKEUP_MODE_IGNITION_ON "" VALUE 0x700107a1 Scalar_UBYTE 0 VBU0706_CM_uint8_cnt 0.0 255.0 /end CHARACTERISTIC
/begin CHARACTERISTIC BMM_VEHICLE_WAKEUP_MODE_SOFTWARE_FLASHING "" VALUE 0x700107a2 Scalar_UBYTE 0 VBU0706_CM_uint8_cnt 0.0 255.0 /end CHARACTERISTIC
/begin CHARACTERISTIC CTD_MAIN_CONTACTOR_STATUS_Open "" VALUE 0x700107e9 Scalar_UBYTE 0 VBU0706_CM_uint8_cnt 0.0 255.0 /end CHARACTERISTIC
/begin CHARACTERISTIC CTD_MAIN_CONTACTOR_STATUS_UNKNOWN "" VALUE 0x700107ea Scalar_UBYTE 0 VBU0706_CM_uint8_cnt 0.0 255.0 /end CHARACTERISTIC
/begin CHARACTERISTIC CTD_MAIN_FUSE_BLOWN_FAULT "" VALUE 0x700107eb Scalar_UBYTE 0 VBU0706_CM_uint8_cnt 0.0 255.0 /end CHARACTERISTIC
/begin CHARACTERISTIC CTD_PRECHARGE_STATUS_FAIL "" VALUE 0x700107ef Scalar_UBYTE 0 VBU0706_CM_uint8_cnt 0.0 255.0 /end CHARACTERISTIC
/begin CHARACTERISTIC CTD_PRECHARGE_STATUS_SUCCESS "" VALUE 0x700107f1 Scalar_UBYTE 0 VBU0706_CM_uint8_cnt 0.0 255.0 /end CHARACTERISTIC
/begin CHARACTERISTIC CTS_MAIN_CONTACTOR_COMMAND_CLOSE "" VALUE 0x700107f2 Scalar_UBYTE 0 VBU0706_CM_uint8_cnt 0.0 255.0 /end CHARACTERISTIC
/begin CHARACTERISTIC CTS_MAIN_CONTACTOR_COMMAND_OPEN "" VALUE 0x700107f3 Scalar_UBYTE 0 VBU0706_CM_uint8_cnt 0.0 255.0 /end CHARACTERISTIC
/begin CHARACTERISTIC CTS_PEU_DISCHARGE_ACTIVE "" VALUE 0x700107f4 Scalar_UBYTE 0 VBU0706_CM_uint8_cnt 0.0 255.0 /end CHARACTERISTIC
/begin CHARACTERISTIC CTS_STATE_CLOSE_AND_DIAGNOSE_MPR_STUCKOPEN "" VALUE 0x700107f5 Scalar_UBYTE 0 VBU0706_CM_uint8_cnt 0.0 255.0 /end CHARACTERISTIC
/begin CHARACTERISTIC CTS_STATE_CLOSE_MC_HSD_DIAGNOSE_LSD_STG "" VALUE 0x700107f6 Scalar_UBYTE 0 VBU0706_CM_uint8_cnt 0.0 255.0 /end CHARACTERISTIC
/begin CHARACTERISTIC CTS_STATE_CLOSE_MNC_PRECHARGING_MONITORING "" VALUE 0x700107f7 Scalar_UBYTE 0 VBU0706_CM_uint8_cnt 0.0 255.0 /end CHARACTERISTIC
/begin CHARACTERISTIC CTS_STATE_CLOSE_MPC "" VALUE 0x700107f8 Scalar_UBYTE 0 VBU0706_CM_uint8_cnt 0.0 255.0 /end CHARACTERISTIC
/begin CHARACTERISTIC CTS_STATE_DEACTIVATION "" VALUE 0x700107f9 Scalar_UBYTE 0 VBU0706_CM_uint8_cnt 0.0 255.0 /end CHARACTERISTIC
/begin CHARACTERISTIC CTS_STATE_DIAGNOSE_MNC_WELD "" VALUE 0x700107fa Scalar_UBYTE 0 VBU0706_CM_uint8_cnt 0.0 255.0 /end CHARACTERISTIC
/begin CHARACTERISTIC CTS_STATE_DIAGNOSE_MPC_WELD "" VALUE 0x700107fb Scalar_UBYTE 0 VBU0706_CM_uint8_cnt 0.0 255.0 /end CHARACTERISTIC
/begin CHARACTERISTIC CTS_STATE_DIAGNOSE_MPC_WELD_POWER_DOWN "" VALUE 0x700107fc Scalar_UBYTE 0 VBU0706_CM_uint8_cnt 0.0 255.0 /end CHARACTERISTIC
/begin CHARACTERISTIC CTS_STATE_NORMAL_OPERATING "" VALUE 0x700107fd Scalar_UBYTE 0 VBU0706_CM_uint8_cnt 0.0 255.0 /end CHARACTERISTIC
/begin CHARACTERISTIC CTS_STATE_OPEN_MAIN_POSITIVE_CONTACTOR "" VALUE 0x700107fe Scalar_UBYTE 0 VBU0706_CM_uint8_cnt 0.0 255.0 /end CHARACTERISTIC
/begin CHARACTERISTIC CTS_STATE_OPEN_MC_AND_DIAGNOSE_WELD "" VALUE 0x700107ff Scalar_UBYTE 0 VBU0706_CM_uint8_cnt 0.0 255.0 /end CHARACTERISTIC
/begin CHARACTERISTIC CTS_STATE_OPEN_MC_HSD "" VALUE 0x70010800 Scalar_UBYTE 0 VBU0706_CM_uint8_cnt 0.0 255.0 /end CHARACTERISTIC
/begin CHARACTERISTIC CTS_STATE_OPEN_MPR_AND_DIAGNOSE_MPC_STUCKOPEN "" VALUE 0x70010801 Scalar_UBYTE 0 VBU0706_CM_uint8_cnt 0.0 255.0 /end CHARACTERISTIC
/begin CHARACTERISTIC CTS_STATE_STANDBY "" VALUE 0x70010802 Scalar_UBYTE 0 VBU0706_CM_uint8_cnt 0.0 255.0 /end CHARACTERISTIC
/begin CHARACTERISTIC CVT_CELL_VOLTAGE_OVER_DEVIATION_FAULT "" VALUE 0x70010807 Scalar_UBYTE 0 VBU0706_CM_uint8_cnt 0.0 255.0 /end CHARACTERISTIC
/begin CHARACTERISTIC CYCLE_WAKEUP_STATE_ABNORMAL "" VALUE 0x70010808 Scalar_UBYTE 0 VBU0706_CM_uint8_cnt 0.0 255.0 /end CHARACTERISTIC
/begin CHARACTERISTIC CYCLE_WAKEUP_STATE_INIT "" VALUE 0x70010809 Scalar_UBYTE 0 VBU0706_CM_uint8_cnt 0.0 255.0 /end CHARACTERISTIC
/begin CHARACTERISTIC CaDSM_FaultCat_enum "" VAL_BLK 0x70010eaf Scalar_UBYTE 0 VBU0706_CM_uint8_cnt 0.0 255.0 NUMBER 330 /end CHARACTERISTIC
/begin CHARACTERISTIC CbCVT_CellOverVoltageEVMFaultEnable_flg "" VALUE 0x70010851 Scalar_UBYTE 0 VBU0706_CM_uint8_cnt 0.0 255.0 /end CHARACTERISTIC
/begin CHARACTERISTIC CbCVT_CellOverVoltageFaultEnable_flg "" VALUE 0x70010852 Scalar_UBYTE 0 VBU0706_CM_uint8_cnt 0.0 255.0 /end CHARACTERISTIC
/begin CHARACTERISTIC CbCVT_CellUnderVoltageEVMFaultEnable_flg "" VALUE 0x70010853 Scalar_UBYTE 0 VBU0706_CM_uint8_cnt 0.0 255.0 /end CHARACTERISTIC
/begin CHARACTERISTIC CbCVT_CellUnderVoltageFaultEnable_flg "" VALUE 0x70010854 Scalar_UBYTE 0 VBU0706_CM_uint8_cnt 0.0 255.0 /end CHARACTERISTIC
/begin CHARACTERISTIC CbCVT_CellVoltageOverDeviationEVMFaultEnable_flg "" VALUE 0x70010855 Scalar_UBYTE 0 VBU0706_CM_uint8_cnt 0.0 255.0 /end CHARACTERISTIC
/begin CHARACTERISTIC CbCVT_CellVoltageOverDeviationFaultEnable_flg "" VALUE 0x70010856 Scalar_UBYTE 0 VBU0706_CM_uint8_cnt 0.0 255.0 /end CHARACTERISTIC
/begin CHARACTERISTIC CcCTM_CellTempInvalidFault_n "" VALUE 0x70010926 Scalar_UBYTE 0 VBU0706_CM_uint8_cnt 0.0 255.0 /end CHARACTERISTIC
/begin CHARACTERISTIC CcCTS_MaxPrechargeTimes_n "" VALUE 0x70010930 Scalar_UBYTE 0 VBU0706_CM_uint8_cnt 0.0 255.0 /end CHARACTERISTIC
/begin CHARACTERISTIC CcCTS_NegativeLoadCurrent_A "" VALUE 0x70010931 Scalar_UBYTE 0 VBU0706_CM_uint8_cnt 0.0 255.0 /end CHARACTERISTIC
/begin CHARACTERISTIC CcCTS_PositiveLoadCurrent_A "" VALUE 0x70010932 Scalar_UBYTE 0 VBU0706_CM_uint8_cnt 0.0 255.0 /end CHARACTERISTIC
/begin CHARACTERISTIC CcCTS_PrechargeTimesLimitEnable_flg "" VALUE 0x70010933 Scalar_UBYTE 0 VBU0706_CM_uint8_cnt 0.0 255.0 /end CHARACTERISTIC
/begin CHARACTERISTIC CcCTS_PrechargeTimesLower_n "" VALUE 0x70010934 Scalar_UBYTE 0 VBU0706_CM_uint8_cnt 0.0 255.0 /end CHARACTERISTIC
/begin CHARACTERISTIC CcCTS_PrechargeTimesUpper_n "" VALUE 0x70010935 Scalar_UBYTE 0 VBU0706_CM_uint8_cnt 0.0 255.0 /end CHARACTERISTIC
/begin CHARACTERISTIC CcCVT_CellOverVoltageFaultFIC_n "" VALUE 0x70010939 Scalar_UBYTE 0 VBU0706_CM_uint8_n 0.0 255.0 /end CHARACTERISTIC
/begin CHARACTERISTIC CcCVT_CellVoltageInvalidFault_n "" VALUE 0x7001093f Scalar_UBYTE 0 VBU0706_CM_uint8_n 0.0 255.0 /end CHARACTERISTIC
/begin CHARACTERISTIC CmSYS_OpenContactorsDelayFaultCat_enum "" VALUE 0x70010998 Scalar_UBYTE 0 VBU0706_CM_uint8_cnt 0.0 255.0 /end CHARACTERISTIC
/begin CHARACTERISTIC CmSYS_OpenContactorsNowFaultCat_enum "" VALUE 0x70010999 Scalar_UBYTE 0 VBU0706_CM_uint8_cnt 0.0 255.0 /end CHARACTERISTIC
/begin CHARACTERISTIC DIAGNOSTIC_COMPLETE "" VALUE 0x70010a6e Scalar_UBYTE 0 VBU0706_CM_uint8_cnt 0.0 255.0 /end CHARACTERISTIC
/begin CHARACTERISTIC DIAGNOSTIC_CONDITION_NOT_MET "" VALUE 0x70010a6f Scalar_UBYTE 0 VBU0706_CM_uint8_cnt 0.0 255.0 /end CHARACTERISTIC
/begin CHARACTERISTIC PMM_stDCChMode_SY "" VALUE 0x70010b58 Scalar_UBYTE 0 VBU0706_CM_uint8_cnt 0.0 255.0 /end CHARACTERISTIC
/begin CHARACTERISTIC VCR_CONTACTOR_NO_REQUEST "" VALUE 0x70010bcd Scalar_UBYTE 0 VBU0706_CM_uint8_cnt 0.0 255.0 /end CHARACTERISTIC
/begin CHARACTERISTIC VCR_CONTACTOR_OPEN "" VALUE 0x70010bce Scalar_UBYTE 0 VBU0706_CM_uint8_cnt 0.0 255.0 /end CHARACTERISTIC
/begin MEASUREMENT CTD_stMnPosContactorStatus "" FLOAT32_IEEE VBU0706_CM_single 0 0 -3.4E+38 3.4E+38 ECU_ADDRESS 0x700114c2 /end MEASUREMENT
/begin MEASUREMENT CTD_stMnNegContactorStatus "" FLOAT32_IEEE VBU0706_CM_single 0 0 -3.4E+38 3.4E+38 ECU_ADDRESS 0x700114be /end MEASUREMENT
/begin MEASUREMENT CTD_stPrechargeContactorStatus "" FLOAT32_IEEE VBU0706_CM_single 0 0 -3.4E+38 3.4E+38 ECU_ADDRESS 0x700114c6 /end MEASUREMENT
/begin MEASUREMENT CTD_stHeatingContactorStatus "" FLOAT32_IEEE VBU0706_CM_single 0 0 -3.4E+38 3.4E+38 ECU_ADDRESS 0x700114ba /end MEASUREMENT
/begin MEASUREMENT CTS_timsPrechargeTimer "" FLOAT32_IEEE VBU0706_CM_single 0 0 -3.4E+38 3.4E+38 ECU_ADDRESS 0x700114ee /end MEASUREMENT
/begin MEASUREMENT CVT_uCellVoltagePack "" FLOAT32_IEEE VBU0706_CM_single 0 0 -3.4E+38 3.4E+38 ECU_ADDRESS 0x700114f2 /end MEASUREMENT
/begin MEASUREMENT CTM_tCellTempMin "" FLOAT32_IEEE VBU0706_CM_single 0 0 -3.4E+38 3.4E+38 ECU_ADDRESS 0x700114da /end MEASUREMENT
/begin MEASUREMENT CTM_tOriginalCellTempMin "" FLOAT32_IEEE VBU0706_CM_single 0 0 -3.4E+38 3.4E+38 ECU_ADDRESS 0x700114e6 /end MEASUREMENT
/begin MEASUREMENT CTM_tCellTempMax "" FLOAT32_IEEE VBU0706_CM_single 0 0 -3.4E+38 3.4E+38 ECU_ADDRESS 0x700114d6 /end MEASUREMENT
/begin MEASUREMENT CTM_tOriginalCellTempMax "" FLOAT32_IEEE VBU0706_CM_single 0 0 -3.4E+38 3.4E+38 ECU_ADDRESS 0x700114e2 /end MEASUREMENT
/begin MEASUREMENT CTM_tCellTempAve "" FLOAT32_IEEE VBU0706_CM_single 0 0 -3.4E+38 3.4E+38 ECU_ADDRESS 0x700114d2 /end MEASUREMENT
/begin MEASUREMENT CTM_tOriginalCellTempAve "" FLOAT32_IEEE VBU0706_CM_single 0 0 -3.4E+38 3.4E+38 ECU_ADDRESS 0x700114de /end MEASUREMENT
/begin MEASUREMENT CTM_tOriginalCellTempSecondMax "" FLOAT32_IEEE VBU0706_CM_single 0 0 -40.0 200.0 ECU_ADDRESS 0x700114ea /end MEASUREMENT
/begin MEASUREMENT BCV_iABatteryCurrentRaw "" FLOAT32_IEEE VBU0706_CM_single 0 0 -3.4E+38 3.4E+38 ECU_ADDRESS 0x7001144a /end MEASUREMENT
/begin MEASUREMENT HV5_MP_Pcharge_Relay__AD "" FLOAT32_IEEE VBU0706_CM_single 0 0 -3.4E+38 3.4E+38 ECU_ADDRESS 0x70011676 /end MEASUREMENT
/begin MEASUREMENT Hall2_AD "" FLOAT32_IEEE VBU0706_CM_single 0 0 -3.4E+38 3.4E+38 ECU_ADDRESS 0x7001167e /end MEASUREMENT
/begin MEASUREMENT Hall1_AD "" FLOAT32_IEEE VBU0706_CM_single 0 0 -3.4E+38 3.4E+38 ECU_ADDRESS 0x7001167a /end MEASUREMENT
/begin MEASUREMENT Total_Volt_B "" FLOAT32_IEEE VBU0706_CM_single 0 0 -3.4E+38 3.4E+38 ECU_ADDRESS 0x70011b66 /end MEASUREMENT
/begin MEASUREMENT LINK_Relay_MN_AD "" FLOAT32_IEEE VBU0706_CM_single 0 0 -3.4E+38 3.4E+38 ECU_ADDRESS 0x700116e2 /end MEASUREMENT
/begin MEASUREMENT HV4_Heat_Fuse__AD "" FLOAT32_IEEE VBU0706_CM_single 0 0 -3.4E+38 3.4E+38 ECU_ADDRESS 0x70011672 /end MEASUREMENT
/begin MEASUREMENT HV3_Main_Fuse__AD "" FLOAT32_IEEE VBU0706_CM_single 0 0 -3.4E+38 3.4E+38 ECU_ADDRESS 0x7001166e /end MEASUREMENT
/begin MEASUREMENT HV2_Heating_Relay__AD "" FLOAT32_IEEE VBU0706_CM_single 0 0 -3.4E+38 3.4E+38 ECU_ADDRESS 0x7001166a /end MEASUREMENT
/begin MEASUREMENT HV1_AD "" FLOAT32_IEEE VBU0706_CM_single 0 0 -3.4E+38 3.4E+38 ECU_ADDRESS 0x70011666 /end MEASUREMENT
/begin MEASUREMENT Temperature_40 "" FLOAT32_IEEE VBU0706_CM_single 0 0 -3.4E+38 3.4E+38 ECU_ADDRESS 0x70011b4a /end MEASUREMENT
/begin MEASUREMENT Temperature_39 "" FLOAT32_IEEE VBU0706_CM_single 0 0 -3.4E+38 3.4E+38 ECU_ADDRESS 0x70011b42 /end MEASUREMENT
/begin MEASUREMENT Temperature_38 "" FLOAT32_IEEE VBU0706_CM_single 0 0 -3.4E+38 3.4E+38 ECU_ADDRESS 0x70011b3e /end MEASUREMENT
/begin MEASUREMENT Temperature_37 "" FLOAT32_IEEE VBU0706_CM_single 0 0 -3.4E+38 3.4E+38 ECU_ADDRESS 0x70011b3a /end MEASUREMENT
/begin MEASUREMENT Temperature_36 "" FLOAT32_IEEE VBU0706_CM_single 0 0 -3.4E+38 3.4E+38 ECU_ADDRESS 0x70011b36 /end MEASUREMENT
/begin MEASUREMENT Temperature_35 "" FLOAT32_IEEE VBU0706_CM_single 0 0 -3.4E+38 3.4E+38 ECU_ADDRESS 0x70011b32 /end MEASUREMENT
/begin MEASUREMENT Temperature_34 "" FLOAT32_IEEE VBU0706_CM_single 0 0 -3.4E+38 3.4E+38 ECU_ADDRESS 0x70011b2e /end MEASUREMENT
/begin MEASUREMENT Temperature_33 "" FLOAT32_IEEE VBU0706_CM_single 0 0 -3.4E+38 3.4E+38 ECU_ADDRESS 0x70011b2a /end MEASUREMENT
/begin MEASUREMENT Temperature_32 "" FLOAT32_IEEE VBU0706_CM_single 0 0 -3.4E+38 3.4E+38 ECU_ADDRESS 0x70011b26 /end MEASUREMENT
/begin MEASUREMENT Temperature_31 "" FLOAT32_IEEE VBU0706_CM_single 0 0 -3.4E+38 3.4E+38 ECU_ADDRESS 0x70011b22 /end MEASUREMENT
/begin MEASUREMENT Temperature_30 "" FLOAT32_IEEE VBU0706_CM_single 0 0 -3.4E+38 3.4E+38 ECU_ADDRESS 0x70011b1e /end MEASUREMENT
/begin MEASUREMENT Temperature_29 "" FLOAT32_IEEE VBU0706_CM_single 0 0 -3.4E+38 3.4E+38 ECU_ADDRESS 0x70011b16 /end MEASUREMENT
/begin MEASUREMENT Temperature_28 "" FLOAT32_IEEE VBU0706_CM_single 0 0 -3.4E+38 3.4E+38 ECU_ADDRESS 0x70011b12 /end MEASUREMENT
/begin MEASUREMENT Temperature_27 "" FLOAT32_IEEE VBU0706_CM_single 0 0 -3.4E+38 3.4E+38 ECU_ADDRESS 0x70011b0e /end MEASUREMENT
/begin MEASUREMENT Temperature_26 "" FLOAT32_IEEE VBU0706_CM_single 0 0 -3.4E+38 3.4E+38 ECU_ADDRESS 0x70011b0a /end MEASUREMENT
/begin MEASUREMENT Temperature_25 "" FLOAT32_IEEE VBU0706_CM_single 0 0 -3.4E+38 3.4E+38 ECU_ADDRESS 0x70011b06 /end MEASUREMENT
/begin MEASUREMENT Temperature_24 "" FLOAT32_IEEE VBU0706_CM_single 0 0 -3.4E+38 3.4E+38 ECU_ADDRESS 0x70011b02 /end MEASUREMENT
/begin MEASUREMENT Temperature_23 "" FLOAT32_IEEE VBU0706_CM_single 0 0 -3.4E+38 3.4E+38 ECU_ADDRESS 0x70011afe /end MEASUREMENT
/begin MEASUREMENT Temperature_22 "" FLOAT32_IEEE VBU0706_CM_single 0 0 -3.4E+38 3.4E+38 ECU_ADDRESS 0x70011afa /end MEASUREMENT
/begin MEASUREMENT Temperature_21 "" FLOAT32_IEEE VBU0706_CM_single 0 0 -3.4E+38 3.4E+38 ECU_ADDRESS 0x70011af6 /end MEASUREMENT
/begin MEASUREMENT Temperature_20 "" FLOAT32_IEEE VBU0706_CM_single 0 0 -3.4E+38 3.4E+38 ECU_ADDRESS 0x70011af2 /end MEASUREMENT
/begin MEASUREMENT Temperature_19 "" FLOAT32_IEEE VBU0706_CM_single 0 0 -3.4E+38 3.4E+38 ECU_ADDRESS 0x70011aea /end MEASUREMENT
/begin MEASUREMENT Temperature_18 "" FLOAT32_IEEE VBU0706_CM_single 0 0 -3.4E+38 3.4E+38 ECU_ADDRESS 0x70011ae6 /end MEASUREMENT
/begin MEASUREMENT Temperature_17 "" FLOAT32_IEEE VBU0706_CM_single 0 0 -3.4E+38 3.4E+38 ECU_ADDRESS 0x70011ae2 /end MEASUREMENT
/begin MEASUREMENT LEM_SensorName "" FLOAT32_IEEE VBU0706_CM_single 0 0 -3.4E+38 3.4E+38 ECU_ADDRESS 0x700116de /end MEASUREMENT
/begin MEASUREMENT LEM_BatteryCurrent "" FLOAT32_IEEE VBU0706_CM_single 0 0 -3.4E+38 3.4E+38 ECU_ADDRESS 0x700116da /end MEASUREMENT
/begin MEASUREMENT Temp_HCU_8 "" FLOAT32_IEEE VBU0706_CM_single 0 0 -3.4E+38 3.4E+38 ECU_ADDRESS 0x70011ab6 /end MEASUREMENT
/begin MEASUREMENT Temp_HCU_7 "" FLOAT32_IEEE VBU0706_CM_single 0 0 -3.4E+38 3.4E+38 ECU_ADDRESS 0x70011ab2 /end MEASUREMENT
/begin MEASUREMENT Temp_HCU_6 "" FLOAT32_IEEE VBU0706_CM_single 0 0 -3.4E+38 3.4E+38 ECU_ADDRESS 0x70011aae /end MEASUREMENT
/begin MEASUREMENT Temp_HCU_5 "" FLOAT32_IEEE VBU0706_CM_single 0 0 -3.4E+38 3.4E+38 ECU_ADDRESS 0x70011aaa /end MEASUREMENT
/begin MEASUREMENT Temp_HCU_4 "" FLOAT32_IEEE VBU0706_CM_single 0 0 -3.4E+38 3.4E+38 ECU_ADDRESS 0x70011aa6 /end MEASUREMENT
/begin MEASUREMENT Temp_HCU_3 "" FLOAT32_IEEE VBU0706_CM_single 0 0 -3.4E+38 3.4E+38 ECU_ADDRESS 0x70011aa2 /end MEASUREMENT
/begin MEASUREMENT Temp_HCU_Water_Outlet "" FLOAT32_IEEE VBU0706_CM_single 0 0 -3.4E+38 3.4E+38 ECU_ADDRESS 0x70011abe /end MEASUREMENT
/begin MEASUREMENT Temp_HCU_Water_Inlet "" FLOAT32_IEEE VBU0706_CM_single 0 0 -3.4E+38 3.4E+38 ECU_ADDRESS 0x70011aba /end MEASUREMENT
/begin MEASUREMENT High_Cell_Temp_2 "" FLOAT32_IEEE VBU0706_CM_single 0 0 -3.4E+38 3.4E+38 ECU_ADDRESS 0x70011686 /end MEASUREMENT
/begin MEASUREMENT High_Cell_Temp_1 "" FLOAT32_IEEE VBU0706_CM_single 0 0 -3.4E+38 3.4E+38 ECU_ADDRESS 0x70011682 /end MEASUREMENT
/begin MEASUREMENT Temperature_16 "" FLOAT32_IEEE VBU0706_CM_single 0 0 -3.4E+38 3.4E+38 ECU_ADDRESS 0x70011ade /end MEASUREMENT
/begin MEASUREMENT Temperature_15 "" FLOAT32_IEEE VBU0706_CM_single 0 0 -3.4E+38 3.4E+38 ECU_ADDRESS 0x70011ada /end MEASUREMENT
/begin MEASUREMENT Temperature_14 "" FLOAT32_IEEE VBU0706_CM_single 0 0 -3.4E+38 3.4E+38 ECU_ADDRESS 0x70011ad6 /end MEASUREMENT
/begin MEASUREMENT Temperature_13 "" FLOAT32_IEEE VBU0706_CM_single 0 0 -3.4E+38 3.4E+38 ECU_ADDRESS 0x70011ad2 /end MEASUREMENT
/begin MEASUREMENT Temperature_12 "" FLOAT32_IEEE VBU0706_CM_single 0 0 -3.4E+38 3.4E+38 ECU_ADDRESS 0x70011ace /end MEASUREMENT
/begin MEASUREMENT Temperature_11 "" FLOAT32_IEEE VBU0706_CM_single 0 0 -3.4E+38 3.4E+38 ECU_ADDRESS 0x70011aca /end MEASUREMENT
/begin MEASUREMENT Temperature_10 "" FLOAT32_IEEE VBU0706_CM_single 0 0 -3.4E+38 3.4E+38 ECU_ADDRESS 0x70011ac6 /end MEASUREMENT
/begin MEASUREMENT Temperature_9 "" FLOAT32_IEEE VBU0706_CM_single 0 0 -3.4E+38 3.4E+38 ECU_ADDRESS 0x70011b5e /end MEASUREMENT
/begin MEASUREMENT Low_Cell_Temp_5 "" FLOAT32_IEEE VBU0706_CM_single 0 0 -3.4E+38 3.4E+38 ECU_ADDRESS 0x70011722 /end MEASUREMENT
/begin MEASUREMENT Low_Cell_Temp_4 "" FLOAT32_IEEE VBU0706_CM_single 0 0 -3.4E+38 3.4E+38 ECU_ADDRESS 0x7001171e /end MEASUREMENT
/begin MEASUREMENT Low_Cell_Temp_3 "" FLOAT32_IEEE VBU0706_CM_single 0 0 -3.4E+38 3.4E+38 ECU_ADDRESS 0x7001171a /end MEASUREMENT
/begin MEASUREMENT Low_Cell_Temp_2 "" FLOAT32_IEEE VBU0706_CM_single 0 0 -3.4E+38 3.4E+38 ECU_ADDRESS 0x70011716 /end MEASUREMENT
/begin MEASUREMENT High_Cell_Temp_5 "" FLOAT32_IEEE VBU0706_CM_single 0 0 -3.4E+38 3.4E+38 ECU_ADDRESS 0x70011692 /end MEASUREMENT
/begin MEASUREMENT High_Cell_Temp_4 "" FLOAT32_IEEE VBU0706_CM_single 0 0 -3.4E+38 3.4E+38 ECU_ADDRESS 0x7001168e /end MEASUREMENT
/begin MEASUREMENT High_Cell_Temp_3 "" FLOAT32_IEEE VBU0706_CM_single 0 0 -3.4E+38 3.4E+38 ECU_ADDRESS 0x7001168a /end MEASUREMENT
/begin MEASUREMENT Min_Temp "" FLOAT32_IEEE VBU0706_CM_single 0 0 -3.4E+38 3.4E+38 ECU_ADDRESS 0x7001174e /end MEASUREMENT
/begin MEASUREMENT Max_Temp "" FLOAT32_IEEE VBU0706_CM_single 0 0 -3.4E+38 3.4E+38 ECU_ADDRESS 0x7001174a /end MEASUREMENT
/begin MEASUREMENT Insulation_R_Minus "" FLOAT32_IEEE VBU0706_CM_single 0 0 -3.4E+38 3.4E+38 ECU_ADDRESS 0x700116d2 /end MEASUREMENT
/begin MEASUREMENT Insulation_R_Plus "" FLOAT32_IEEE VBU0706_CM_single 0 0 -3.4E+38 3.4E+38 ECU_ADDRESS 0x700116d6 /end MEASUREMENT
/begin MEASUREMENT Board_Temp "" FLOAT32_IEEE VBU0706_CM_single 0 0 -3.4E+38 3.4E+38 ECU_ADDRESS 0x700114a6 /end MEASUREMENT
/begin MEASUREMENT Ave_Temp "" FLOAT32_IEEE VBU0706_CM_single 0 0 -3.4E+38 3.4E+38 ECU_ADDRESS 0x70011426 /end MEASUREMENT
/begin MEASUREMENT Ave_Volt "" FLOAT32_IEEE VBU0706_CM_single 0 0 -3.4E+38 3.4E+38 ECU_ADDRESS 0x7001142a /end MEASUREMENT
/begin MEASUREMENT Total_Volt "" FLOAT32_IEEE VBU0706_CM_single 0 0 -3.4E+38 3.4E+38 ECU_ADDRESS 0x70011b62 /end MEASUREMENT
/begin MEASUREMENT Temperature_8 "" FLOAT32_IEEE VBU0706_CM_single 0 0 -3.4E+38 3.4E+38 ECU_ADDRESS 0x70011b5a /end MEASUREMENT
/begin MEASUREMENT Temperature_7 "" FLOAT32_IEEE VBU0706_CM_single 0 0 -3.4E+38 3.4E+38 ECU_ADDRESS 0x70011b56 /end MEASUREMENT
/begin MEASUREMENT Temperature_6 "" FLOAT32_IEEE VBU0706_CM_single 0 0 -3.4E+38 3.4E+38 ECU_ADDRESS 0x70011b52 /end MEASUREMENT
/begin MEASUREMENT Temperature_5 "" FLOAT32_IEEE VBU0706_CM_single 0 0 -3.4E+38 3.4E+38 ECU_ADDRESS 0x70011b4e /end MEASUREMENT
/begin MEASUREMENT Temperature_4 "" FLOAT32_IEEE VBU0706_CM_single 0 0 -3.4E+38 3.4E+38 ECU_ADDRESS 0x70011b46 /end MEASUREMENT
/begin MEASUREMENT Temperature_3 "" FLOAT32_IEEE VBU0706_CM_single 0 0 -3.4E+38 3.4E+38 ECU_ADDRESS 0x70011b1a /end MEASUREMENT
/begin MEASUREMENT Temperature_2 "" FLOAT32_IEEE VBU0706_CM_single 0 0 -3.4E+38 3.4E+38 ECU_ADDRESS 0x70011aee /end MEASUREMENT
/begin MEASUREMENT Temperature_1 "" FLOAT32_IEEE VBU0706_CM_single 0 0 -3.4E+38 3.4E+38 ECU_ADDRESS 0x70011ac2 /end MEASUREMENT
/begin MEASUREMENT uBrkPresRaw "" FLOAT32_IEEE VBU0706_CM_single 0 0 -3.4E+38 3.4E+38 ECU_ADDRESS 0x70011c4a /end MEASUREMENT
/begin MEASUREMENT BSWIN_uVacuumPre "" FLOAT32_IEEE VBU0706_CM_single 0 0 -3.4E+38 3.4E+38 ECU_ADDRESS 0x700114a2 /end MEASUREMENT
/begin MEASUREMENT BSWIN_EDSInletCoolTemp "" FLOAT32_IEEE VBU0706_CM_single 0 0 -3.4E+38 3.4E+38 ECU_ADDRESS 0x70011496 /end MEASUREMENT
/begin MEASUREMENT uLVBattRaw "" FLOAT32_IEEE VBU0706_CM_single 0 0 -3.4E+38 3.4E+38 ECU_ADDRESS 0x70011c5a /end MEASUREMENT
/begin MEASUREMENT INP_uLVBatt "" FLOAT32_IEEE VBU0706_CM_single 0 0 0.0 28.0 ECU_ADDRESS 0x700116ce /end MEASUREMENT
/begin MEASUREMENT uDCChPortPosTempRaw "" FLOAT32_IEEE VBU0706_CM_single 0 0 -3.4E+38 3.4E+38 ECU_ADDRESS 0x70011c52 /end MEASUREMENT
/begin MEASUREMENT BSWIN_HVIL_du "" FLOAT32_IEEE VBU0706_CM_single 0 0 -3.4E+38 3.4E+38 ECU_ADDRESS 0x7001149a /end MEASUREMENT
/begin MEASUREMENT BSWIN_HVIL_f "" FLOAT32_IEEE VBU0706_CM_single 0 0 -3.4E+38 3.4E+38 ECU_ADDRESS 0x7001149e /end MEASUREMENT
/begin MEASUREMENT uAccPed1Raw "" FLOAT32_IEEE VBU0706_CM_single 0 0 -3.4E+38 3.4E+38 ECU_ADDRESS 0x70011c42 /end MEASUREMENT
/begin MEASUREMENT uAccPed2Raw "" FLOAT32_IEEE VBU0706_CM_single 0 0 -3.4E+38 3.4E+38 ECU_ADDRESS 0x70011c46 /end MEASUREMENT
/begin MEASUREMENT uDCChPortTempNegativeRaw "" FLOAT32_IEEE VBU0706_CM_single 0 0 -3.4E+38 3.4E+38 ECU_ADDRESS 0x70011c56 /end MEASUREMENT
/begin MEASUREMENT uDCChCC2 "" FLOAT32_IEEE VBU0706_CM_single 0 0 -3.4E+38 3.4E+38 ECU_ADDRESS 0x70011c4e /end MEASUREMENT
/begin MEASUREMENT BSWIN_AmbientTemp "" FLOAT32_IEEE VBU0706_CM_single 0 0 -3.4E+38 3.4E+38 ECU_ADDRESS 0x7001148a /end MEASUREMENT
/begin MEASUREMENT BSWIN_BatteryPre_du "" FLOAT32_IEEE VBU0706_CM_single 0 0 -3.4E+38 3.4E+38 ECU_ADDRESS 0x7001148e /end MEASUREMENT
/begin MEASUREMENT BSWIN_BatteryPre_f "" FLOAT32_IEEE VBU0706_CM_single 0 0 -3.4E+38 3.4E+38 ECU_ADDRESS 0x70011492 /end MEASUREMENT
/begin MEASUREMENT CVT_mvCellVoltageSecondMin "" UWORD VBU0706_CM_uint16 0 0 0 65535 ECU_ADDRESS 0x7001120a /end MEASUREMENT
/begin MEASUREMENT CVT_mvCellVoltageSecondMax "" UWORD VBU0706_CM_uint16 0 0 0 65535 ECU_ADDRESS 0x70011208 /end MEASUREMENT
/begin MEASUREMENT CVT_mvCellVoltageMin "" UWORD VBU0706_CM_uint16 0 0 0.0 5000.0 ECU_ADDRESS 0x70011206 /end MEASUREMENT
/begin MEASUREMENT CVT_mvCellVoltageMax "" UWORD VBU0706_CM_uint16 0 0 0.0 5000.0 ECU_ADDRESS 0x70011204 /end MEASUREMENT
/begin MEASUREMENT CVT_mvCellVoltageAve "" UWORD VBU0706_CM_uint16 0 0 0 65535 ECU_ADDRESS 0x70011202 /end MEASUREMENT
/begin MEASUREMENT CTD_stPrechargeRelayBlown "" UWORD VBU0706_CM_uint16 0 0 0 65535 ECU_ADDRESS 0x700111f6 /end MEASUREMENT
/begin MEASUREMENT CTD_stMainFuseBlownFault "" UWORD VBU0706_CM_uint16 0 0 0 65535 ECU_ADDRESS 0x700111ec /end MEASUREMENT
/begin MEASUREMENT BMM_numMonitorLastCycle "" UWORD VBU0706_CM_uint16 0 0 0 65535 ECU_ADDRESS 0x700111e8 /end MEASUREMENT
/begin MEASUREMENT CellVolt36 "" UWORD VBU0706_CM_uint16 0 0 0 65535 ECU_ADDRESS 0x70011310 /end MEASUREMENT
/begin MEASUREMENT CellVolt35 "" UWORD VBU0706_CM_uint16 0 0 0 65535 ECU_ADDRESS 0x7001130e /end MEASUREMENT
/begin MEASUREMENT CellVolt34 "" UWORD VBU0706_CM_uint16 0 0 0 65535 ECU_ADDRESS 0x7001130c /end MEASUREMENT
/begin MEASUREMENT CellVolt33 "" UWORD VBU0706_CM_uint16 0 0 0 65535 ECU_ADDRESS 0x7001130a /end MEASUREMENT
/begin MEASUREMENT CellVolt32 "" UWORD VBU0706_CM_uint16 0 0 0 65535 ECU_ADDRESS 0x70011308 /end MEASUREMENT
/begin MEASUREMENT CellVolt31 "" UWORD VBU0706_CM_uint16 0 0 0 65535 ECU_ADDRESS 0x70011306 /end MEASUREMENT
/begin MEASUREMENT CellVolt30 "" UWORD VBU0706_CM_uint16 0 0 0 65535 ECU_ADDRESS 0x70011304 /end MEASUREMENT
/begin MEASUREMENT CellVolt29 "" UWORD VBU0706_CM_uint16 0 0 0 65535 ECU_ADDRESS 0x70011300 /end MEASUREMENT
/begin MEASUREMENT CellVolt28 "" UWORD VBU0706_CM_uint16 0 0 0 65535 ECU_ADDRESS 0x700112fe /end MEASUREMENT
/begin MEASUREMENT CellVolt27 "" UWORD VBU0706_CM_uint16 0 0 0 65535 ECU_ADDRESS 0x700112fc /end MEASUREMENT
/begin MEASUREMENT CellVolt26 "" UWORD VBU0706_CM_uint16 0 0 0 65535 ECU_ADDRESS 0x700112fa /end MEASUREMENT
/begin MEASUREMENT CellVolt25 "" UWORD VBU0706_CM_uint16 0 0 0 65535 ECU_ADDRESS 0x700112f8 /end MEASUREMENT
/begin MEASUREMENT CellVolt24 "" UWORD VBU0706_CM_uint16 0 0 0 65535 ECU_ADDRESS 0x700112f6 /end MEASUREMENT
/begin MEASUREMENT CellVolt23 "" UWORD VBU0706_CM_uint16 0 0 0 65535 ECU_ADDRESS 0x700112f4 /end MEASUREMENT
/begin MEASUREMENT CellVolt22 "" UWORD VBU0706_CM_uint16 0 0 0 65535 ECU_ADDRESS 0x700112f2 /end MEASUREMENT
/begin MEASUREMENT CellVolt21 "" UWORD VBU0706_CM_uint16 0 0 0 65535 ECU_ADDRESS 0x700112f0 /end MEASUREMENT
/begin MEASUREMENT CellVolt200 "" UWORD VBU0706_CM_uint16 0 0 0 65535 ECU_ADDRESS 0x700112ee /end MEASUREMENT
/begin MEASUREMENT CellVolt199 "" UWORD VBU0706_CM_uint16 0 0 0 65535 ECU_ADDRESS 0x700112e8 /end MEASUREMENT
/begin MEASUREMENT CellVolt198 "" UWORD VBU0706_CM_uint16 0 0 0 65535 ECU_ADDRESS 0x700112e6 /end MEASUREMENT
/begin MEASUREMENT CellVolt197 "" UWORD VBU0706_CM_uint16 0 0 0 65535 ECU_ADDRESS 0x700112e4 /end MEASUREMENT
/begin MEASUREMENT CellVolt20 "" UWORD VBU0706_CM_uint16 0 0 0 65535 ECU_ADDRESS 0x700112ec /end MEASUREMENT
/begin MEASUREMENT CellVolt19 "" UWORD VBU0706_CM_uint16 0 0 0 65535 ECU_ADDRESS 0x700112d4 /end MEASUREMENT
/begin MEASUREMENT CellVolt18 "" UWORD VBU0706_CM_uint16 0 0 0 65535 ECU_ADDRESS 0x700112be /end MEASUREMENT
/begin MEASUREMENT CellVolt17 "" UWORD VBU0706_CM_uint16 0 0 0 65535 ECU_ADDRESS 0x700112a8 /end MEASUREMENT
/begin MEASUREMENT CellVolt196 "" UWORD VBU0706_CM_uint16 0 0 0 65535 ECU_ADDRESS 0x700112e2 /end MEASUREMENT
/begin MEASUREMENT CellVolt195 "" UWORD VBU0706_CM_uint16 0 0 0 65535 ECU_ADDRESS 0x700112e0 /end MEASUREMENT
/begin MEASUREMENT CellVolt194 "" UWORD VBU0706_CM_uint16 0 0 0 65535 ECU_ADDRESS 0x700112de /end MEASUREMENT
/begin MEASUREMENT CellVolt193 "" UWORD VBU0706_CM_uint16 0 0 0 65535 ECU_ADDRESS 0x700112dc /end MEASUREMENT
/begin MEASUREMENT CellVolt192 "" UWORD VBU0706_CM_uint16 0 0 0 65535 ECU_ADDRESS 0x700112da /end MEASUREMENT
/begin MEASUREMENT CellVolt191 "" UWORD VBU0706_CM_uint16 0 0 0 65535 ECU_ADDRESS 0x700112d8 /end MEASUREMENT
/begin MEASUREMENT CellVolt190 "" UWORD VBU0706_CM_uint16 0 0 0 65535 ECU_ADDRESS 0x700112d6 /end MEASUREMENT
/begin MEASUREMENT CellVolt189 "" UWORD VBU0706_CM_uint16 0 0 0 65535 ECU_ADDRESS 0x700112d2 /end MEASUREMENT
/begin MEASUREMENT CellVolt188 "" UWORD VBU0706_CM_uint16 0 0 0 65535 ECU_ADDRESS 0x700112d0 /end MEASUREMENT
/begin MEASUREMENT CellVolt187 "" UWORD VBU0706_CM_uint16 0 0 0 65535 ECU_ADDRESS 0x700112ce /end MEASUREMENT
/begin MEASUREMENT CellVolt186 "" UWORD VBU0706_CM_uint16 0 0 0 65535 ECU_ADDRESS 0x700112cc /end MEASUREMENT
/begin MEASUREMENT CellVolt185 "" UWORD VBU0706_CM_uint16 0 0 0 65535 ECU_ADDRESS 0x700112ca /end MEASUREMENT
/begin MEASUREMENT CellVolt184 "" UWORD VBU0706_CM_uint16 0 0 0 65535 ECU_ADDRESS 0x700112c8 /end MEASUREMENT
/begin MEASUREMENT CellVolt183 "" UWORD VBU0706_CM_uint16 0 0 0 65535 ECU_ADDRESS 0x700112c6 /end MEASUREMENT
/begin MEASUREMENT CellVolt182 "" UWORD VBU0706_CM_uint16 0 0 0 65535 ECU_ADDRESS 0x700112c4 /end MEASUREMENT
/begin MEASUREMENT CellVolt181 "" UWORD VBU0706_CM_uint16 0 0 0 65535 ECU_ADDRESS 0x700112c2 /end MEASUREMENT
/begin MEASUREMENT CellVolt180 "" UWORD VBU0706_CM_uint16 0 0 0 65535 ECU_ADDRESS 0x700112c0 /end MEASUREMENT
/begin MEASUREMENT CellVolt179 "" UWORD VBU0706_CM_uint16 0 0 0 65535 ECU_ADDRESS 0x700112bc /end MEASUREMENT
/begin MEASUREMENT CellVolt178 "" UWORD VBU0706_CM_uint16 0 0 0 65535 ECU_ADDRESS 0x700112ba /end MEASUREMENT
/begin MEASUREMENT CellVolt177 "" UWORD VBU0706_CM_uint16 0 0 0 65535 ECU_ADDRESS 0x700112b8 /end MEASUREMENT
/begin MEASUREMENT CellVolt176 "" UWORD VBU0706_CM_uint16 0 0 0 65535 ECU_ADDRESS 0x700112b6 /end MEASUREMENT
/begin MEASUREMENT CellVolt175 "" UWORD VBU0706_CM_uint16 0 0 0 65535 ECU_ADDRESS 0x700112b4 /end MEASUREMENT
/begin MEASUREMENT CellVolt174 "" UWORD VBU0706_CM_uint16 0 0 0 65535 ECU_ADDRESS 0x700112b2 /end MEASUREMENT
/begin MEASUREMENT CellVolt173 "" UWORD VBU0706_CM_uint16 0 0 0 65535 ECU_ADDRESS 0x700112b0 /end MEASUREMENT
/begin MEASUREMENT CellVolt172 "" UWORD VBU0706_CM_uint16 0 0 0 65535 ECU_ADDRESS 0x700112ae /end MEASUREMENT
/begin MEASUREMENT CellVolt171 "" UWORD VBU0706_CM_uint16 0 0 0 65535 ECU_ADDRESS 0x700112ac /end MEASUREMENT
/begin MEASUREMENT CellVolt170 "" UWORD VBU0706_CM_uint16 0 0 0 65535 ECU_ADDRESS 0x700112aa /end MEASUREMENT
/begin MEASUREMENT CellVolt169 "" UWORD VBU0706_CM_uint16 0 0 0 65535 ECU_ADDRESS 0x700112a6 /end MEASUREMENT
/begin MEASUREMENT CellVolt168 "" UWORD VBU0706_CM_uint16 0 0 0 65535 ECU_ADDRESS 0x700112a4 /end MEASUREMENT
/begin MEASUREMENT CellVolt167 "" UWORD VBU0706_CM_uint16 0 0 0 65535 ECU_ADDRESS 0x700112a2 /end MEASUREMENT
/begin MEASUREMENT CellVolt166 "" UWORD VBU0706_CM_uint16 0 0 0 65535 ECU_ADDRESS 0x700112a0 /end MEASUREMENT
/begin MEASUREMENT CellVolt165 "" UWORD VBU0706_CM_uint16 0 0 0 65535 ECU_ADDRESS 0x7001129e /end MEASUREMENT
/begin MEASUREMENT CellVolt164 "" UWORD VBU0706_CM_uint16 0 0 0 65535 ECU_ADDRESS 0x7001129c /end MEASUREMENT
/begin MEASUREMENT CellVolt163 "" UWORD VBU0706_CM_uint16 0 0 0 65535 ECU_ADDRESS 0x7001129a /end MEASUREMENT
/begin MEASUREMENT CellVolt162 "" UWORD VBU0706_CM_uint16 0 0 0 65535 ECU_ADDRESS 0x70011298 /end MEASUREMENT
/begin MEASUREMENT CellVolt161 "" UWORD VBU0706_CM_uint16 0 0 0 65535 ECU_ADDRESS 0x70011296 /end MEASUREMENT
/begin MEASUREMENT CellVolt160 "" UWORD VBU0706_CM_uint16 0 0 0 65535 ECU_ADDRESS 0x70011294 /end MEASUREMENT
/begin MEASUREMENT CellVolt159 "" UWORD VBU0706_CM_uint16 0 0 0 65535 ECU_ADDRESS 0x70011290 /end MEASUREMENT
/begin MEASUREMENT CellVolt158 "" UWORD VBU0706_CM_uint16 0 0 0 65535 ECU_ADDRESS 0x7001128e /end MEASUREMENT
/begin MEASUREMENT CellVolt157 "" UWORD VBU0706_CM_uint16 0 0 0 65535 ECU_ADDRESS 0x7001128c /end MEASUREMENT
/begin MEASUREMENT CellVolt16 "" UWORD VBU0706_CM_uint16 0 0 0 65535 ECU_ADDRESS 0x70011292 /end MEASUREMENT
/begin MEASUREMENT CellVolt15 "" UWORD VBU0706_CM_uint16 0 0 0 65535 ECU_ADDRESS 0x7001127c /end MEASUREMENT
/begin MEASUREMENT CellVolt14 "" UWORD VBU0706_CM_uint16 0 0 0 65535 ECU_ADDRESS 0x70011266 /end MEASUREMENT
/begin MEASUREMENT CellVolt13 "" UWORD VBU0706_CM_uint16 0 0 0 65535 ECU_ADDRESS 0x70011250 /end MEASUREMENT
/begin MEASUREMENT CellVolt156 "" UWORD VBU0706_CM_uint16 0 0 0 65535 ECU_ADDRESS 0x7001128a /end MEASUREMENT
/begin MEASUREMENT CellVolt155 "" UWORD VBU0706_CM_uint16 0 0 0 65535 ECU_ADDRESS 0x70011288 /end MEASUREMENT
/begin MEASUREMENT CellVolt154 "" UWORD VBU0706_CM_uint16 0 0 0 65535 ECU_ADDRESS 0x70011286 /end MEASUREMENT
/begin MEASUREMENT CellVolt153 "" UWORD VBU0706_CM_uint16 0 0 0 65535 ECU_ADDRESS 0x70011284 /end MEASUREMENT
/begin MEASUREMENT CellVolt152 "" UWORD VBU0706_CM_uint16 0 0 0 65535 ECU_ADDRESS 0x70011282 /end MEASUREMENT
/begin MEASUREMENT CellVolt151 "" UWORD VBU0706_CM_uint16 0 0 0 65535 ECU_ADDRESS 0x70011280 /end MEASUREMENT
/begin MEASUREMENT CellVolt150 "" UWORD VBU0706_CM_uint16 0 0 0 65535 ECU_ADDRESS 0x7001127e /end MEASUREMENT
/begin MEASUREMENT CellVolt149 "" UWORD VBU0706_CM_uint16 0 0 0 65535 ECU_ADDRESS 0x7001127a /end MEASUREMENT
/begin MEASUREMENT CellVolt148 "" UWORD VBU0706_CM_uint16 0 0 0 65535 ECU_ADDRESS 0x70011278 /end MEASUREMENT
/begin MEASUREMENT CellVolt147 "" UWORD VBU0706_CM_uint16 0 0 0 65535 ECU_ADDRESS 0x70011276 /end MEASUREMENT
/begin MEASUREMENT CellVolt146 "" UWORD VBU0706_CM_uint16 0 0 0 65535 ECU_ADDRESS 0x70011274 /end MEASUREMENT
/begin MEASUREMENT CellVolt145 "" UWORD VBU0706_CM_uint16 0 0 0 65535 ECU_ADDRESS 0x70011272 /end MEASUREMENT
/begin MEASUREMENT CellVolt144 "" UWORD VBU0706_CM_uint16 0 0 0 65535 ECU_ADDRESS 0x70011270 /end MEASUREMENT
/begin MEASUREMENT CellVolt143 "" UWORD VBU0706_CM_uint16 0 0 0 65535 ECU_ADDRESS 0x7001126e /end MEASUREMENT
/begin MEASUREMENT CellVolt142 "" UWORD VBU0706_CM_uint16 0 0 0 65535 ECU_ADDRESS 0x7001126c /end MEASUREMENT
/begin MEASUREMENT CellVolt141 "" UWORD VBU0706_CM_uint16 0 0 0 65535 ECU_ADDRESS 0x7001126a /end MEASUREMENT
/begin MEASUREMENT CellVolt140 "" UWORD VBU0706_CM_uint16 0 0 0 65535 ECU_ADDRESS 0x70011268 /end MEASUREMENT
/begin MEASUREMENT CellVolt139 "" UWORD VBU0706_CM_uint16 0 0 0 65535 ECU_ADDRESS 0x70011264 /end MEASUREMENT
/begin MEASUREMENT CellVolt138 "" UWORD VBU0706_CM_uint16 0 0 0 65535 ECU_ADDRESS 0x70011262 /end MEASUREMENT
/begin MEASUREMENT CellVolt137 "" UWORD VBU0706_CM_uint16 0 0 0 65535 ECU_ADDRESS 0x70011260 /end MEASUREMENT
/begin MEASUREMENT CellVolt136 "" UWORD VBU0706_CM_uint16 0 0 0 65535 ECU_ADDRESS 0x7001125e /end MEASUREMENT
/begin MEASUREMENT CellVolt135 "" UWORD VBU0706_CM_uint16 0 0 0 65535 ECU_ADDRESS 0x7001125c /end MEASUREMENT
/begin MEASUREMENT CellVolt134 "" UWORD VBU0706_CM_uint16 0 0 0 65535 ECU_ADDRESS 0x7001125a /end MEASUREMENT
/begin MEASUREMENT CellVolt133 "" UWORD VBU0706_CM_uint16 0 0 0 65535 ECU_ADDRESS 0x70011258 /end MEASUREMENT
/begin MEASUREMENT CellVolt132 "" UWORD VBU0706_CM_uint16 0 0 0 65535 ECU_ADDRESS 0x70011256 /end MEASUREMENT
/begin MEASUREMENT CellVolt131 "" UWORD VBU0706_CM_uint16 0 0 0 65535 ECU_ADDRESS 0x70011254 /end MEASUREMENT
/begin MEASUREMENT CellVolt130 "" UWORD VBU0706_CM_uint16 0 0 0 65535 ECU_ADDRESS 0x70011252 /end MEASUREMENT
/begin MEASUREMENT CellVolt129 "" UWORD VBU0706_CM_uint16 0 0 0 65535 ECU_ADDRESS 0x7001124e /end MEASUREMENT
/begin MEASUREMENT CellVolt128 "" UWORD VBU0706_CM_uint16 0 0 0 65535 ECU_ADDRESS 0x7001124c /end MEASUREMENT
/begin MEASUREMENT CellVolt127 "" UWORD VBU0706_CM_uint16 0 0 0 65535 ECU_ADDRESS 0x7001124a /end MEASUREMENT
/begin MEASUREMENT CellVolt126 "" UWORD VBU0706_CM_uint16 0 0 0 65535 ECU_ADDRESS 0x70011248 /end MEASUREMENT
/begin MEASUREMENT CellVolt125 "" UWORD VBU0706_CM_uint16 0 0 0 65535 ECU_ADDRESS 0x70011246 /end MEASUREMENT
/begin MEASUREMENT CellVolt124 "" UWORD VBU0706_CM_uint16 0 0 0 65535 ECU_ADDRESS 0x70011244 /end MEASUREMENT
/begin MEASUREMENT CellVolt123 "" UWORD VBU0706_CM_uint16 0 0 0 65535 ECU_ADDRESS 0x70011242 /end MEASUREMENT
/begin MEASUREMENT CellVolt122 "" UWORD VBU0706_CM_uint16 0 0 0 65535 ECU_ADDRESS 0x70011240 /end MEASUREMENT
/begin MEASUREMENT CellVolt121 "" UWORD VBU0706_CM_uint16 0 0 0 65535 ECU_ADDRESS 0x7001123e /end MEASUREMENT
/begin MEASUREMENT CellVolt120 "" UWORD VBU0706_CM_uint16 0 0 0 65535 ECU_ADDRESS 0x7001123c /end MEASUREMENT
/begin MEASUREMENT CellVolt119 "" UWORD VBU0706_CM_uint16 0 0 0 65535 ECU_ADDRESS 0x70011238 /end MEASUREMENT
/begin MEASUREMENT CellVolt118 "" UWORD VBU0706_CM_uint16 0 0 0 65535 ECU_ADDRESS 0x70011236 /end MEASUREMENT
/begin MEASUREMENT CellVolt117 "" UWORD VBU0706_CM_uint16 0 0 0 65535 ECU_ADDRESS 0x70011234 /end MEASUREMENT
/begin MEASUREMENT CellVolt12 "" UWORD VBU0706_CM_uint16 0 0 0 65535 ECU_ADDRESS 0x7001123a /end MEASUREMENT
/begin MEASUREMENT CellVolt11 "" UWORD VBU0706_CM_uint16 0 0 0 65535 ECU_ADDRESS 0x70011224 /end MEASUREMENT
/begin MEASUREMENT CellVolt10 "" UWORD VBU0706_CM_uint16 0 0 0 65535 ECU_ADDRESS 0x7001120e /end MEASUREMENT
/begin MEASUREMENT CellVolt9 "" UWORD VBU0706_CM_uint16 0 0 0 65535 ECU_ADDRESS 0x70011386 /end MEASUREMENT
/begin MEASUREMENT CellVolt116 "" UWORD VBU0706_CM_uint16 0 0 0 65535 ECU_ADDRESS 0x70011232 /end MEASUREMENT
/begin MEASUREMENT CellVolt115 "" UWORD VBU0706_CM_uint16 0 0 0 65535 ECU_ADDRESS 0x70011230 /end MEASUREMENT
/begin MEASUREMENT CellVolt114 "" UWORD VBU0706_CM_uint16 0 0 0 65535 ECU_ADDRESS 0x7001122e /end MEASUREMENT
/begin MEASUREMENT CellVolt113 "" UWORD VBU0706_CM_uint16 0 0 0 65535 ECU_ADDRESS 0x7001122c /end MEASUREMENT
/begin MEASUREMENT CellVolt112 "" UWORD VBU0706_CM_uint16 0 0 0 65535 ECU_ADDRESS 0x7001122a /end MEASUREMENT
/begin MEASUREMENT CellVolt111 "" UWORD VBU0706_CM_uint16 0 0 0 65535 ECU_ADDRESS 0x70011228 /end MEASUREMENT
/begin MEASUREMENT CellVolt110 "" UWORD VBU0706_CM_uint16 0 0 0 65535 ECU_ADDRESS 0x70011226 /end MEASUREMENT
/begin MEASUREMENT CellVolt109 "" UWORD VBU0706_CM_uint16 0 0 0 65535 ECU_ADDRESS 0x70011222 /end MEASUREMENT
/begin MEASUREMENT CellVolt108 "" UWORD VBU0706_CM_uint16 0 0 0 65535 ECU_ADDRESS 0x70011220 /end MEASUREMENT
/begin MEASUREMENT CellVolt107 "" UWORD VBU0706_CM_uint16 0 0 0 65535 ECU_ADDRESS 0x7001121e /end MEASUREMENT
/begin MEASUREMENT CellVolt106 "" UWORD VBU0706_CM_uint16 0 0 0 65535 ECU_ADDRESS 0x7001121c /end MEASUREMENT
/begin MEASUREMENT CellVolt105 "" UWORD VBU0706_CM_uint16 0 0 0 65535 ECU_ADDRESS 0x7001121a /end MEASUREMENT
/begin MEASUREMENT CellVolt104 "" UWORD VBU0706_CM_uint16 0 0 0 65535 ECU_ADDRESS 0x70011218 /end MEASUREMENT
/begin MEASUREMENT CellVolt103 "" UWORD VBU0706_CM_uint16 0 0 0 65535 ECU_ADDRESS 0x70011216 /end MEASUREMENT
/begin MEASUREMENT CellVolt102 "" UWORD VBU0706_CM_uint16 0 0 0 65535 ECU_ADDRESS 0x70011214 /end MEASUREMENT
/begin MEASUREMENT CellVolt101 "" UWORD VBU0706_CM_uint16 0 0 0 65535 ECU_ADDRESS 0x70011212 /end MEASUREMENT
/begin MEASUREMENT CellVolt100 "" UWORD VBU0706_CM_uint16 0 0 0 65535 ECU_ADDRESS 0x70011210 /end MEASUREMENT
/begin MEASUREMENT CellVolt99 "" UWORD VBU0706_CM_uint16 0 0 0 65535 ECU_ADDRESS 0x7001139a /end MEASUREMENT
/begin MEASUREMENT CellVolt98 "" UWORD VBU0706_CM_uint16 0 0 0 65535 ECU_ADDRESS 0x70011398 /end MEASUREMENT
/begin MEASUREMENT CellVolt97 "" UWORD VBU0706_CM_uint16 0 0 0 65535 ECU_ADDRESS 0x70011396 /end MEASUREMENT
/begin MEASUREMENT CellVolt96 "" UWORD VBU0706_CM_uint16 0 0 0 65535 ECU_ADDRESS 0x70011394 /end MEASUREMENT
/begin MEASUREMENT CellVolt95 "" UWORD VBU0706_CM_uint16 0 0 0 65535 ECU_ADDRESS 0x70011392 /end MEASUREMENT
/begin MEASUREMENT CellVolt94 "" UWORD VBU0706_CM_uint16 0 0 0 65535 ECU_ADDRESS 0x70011390 /end MEASUREMENT
/begin MEASUREMENT CellVolt93 "" UWORD VBU0706_CM_uint16 0 0 0 65535 ECU_ADDRESS 0x7001138e /end MEASUREMENT
/begin MEASUREMENT CellVolt92 "" UWORD VBU0706_CM_uint16 0 0 0 65535 ECU_ADDRESS 0x7001138c /end MEASUREMENT
/begin MEASUREMENT CellVolt91 "" UWORD VBU0706_CM_uint16 0 0 0 65535 ECU_ADDRESS 0x7001138a /end MEASUREMENT
/begin MEASUREMENT CellVolt90 "" UWORD VBU0706_CM_uint16 0 0 0 65535 ECU_ADDRESS 0x70011388 /end MEASUREMENT
/begin MEASUREMENT CellVolt89 "" UWORD VBU0706_CM_uint16 0 0 0 65535 ECU_ADDRESS 0x70011384 /end MEASUREMENT
/begin MEASUREMENT CellVolt88 "" UWORD VBU0706_CM_uint16 0 0 0 65535 ECU_ADDRESS 0x70011382 /end MEASUREMENT
/begin MEASUREMENT CellVolt87 "" UWORD VBU0706_CM_uint16 0 0 0 65535 ECU_ADDRESS 0x70011380 /end MEASUREMENT
/begin MEASUREMENT CellVolt86 "" UWORD VBU0706_CM_uint16 0 0 0 65535 ECU_ADDRESS 0x7001137e /end MEASUREMENT
/begin MEASUREMENT CellVolt85 "" UWORD VBU0706_CM_uint16 0 0 0 65535 ECU_ADDRESS 0x7001137c /end MEASUREMENT
/begin MEASUREMENT CellVolt84 "" UWORD VBU0706_CM_uint16 0 0 0 65535 ECU_ADDRESS 0x7001137a /end MEASUREMENT
/begin MEASUREMENT CellVolt83 "" UWORD VBU0706_CM_uint16 0 0 0 65535 ECU_ADDRESS 0x70011378 /end MEASUREMENT
/begin MEASUREMENT CellVolt82 "" UWORD VBU0706_CM_uint16 0 0 0 65535 ECU_ADDRESS 0x70011376 /end MEASUREMENT
/begin MEASUREMENT CellVolt81 "" UWORD VBU0706_CM_uint16 0 0 0 65535 ECU_ADDRESS 0x70011374 /end MEASUREMENT
/begin MEASUREMENT CellVolt80 "" UWORD VBU0706_CM_uint16 0 0 0 65535 ECU_ADDRESS 0x70011372 /end MEASUREMENT
/begin MEASUREMENT CellVolt79 "" UWORD VBU0706_CM_uint16 0 0 0 65535 ECU_ADDRESS 0x7001136e /end MEASUREMENT
/begin MEASUREMENT CellVolt78 "" UWORD VBU0706_CM_uint16 0 0 0 65535 ECU_ADDRESS 0x7001136c /end MEASUREMENT
/begin MEASUREMENT CellVolt77 "" UWORD VBU0706_CM_uint16 0 0 0 65535 ECU_ADDRESS 0x7001136a /end MEASUREMENT
/begin MEASUREMENT CellVolt8 "" UWORD VBU0706_CM_uint16 0 0 0 65535 ECU_ADDRESS 0x70011370 /end MEASUREMENT
/begin MEASUREMENT CellVolt7 "" UWORD VBU0706_CM_uint16 0 0 0 65535 ECU_ADDRESS 0x7001135a /end MEASUREMENT
/begin MEASUREMENT CellVolt6 "" UWORD VBU0706_CM_uint16 0 0 0 65535 ECU_ADDRESS 0x70011344 /end MEASUREMENT
/begin MEASUREMENT CellVolt5 "" UWORD VBU0706_CM_uint16 0 0 0 65535 ECU_ADDRESS 0x7001132e /end MEASUREMENT
/begin MEASUREMENT CellVolt76 "" UWORD VBU0706_CM_uint16 0 0 0 65535 ECU_ADDRESS 0x70011368 /end MEASUREMENT
/begin MEASUREMENT CellVolt75 "" UWORD VBU0706_CM_uint16 0 0 0 65535 ECU_ADDRESS 0x70011366 /end MEASUREMENT
/begin MEASUREMENT CellVolt74 "" UWORD VBU0706_CM_uint16 0 0 0 65535 ECU_ADDRESS 0x70011364 /end MEASUREMENT
/begin MEASUREMENT CellVolt73 "" UWORD VBU0706_CM_uint16 0 0 0 65535 ECU_ADDRESS 0x70011362 /end MEASUREMENT
/begin MEASUREMENT CellVolt72 "" UWORD VBU0706_CM_uint16 0 0 0 65535 ECU_ADDRESS 0x70011360 /end MEASUREMENT
/begin MEASUREMENT CellVolt71 "" UWORD VBU0706_CM_uint16 0 0 0 65535 ECU_ADDRESS 0x7001135e /end MEASUREMENT
/begin MEASUREMENT CellVolt70 "" UWORD VBU0706_CM_uint16 0 0 0 65535 ECU_ADDRESS 0x7001135c /end MEASUREMENT
/begin MEASUREMENT CellVolt69 "" UWORD VBU0706_CM_uint16 0 0 0 65535 ECU_ADDRESS 0x70011358 /end MEASUREMENT
/begin MEASUREMENT CellVolt68 "" UWORD VBU0706_CM_uint16 0 0 0 65535 ECU_ADDRESS 0x70011356 /end MEASUREMENT
/begin MEASUREMENT CellVolt67 "" UWORD VBU0706_CM_uint16 0 0 0 65535 ECU_ADDRESS 0x70011354 /end MEASUREMENT
/begin MEASUREMENT CellVolt66 "" UWORD VBU0706_CM_uint16 0 0 0 65535 ECU_ADDRESS 0x70011352 /end MEASUREMENT
/begin MEASUREMENT CellVolt65 "" UWORD VBU0706_CM_uint16 0 0 0 65535 ECU_ADDRESS 0x70011350 /end MEASUREMENT
/begin MEASUREMENT CellVolt64 "" UWORD VBU0706_CM_uint16 0 0 0 65535 ECU_ADDRESS 0x7001134e /end MEASUREMENT
/begin MEASUREMENT CellVolt63 "" UWORD VBU0706_CM_uint16 0 0 0 65535 ECU_ADDRESS 0x7001134c /end MEASUREMENT
/begin MEASUREMENT CellVolt62 "" UWORD VBU0706_CM_uint16 0 0 0 65535 ECU_ADDRESS 0x7001134a /end MEASUREMENT
/begin MEASUREMENT CellVolt61 "" UWORD VBU0706_CM_uint16 0 0 0 65535 ECU_ADDRESS 0x70011348 /end MEASUREMENT
/begin MEASUREMENT CellVolt60 "" UWORD VBU0706_CM_uint16 0 0 0 65535 ECU_ADDRESS 0x70011346 /end MEASUREMENT
/begin MEASUREMENT CellVolt59 "" UWORD VBU0706_CM_uint16 0 0 0 65535 ECU_ADDRESS 0x70011342 /end MEASUREMENT
/begin MEASUREMENT CellVolt58 "" UWORD VBU0706_CM_uint16 0 0 0 65535 ECU_ADDRESS 0x70011340 /end MEASUREMENT
/begin MEASUREMENT CellVolt57 "" UWORD VBU0706_CM_uint16 0 0 0 65535 ECU_ADDRESS 0x7001133e /end MEASUREMENT
/begin MEASUREMENT CellVolt56 "" UWORD VBU0706_CM_uint16 0 0 0 65535 ECU_ADDRESS 0x7001133c /end MEASUREMENT
/begin MEASUREMENT CellVolt55 "" UWORD VBU0706_CM_uint16 0 0 0 65535 ECU_ADDRESS 0x7001133a /end MEASUREMENT
/begin MEASUREMENT CellVolt54 "" UWORD VBU0706_CM_uint16 0 0 0 65535 ECU_ADDRESS 0x70011338 /end MEASUREMENT
/begin MEASUREMENT CellVolt53 "" UWORD VBU0706_CM_uint16 0 0 0 65535 ECU_ADDRESS 0x70011336 /end MEASUREMENT
/begin MEASUREMENT CellVolt52 "" UWORD VBU0706_CM_uint16 0 0 0 65535 ECU_ADDRESS 0x70011334 /end MEASUREMENT
/begin MEASUREMENT CellVolt51 "" UWORD VBU0706_CM_uint16 0 0 0 65535 ECU_ADDRESS 0x70011332 /end MEASUREMENT
/begin MEASUREMENT CellVolt50 "" UWORD VBU0706_CM_uint16 0 0 0 65535 ECU_ADDRESS 0x70011330 /end MEASUREMENT
/begin MEASUREMENT CellVolt49 "" UWORD VBU0706_CM_uint16 0 0 0 65535 ECU_ADDRESS 0x7001132c /end MEASUREMENT
/begin MEASUREMENT CellVolt48 "" UWORD VBU0706_CM_uint16 0 0 0 65535 ECU_ADDRESS 0x7001132a /end MEASUREMENT
/begin MEASUREMENT CellVolt47 "" UWORD VBU0706_CM_uint16 0 0 0 65535 ECU_ADDRESS 0x70011328 /end MEASUREMENT
/begin MEASUREMENT CellVolt46 "" UWORD VBU0706_CM_uint16 0 0 0 65535 ECU_ADDRESS 0x70011326 /end MEASUREMENT
/begin MEASUREMENT CellVolt45 "" UWORD VBU0706_CM_uint16 0 0 0 65535 ECU_ADDRESS 0x70011324 /end MEASUREMENT
/begin MEASUREMENT CellVolt44 "" UWORD VBU0706_CM_uint16 0 0 0 65535 ECU_ADDRESS 0x70011322 /end MEASUREMENT
/begin MEASUREMENT CellVolt43 "" UWORD VBU0706_CM_uint16 0 0 0 65535 ECU_ADDRESS 0x70011320 /end MEASUREMENT
/begin MEASUREMENT CellVolt42 "" UWORD VBU0706_CM_uint16 0 0 0 65535 ECU_ADDRESS 0x7001131e /end MEASUREMENT
/begin MEASUREMENT CellVolt41 "" UWORD VBU0706_CM_uint16 0 0 0 65535 ECU_ADDRESS 0x7001131c /end MEASUREMENT
/begin MEASUREMENT CellVolt40 "" UWORD VBU0706_CM_uint16 0 0 0 65535 ECU_ADDRESS 0x7001131a /end MEASUREMENT
/begin MEASUREMENT CellVolt39 "" UWORD VBU0706_CM_uint16 0 0 0 65535 ECU_ADDRESS 0x70011316 /end MEASUREMENT
/begin MEASUREMENT CellVolt38 "" UWORD VBU0706_CM_uint16 0 0 0 65535 ECU_ADDRESS 0x70011314 /end MEASUREMENT
/begin MEASUREMENT CellVolt37 "" UWORD VBU0706_CM_uint16 0 0 0 65535 ECU_ADDRESS 0x70011312 /end MEASUREMENT
/begin MEASUREMENT CellVolt4 "" UWORD VBU0706_CM_uint16 0 0 0 65535 ECU_ADDRESS 0x70011318 /end MEASUREMENT
/begin MEASUREMENT CellVolt3 "" UWORD VBU0706_CM_uint16 0 0 0 65535 ECU_ADDRESS 0x70011302 /end MEASUREMENT
/begin MEASUREMENT CellVolt2 "" UWORD VBU0706_CM_uint16 0 0 0 65535 ECU_ADDRESS 0x700112ea /end MEASUREMENT
/begin MEASUREMENT CellVolt1 "" UWORD VBU0706_CM_uint16 0 0 0 65535 ECU_ADDRESS 0x7001120c /end MEASUREMENT
/begin MEASUREMENT Low_Cell_Volt_5 "" UWORD VBU0706_CM_uint16 0 0 0 65535 ECU_ADDRESS 0x700113c4 /end MEASUREMENT
/begin MEASUREMENT Low_Cell_Volt_4 "" UWORD VBU0706_CM_uint16 0 0 0 65535 ECU_ADDRESS 0x700113c2 /end MEASUREMENT
/begin MEASUREMENT Low_Cell_Volt_3 "" UWORD VBU0706_CM_uint16 0 0 0 65535 ECU_ADDRESS 0x700113c0 /end MEASUREMENT
/begin MEASUREMENT Low_Cell_Volt_2 "" UWORD VBU0706_CM_uint16 0 0 0 65535 ECU_ADDRESS 0x700113be /end MEASUREMENT
/begin MEASUREMENT Low_Cell_Volt_1 "" UWORD VBU0706_CM_uint16 0 0 0 65535 ECU_ADDRESS 0x700113bc /end MEASUREMENT
/begin MEASUREMENT High_Cell_Volt_5 "" UWORD VBU0706_CM_uint16 0 0 0 65535 ECU_ADDRESS 0x700113aa /end MEASUREMENT
/begin MEASUREMENT High_Cell_Volt_4 "" UWORD VBU0706_CM_uint16 0 0 0 65535 ECU_ADDRESS 0x700113a8 /end MEASUREMENT
/begin MEASUREMENT High_Cell_Volt_3 "" UWORD VBU0706_CM_uint16 0 0 0 65535 ECU_ADDRESS 0x700113a6 /end MEASUREMENT
/begin MEASUREMENT High_Cell_Volt_2 "" UWORD VBU0706_CM_uint16 0 0 0 65535 ECU_ADDRESS 0x700113a4 /end MEASUREMENT
/begin MEASUREMENT High_Cell_Volt_1 "" UWORD VBU0706_CM_uint16 0 0 0 65535 ECU_ADDRESS 0x700113a2 /end MEASUREMENT
/begin MEASUREMENT Min_Volt "" UWORD VBU0706_CM_uint16 0 0 0 65535 ECU_ADDRESS 0x700113c8 /end MEASUREMENT
/begin MEASUREMENT Max_Volt "" UWORD VBU0706_CM_uint16 0 0 0 65535 ECU_ADDRESS 0x700113c6 /end MEASUREMENT
/begin MEASUREMENT PWM_IN2_Duty "" UWORD VBU0706_CM_uint16 0 0 0 65535 ECU_ADDRESS 0x700113ce /end MEASUREMENT
/begin MEASUREMENT PWM_IN2_Freq "" UWORD VBU0706_CM_uint16 0 0 0 65535 ECU_ADDRESS 0x700113d0 /end MEASUREMENT
/begin MEASUREMENT PWM_IN1_Duty "" UWORD VBU0706_CM_uint16 0 0 0 65535 ECU_ADDRESS 0x700113ca /end MEASUREMENT
/begin MEASUREMENT PWM_IN1_Freq "" UWORD VBU0706_CM_uint16 0 0 0 65535 ECU_ADDRESS 0x700113cc /end MEASUREMENT
/begin MEASUREMENT CTD_stMnContactorsStatus "" UBYTE VBU0706_CM_uint8 0 0 0 255 ECU_ADDRESS 0x70011d38 /end MEASUREMENT
/begin MEASUREMENT CTC_stResetContactorRequest "" UBYTE VBU0706_CM_uint8 0 0 0 255 ECU_ADDRESS 0x70011d2d /end MEASUREMENT
/begin MEASUREMENT CVT_numCellVoltageSecondMinID "" UBYTE VBU0706_CM_uint8 0 0 0 255 ECU_ADDRESS 0x70011d59 /end MEASUREMENT
/begin MEASUREMENT CVT_numCellVoltageSecondMaxID "" UBYTE VBU0706_CM_uint8 0 0 0 255 ECU_ADDRESS 0x70011d58 /end MEASUREMENT
/begin MEASUREMENT CVT_numCellVoltageMinID "" UBYTE VBU0706_CM_uint8 0 0 0 255 ECU_ADDRESS 0x70011d57 /end MEASUREMENT
/begin MEASUREMENT CVT_numCellVoltageMaxID "" UBYTE VBU0706_CM_uint8 0 0 0 255 ECU_ADDRESS 0x70011d56 /end MEASUREMENT
/begin MEASUREMENT CVT_numInvalidCellVoltages "" UBYTE VBU0706_CM_uint8 0 0 0 255 ECU_ADDRESS 0x70011d5a /end MEASUREMENT
/begin MEASUREMENT CTS_stContactorRequest "" UBYTE VBU0706_CM_uint8 0 0 0 255 ECU_ADDRESS 0x70011d54 /end MEASUREMENT
/begin MEASUREMENT CTS_stState "" UBYTE VBU0706_CM_uint8 0 0 0 255 ECU_ADDRESS 0x70011d55 /end MEASUREMENT
/begin MEASUREMENT CTS_stCmdPrechargeRelay "" UBYTE VBU0706_CM_uint8 0 0 0 255 ECU_ADDRESS 0x70011d53 /end MEASUREMENT
/begin MEASUREMENT CTS_stCmdMnNegContactor "" UBYTE VBU0706_CM_uint8 0 0 0 255 ECU_ADDRESS 0x70011d51 /end MEASUREMENT
/begin MEASUREMENT CTS_stCmdMnPosContactor "" UBYTE VBU0706_CM_uint8 0 0 0 255 ECU_ADDRESS 0x70011d52 /end MEASUREMENT
/begin MEASUREMENT CTM_numOriginalCellTempMinID "" UBYTE VBU0706_CM_uint8 0 0 0.0 200.0 ECU_ADDRESS 0x70011d43 /end MEASUREMENT
/begin MEASUREMENT CTM_numCellTempMinID "" UBYTE VBU0706_CM_uint8 0 0 0.0 40.0 ECU_ADDRESS 0x70011d41 /end MEASUREMENT
/begin MEASUREMENT CTM_numOriginalCellTempSecondMaxID "" UBYTE VBU0706_CM_uint8 0 0 0.0 40.0 ECU_ADDRESS 0x70011d44 /end MEASUREMENT
/begin MEASUREMENT CTM_numCellTempMaxID "" UBYTE VBU0706_CM_uint8 0 0 0.0 40.0 ECU_ADDRESS 0x70011d40 /end MEASUREMENT
/begin MEASUREMENT CTM_numOriginalCellTempMaxID "" UBYTE VBU0706_CM_uint8 0 0 0.0 40.0 ECU_ADDRESS 0x70011d42 /end MEASUREMENT
/begin MEASUREMENT CTC_stContactorsCommandStatus "" UBYTE VBU0706_CM_uint8 0 0 0 255 ECU_ADDRESS 0x70011d2c /end MEASUREMENT
/begin MEASUREMENT BCV_stBdmCurrentComIndex "" UBYTE VBU0706_CM_uint8 0 0 0 255 ECU_ADDRESS 0x70011d00 /end MEASUREMENT
/begin MEASUREMENT BCV_stBdmCurrentPerformanceIndex "" UBYTE VBU0706_CM_uint8 0 0 0 255 ECU_ADDRESS 0x70011d01 /end MEASUREMENT
/begin MEASUREMENT BCV_BdmVoltagePerformanceIndex_enum "" UBYTE VBU0706_CM_uint8 0 0 0 255 ECU_ADDRESS 0x70011cf4 /end MEASUREMENT
/begin MEASUREMENT HCU_Message_3_AD3_Heart "" UBYTE VBU0706_CM_uint8 0 0 0 255 ECU_ADDRESS 0x70011e19 /end MEASUREMENT
/begin MEASUREMENT HCU_Message_3_AD2_Heart "" UBYTE VBU0706_CM_uint8 0 0 0 255 ECU_ADDRESS 0x70011e18 /end MEASUREMENT
/begin MEASUREMENT HCU_Message_2_AD1_Heart "" UBYTE VBU0706_CM_uint8 0 0 0 255 ECU_ADDRESS 0x70011e17 /end MEASUREMENT
/begin MEASUREMENT HCU_Message_1_RelayStatus_Heart "" UBYTE VBU0706_CM_uint8 0 0 0 255 ECU_ADDRESS 0x70011e16 /end MEASUREMENT
/begin MEASUREMENT HCU_State "" UBYTE VBU0706_CM_uint8 0 0 0 255 ECU_ADDRESS 0x70011e1c /end MEASUREMENT
/begin MEASUREMENT Relay5_Error_State "" UBYTE VBU0706_CM_uint8 0 0 0 255 ECU_ADDRESS 0x70011ec4 /end MEASUREMENT
/begin MEASUREMENT Relay6_Error_State "" UBYTE VBU0706_CM_uint8 0 0 0 255 ECU_ADDRESS 0x70011ec5 /end MEASUREMENT
/begin MEASUREMENT Relay_Precharge_Error_State "" UBYTE VBU0706_CM_uint8 0 0 0 255 ECU_ADDRESS 0x70011ecf /end MEASUREMENT
/begin MEASUREMENT Relay_Heat_Error_State "" UBYTE VBU0706_CM_uint8 0 0 0 255 ECU_ADDRESS 0x70011ec9 /end MEASUREMENT
/begin MEASUREMENT Relay_MainPositive_Error_State "" UBYTE VBU0706_CM_uint8 0 0 0 255 ECU_ADDRESS 0x70011ecd /end MEASUREMENT
/begin MEASUREMENT Relay_MainNegative_Error_State "" UBYTE VBU0706_CM_uint8 0 0 0 255 ECU_ADDRESS 0x70011ecb /end MEASUREMENT
/begin MEASUREMENT Relay_MainPositive "" UBYTE VBU0706_CM_uint8 0 0 0 255 ECU_ADDRESS 0x70011ecc /end MEASUREMENT
/begin MEASUREMENT Relay_MainNegative "" UBYTE VBU0706_CM_uint8 0 0 0 255 ECU_ADDRESS 0x70011eca /end MEASUREMENT
/begin MEASUREMENT Relay_Precharge "" UBYTE VBU0706_CM_uint8 0 0 0 255 ECU_ADDRESS 0x70011ece /end MEASUREMENT
/begin MEASUREMENT Relay_Heat "" UBYTE VBU0706_CM_uint8 0 0 0 255 ECU_ADDRESS 0x70011ec8 /end MEASUREMENT
/begin MEASUREMENT Relay_5 "" UBYTE VBU0706_CM_uint8 0 0 0 255 ECU_ADDRESS 0x70011ec6 /end MEASUREMENT
/begin MEASUREMENT Relay_6 "" UBYTE VBU0706_CM_uint8 0 0 0 255 ECU_ADDRESS 0x70011ec7 /end MEASUREMENT
/begin MEASUREMENT LEM_CurrentSensorInvalid "" UBYTE VBU0706_CM_uint8 0 0 0 255 ECU_ADDRESS 0x70011e4b /end MEASUREMENT
/begin MEASUREMENT LEM_stFaultInfor "" UBYTE VBU0706_CM_uint8 0 0 0 255 ECU_ADDRESS 0x70011e4c /end MEASUREMENT
/begin MEASUREMENT Total_Temp_Num "" UBYTE VBU0706_CM_uint8 0 0 0 255 ECU_ADDRESS 0x70011f1b /end MEASUREMENT
/begin MEASUREMENT Total_Volt_Cell_Num "" UBYTE VBU0706_CM_uint8 0 0 0 255 ECU_ADDRESS 0x70011f1c /end MEASUREMENT
/begin MEASUREMENT High_Cell_Temp_2_BMU_Index "" UBYTE VBU0706_CM_uint8 0 0 0 255 ECU_ADDRESS 0x70011e23 /end MEASUREMENT
/begin MEASUREMENT High_Cell_Temp_2_BMU_ID "" UBYTE VBU0706_CM_uint8 0 0 0 255 ECU_ADDRESS 0x70011e22 /end MEASUREMENT
/begin MEASUREMENT High_Cell_Temp_1_BMU_Index "" UBYTE VBU0706_CM_uint8 0 0 0 255 ECU_ADDRESS 0x70011e21 /end MEASUREMENT
/begin MEASUREMENT High_Cell_Temp_1_BMU_ID "" UBYTE VBU0706_CM_uint8 0 0 0 255 ECU_ADDRESS 0x70011e20 /end MEASUREMENT
/begin MEASUREMENT Low_Cell_Volt_5_BMU_Index "" UBYTE VBU0706_CM_uint8 0 0 0 255 ECU_ADDRESS 0x70011e72 /end MEASUREMENT
/begin MEASUREMENT Low_Cell_Volt_5_BMU_ID "" UBYTE VBU0706_CM_uint8 0 0 0 255 ECU_ADDRESS 0x70011e71 /end MEASUREMENT
/begin MEASUREMENT Low_Cell_Volt_4_BMU_Index "" UBYTE VBU0706_CM_uint8 0 0 0 255 ECU_ADDRESS 0x70011e70 /end MEASUREMENT
/begin MEASUREMENT Low_Cell_Volt_4_BMU_ID "" UBYTE VBU0706_CM_uint8 0 0 0 255 ECU_ADDRESS 0x70011e6f /end MEASUREMENT
/begin MEASUREMENT Low_Cell_Volt_3_BMU_Index "" UBYTE VBU0706_CM_uint8 0 0 0 255 ECU_ADDRESS 0x70011e6e /end MEASUREMENT
/begin MEASUREMENT Low_Cell_Volt_3_BMU_ID "" UBYTE VBU0706_CM_uint8 0 0 0 255 ECU_ADDRESS 0x70011e6d /end MEASUREMENT
/begin MEASUREMENT Low_Cell_Volt_2_BMU_Index "" UBYTE VBU0706_CM_uint8 0 0 0 255 ECU_ADDRESS 0x70011e6c /end MEASUREMENT
/begin MEASUREMENT Low_Cell_Volt_2_BMU_ID "" UBYTE VBU0706_CM_uint8 0 0 0 255 ECU_ADDRESS 0x70011e6b /end MEASUREMENT
/begin MEASUREMENT Low_Cell_Volt_1_BMU_Index "" UBYTE VBU0706_CM_uint8 0 0 0 255 ECU_ADDRESS 0x70011e6a /end MEASUREMENT
/begin MEASUREMENT Low_Cell_Volt_1_BMU_ID "" UBYTE VBU0706_CM_uint8 0 0 0 255 ECU_ADDRESS 0x70011e69 /end MEASUREMENT
/begin MEASUREMENT High_Cell_Volt_5_BMU_Index "" UBYTE VBU0706_CM_uint8 0 0 0 255 ECU_ADDRESS 0x70011e33 /end MEASUREMENT
/begin MEASUREMENT High_Cell_Volt_5_BMU_ID "" UBYTE VBU0706_CM_uint8 0 0 0 255 ECU_ADDRESS 0x70011e32 /end MEASUREMENT
/begin MEASUREMENT High_Cell_Volt_4_BMU_Index "" UBYTE VBU0706_CM_uint8 0 0 0 255 ECU_ADDRESS 0x70011e31 /end MEASUREMENT
/begin MEASUREMENT High_Cell_Volt_4_BMU_ID "" UBYTE VBU0706_CM_uint8 0 0 0 255 ECU_ADDRESS 0x70011e30 /end MEASUREMENT
/begin MEASUREMENT High_Cell_Volt_3_BMU_Index "" UBYTE VBU0706_CM_uint8 0 0 0 255 ECU_ADDRESS 0x70011e2f /end MEASUREMENT
/begin MEASUREMENT High_Cell_Volt_3_BMU_ID "" UBYTE VBU0706_CM_uint8 0 0 0 255 ECU_ADDRESS 0x70011e2e /end MEASUREMENT
/begin MEASUREMENT High_Cell_Volt_2_BMU_Index "" UBYTE VBU0706_CM_uint8 0 0 0 255 ECU_ADDRESS 0x70011e2d /end MEASUREMENT
/begin MEASUREMENT High_Cell_Volt_2_BMU_ID "" UBYTE VBU0706_CM_uint8 0 0 0 255 ECU_ADDRESS 0x70011e2c /end MEASUREMENT
/begin MEASUREMENT High_Cell_Volt_1_BMU_Index "" UBYTE VBU0706_CM_uint8 0 0 0 255 ECU_ADDRESS 0x70011e2b /end MEASUREMENT
/begin MEASUREMENT High_Cell_Volt_1_BMU_ID "" UBYTE VBU0706_CM_uint8 0 0 0 255 ECU_ADDRESS 0x70011e2a /end MEASUREMENT
/begin MEASUREMENT HCU_Statistics_State3_Heart "" UBYTE VBU0706_CM_uint8 0 0 0 255 ECU_ADDRESS 0x70011e1f /end MEASUREMENT
/begin MEASUREMENT Min_Volt_BMU_index "" UBYTE VBU0706_CM_uint8 0 0 0 255 ECU_ADDRESS 0x70011e7e /end MEASUREMENT
/begin MEASUREMENT Min_Volt_BMU_ID "" UBYTE VBU0706_CM_uint8 0 0 0 255 ECU_ADDRESS 0x70011e7d /end MEASUREMENT
/begin MEASUREMENT Min_Volt_Index "" UBYTE VBU0706_CM_uint8 0 0 0 255 ECU_ADDRESS 0x70011e7f /end MEASUREMENT
/begin MEASUREMENT Max_Volt_BMU_index "" UBYTE VBU0706_CM_uint8 0 0 0 255 ECU_ADDRESS 0x70011e78 /end MEASUREMENT
/begin MEASUREMENT HCU_Statistics_State2_Heart "" UBYTE VBU0706_CM_uint8 0 0 0 255 ECU_ADDRESS 0x70011e1e /end MEASUREMENT
/begin MEASUREMENT Max_Volt_BMU_ID "" UBYTE VBU0706_CM_uint8 0 0 0 255 ECU_ADDRESS 0x70011e77 /end MEASUREMENT
/begin MEASUREMENT Max_Volt_Index "" UBYTE VBU0706_CM_uint8 0 0 0 255 ECU_ADDRESS 0x70011e79 /end MEASUREMENT
/begin MEASUREMENT Min_Temp_BMU_index "" UBYTE VBU0706_CM_uint8 0 0 0 255 ECU_ADDRESS 0x70011e7b /end MEASUREMENT
/begin MEASUREMENT Min_Temp_BMU_ID "" UBYTE VBU0706_CM_uint8 0 0 0 255 ECU_ADDRESS 0x70011e7a /end MEASUREMENT
/begin MEASUREMENT Min_Temp_index "" UBYTE VBU0706_CM_uint8 0 0 0 255 ECU_ADDRESS 0x70011e7c /end MEASUREMENT
/begin MEASUREMENT Low_Cell_Temp_5_BMU_Index "" UBYTE VBU0706_CM_uint8 0 0 0 255 ECU_ADDRESS 0x70011e68 /end MEASUREMENT
/begin MEASUREMENT Low_Cell_Temp_5_BMU_ID "" UBYTE VBU0706_CM_uint8 0 0 0 255 ECU_ADDRESS 0x70011e67 /end MEASUREMENT
/begin MEASUREMENT Low_Cell_Temp_4_BMU_Index "" UBYTE VBU0706_CM_uint8 0 0 0 255 ECU_ADDRESS 0x70011e66 /end MEASUREMENT
/begin MEASUREMENT Low_Cell_Temp_4_BMU_ID "" UBYTE VBU0706_CM_uint8 0 0 0 255 ECU_ADDRESS 0x70011e65 /end MEASUREMENT
/begin MEASUREMENT Low_Cell_Temp_3_BMU_Index "" UBYTE VBU0706_CM_uint8 0 0 0 255 ECU_ADDRESS 0x70011e64 /end MEASUREMENT
/begin MEASUREMENT Low_Cell_Temp_3_BMU_ID "" UBYTE VBU0706_CM_uint8 0 0 0 255 ECU_ADDRESS 0x70011e63 /end MEASUREMENT
/begin MEASUREMENT Low_Cell_Temp_2_BMU_Index "" UBYTE VBU0706_CM_uint8 0 0 0 255 ECU_ADDRESS 0x70011e62 /end MEASUREMENT
/begin MEASUREMENT Low_Cell_Temp_2_BMU_ID "" UBYTE VBU0706_CM_uint8 0 0 0 255 ECU_ADDRESS 0x70011e61 /end MEASUREMENT
/begin MEASUREMENT Low_Cell_Temp_1_BMU_Index "" UBYTE VBU0706_CM_uint8 0 0 0 255 ECU_ADDRESS 0x70011e60 /end MEASUREMENT
/begin MEASUREMENT Low_Cell_Temp_1_BMU_ID "" UBYTE VBU0706_CM_uint8 0 0 0 255 ECU_ADDRESS 0x70011e5f /end MEASUREMENT
/begin MEASUREMENT Low_Cell_Temp_1 "" UBYTE VBU0706_CM_uint8 0 0 0 255 ECU_ADDRESS 0x70011e5e /end MEASUREMENT
/begin MEASUREMENT High_Cell_Temp_5_BMU_Index "" UBYTE VBU0706_CM_uint8 0 0 0 255 ECU_ADDRESS 0x70011e29 /end MEASUREMENT
/begin MEASUREMENT High_Cell_Temp_5_BMU_ID "" UBYTE VBU0706_CM_uint8 0 0 0 255 ECU_ADDRESS 0x70011e28 /end MEASUREMENT
/begin MEASUREMENT High_Cell_Temp_4_BMU_Index "" UBYTE VBU0706_CM_uint8 0 0 0 255 ECU_ADDRESS 0x70011e27 /end MEASUREMENT
/begin MEASUREMENT High_Cell_Temp_4_BMU_ID "" UBYTE VBU0706_CM_uint8 0 0 0 255 ECU_ADDRESS 0x70011e26 /end MEASUREMENT
/begin MEASUREMENT High_Cell_Temp_3_BMU_Index "" UBYTE VBU0706_CM_uint8 0 0 0 255 ECU_ADDRESS 0x70011e25 /end MEASUREMENT
/begin MEASUREMENT High_Cell_Temp_3_BMU_ID "" UBYTE VBU0706_CM_uint8 0 0 0 255 ECU_ADDRESS 0x70011e24 /end MEASUREMENT
/begin MEASUREMENT HCU_Statistics_State1_Heart "" UBYTE VBU0706_CM_uint8 0 0 0 255 ECU_ADDRESS 0x70011e1d /end MEASUREMENT
/begin MEASUREMENT Max_Temp_BMU_index "" UBYTE VBU0706_CM_uint8 0 0 0 255 ECU_ADDRESS 0x70011e75 /end MEASUREMENT
/begin MEASUREMENT MaxTempBMU_ID "" UBYTE VBU0706_CM_uint8 0 0 0 255 ECU_ADDRESS 0x70011e74 /end MEASUREMENT
/begin MEASUREMENT Max_Temp_index "" UBYTE VBU0706_CM_uint8 0 0 0 255 ECU_ADDRESS 0x70011e76 /end MEASUREMENT
/begin MEASUREMENT HCU_Message_6_Heart "" UBYTE VBU0706_CM_uint8 0 0 0 255 ECU_ADDRESS 0x70011e1b /end MEASUREMENT
/begin MEASUREMENT HCU_Message_5_Heart "" UBYTE VBU0706_CM_uint8 0 0 0 255 ECU_ADDRESS 0x70011e1a /end MEASUREMENT
/begin MEASUREMENT Volt_Line_Error "" UBYTE VBU0706_CM_uint8 0 0 0 255 ECU_ADDRESS 0x70011f54 /end MEASUREMENT
/begin MEASUREMENT Temp_Line_Error "" UBYTE VBU0706_CM_uint8 0 0 0 255 ECU_ADDRESS 0x70011f1a /end MEASUREMENT
/begin MEASUREMENT Comm_Error "" UBYTE VBU0706_CM_uint8 0 0 0 255 ECU_ADDRESS 0x70011d5c /end MEASUREMENT
/begin MEASUREMENT Self_Test "" UBYTE VBU0706_CM_uint8 0 0 0 255 ECU_ADDRESS 0x70011ef5 /end MEASUREMENT
/begin MEASUREMENT Power_Supply_Error_lev "" UBYTE VBU0706_CM_uint8 0 0 0 255 ECU_ADDRESS 0x70011ec3 /end MEASUREMENT
/begin MEASUREMENT Power_5V_High_Error "" UBYTE VBU0706_CM_uint8 0 0 0 255 ECU_ADDRESS 0x70011ec1 /end MEASUREMENT
/begin MEASUREMENT Power_5V_Low_Error "" UBYTE VBU0706_CM_uint8 0 0 0 255 ECU_ADDRESS 0x70011ec2 /end MEASUREMENT
/begin MEASUREMENT ADS_Error_1 "" UBYTE VBU0706_CM_uint8 0 0 0 255 ECU_ADDRESS 0x70011cda /end MEASUREMENT
/begin MEASUREMENT ADS_Error_2 "" UBYTE VBU0706_CM_uint8 0 0 0 255 ECU_ADDRESS 0x70011cdb /end MEASUREMENT
/begin MEASUREMENT Self_Lock_State "" UBYTE VBU0706_CM_uint8 0 0 0 255 ECU_ADDRESS 0x70011ef4 /end MEASUREMENT
/begin MEASUREMENT Insulation_State "" UBYTE VBU0706_CM_uint8 0 0 0 255 ECU_ADDRESS 0x70011e4a /end MEASUREMENT
/begin MEASUREMENT Insulation_Resistance "" UBYTE VBU0706_CM_uint8 0 0 0 255 ECU_ADDRESS 0x70011e49 /end MEASUREMENT
/begin MEASUREMENT CTC_flgHALMnNegContactor "" UBYTE VBU0706_CM_boolean 0 0 0 1 ECU_ADDRESS 0x70011d29 /end MEASUREMENT
/begin MEASUREMENT CTC_flgHALMnPosContactor "" UBYTE VBU0706_CM_boolean 0 0 0 1 ECU_ADDRESS 0x70011d2a /end MEASUREMENT
/begin MEASUREMENT CTC_flgHALPrechargeRelay "" UBYTE VBU0706_CM_boolean 0 0 0 1 ECU_ADDRESS 0x70011d2b /end MEASUREMENT
/begin MEASUREMENT LaCBL_flgCellBoardTempAvailable "" UBYTE VBU0706_CM_boolean 0 0 0 1 ARRAY_SIZE 198 ECU_ADDRESS 0x70011f5d /end MEASUREMENT
/begin MEASUREMENT DSM_flgNoRestart "" UBYTE VBU0706_CM_boolean 0 0 0.0 1.0 ECU_ADDRESS 0x70011dac /end MEASUREMENT
/begin MEASUREMENT DSM_flgNoCharge "" UBYTE VBU0706_CM_boolean 0 0 0 1 ECU_ADDRESS 0x70011dab /end MEASUREMENT
/begin MEASUREMENT DSM_flgDriverCycleActive "" UBYTE VBU0706_CM_boolean 0 0 0.0 1.0 ECU_ADDRESS 0x70011da9 /end MEASUREMENT
/begin MEASUREMENT DSM_flgCscValueUncertain "" UBYTE VBU0706_CM_boolean 0 0 0 1 ECU_ADDRESS 0x70011da7 /end MEASUREMENT
/begin MEASUREMENT DSM_flgCycleUploadAbnormalEvent "" UBYTE VBU0706_CM_boolean 0 0 0 1 ECU_ADDRESS 0x70011da8 /end MEASUREMENT
/begin MEASUREMENT CTS_flgCmdOpenContactorsNow "" UBYTE VBU0706_CM_boolean 0 0 0 1 ECU_ADDRESS 0x70011d4a /end MEASUREMENT
/begin MEASUREMENT CTS_flgCmdOpenContactorsDelay "" UBYTE VBU0706_CM_boolean 0 0 0 1 ECU_ADDRESS 0x70011d49 /end MEASUREMENT
/begin MEASUREMENT CTS_flgRunPrechargeDiagnostic "" UBYTE VBU0706_CM_boolean 0 0 0 1 ECU_ADDRESS 0x70011d50 /end MEASUREMENT
/begin MEASUREMENT CTS_flgRunNegContactorWeldCheck "" UBYTE VBU0706_CM_boolean 0 0 0 1 ECU_ADDRESS 0x70011d4e /end MEASUREMENT
/begin MEASUREMENT CTS_flgRunPosContactorWeldCheck "" UBYTE VBU0706_CM_boolean 0 0 0 1 ECU_ADDRESS 0x70011d4f /end MEASUREMENT
/begin MEASUREMENT CTD_flgPrechargeResistanceBlownFaultTestEnable "" UBYTE VBU0706_CM_boolean 0 0 0 1 ECU_ADDRESS 0x70011d32 /end MEASUREMENT
/begin MEASUREMENT CTD_flgPrechargeResistanceBlownFaultTestFail "" UBYTE VBU0706_CM_boolean 0 0 0 1 ECU_ADDRESS 0x70011d33 /end MEASUREMENT
/begin MEASUREMENT CTD_flgMainFuseBlowFaultTestEnable "" UBYTE VBU0706_CM_boolean 0 0 0 1 ECU_ADDRESS 0x70011d30 /end MEASUREMENT
/begin MEASUREMENT CTD_flgMainFuseBlowFaultTestFail "" UBYTE VBU0706_CM_boolean 0 0 0 1 ECU_ADDRESS 0x70011d31 /end MEASUREMENT
/begin MEASUREMENT BMM_flgEEBlockStoreEnable "" UBYTE VBU0706_CM_boolean 0 0 0 1 ECU_ADDRESS 0x70011d09 /end MEASUREMENT
/begin MEASUREMENT BMM_flgFastChargeWakeup "" UBYTE VBU0706_CM_boolean 0 0 0.0 1.0 ECU_ADDRESS 0x70011d0a /end MEASUREMENT
/begin MEASUREMENT BMM_flgIgnitionOnWakeup "" UBYTE VBU0706_CM_boolean 0 0 0.0 1.0 ECU_ADDRESS 0x70011d0c /end MEASUREMENT
/begin MEASUREMENT BMM_flgHoldAfterrun "" UBYTE VBU0706_CM_boolean 0 0 0.0 1.0 ECU_ADDRESS 0x70011d0b /end MEASUREMENT
/begin MEASUREMENT BCV_flgBatteryCurrentSystemValid "" UBYTE VBU0706_CM_boolean 0 0 0 1 ECU_ADDRESS 0x70011cf5 /end MEASUREMENT
/begin MEASUREMENT BCV_flgDCContactorOverCurrent "" UBYTE VBU0706_CM_boolean 0 0 0 1 ECU_ADDRESS 0x70011cfa /end MEASUREMENT
/begin MEASUREMENT INP_flgIgnOn "" UBYTE VBU0706_CM_boolean 0 0 0.0 1.0 ECU_ADDRESS 0x70011e41 /end MEASUREMENT
/begin MEASUREMENT BSWIN_BrkSwtRaw "" UBYTE VBU0706_CM_boolean 0 0 0 1 ECU_ADDRESS 0x70011d14 /end MEASUREMENT
/begin MEASUREMENT BSWIN_BrkLmpSwtRaw "" UBYTE VBU0706_CM_boolean 0 0 0 1 ECU_ADDRESS 0x70011d13 /end MEASUREMENT
/begin MEASUREMENT BSWIN_ACACMidPre "" UBYTE VBU0706_CM_boolean 0 0 0 1 ECU_ADDRESS 0x70011d11 /end MEASUREMENT
/begin MEASUREMENT BSWIN_ACPreSw "" UBYTE VBU0706_CM_boolean 0 0 0 1 ECU_ADDRESS 0x70011d12 /end MEASUREMENT
/begin MEASUREMENT BSWIN_flgGearH1 "" UBYTE VBU0706_CM_boolean 0 0 0 1 ECU_ADDRESS 0x70011d16 /end MEASUREMENT
/begin MEASUREMENT BSWIN_flgGearH2 "" UBYTE VBU0706_CM_boolean 0 0 0 1 ECU_ADDRESS 0x70011d17 /end MEASUREMENT
/begin MEASUREMENT BSWIN_flgGearH3 "" UBYTE VBU0706_CM_boolean 0 0 0 1 ECU_ADDRESS 0x70011d18 /end MEASUREMENT
/begin MEASUREMENT INP_flgDCChAPlusWkup "" UBYTE VBU0706_CM_boolean 0 0 0.0 1.0 ECU_ADDRESS 0x70011e3c /end MEASUREMENT
/begin MEASUREMENT BSWIN_Crank "" UBYTE VBU0706_CM_boolean 0 0 0 1 ECU_ADDRESS 0x70011d15 /end MEASUREMENT
/begin MEASUREMENT LcCTS_CloseAndDiagnoseContactorsTimer_ms "" UWORD VBU0706_CM_uint16 0 0 0 65535 ECU_ADDRESS 0x700113ac /end MEASUREMENT
/begin MEASUREMENT LcCTS_OpenContactorsDelayTimer_ms "" UWORD VBU0706_CM_uint16 0 0 0 65535 ECU_ADDRESS 0x700113b6 /end MEASUREMENT
/begin MEASUREMENT LcCTS_StandbyTimer_ms "" UWORD VBU0706_CM_uint16 0 0 0 65535 ECU_ADDRESS 0x700113b8 /end MEASUREMENT
/begin MEASUREMENT LcCTS_OpenAndDiagnoseWeldTimer_ms "" UWORD VBU0706_CM_uint16 0 0 0 65535 ECU_ADDRESS 0x700113b4 /end MEASUREMENT
/begin MEASUREMENT LcCTS_DiagnoseMPCWeldcheckDischargeTimer_ms "" UWORD VBU0706_CM_uint16 0 0 0 65535 ECU_ADDRESS 0x700113b0 /end MEASUREMENT
/begin MEASUREMENT LcCTS_DiagnoseMPCWeldcheckTimer_ms "" UWORD VBU0706_CM_uint16 0 0 0 65535 ECU_ADDRESS 0x700113b2 /end MEASUREMENT
/begin MEASUREMENT LcCTS_CmdMnPosContactorCounter_ms "" UWORD VBU0706_CM_uint16 0 0 0 65535 ECU_ADDRESS 0x700113ae /end MEASUREMENT
/begin COMPU_METHOD VBU0706_CM_single_cnt "Q = V" RAT_FUNC "%8.6" "cnt" COEFFS 0 1 0 0 0 1 /end COMPU_METHOD
/begin COMPU_METHOD VBU0706_CM_uint16_cnt "Q = V" RAT_FUNC "%5.0" "cnt" COEFFS 0 1 0 0 0 1 /end COMPU_METHOD
/begin COMPU_METHOD VBU0706_CM_single_A "Q = V" RAT_FUNC "%8.6" "A" COEFFS 0 1 0 0 0 1 /end COMPU_METHOD
/begin COMPU_METHOD VBU0706_CM_single_V "Q = V" RAT_FUNC "%8.6" "V" COEFFS 0 1 0 0 0 1 /end COMPU_METHOD
/begin COMPU_METHOD VBU0706_CM_uint16 "Q = V" RAT_FUNC "%5.0" "" COEFFS 0 1 0 0 0 1 /end COMPU_METHOD
/begin COMPU_METHOD VBU0706_CM_uint8 "Q = V" RAT_FUNC "%3.0" "" COEFFS 0 1 0 0 0 1 /end COMPU_METHOD
/begin COMPU_METHOD VBU0706_CM_single "Q = V" RAT_FUNC "%8.6" "" COEFFS 0 1 0 0 0 1 /end COMPU_METHOD
/begin COMPU_METHOD VBU0706_CM_uint32_cnt "Q = V" RAT_FUNC "%10.0" "cnt" COEFFS 0 1 0 0 0 1 /end COMPU_METHOD
/begin COMPU_METHOD VBU0706_CM_uint32_ms "Q = V" RAT_FUNC "%10.0" "ms" COEFFS 0 1 0 0 0 1 /end COMPU_METHOD
/begin COMPU_METHOD VBU0706_CM_uint16_mV "Q = V" RAT_FUNC "%5.0" "mV" COEFFS 0 1 0 0 0 1 /end COMPU_METHOD
/begin COMPU_METHOD VBU0706_CM_uint16_ms "Q = V" RAT_FUNC "%5.0" "ms" COEFFS 0 1 0 0 0 1 /end COMPU_METHOD
/begin COMPU_METHOD VBU0706_CM_uint16_s "Q = V" RAT_FUNC "%5.0" "s" COEFFS 0 1 0 0 0 1 /end COMPU_METHOD
/begin COMPU_METHOD VBU0706_CM_boolean "Q = V" RAT_FUNC "%1.0" "" COEFFS 0 1 0 0 0 1 /end COMPU_METHOD
/begin COMPU_METHOD VBU0706_CM_boolean_cnt "Q = V" RAT_FUNC "%1.0" "cnt" COEFFS 0 1 0 0 0 1 /end COMPU_METHOD
/begin COMPU_METHOD VBU0706_CM_int8_cnt "Q = V" RAT_FUNC "%3.0" "cnt" COEFFS 0 1 0 0 0 1 /end COMPU_METHOD
/begin COMPU_METHOD VBU0706_CM_int8_n "Q = V" RAT_FUNC "%3.0" "n" COEFFS 0 1 0 0 0 1 /end COMPU_METHOD
/begin COMPU_METHOD VBU0706_CM_uint8_cnt "Q = V" RAT_FUNC "%3.0" "cnt" COEFFS 0 1 0 0 0 1 /end COMPU_METHOD
/begin COMPU_METHOD VBU0706_CM_uint8_n "Q = V" RAT_FUNC "%3.0" "n" COEFFS 0 1 0 0 0 1 /end COMPU_METHOD
/begin GROUP S2337_Subsystem "VBU0706/Task_10ms/Subsystem/HALIn/HW/Subsystem"
 /begin SUB_GROUP S2340_Input_HW_Signal_Range_Check2 S2340_Input_HW_Signal_Range_Check3 S2340_Input_HW_Signal_Range_Check4 S2340_Input_HW_Signal_Range_Check6 S2340_Input_HW_Signal_Range_Check_Table1 S2340_Input_HW_Signal_Range_Check_Table2 S2340_Input_HW_Signal_Range_Check_Table4 S2340_Input_HW_Signal_Range_Check_Table5 /end SUB_GROUP
 /begin REF_MEASUREMENT BSWIN_AmbientTemp BSWIN_EDSInletCoolTemp BSWIN_uVacuumPre INP_uLVBatt uAccPed1Raw uAccPed2Raw uBrkPresRaw uDCChCC2 uDCChPortPosTempRaw uDCChPortTempNegativeRaw uLVBattRaw /end REF_MEASUREMENT
/end GROUP
/begin GROUP S2337_Subsystem1 "VBU0706/Task_10ms/Subsystem/HALIn/HW/Subsystem1"
 /begin SUB_GROUP S2341_BrkLmpSwtConfirm S2341_BrkLmpSwtConfirm1 S2341_INP_flgGearH1Confirm S2341_INP_flgGearH2Confirm S2341_INP_flgGearH3Confirm S2341_INP_flgIgnOnConfirm S2341_INP_flgIgnOnConfirm1 S2341_IN_ACMidPreConfirm S2341_IN_CrankConfirm S2341_IN_DriverACOnConfirm /end SUB_GROUP
 /begin REF_MEASUREMENT BSWIN_ACACMidPre BSWIN_ACPreSw BSWIN_BrkLmpSwtRaw BSWIN_BrkSwtRaw BSWIN_Crank BSWIN_flgGearH1 BSWIN_flgGearH2 BSWIN_flgGearH3 INP_flgDCChAPlusWkup INP_flgIgnOn /end REF_MEASUREMENT
/end GROUP
/begin GROUP S2337_Subsystem2 "VBU0706/Task_10ms/Subsystem/HALIn/HW/Subsystem2"
 /begin SUB_GROUP S2342_Input_HW_Signal_Range_Check1 S2342_Input_HW_Signal_Range_Check2 S2342_Input_HW_Signal_Range_Check3 S2342_Input_HW_Signal_Range_Check7 /end SUB_GROUP
 /begin REF_MEASUREMENT BSWIN_BatteryPre_du BSWIN_BatteryPre_f BSWIN_HVIL_du BSWIN_HVIL_f /end REF_MEASUREMENT
/end GROUP
/begin GROUP S2338_MsgRxData_Unpack1 "VBU0706/Task_10ms/Subsystem/HALIn/LIN/MsgRxData_Unpack1" /begin SUB_GROUP S2495_CanRxData_Unpack S2495_CanRxData_Unpack1 /end SUB_GROUP /end GROUP
/begin GROUP S2339_Subsystem "VBU0706/Task_10ms/Subsystem/HALIn/PTCAN/Subsystem"
 /begin SUB_GROUP S2505_20ms S2505_50ms S2505_CanMsgUnpack S2505_Subsystem2 S2505_Subsystem3 S2505_Subsystem4 /end SUB_GROUP
/end GROUP
/begin GROUP S3227_PTCAN1Transmit "VBU0706/Task_10ms/Subsystem/VCU /APO2HAL/PTCAN1Transmit"
 /begin SUB_GROUP S3240_VCU_151 S3240_VCU_153 S3240_VCU_201 S3240_VCU_501 S3240_VCU_502 S3240_VCU_AC_238 S3240_VCU_DCDC_250 S3240_VCU_EPB_155 S3240_VCU_IC_210 S3240_VCU_MCU_105 /end SUB_GROUP
/end GROUP
/begin GROUP S3227_Subsystem2 "VBU0706/Task_10ms/Subsystem/VCU /APO2HAL/Subsystem2" /begin SUB_GROUP S3241_Subsystem /end SUB_GROUP /end GROUP
/begin GROUP S3228_DSPL "VBU0706/Task_10ms/Subsystem/VCU /DSPL/DSPL" /begin SUB_GROUP S3343_DriveRange S3343_Other /end SUB_GROUP /end GROUP
/begin GROUP S3229_EDIS_Ctrl "VBU0706/Task_10ms/Subsystem/VCU /EDIS/EDIS_Ctrl"
 /begin SUB_GROUP S3470_BatDis_Power_Lim_Calc S3470_battery_power_calculate S3470_drive_power_calculate /end SUB_GROUP
 /begin REF_CHARACTERISTIC PMM_stDCChMode_SY /end REF_CHARACTERISTIC
/end GROUP
/begin GROUP S3230_PMM_Ctrl "VBU0706/Task_10ms/Subsystem/VCU /PMM/PMM_Ctrl" /begin SUB_GROUP S3553_LVC S3553_PMM /end SUB_GROUP /end GROUP
/begin GROUP S3231_SPD "VBU0706/Task_10ms/Subsystem/VCU /SPD/SPD" /begin SUB_GROUP S3702_SignalProcessing_10ms /end SUB_GROUP /end GROUP
/begin GROUP S3232_THM "VBU0706/Task_10ms/Subsystem/VCU /THM/THM"
 /begin SUB_GROUP S3738_Active S3738_AfterRun S3738_Compr S3738_ESSThermalMode S3738_EXVRaw S3738_FANRaw S3738_FPVRaw S3738_PTC S3738_PumpRaw /end SUB_GROUP
/end GROUP
/begin GROUP S3232_THMINP "VBU0706/Task_10ms/Subsystem/VCU /THM/THMINP" /begin SUB_GROUP S3739_Fliter /end SUB_GROUP /end GROUP
/begin GROUP S3232_THMOUT "VBU0706/Task_10ms/Subsystem/VCU /THM/THMOUT"
 /begin SUB_GROUP S3740_AC S3740_AfterRun S3740_EXV S3740_FAN S3740_FPV S3740_PTC S3740_Pump /end SUB_GROUP
/end GROUP
/begin GROUP S3233_TQC "VBU0706/Task_10ms/Subsystem/VCU /TQC/TQC" /begin SUB_GROUP S3810_Subsystem /end SUB_GROUP /end GROUP
/begin GROUP S3234_TrqDem "VBU0706/Task_10ms/Subsystem/VCU /TQD/TrqDem"
 /begin SUB_GROUP S3856_BrkRgn_Cal S3856_TrqDem_Arb S3856_TrqDem_DrvTrq_Cal S3856_TrqDem_InputTransfer /end SUB_GROUP
/end GROUP
/begin GROUP S3235_TQOAll "VBU0706/Task_10ms/Subsystem/VCU /TQO/TQOAll"
 /begin SUB_GROUP S3882_STC S3882_TQARB S3882_TQCMP S3882_TQDIS S3882_TQDMP S3882_TQO /end SUB_GROUP
/end GROUP
/begin GROUP S3237_Subsystem "VBU0706/Task_10ms/Subsystem/VCU /VTQA/Subsystem" /begin SUB_GROUP S4001_Subsystem /end SUB_GROUP /end GROUP
/begin GROUP S3238_VehINP_Logic "VBU0706/Task_10ms/Subsystem/VCU /VehINP/VehINP_Logic"
 /begin SUB_GROUP S4034_APD S4034_FPV S4034_GearShift S4034_Mode S4034_PEU_InverterStatus S4034_VacuumPump_Control S4034_VehINP_BPD S4034_Veh_Status /end SUB_GROUP
/end GROUP
/begin GROUP S21_CanRxData_Unpack "VBU0706/Function-Call Subsystem/Subsystem/CHGCAN/CanMsgUnpack/MsgRxData_Unpack10/CanRxData_Unpack" /begin SUB_GROUP S32_TP /end SUB_GROUP /end GROUP
/begin GROUP S54_CanRxData_Unpack "VBU0706/Function-Call Subsystem/Subsystem/PrivateCAN/CanMsgUnpack1/MsgRxData_Unpack1/CanRxData_Unpack"
 /begin REF_MEASUREMENT Temperature_1 Temperature_2 Temperature_3 Temperature_4 Temperature_5 Temperature_6 Temperature_7 Temperature_8 /end REF_MEASUREMENT
/end GROUP
/begin GROUP S55_CanRxData_Unpack "VBU0706/Function-Call Subsystem/Subsystem/PrivateCAN/CanMsgUnpack1/MsgRxData_Unpack10/CanRxData_Unpack"
 /begin REF_MEASUREMENT ADS_Error_1 ADS_Error_2 Comm_Error HCU_Message_5_Heart Insulation_Resistance Insulation_State Power_5V_High_Error Power_5V_Low_Error Power_Supply_Error_lev Self_Lock_State Self_Test Temp_Line_Error Volt_Line_Error /end REF_MEASUREMENT
/end GROUP
/begin GROUP S56_CanRxData_Unpack "VBU0706/Function-Call Subsystem/Subsystem/PrivateCAN/CanMsgUnpack1/MsgRxData_Unpack11/CanRxData_Unpack"
 /begin REF_MEASUREMENT Ave_Temp Ave_Volt Board_Temp HCU_Message_6_Heart Total_Volt /end REF_MEASUREMENT
/end GROUP
/begin GROUP S57_CanRxData_Unpack "VBU0706/Function-Call Subsystem/Subsystem/PrivateCAN/CanMsgUnpack1/MsgRxData_Unpack12/CanRxData_Unpack"
 /begin REF_MEASUREMENT Insulation_R_Minus Insulation_R_Plus PWM_IN1_Duty PWM_IN1_Freq PWM_IN2_Duty PWM_IN2_Freq /end REF_MEASUREMENT
/end GROUP
/begin GROUP S58_CanRxData_Unpack "VBU0706/Function-Call Subsystem/Subsystem/PrivateCAN/CanMsgUnpack1/MsgRxData_Unpack13/CanRxData_Unpack"
 /begin REF_MEASUREMENT HCU_Statistics_State1_Heart MaxTempBMU_ID Max_Temp Max_Temp_BMU_index Max_Temp_index Min_Temp /end REF_MEASUREMENT
/end GROUP
/begin GROUP S59_CanRxData_Unpack "VBU0706/Function-Call Subsystem/Subsystem/PrivateCAN/CanMsgUnpack1/MsgRxData_Unpack14/CanRxData_Unpack"
 /begin REF_MEASUREMENT High_Cell_Temp_3 High_Cell_Temp_3_BMU_ID High_Cell_Temp_3_BMU_Index High_Cell_Temp_4 High_Cell_Temp_4_BMU_ID High_Cell_Temp_4_BMU_Index /end REF_MEASUREMENT
/end GROUP
/begin GROUP S60_CanRxData_Unpack "VBU0706/Function-Call Subsystem/Subsystem/PrivateCAN/CanMsgUnpack1/MsgRxData_Unpack15/CanRxData_Unpack"
 /begin REF_MEASUREMENT High_Cell_Temp_5 High_Cell_Temp_5_BMU_ID High_Cell_Temp_5_BMU_Index Low_Cell_Temp_1 Low_Cell_Temp_1_BMU_ID Low_Cell_Temp_1_BMU_Index /end REF_MEASUREMENT
/end GROUP
/begin GROUP S61_CanRxData_Unpack "VBU0706/Function-Call Subsystem/Subsystem/PrivateCAN/CanMsgUnpack1/MsgRxData_Unpack16/CanRxData_Unpack"
 /begin REF_MEASUREMENT Low_Cell_Temp_2 Low_Cell_Temp_2_BMU_ID Low_Cell_Temp_2_BMU_Index Low_Cell_Temp_3 Low_Cell_Temp_3_BMU_ID Low_Cell_Temp_3_BMU_Index /end REF_MEASUREMENT
/end GROUP
/begin GROUP S62_CanRxData_Unpack "VBU0706/Function-Call Subsystem/Subsystem/PrivateCAN/CanMsgUnpack1/MsgRxData_Unpack17/CanRxData_Unpack"
 /begin REF_MEASUREMENT Low_Cell_Temp_4 Low_Cell_Temp_4_BMU_ID Low_Cell_Temp_4_BMU_Index Low_Cell_Temp_5 Low_Cell_Temp_5_BMU_ID Low_Cell_Temp_5_BMU_Index /end REF_MEASUREMENT
/end GROUP
/begin GROUP S63_CanRxData_Unpack "VBU0706/Function-Call Subsystem/Subsystem/PrivateCAN/CanMsgUnpack1/MsgRxData_Unpack18/CanRxData_Unpack"
 /begin REF_MEASUREMENT HCU_Statistics_State2_Heart Max_Volt Max_Volt_BMU_ID Max_Volt_Index Min_Temp_BMU_ID Min_Temp_BMU_index Min_Temp_index /end REF_MEASUREMENT
/end GROUP
/begin GROUP S64_CanRxData_Unpack "VBU0706/Function-Call Subsystem/Subsystem/PrivateCAN/CanMsgUnpack1/MsgRxData_Unpack19/CanRxData_Unpack"
 /begin REF_MEASUREMENT HCU_Statistics_State3_Heart Max_Volt_BMU_index Min_Volt Min_Volt_BMU_ID Min_Volt_BMU_index Min_Volt_Index /end REF_MEASUREMENT
/end GROUP
/begin GROUP S65_CanRxData_Unpack "VBU0706/Function-Call Subsystem/Subsystem/PrivateCAN/CanMsgUnpack1/MsgRxData_Unpack2/CanRxData_Unpack"
 /begin REF_MEASUREMENT Temperature_10 Temperature_11 Temperature_12 Temperature_13 Temperature_14 Temperature_15 Temperature_16 Temperature_9 /end REF_MEASUREMENT
/end GROUP
/begin GROUP S66_CanRxData_Unpack "VBU0706/Function-Call Subsystem/Subsystem/PrivateCAN/CanMsgUnpack1/MsgRxData_Unpack20/CanRxData_Unpack"
 /begin REF_MEASUREMENT High_Cell_Volt_1 High_Cell_Volt_1_BMU_ID High_Cell_Volt_1_BMU_Index High_Cell_Volt_2 High_Cell_Volt_2_BMU_ID High_Cell_Volt_2_BMU_Index /end REF_MEASUREMENT
/end GROUP
/begin GROUP S67_CanRxData_Unpack "VBU0706/Function-Call Subsystem/Subsystem/PrivateCAN/CanMsgUnpack1/MsgRxData_Unpack21/CanRxData_Unpack"
 /begin REF_MEASUREMENT High_Cell_Volt_3 High_Cell_Volt_3_BMU_ID High_Cell_Volt_3_BMU_Index High_Cell_Volt_4 High_Cell_Volt_4_BMU_ID High_Cell_Volt_4_BMU_Index /end REF_MEASUREMENT
/end GROUP
/begin GROUP S68_CanRxData_Unpack "VBU0706/Function-Call Subsystem/Subsystem/PrivateCAN/CanMsgUnpack1/MsgRxData_Unpack22/CanRxData_Unpack"
 /begin REF_MEASUREMENT High_Cell_Volt_5 High_Cell_Volt_5_BMU_ID High_Cell_Volt_5_BMU_Index Low_Cell_Volt_1 Low_Cell_Volt_1_BMU_ID Low_Cell_Volt_1_BMU_Index /end REF_MEASUREMENT
/end GROUP
/begin GROUP S69_CanRxData_Unpack "VBU0706/Function-Call Subsystem/Subsystem/PrivateCAN/CanMsgUnpack1/MsgRxData_Unpack23/CanRxData_Unpack"
 /begin REF_MEASUREMENT Low_Cell_Volt_2 Low_Cell_Volt_2_BMU_ID Low_Cell_Volt_2_BMU_Index Low_Cell_Volt_3 Low_Cell_Volt_3_BMU_ID Low_Cell_Volt_3_BMU_Index /end REF_MEASUREMENT
/end GROUP
/begin GROUP S70_CanRxData_Unpack "VBU0706/Function-Call Subsystem/Subsystem/PrivateCAN/CanMsgUnpack1/MsgRxData_Unpack24/CanRxData_Unpack"
 /begin REF_MEASUREMENT Low_Cell_Volt_4 Low_Cell_Volt_4_BMU_ID Low_Cell_Volt_4_BMU_Index Low_Cell_Volt_5 Low_Cell_Volt_5_BMU_ID Low_Cell_Volt_5_BMU_Index /end REF_MEASUREMENT
/end GROUP
/begin GROUP S71_CanRxData_Unpack "VBU0706/Function-Call Subsystem/Subsystem/PrivateCAN/CanMsgUnpack1/MsgRxData_Unpack25/CanRxData_Unpack"
 /begin REF_MEASUREMENT High_Cell_Temp_1 High_Cell_Temp_1_BMU_ID High_Cell_Temp_1_BMU_Index High_Cell_Temp_2 High_Cell_Temp_2_BMU_ID High_Cell_Temp_2_BMU_Index /end REF_MEASUREMENT
/end GROUP
/begin GROUP S72_CanRxData_Unpack "VBU0706/Function-Call Subsystem/Subsystem/PrivateCAN/CanMsgUnpack1/MsgRxData_Unpack26/CanRxData_Unpack"
 /begin REF_MEASUREMENT Temp_HCU_3 Temp_HCU_4 Temp_HCU_5 Temp_HCU_6 Temp_HCU_7 Temp_HCU_8 Temp_HCU_Water_Inlet Temp_HCU_Water_Outlet /end REF_MEASUREMENT
/end GROUP
/begin GROUP S73_CanRxData_Unpack "VBU0706/Function-Call Subsystem/Subsystem/PrivateCAN/CanMsgUnpack1/MsgRxData_Unpack27/CanRxData_Unpack" /begin REF_MEASUREMENT Total_Temp_Num Total_Volt_Cell_Num /end REF_MEASUREMENT /end GROUP
/begin GROUP S74_CanRxData_Unpack "VBU0706/Function-Call Subsystem/Subsystem/PrivateCAN/CanMsgUnpack1/MsgRxData_Unpack28/CanRxData_Unpack"
 /begin REF_MEASUREMENT LEM_BatteryCurrent LEM_CurrentSensorInvalid LEM_SensorName LEM_stFaultInfor /end REF_MEASUREMENT
/end GROUP
/begin GROUP S75_CanRxData_Unpack "VBU0706/Function-Call Subsystem/Subsystem/PrivateCAN/CanMsgUnpack1/MsgRxData_Unpack29/CanRxData_Unpack" /begin REF_MEASUREMENT CellVolt1 CellVolt2 CellVolt3 CellVolt4 /end REF_MEASUREMENT /end GROUP
/begin GROUP S76_CanRxData_Unpack "VBU0706/Function-Call Subsystem/Subsystem/PrivateCAN/CanMsgUnpack1/MsgRxData_Unpack3/CanRxData_Unpack"
 /begin REF_MEASUREMENT Temperature_17 Temperature_18 Temperature_19 Temperature_20 Temperature_21 Temperature_22 Temperature_23 Temperature_24 /end REF_MEASUREMENT
/end GROUP
/begin GROUP S77_CanRxData_Unpack "VBU0706/Function-Call Subsystem/Subsystem/PrivateCAN/CanMsgUnpack1/MsgRxData_Unpack30/CanRxData_Unpack" /begin REF_MEASUREMENT CellVolt37 CellVolt38 CellVolt39 CellVolt40 /end REF_MEASUREMENT /end GROUP
/begin GROUP S78_CanRxData_Unpack "VBU0706/Function-Call Subsystem/Subsystem/PrivateCAN/CanMsgUnpack1/MsgRxData_Unpack31/CanRxData_Unpack" /begin REF_MEASUREMENT CellVolt41 CellVolt42 CellVolt43 CellVolt44 /end REF_MEASUREMENT /end GROUP
/begin GROUP S79_CanRxData_Unpack "VBU0706/Function-Call Subsystem/Subsystem/PrivateCAN/CanMsgUnpack1/MsgRxData_Unpack32/CanRxData_Unpack" /begin REF_MEASUREMENT CellVolt45 CellVolt46 CellVolt47 CellVolt48 /end REF_MEASUREMENT /end GROUP
/begin GROUP S80_CanRxData_Unpack "VBU0706/Function-Call Subsystem/Subsystem/PrivateCAN/CanMsgUnpack1/MsgRxData_Unpack33/CanRxData_Unpack" /begin REF_MEASUREMENT CellVolt49 CellVolt50 CellVolt51 CellVolt52 /end REF_MEASUREMENT /end GROUP
/begin GROUP S81_CanRxData_Unpack "VBU0706/Function-Call Subsystem/Subsystem/PrivateCAN/CanMsgUnpack1/MsgRxData_Unpack34/CanRxData_Unpack" /begin REF_MEASUREMENT CellVolt53 CellVolt54 CellVolt55 CellVolt56 /end REF_MEASUREMENT /end GROUP
/begin GROUP S82_CanRxData_Unpack "VBU0706/Function-Call Subsystem/Subsystem/PrivateCAN/CanMsgUnpack1/MsgRxData_Unpack35/CanRxData_Unpack" /begin REF_MEASUREMENT CellVolt57 CellVolt58 CellVolt59 CellVolt60 /end REF_MEASUREMENT /end GROUP
/begin GROUP S83_CanRxData_Unpack "VBU0706/Function-Call Subsystem/Subsystem/PrivateCAN/CanMsgUnpack1/MsgRxData_Unpack36/CanRxData_Unpack" /begin REF_MEASUREMENT CellVolt61 CellVolt62 CellVolt63 CellVolt64 /end REF_MEASUREMENT /end GROUP
/begin GROUP S84_CanRxData_Unpack "VBU0706/Function-Call Subsystem/Subsystem/PrivateCAN/CanMsgUnpack1/MsgRxData_Unpack37/CanRxData_Unpack" /begin REF_MEASUREMENT CellVolt65 CellVolt66 CellVolt67 CellVolt68 /end REF_MEASUREMENT /end GROUP
/begin GROUP S85_CanRxData_Unpack "VBU0706/Function-Call Subsystem/Subsystem/PrivateCAN/CanMsgUnpack1/MsgRxData_Unpack38/CanRxData_Unpack" /begin REF_MEASUREMENT CellVolt69 CellVolt70 CellVolt71 CellVolt72 /end REF_MEASUREMENT /end GROUP
/begin GROUP S86_CanRxData_Unpack "VBU0706/Function-Call Subsystem/Subsystem/PrivateCAN/CanMsgUnpack1/MsgRxData_Unpack39/CanRxData_Unpack" /begin REF_MEASUREMENT CellVolt73 CellVolt74 CellVolt75 CellVolt76 /end REF_MEASUREMENT /end GROUP
/begin GROUP S87_CanRxData_Unpack "VBU0706/Function-Call Subsystem/Subsystem/PrivateCAN/CanMsgUnpack1/MsgRxData_Unpack4/CanRxData_Unpack"
 /begin REF_MEASUREMENT Temperature_25 Temperature_26 Temperature_27 Temperature_28 Temperature_29 Temperature_30 Temperature_31 Temperature_32 /end REF_MEASUREMENT
/end GROUP
/begin GROUP S88_CanRxData_Unpack "VBU0706/Function-Call Subsystem/Subsystem/PrivateCAN/CanMsgUnpack1/MsgRxData_Unpack40/CanRxData_Unpack" /begin REF_MEASUREMENT CellVolt5 CellVolt6 CellVolt7 CellVolt8 /end REF_MEASUREMENT /end GROUP
/begin GROUP S89_CanRxData_Unpack "VBU0706/Function-Call Subsystem/Subsystem/PrivateCAN/CanMsgUnpack1/MsgRxData_Unpack41/CanRxData_Unpack" /begin REF_MEASUREMENT CellVolt77 CellVolt78 CellVolt79 CellVolt80 /end REF_MEASUREMENT /end GROUP
/begin GROUP S90_CanRxData_Unpack "VBU0706/Function-Call Subsystem/Subsystem/PrivateCAN/CanMsgUnpack1/MsgRxData_Unpack42/CanRxData_Unpack" /begin REF_MEASUREMENT CellVolt81 CellVolt82 CellVolt83 CellVolt84 /end REF_MEASUREMENT /end GROUP
/begin GROUP S91_CanRxData_Unpack "VBU0706/Function-Call Subsystem/Subsystem/PrivateCAN/CanMsgUnpack1/MsgRxData_Unpack43/CanRxData_Unpack" /begin REF_MEASUREMENT CellVolt85 CellVolt86 CellVolt87 CellVolt88 /end REF_MEASUREMENT /end GROUP
/begin GROUP S92_CanRxData_Unpack "VBU0706/Function-Call Subsystem/Subsystem/PrivateCAN/CanMsgUnpack1/MsgRxData_Unpack44/CanRxData_Unpack" /begin REF_MEASUREMENT CellVolt89 CellVolt90 CellVolt91 CellVolt92 /end REF_MEASUREMENT /end GROUP
/begin GROUP S93_CanRxData_Unpack "VBU0706/Function-Call Subsystem/Subsystem/PrivateCAN/CanMsgUnpack1/MsgRxData_Unpack45/CanRxData_Unpack" /begin REF_MEASUREMENT CellVolt93 CellVolt94 CellVolt95 CellVolt96 /end REF_MEASUREMENT /end GROUP
/begin GROUP S94_CanRxData_Unpack "VBU0706/Function-Call Subsystem/Subsystem/PrivateCAN/CanMsgUnpack1/MsgRxData_Unpack46/CanRxData_Unpack" /begin REF_MEASUREMENT CellVolt100 CellVolt97 CellVolt98 CellVolt99 /end REF_MEASUREMENT /end GROUP
/begin GROUP S95_CanRxData_Unpack "VBU0706/Function-Call Subsystem/Subsystem/PrivateCAN/CanMsgUnpack1/MsgRxData_Unpack47/CanRxData_Unpack" /begin REF_MEASUREMENT CellVolt101 CellVolt102 CellVolt103 CellVolt104 /end REF_MEASUREMENT /end GROUP
/begin GROUP S96_CanRxData_Unpack "VBU0706/Function-Call Subsystem/Subsystem/PrivateCAN/CanMsgUnpack1/MsgRxData_Unpack48/CanRxData_Unpack" /begin REF_MEASUREMENT CellVolt105 CellVolt106 CellVolt107 CellVolt108 /end REF_MEASUREMENT /end GROUP
/begin GROUP S97_CanRxData_Unpack "VBU0706/Function-Call Subsystem/Subsystem/PrivateCAN/CanMsgUnpack1/MsgRxData_Unpack49/CanRxData_Unpack" /begin REF_MEASUREMENT CellVolt109 CellVolt110 CellVolt111 CellVolt112 /end REF_MEASUREMENT /end GROUP
/begin GROUP S98_CanRxData_Unpack "VBU0706/Function-Call Subsystem/Subsystem/PrivateCAN/CanMsgUnpack1/MsgRxData_Unpack5/CanRxData_Unpack"
 /begin REF_MEASUREMENT Temperature_33 Temperature_34 Temperature_35 Temperature_36 Temperature_37 Temperature_38 Temperature_39 Temperature_40 /end REF_MEASUREMENT
/end GROUP
/begin GROUP S99_CanRxData_Unpack "VBU0706/Function-Call Subsystem/Subsystem/PrivateCAN/CanMsgUnpack1/MsgRxData_Unpack50/CanRxData_Unpack" /begin REF_MEASUREMENT CellVolt113 CellVolt114 CellVolt115 CellVolt116 /end REF_MEASUREMENT /end GROUP
/begin GROUP S100_CanRxData_Unpack "VBU0706/Function-Call Subsystem/Subsystem/PrivateCAN/CanMsgUnpack1/MsgRxData_Unpack51/CanRxData_Unpack" /begin REF_MEASUREMENT CellVolt10 CellVolt11 CellVolt12 CellVolt9 /end REF_MEASUREMENT /end GROUP
/begin GROUP S101_CanRxData_Unpack "VBU0706/Function-Call Subsystem/Subsystem/PrivateCAN/CanMsgUnpack1/MsgRxData_Unpack52/CanRxData_Unpack" /begin REF_MEASUREMENT CellVolt117 CellVolt118 CellVolt119 CellVolt120 /end REF_MEASUREMENT /end GROUP
/begin GROUP S102_CanRxData_Unpack "VBU0706/Function-Call Subsystem/Subsystem/PrivateCAN/CanMsgUnpack1/MsgRxData_Unpack53/CanRxData_Unpack" /begin REF_MEASUREMENT CellVolt121 CellVolt122 CellVolt123 CellVolt124 /end REF_MEASUREMENT /end GROUP
/begin GROUP S103_CanRxData_Unpack "VBU0706/Function-Call Subsystem/Subsystem/PrivateCAN/CanMsgUnpack1/MsgRxData_Unpack54/CanRxData_Unpack" /begin REF_MEASUREMENT CellVolt125 CellVolt126 CellVolt127 CellVolt128 /end REF_MEASUREMENT /end GROUP
/begin GROUP S104_CanRxData_Unpack "VBU0706/Function-Call Subsystem/Subsystem/PrivateCAN/CanMsgUnpack1/MsgRxData_Unpack55/CanRxData_Unpack" /begin REF_MEASUREMENT CellVolt129 CellVolt130 CellVolt131 CellVolt132 /end REF_MEASUREMENT /end GROUP
/begin GROUP S105_CanRxData_Unpack "VBU0706/Function-Call Subsystem/Subsystem/PrivateCAN/CanMsgUnpack1/MsgRxData_Unpack56/CanRxData_Unpack" /begin REF_MEASUREMENT CellVolt133 CellVolt134 CellVolt135 CellVolt136 /end REF_MEASUREMENT /end GROUP
/begin GROUP S106_CanRxData_Unpack "VBU0706/Function-Call Subsystem/Subsystem/PrivateCAN/CanMsgUnpack1/MsgRxData_Unpack57/CanRxData_Unpack" /begin REF_MEASUREMENT CellVolt137 CellVolt138 CellVolt139 CellVolt140 /end REF_MEASUREMENT /end GROUP
/begin GROUP S107_CanRxData_Unpack "VBU0706/Function-Call Subsystem/Subsystem/PrivateCAN/CanMsgUnpack1/MsgRxData_Unpack58/CanRxData_Unpack" /begin REF_MEASUREMENT CellVolt141 CellVolt142 CellVolt143 CellVolt144 /end REF_MEASUREMENT /end GROUP
/begin GROUP S108_CanRxData_Unpack "VBU0706/Function-Call Subsystem/Subsystem/PrivateCAN/CanMsgUnpack1/MsgRxData_Unpack59/CanRxData_Unpack" /begin REF_MEASUREMENT CellVolt145 CellVolt146 CellVolt147 CellVolt148 /end REF_MEASUREMENT /end GROUP
/begin GROUP S109_CanRxData_Unpack "VBU0706/Function-Call Subsystem/Subsystem/PrivateCAN/CanMsgUnpack1/MsgRxData_Unpack6/CanRxData_Unpack"
 /begin REF_MEASUREMENT HCU_Message_1_RelayStatus_Heart HCU_State Relay5_Error_State Relay6_Error_State Relay_5 Relay_6 Relay_Heat Relay_Heat_Error_State Relay_MainNegative Relay_MainNegative_Error_State Relay_MainPositive Relay_MainPositive_Error_State Relay_Precharge Relay_Precharge_Error_State /end REF_MEASUREMENT
/end GROUP
/begin GROUP S110_CanRxData_Unpack "VBU0706/Function-Call Subsystem/Subsystem/PrivateCAN/CanMsgUnpack1/MsgRxData_Unpack60/CanRxData_Unpack" /begin REF_MEASUREMENT CellVolt149 CellVolt150 CellVolt151 CellVolt152 /end REF_MEASUREMENT /end GROUP
/begin GROUP S111_CanRxData_Unpack "VBU0706/Function-Call Subsystem/Subsystem/PrivateCAN/CanMsgUnpack1/MsgRxData_Unpack61/CanRxData_Unpack" /begin REF_MEASUREMENT CellVolt153 CellVolt154 CellVolt155 CellVolt156 /end REF_MEASUREMENT /end GROUP
/begin GROUP S112_CanRxData_Unpack "VBU0706/Function-Call Subsystem/Subsystem/PrivateCAN/CanMsgUnpack1/MsgRxData_Unpack62/CanRxData_Unpack" /begin REF_MEASUREMENT CellVolt13 CellVolt14 CellVolt15 CellVolt16 /end REF_MEASUREMENT /end GROUP
/begin GROUP S113_CanRxData_Unpack "VBU0706/Function-Call Subsystem/Subsystem/PrivateCAN/CanMsgUnpack1/MsgRxData_Unpack63/CanRxData_Unpack" /begin REF_MEASUREMENT CellVolt157 CellVolt158 CellVolt159 CellVolt160 /end REF_MEASUREMENT /end GROUP
/begin GROUP S114_CanRxData_Unpack "VBU0706/Function-Call Subsystem/Subsystem/PrivateCAN/CanMsgUnpack1/MsgRxData_Unpack64/CanRxData_Unpack" /begin REF_MEASUREMENT CellVolt161 CellVolt162 CellVolt163 CellVolt164 /end REF_MEASUREMENT /end GROUP
/begin GROUP S115_CanRxData_Unpack "VBU0706/Function-Call Subsystem/Subsystem/PrivateCAN/CanMsgUnpack1/MsgRxData_Unpack65/CanRxData_Unpack" /begin REF_MEASUREMENT CellVolt165 CellVolt166 CellVolt167 CellVolt168 /end REF_MEASUREMENT /end GROUP
/begin GROUP S116_CanRxData_Unpack "VBU0706/Function-Call Subsystem/Subsystem/PrivateCAN/CanMsgUnpack1/MsgRxData_Unpack66/CanRxData_Unpack" /begin REF_MEASUREMENT CellVolt169 CellVolt170 CellVolt171 CellVolt172 /end REF_MEASUREMENT /end GROUP
/begin GROUP S117_CanRxData_Unpack "VBU0706/Function-Call Subsystem/Subsystem/PrivateCAN/CanMsgUnpack1/MsgRxData_Unpack67/CanRxData_Unpack" /begin REF_MEASUREMENT CellVolt173 CellVolt174 CellVolt175 CellVolt176 /end REF_MEASUREMENT /end GROUP
/begin GROUP S118_CanRxData_Unpack "VBU0706/Function-Call Subsystem/Subsystem/PrivateCAN/CanMsgUnpack1/MsgRxData_Unpack68/CanRxData_Unpack" /begin REF_MEASUREMENT CellVolt177 CellVolt178 CellVolt179 CellVolt180 /end REF_MEASUREMENT /end GROUP
/begin GROUP S119_CanRxData_Unpack "VBU0706/Function-Call Subsystem/Subsystem/PrivateCAN/CanMsgUnpack1/MsgRxData_Unpack69/CanRxData_Unpack" /begin REF_MEASUREMENT CellVolt181 CellVolt182 CellVolt183 CellVolt184 /end REF_MEASUREMENT /end GROUP
/begin GROUP S120_CanRxData_Unpack "VBU0706/Function-Call Subsystem/Subsystem/PrivateCAN/CanMsgUnpack1/MsgRxData_Unpack7/CanRxData_Unpack"
 /begin REF_MEASUREMENT HCU_Message_2_AD1_Heart HV1_AD HV2_Heating_Relay__AD HV3_Main_Fuse__AD /end REF_MEASUREMENT
/end GROUP
/begin GROUP S121_CanRxData_Unpack "VBU0706/Function-Call Subsystem/Subsystem/PrivateCAN/CanMsgUnpack1/MsgRxData_Unpack70/CanRxData_Unpack" /begin REF_MEASUREMENT CellVolt185 CellVolt186 CellVolt187 CellVolt188 /end REF_MEASUREMENT /end GROUP
/begin GROUP S122_CanRxData_Unpack "VBU0706/Function-Call Subsystem/Subsystem/PrivateCAN/CanMsgUnpack1/MsgRxData_Unpack71/CanRxData_Unpack" /begin REF_MEASUREMENT CellVolt189 CellVolt190 CellVolt191 CellVolt192 /end REF_MEASUREMENT /end GROUP
/begin GROUP S123_CanRxData_Unpack "VBU0706/Function-Call Subsystem/Subsystem/PrivateCAN/CanMsgUnpack1/MsgRxData_Unpack72/CanRxData_Unpack" /begin REF_MEASUREMENT CellVolt193 CellVolt194 CellVolt195 CellVolt196 /end REF_MEASUREMENT /end GROUP
/begin GROUP S124_CanRxData_Unpack "VBU0706/Function-Call Subsystem/Subsystem/PrivateCAN/CanMsgUnpack1/MsgRxData_Unpack73/CanRxData_Unpack" /begin REF_MEASUREMENT CellVolt17 CellVolt18 CellVolt19 CellVolt20 /end REF_MEASUREMENT /end GROUP
/begin GROUP S125_CanRxData_Unpack "VBU0706/Function-Call Subsystem/Subsystem/PrivateCAN/CanMsgUnpack1/MsgRxData_Unpack74/CanRxData_Unpack" /begin REF_MEASUREMENT CellVolt197 CellVolt198 CellVolt199 CellVolt200 /end REF_MEASUREMENT /end GROUP
/begin GROUP S126_CanRxData_Unpack "VBU0706/Function-Call Subsystem/Subsystem/PrivateCAN/CanMsgUnpack1/MsgRxData_Unpack75/CanRxData_Unpack" /begin REF_MEASUREMENT CellVolt21 CellVolt22 CellVolt23 CellVolt24 /end REF_MEASUREMENT /end GROUP
/begin GROUP S127_CanRxData_Unpack "VBU0706/Function-Call Subsystem/Subsystem/PrivateCAN/CanMsgUnpack1/MsgRxData_Unpack76/CanRxData_Unpack" /begin REF_MEASUREMENT CellVolt25 CellVolt26 CellVolt27 CellVolt28 /end REF_MEASUREMENT /end GROUP
/begin GROUP S128_CanRxData_Unpack "VBU0706/Function-Call Subsystem/Subsystem/PrivateCAN/CanMsgUnpack1/MsgRxData_Unpack77/CanRxData_Unpack" /begin REF_MEASUREMENT CellVolt29 CellVolt30 CellVolt31 CellVolt32 /end REF_MEASUREMENT /end GROUP
/begin GROUP S129_CanRxData_Unpack "VBU0706/Function-Call Subsystem/Subsystem/PrivateCAN/CanMsgUnpack1/MsgRxData_Unpack78/CanRxData_Unpack" /begin REF_MEASUREMENT CellVolt33 CellVolt34 CellVolt35 CellVolt36 /end REF_MEASUREMENT /end GROUP
/begin GROUP S130_CanRxData_Unpack "VBU0706/Function-Call Subsystem/Subsystem/PrivateCAN/CanMsgUnpack1/MsgRxData_Unpack8/CanRxData_Unpack"
 /begin REF_MEASUREMENT HCU_Message_3_AD2_Heart HV4_Heat_Fuse__AD LINK_Relay_MN_AD Total_Volt_B /end REF_MEASUREMENT
/end GROUP
/begin GROUP S131_CanRxData_Unpack "VBU0706/Function-Call Subsystem/Subsystem/PrivateCAN/CanMsgUnpack1/MsgRxData_Unpack9/CanRxData_Unpack"
 /begin REF_MEASUREMENT HCU_Message_3_AD3_Heart HV5_MP_Pcharge_Relay__AD Hall1_AD Hall2_AD /end REF_MEASUREMENT
/end GROUP
/begin GROUP S315_Calculate_BatteryCurrent "VBU0706/Function-Call Subsystem/Subsystem1/BCV/BCV/Subsystem/Calculate_BatteryCurrent"
 /begin SUB_GROUP S316_Check_BatteryCurrent_Valid S316_Correct_BatteryCurrent S316_UpdateBatteryCurrent /end SUB_GROUP
/end GROUP
/begin GROUP S315_Calculate_BatteryVoltage "VBU0706/Function-Call Subsystem/Subsystem1/BCV/BCV/Subsystem/Calculate_BatteryVoltage"
 /begin SUB_GROUP S317_Check_BatteryVoltage_Valid S317_Check_BusNegativeVoltage_Valid S317_Check_BusVoltage_Valid S317_Check_FuseVoltage_Valid S317_Check_PrechargeVoltage_Valid S317_Check_Vx1Voltage_Valid S317_Check_Vx2Voltage_Valid S317_Update_BatteryVoltage S317_Update_BusNegativeVoltage S317_Update_BusVoltage S317_Update_FuseVoltage S317_Update_PrechargeVoltage S317_Update_Vx2Voltage /end SUB_GROUP
/end GROUP
/begin GROUP S315_Calculate_Lifetime_Data "VBU0706/Function-Call Subsystem/Subsystem1/BCV/BCV/Subsystem/Calculate_Lifetime_Data"
 /begin SUB_GROUP S318_Calculate_FuseProtect_Counter S318_Calculate_LifeTimeCharge S318_Calculate_LifeTimeCoulomb S318_Calculate_LifeTimeDischarge S318_Calculate_LifeTimeFastcharge /end SUB_GROUP
/end GROUP
/begin GROUP S315_Diagnose_BCV_Communication_Fault "VBU0706/Function-Call Subsystem/Subsystem1/BCV/BCV/Subsystem/Diagnose_BCV_Communication_Fault" /begin SUB_GROUP S319_DIagnose_OutOfRange_Fault /end SUB_GROUP /end GROUP
/begin GROUP S315_Diagnose_BCV_Data_Fault "VBU0706/Function-Call Subsystem/Subsystem1/BCV/BCV/Subsystem/Diagnose_BCV_Data_Fault"
 /begin SUB_GROUP S320_Diagnose_BatteryBusVoltageMismatch_Fault S320_Diagnose_VoltageCurrent_Fault /end SUB_GROUP
/end GROUP
/begin GROUP S315_Interface_Switch "VBU0706/Function-Call Subsystem/Subsystem1/BCV/BCV/Subsystem/Interface_Switch"
 /begin REF_CHARACTERISTIC CbBCV_HALBatteryVoltageORF_flg CcBCV_HALBatteryVoltageORV_V /end REF_CHARACTERISTIC
/end GROUP
/begin GROUP S315_Interface_Switch1 "VBU0706/Function-Call Subsystem/Subsystem1/BCV/BCV/Subsystem/Interface_Switch1"
 /begin REF_CHARACTERISTIC CbBCV_HALBatteryVoltageStatusORF_flg CbBCV_HALBatteryVoltageStatusORV_flg /end REF_CHARACTERISTIC
/end GROUP
/begin GROUP S315_Interface_Switch2 "VBU0706/Function-Call Subsystem/Subsystem1/BCV/BCV/Subsystem/Interface_Switch2" /begin REF_CHARACTERISTIC CbBCV_HALVx2VoltageORF_flg CcBCV_HALVx2VoltageORV_V /end REF_CHARACTERISTIC /end GROUP
/begin GROUP S315_Interface_Switch3 "VBU0706/Function-Call Subsystem/Subsystem1/BCV/BCV/Subsystem/Interface_Switch3"
 /begin REF_CHARACTERISTIC CbBCV_HALVx2VoltageStatusORF_flg CbBCV_HALVx2VoltageStatusORV_flg /end REF_CHARACTERISTIC
/end GROUP
/begin GROUP S315_Interface_Switch4 "VBU0706/Function-Call Subsystem/Subsystem1/BCV/BCV/Subsystem/Interface_Switch4"
 /begin REF_CHARACTERISTIC CbBCV_HALBusNegativeVoltageORF_flg CcBCV_HALBusNegativeVoltageORV_V /end REF_CHARACTERISTIC
/end GROUP
/begin GROUP S315_Interface_Switch5 "VBU0706/Function-Call Subsystem/Subsystem1/BCV/BCV/Subsystem/Interface_Switch5"
 /begin REF_CHARACTERISTIC CbBCV_HALBusNegativeVoltageStatusORF_flg CbBCV_HALBusNegativeVoltageStatusORV_flg /end REF_CHARACTERISTIC
/end GROUP
/begin GROUP S315_Interface_Switch6 "VBU0706/Function-Call Subsystem/Subsystem1/BCV/BCV/Subsystem/Interface_Switch6" /begin REF_CHARACTERISTIC CbBCV_HALFuseVoltageORF_flg CcBCV_HALFuseVoltageORV_V /end REF_CHARACTERISTIC /end GROUP
/begin GROUP S315_Interface_Switch7 "VBU0706/Function-Call Subsystem/Subsystem1/BCV/BCV/Subsystem/Interface_Switch7"
 /begin REF_CHARACTERISTIC CbBCV_HALFuseVoltageStatusORF_flg CbBCV_HALFuseVoltageStatusORV_flg /end REF_CHARACTERISTIC
/end GROUP
/begin GROUP S315_Interface_Switch8 "VBU0706/Function-Call Subsystem/Subsystem1/BCV/BCV/Subsystem/Interface_Switch8"
 /begin REF_CHARACTERISTIC CbBCV_HALPrechargeVoltageORF_flg CcBCV_HALPrechargeVoltageORV_V /end REF_CHARACTERISTIC
/end GROUP
/begin GROUP S315_Interface_Switch9 "VBU0706/Function-Call Subsystem/Subsystem1/BCV/BCV/Subsystem/Interface_Switch9"
 /begin REF_CHARACTERISTIC CbBCV_HALPrechargeVoltageStatusORF_flg CbBCV_HALPrechargeVoltageStatusORV_flg /end REF_CHARACTERISTIC
/end GROUP
/begin GROUP S315_Monitor_BCV_Performance "VBU0706/Function-Call Subsystem/Subsystem1/BCV/BCV/Subsystem/Monitor_BCV_Performance"
 /begin SUB_GROUP S331_Diagnose_BDM_BCV_Communication_Fault S331_Diagnose_BDM_BCV_Data_Fault S331_Diagnose_BDM_FastChargeContactorOverCurrentAlarm /end SUB_GROUP
 /begin REF_CHARACTERISTIC CcBCV_BDMOutputDelayTime_ms /end REF_CHARACTERISTIC
 /begin REF_MEASUREMENT BCV_BdmVoltagePerformanceIndex_enum BCV_flgDCContactorOverCurrent BCV_stBdmCurrentComIndex BCV_stBdmCurrentPerformanceIndex /end REF_MEASUREMENT
/end GROUP
/begin GROUP S315_Unpackage_LEM_Msg "VBU0706/Function-Call Subsystem/Subsystem1/BCV/BCV/Subsystem/Unpackage_LEM_Msg" /begin REF_CHARACTERISTIC MILIAMPERES_PER_AMPERE_SY /end REF_CHARACTERISTIC /begin REF_MEASUREMENT BCV_flgBatteryCurrentSystemValid BCV_iABatteryCurrentRaw /end REF_MEASUREMENT /end GROUP
/begin GROUP S516_DetermineSOCJump "VBU0706/Function-Call Subsystem/Subsystem1/BMM/BMM/DetermineAbnormalEventFlag/DetermineSOCJump"
 /begin REF_CHARACTERISTIC CcBMM_SOCJumpDelayTime_ms CcBMM_SOCJumpPowerOnDelayTime_ms CcBMM_SOCJumpThreshold_pct /end REF_CHARACTERISTIC
/end GROUP
/begin GROUP S517_CycleWakeupStateMachine "VBU0706/Function-Call Subsystem/Subsystem1/BMM/BMM/DetermineCycleUpload/CycleWakeupStateMachine"
 /begin REF_CHARACTERISTIC BMM_MaxWakeUpCounter_n CYCLE_WAKEUP_STATE_ABNORMAL CYCLE_WAKEUP_STATE_INIT /end REF_CHARACTERISTIC
/end GROUP
/begin GROUP S517_GetValueInNVM "VBU0706/Function-Call Subsystem/Subsystem1/BMM/BMM/DetermineCycleUpload/GetValueInNVM" /begin REF_MEASUREMENT BMM_numMonitorLastCycle /end REF_MEASUREMENT /end GROUP
/begin GROUP S518_Determine_HoldAfterrun_Condition "VBU0706/Function-Call Subsystem/Subsystem1/BMM/BMM/Determine_Hold_Afterrun/Determine_HoldAfterrun_Condition"
 /begin REF_CHARACTERISTIC CbBMM_DriverIntentionChangeEnable_flg CcBMM_MaxAfterrunTime_s /end REF_CHARACTERISTIC
 /begin REF_MEASUREMENT BMM_flgHoldAfterrun /end REF_MEASUREMENT
/end GROUP
/begin GROUP S519_Determine_Wakeup_Bywire "VBU0706/Function-Call Subsystem/Subsystem1/BMM/BMM/Determine_Wakeup_Mode/Determine_Wakeup_Bywire" /begin REF_CHARACTERISTIC CcBMM_WakeupLineFEDebounceTime_ms /end REF_CHARACTERISTIC /end GROUP
/begin GROUP S519_Wakeup_Fast_Charge "VBU0706/Function-Call Subsystem/Subsystem1/BMM/BMM/Determine_Wakeup_Mode/Wakeup_Fast_Charge"
 /begin REF_CHARACTERISTIC BMM_VEHICLE_WAKEUP_MODE_FAST_CHARGE CbBMM_FastChargeWakeupEnable_flg /end REF_CHARACTERISTIC
 /begin REF_MEASUREMENT BMM_flgFastChargeWakeup /end REF_MEASUREMENT
/end GROUP
/begin GROUP S519_Wakeup_Ignition_On "VBU0706/Function-Call Subsystem/Subsystem1/BMM/BMM/Determine_Wakeup_Mode/Wakeup_Ignition_On"
 /begin REF_CHARACTERISTIC BMM_VEHICLE_WAKEUP_MODE_IGNITION_ON BMM_VEHICLE_WAKEUP_MODE_SOFTWARE_FLASHING /end REF_CHARACTERISTIC
 /begin REF_MEASUREMENT BMM_flgIgnitionOnWakeup /end REF_MEASUREMENT
/end GROUP
/begin GROUP S520_EEPROM_BlockStoreEnable "VBU0706/Function-Call Subsystem/Subsystem1/BMM/BMM/Subsystem/EEPROM_BlockStoreEnable" /begin REF_MEASUREMENT BMM_flgEEBlockStoreEnable /end REF_MEASUREMENT /end GROUP
/begin GROUP S563_Balance_EnableCondition "VBU0706/Function-Call Subsystem/Subsystem1/CBL/Subsystem8/Subsystem/Balance_EnableCondition"
 /begin SUB_GROUP S564_DetermineBalance_EnableCondition S564_DetermineSOCBalance_EnableCondition S564_DetermineVoltaageBalance_EnableCondition /end SUB_GROUP
/end GROUP
/begin GROUP S563_Determine_BoardTemAvailableCheck "VBU0706/Function-Call Subsystem/Subsystem1/CBL/Subsystem8/Subsystem/Determine_BoardTemAvailableCheck"
 /begin REF_CHARACTERISTIC CcCBL_BoardTempBalanceStartMaxHysteresis_C CcCBL_BoardTempBalanceStartMax_C /end REF_CHARACTERISTIC
 /begin REF_MEASUREMENT LaCBL_flgCellBoardTempAvailable /end REF_MEASUREMENT
/end GROUP
/begin GROUP S563_Determine_CSCCellBalanceRequest "VBU0706/Function-Call Subsystem/Subsystem1/CBL/Subsystem8/Subsystem/Determine_CSCCellBalanceRequest"
 /begin SUB_GROUP S566_Determin_MinSocCellCapacity S566_Determine_CellBalanceNumber S566_Determine_CellBalanceRequest S566_Determine_TotalCellBalanceState /end SUB_GROUP
/end GROUP
/begin GROUP S563_Override "VBU0706/Function-Call Subsystem/Subsystem1/CBL/Subsystem8/Subsystem/Override" /begin SUB_GROUP S567_LOW_HIGH1 S567_LOW_HIGH2 /end SUB_GROUP
 /begin REF_CHARACTERISTIC CbCBL_CTMBoardTempValidORF_flg CbCBL_CTMBoardTempValidORV_flg CcCBL_CTMBoardTempMaxORF_flg CcCBL_CTMBoardTempMaxORV_C /end REF_CHARACTERISTIC
/end GROUP
/begin GROUP S632_ControlPrechargeRelay "VBU0706/Function-Call Subsystem/Subsystem1/CTC/Subsystem1/Subsystem/ControlPrechargeRelay" /begin REF_CHARACTERISTIC CTS_MAIN_CONTACTOR_COMMAND_CLOSE /end REF_CHARACTERISTIC /begin REF_MEASUREMENT CTC_flgHALPrechargeRelay /end REF_MEASUREMENT /end GROUP
/begin GROUP S632_ControlResetRelays "VBU0706/Function-Call Subsystem/Subsystem1/CTC/Subsystem1/Subsystem/ControlResetRelays"
 /begin REF_CHARACTERISTIC CTS_MAIN_CONTACTOR_COMMAND_CLOSE CTS_MAIN_CONTACTOR_COMMAND_OPEN CTS_STATE_DEACTIVATION CTS_STATE_OPEN_MPR_AND_DIAGNOSE_MPC_STUCKOPEN /end REF_CHARACTERISTIC
 /begin REF_MEASUREMENT CTC_stResetContactorRequest /end REF_MEASUREMENT
/end GROUP
/begin GROUP S632_ControlmainNegativeRelay "VBU0706/Function-Call Subsystem/Subsystem1/CTC/Subsystem1/Subsystem/ControlmainNegativeRelay"
 /begin REF_CHARACTERISTIC CTS_MAIN_CONTACTOR_COMMAND_CLOSE CTS_MAIN_CONTACTOR_COMMAND_OPEN /end REF_CHARACTERISTIC
 /begin REF_MEASUREMENT CTC_flgHALMnNegContactor /end REF_MEASUREMENT
/end GROUP
/begin GROUP S632_ControlmainPositiveRelay "VBU0706/Function-Call Subsystem/Subsystem1/CTC/Subsystem1/Subsystem/ControlmainPositiveRelay"
 /begin REF_CHARACTERISTIC CTS_MAIN_CONTACTOR_COMMAND_CLOSE CTS_MAIN_CONTACTOR_COMMAND_OPEN /end REF_CHARACTERISTIC
 /begin REF_MEASUREMENT CTC_flgHALMnPosContactor /end REF_MEASUREMENT
/end GROUP
/begin GROUP S632_DetermineRelayCommandStatus "VBU0706/Function-Call Subsystem/Subsystem1/CTC/Subsystem1/Subsystem/DetermineRelayCommandStatus" /begin SUB_GROUP S637_Cmd_Close S637_Cmd_Open /end SUB_GROUP /begin REF_MEASUREMENT CTC_stContactorsCommandStatus /end REF_MEASUREMENT /end GROUP
/begin GROUP S632_Determine_Openings_Number "VBU0706/Function-Call Subsystem/Subsystem1/CTC/Subsystem1/Subsystem/Determine_Openings_Number"
 /begin REF_CHARACTERISTIC CTS_MAIN_CONTACTOR_COMMAND_CLOSE CTS_MAIN_CONTACTOR_COMMAND_OPEN /end REF_CHARACTERISTIC
/end GROUP
/begin GROUP S649_Determine_MainContactor_Status "VBU0706/Function-Call Subsystem/Subsystem1/CTD/Subsystem/Subsystem4/Determine_MainContactor_Status" /begin REF_CHARACTERISTIC CTD_MAIN_CONTACTOR_STATUS_UNKNOWN /end REF_CHARACTERISTIC /begin REF_MEASUREMENT CTD_stMnContactorsStatus /end REF_MEASUREMENT /end GROUP
/begin GROUP S649_DiagnoseRelayWeld "VBU0706/Function-Call Subsystem/Subsystem1/CTD/Subsystem/Subsystem4/DiagnoseRelayWeld"
 /begin SUB_GROUP S651_DetermineRatioPEUtoBat S651_MNC_Weld_Check S651_MPC_Weld_Check /end SUB_GROUP
/end GROUP
/begin GROUP S649_LV_Battery_Voltage "VBU0706/Function-Call Subsystem/Subsystem1/CTD/Subsystem/Subsystem4/LV_Battery_Voltage"
 /begin REF_CHARACTERISTIC CcCTD_HALSystemVoltageLowDelta_V CcCTD_HALSystemVoltageLow_V /end REF_CHARACTERISTIC
/end GROUP
/begin GROUP S649_Lockout_Precharge_Process "VBU0706/Function-Call Subsystem/Subsystem1/CTD/Subsystem/Subsystem4/Lockout_Precharge_Process"
 /begin SUB_GROUP S653_Determine_Fail_Lockout S653_Determine_Lockout_Time S653_Determine_Overload_Lockout S653_HeatProtection_Lockout /end SUB_GROUP
/end GROUP
/begin GROUP S649_MainFuseDiagnostic "VBU0706/Function-Call Subsystem/Subsystem1/CTD/Subsystem/Subsystem4/MainFuseDiagnostic" /begin SUB_GROUP S654_Determine_Diagnostic_Status /end SUB_GROUP
 /begin REF_CHARACTERISTIC CTD_MAIN_FUSE_BLOWN_FAULT CbCTD_MainFuseBlownFaultEnable_flg CcCTD_MainFuseBlownDeltaVoltage_V CcCTD_MainFuseBlownFaultFIC_n CcCTD_MainFuseBlownFaultPIC_n /end REF_CHARACTERISTIC
 /begin REF_MEASUREMENT CTD_flgMainFuseBlowFaultTestEnable CTD_flgMainFuseBlowFaultTestFail CTD_stMainFuseBlownFault /end REF_MEASUREMENT
/end GROUP
/begin GROUP S649_Precharge_Resistance_Diagnostic "VBU0706/Function-Call Subsystem/Subsystem1/CTD/Subsystem/Subsystem4/Precharge_Resistance_Diagnostic"
 /begin SUB_GROUP S655_CONTACTOR_STATUS_CLOSED1 S655_CONTACTOR_STATUS_OPENED1 S655_Determine_Diagnostic_Status /end SUB_GROUP
 /begin REF_CHARACTERISTIC CbCTD_PrechargeResistanceBlownFaultEnable_flg CcCTD_PrechargeResistanceBlownDeltaVoltage_V CcCTD_PrechargeResistanceBlownFaultFIC_n CcCTD_PrechargeResistanceBlownFaultPIC_n /end REF_CHARACTERISTIC
 /begin REF_MEASUREMENT CTD_flgPrechargeResistanceBlownFaultTestEnable CTD_flgPrechargeResistanceBlownFaultTestFail CTD_stPrechargeRelayBlown /end REF_MEASUREMENT
/end GROUP
/begin GROUP S649_PrechrgProcessMonitoring "VBU0706/Function-Call Subsystem/Subsystem1/CTD/Subsystem/Subsystem4/PrechrgProcessMonitoring"
 /begin SUB_GROUP S656_Determine_PrechargeDiag_Disable S656_Determine_Precharge_Timer S656_Determine_Ratio_BusVBatV S656_Precharge_Thermal_Management S656_Precharge_Timeout_Diagnostic S656_Precharging_Process_Monitoring /end SUB_GROUP
/end GROUP
/begin GROUP S649_Stuck_Open_Diagnostic "VBU0706/Function-Call Subsystem/Subsystem1/CTD/Subsystem/Subsystem4/Stuck_Open_Diagnostic"
 /begin SUB_GROUP S657_MNC_Stuck_Open S657_MPC_Stuck_Open S657_MPR_Stuck_Open S657_StuckOpenAssistantConditons /end SUB_GROUP
/end GROUP
/begin GROUP S649_Subsystem "VBU0706/Function-Call Subsystem/Subsystem1/CTD/Subsystem/Subsystem4/Subsystem" /begin REF_CHARACTERISTIC CTD_MAIN_CONTACTOR_STATUS_UNKNOWN /end REF_CHARACTERISTIC /begin REF_MEASUREMENT CTD_stMnPosContactorStatus /end REF_MEASUREMENT /end GROUP
/begin GROUP S649_Subsystem1 "VBU0706/Function-Call Subsystem/Subsystem1/CTD/Subsystem/Subsystem4/Subsystem1"
 /begin REF_CHARACTERISTIC CTD_MAIN_CONTACTOR_STATUS_Open CTD_MAIN_CONTACTOR_STATUS_UNKNOWN /end REF_CHARACTERISTIC
 /begin REF_MEASUREMENT CTD_stPrechargeContactorStatus /end REF_MEASUREMENT
/end GROUP
/begin GROUP S649_Subsystem2 "VBU0706/Function-Call Subsystem/Subsystem1/CTD/Subsystem/Subsystem4/Subsystem2"
 /begin REF_CHARACTERISTIC CTD_MAIN_CONTACTOR_STATUS_Open CTD_MAIN_CONTACTOR_STATUS_UNKNOWN /end REF_CHARACTERISTIC
 /begin REF_MEASUREMENT CTD_stMnNegContactorStatus /end REF_MEASUREMENT
/end GROUP
/begin GROUP S649_Subsystem3 "VBU0706/Function-Call Subsystem/Subsystem1/CTD/Subsystem/Subsystem4/Subsystem3"
 /begin REF_CHARACTERISTIC CTD_MAIN_CONTACTOR_STATUS_Open CTD_MAIN_CONTACTOR_STATUS_UNKNOWN /end REF_CHARACTERISTIC
 /begin REF_MEASUREMENT CTD_stHeatingContactorStatus /end REF_MEASUREMENT
/end GROUP
/begin GROUP S817_BoardTemp_ValidCheck "VBU0706/Function-Call Subsystem/Subsystem1/CTM/CTM/Subsystem/BoardTemp_ValidCheck"
 /begin REF_CHARACTERISTIC CcCTM_BoardTempInvalidFaultDelayTime_ms CcCTM_BoardTempInvalidFault_n SAMPLE_TIME_TASK_D /end REF_CHARACTERISTIC
/end GROUP
/begin GROUP S817_CellTemp_ValidCheck "VBU0706/Function-Call Subsystem/Subsystem1/CTM/CTM/Subsystem/CellTemp_ValidCheck"
 /begin REF_CHARACTERISTIC CcCTM_CellTempInvalidFaultDelayTime_ms CcCTM_CellTempInvalidFault_n SAMPLE_TIME_TASK_D /end REF_CHARACTERISTIC
/end GROUP
/begin GROUP S817_Determine_CellTemp "VBU0706/Function-Call Subsystem/Subsystem1/CTM/CTM/Subsystem/Determine_CellTemp"
 /begin REF_MEASUREMENT CTM_numCellTempMaxID CTM_numCellTempMinID CTM_numOriginalCellTempMaxID CTM_numOriginalCellTempMinID CTM_numOriginalCellTempSecondMaxID CTM_tCellTempAve CTM_tCellTempMax CTM_tCellTempMin CTM_tOriginalCellTempAve CTM_tOriginalCellTempMax CTM_tOriginalCellTempMin CTM_tOriginalCellTempSecondMax /end REF_MEASUREMENT
/end GROUP
/begin GROUP S817_Determine_CellTemp_OverDeviationFaults "VBU0706/Function-Call Subsystem/Subsystem1/CTM/CTM/Subsystem/Determine_CellTemp_OverDeviationFaults" /begin SUB_GROUP S823_EVM_FDC_Handler1 /end SUB_GROUP
 /begin REF_CHARACTERISTIC CbCTM_CellTempOverDeviationEVMFaultEnable_flg CcCTM_CSCSupplyPowerLowHysteresis_V CcCTM_CSCSupplyPowerLow_V CcCTM_CellTempOverDeviationEVMFaultFIC_n CcCTM_CellTempOverDeviationEVMFaultPIC_n CcCTM_CellTempOverDeviationEVMFault_C CcCTM_EnableEVMTempDevDelayTime_ms CcCTM_EnableEVMTempDevThreshold_A SAMPLE_TIME_TASK_D /end REF_CHARACTERISTIC
/end GROUP
/begin GROUP S817_Determine_CellTemp_OverUnderFaults "VBU0706/Function-Call Subsystem/Subsystem1/CTM/CTM/Subsystem/Determine_CellTemp_OverUnderFaults" /begin SUB_GROUP S824_EVM_FDC_Handler /end SUB_GROUP
 /begin REF_CHARACTERISTIC CTM_CELL_UNDER_TEMP_FAULT CbCTM_CellOverTempEVMFaultEnable_flg CbCTM_CellOverTempFaultEnable_flg CbCTM_CellUnderTempFaultEnable_flg CcCTM_CellOverTempEVMFaultFIC_n CcCTM_CellOverTempEVMFaultPIC_n CcCTM_CellOverTempEVMFault_C CcCTM_CellOverTempFaultFIC_n CcCTM_CellOverTempFaultPIC_n CcCTM_CellOverTempFault_C CcCTM_CellOverTempLvl2Fault_C CcCTM_CellOverTempWarningDebounce_ms CcCTM_CellOverTempWarningFault_C CcCTM_CellUnderTempFaultFIC_n CcCTM_CellUnderTempFaultPIC_n CcCTM_CellUnderTempFault_C SAMPLE_TIME_TASK_D /end REF_CHARACTERISTIC
/end GROUP
/begin GROUP S817_Determine_Thermal_Runaway "VBU0706/Function-Call Subsystem/Subsystem1/CTM/CTM/Subsystem/Determine_Thermal_Runaway"
 /begin SUB_GROUP S826_CellThermalRunaway_FaultArrayCheck S826_DetermineTempRiseRate S826_TriggerCycle /end SUB_GROUP
/end GROUP
/begin GROUP S895_Contactors_Timing_Control "VBU0706/Function-Call Subsystem/Subsystem1/CTS/CTS/Subsystem/Contactors_Timing_Control"
 /begin REF_CHARACTERISTIC CTD_PRECHARGE_STATUS_FAIL CTD_PRECHARGE_STATUS_SUCCESS CTS_MAIN_CONTACTOR_COMMAND_CLOSE CTS_MAIN_CONTACTOR_COMMAND_OPEN CTS_PEU_DISCHARGE_ACTIVE CTS_STATE_CLOSE_AND_DIAGNOSE_MPR_STUCKOPEN CTS_STATE_CLOSE_MC_LSD_DIAGNOSE_HSD_STB CTS_STATE_CLOSE_MNC_PRECHARGING_MONITORING CTS_STATE_CLOSE_MPC CTS_STATE_DEACTIVATION CTS_STATE_DIAGNOSE_MNC_WELD CTS_STATE_DIAGNOSE_MPC_WELD CTS_STATE_DIAGNOSE_MPC_WELD_POWER_DOWN CTS_STATE_NORMAL_OPERATING CTS_STATE_OPEN_MAIN_POSITIVE_CONTACTOR CTS_STATE_OPEN_MC_AND_DIAGNOSE_WELD CTS_STATE_OPEN_MC_HSD CTS_STATE_OPEN_MPR_AND_DIAGNOSE_MPC_STUCKOPEN CTS_STATE_STANDBY CcCTS_CmdMnPosContactorDelayTime_ms CcCTS_DeltaVoltagePrecharge_V CcCTS_DiagnoseMPCWeldCheckDischargeTime_ms CcCTS_DiagnoseMPCWeldCheckTime_ms CcCTS_MaxCloseAndDiagnoseContactorsTime_ms CcCTS_MaxPrechargeTimes_n CcCTS_MinOpenAndDiagnoseWeldTime_ms CcCTS_NegativeLoadCurrent_A CcCTS_OpenContactorsDelayTime_ms CcCTS_PositiveLoadCurrent_A CcCTS_PrechargeTimesLimitEnable_flg CcSYS_SystemMaxInitialTime_ms DIAGNOSTIC_COMPLETE DIAGNOSTIC_CONDITION_NOT_MET /end REF_CHARACTERISTIC
 /begin REF_MEASUREMENT CTS_flgRunNegContactorWeldCheck CTS_flgRunPosContactorWeldCheck CTS_flgRunPrechargeDiagnostic CTS_stCmdMnNegContactor CTS_stCmdMnPosContactor CTS_stCmdPrechargeRelay CTS_stState LcCTS_CloseAndDiagnoseContactorsTimer_ms LcCTS_CmdMnPosContactorCounter_ms LcCTS_DiagnoseMPCWeldcheckDischargeTimer_ms LcCTS_DiagnoseMPCWeldcheckTimer_ms LcCTS_OpenAndDiagnoseWeldTimer_ms LcCTS_OpenContactorsDelayTimer_ms LcCTS_StandbyTimer_ms /end REF_MEASUREMENT
/end GROUP
/begin GROUP S895_DeterminePrechargeConditions "VBU0706/Function-Call Subsystem/Subsystem1/CTS/CTS/Subsystem/DeterminePrechargeConditions"
 /begin SUB_GROUP S897_Cell_DataValid_Check S897_Energy_Protection_Check S897_Fault_Check S897_HV_DataValid_Check S897_HV_Safety_Check S897_Precharge_Inhibit_Abort S897_SoC_Initialization_Check /end SUB_GROUP
/end GROUP
/begin GROUP S895_Determine_Contactor_Request "VBU0706/Function-Call Subsystem/Subsystem1/CTS/CTS/Subsystem/Determine_Contactor_Request"
 /begin SUB_GROUP S898_Close_Comamnd S898_Cmd_Close S898_Cmd_Open S898_Open_Comamnd /end SUB_GROUP
 /begin REF_CHARACTERISTIC VCR_CONTACTOR_NO_REQUEST VCR_CONTACTOR_OPEN /end REF_CHARACTERISTIC
 /begin REF_MEASUREMENT CTS_stContactorRequest /end REF_MEASUREMENT
/end GROUP
/begin GROUP S895_Determine_Emergency_Open "VBU0706/Function-Call Subsystem/Subsystem1/CTS/CTS/Subsystem/Determine_Emergency_Open"
 /begin REF_CHARACTERISTIC CbCTS_HvilOpenContactorEnable_flg CmSYS_OpenContactorsDelayFaultCat_enum CmSYS_OpenContactorsNowFaultCat_enum /end REF_CHARACTERISTIC
 /begin REF_MEASUREMENT CTS_flgCmdOpenContactorsDelay CTS_flgCmdOpenContactorsNow /end REF_MEASUREMENT
/end GROUP
/begin GROUP S895_Determine_Precharge_Times "VBU0706/Function-Call Subsystem/Subsystem1/CTS/CTS/Subsystem/Determine_Precharge_Times"
 /begin REF_CHARACTERISTIC CTS_STATE_CLOSE_AND_DIAGNOSE_MPR_STUCKOPEN CTS_STATE_CLOSE_MC_HSD_DIAGNOSE_LSD_STG CTS_STATE_DIAGNOSE_MPC_WELD CTS_STATE_STANDBY CcCTS_PrechargeTimerLimit_ms CcCTS_PrechargeTimerThreshold1_ms CcCTS_PrechargeTimerThreshold2_ms CcCTS_PrechargeTimerThreshold3_ms CcCTS_PrechargeTimer_ms CcCTS_PrechargeTimesLower_n CcCTS_PrechargeTimesUpper_n /end REF_CHARACTERISTIC
 /begin REF_MEASUREMENT CTS_timsPrechargeTimer /end REF_MEASUREMENT
/end GROUP
/begin GROUP S925_CellVoltage_ValidCheck "VBU0706/Function-Call Subsystem/Subsystem1/CVT/CVT/Subsystem/CellVoltage_ValidCheck"
 /begin REF_CHARACTERISTIC CcCVT_CellVoltageInvalidFaultDelayTime_ms CcCVT_CellVoltageInvalidFault_n SAMPLE_TIME_TASK_D /end REF_CHARACTERISTIC
/end GROUP
/begin GROUP S925_Determine_CellVoltage_ExtremeData "VBU0706/Function-Call Subsystem/Subsystem1/CVT/CVT/Subsystem/Determine_CellVoltage_ExtremeData"
 /begin REF_MEASUREMENT CVT_mvCellVoltageAve CVT_mvCellVoltageMax CVT_mvCellVoltageMin CVT_mvCellVoltageSecondMax CVT_mvCellVoltageSecondMin CVT_numCellVoltageMaxID CVT_numCellVoltageMinID CVT_numCellVoltageSecondMaxID CVT_numCellVoltageSecondMinID CVT_numInvalidCellVoltages CVT_uCellVoltagePack /end REF_MEASUREMENT
/end GROUP
/begin GROUP S925_Determine_CellVoltage_OverUnderFaults "VBU0706/Function-Call Subsystem/Subsystem1/CVT/CVT/Subsystem/Determine_CellVoltage_OverUnderFaults"
 /begin SUB_GROUP S928_EVM_FDC_Handler S928_EVM_FDC_Handler1 S928_EVM_FDC_Handler2 /end SUB_GROUP
 /begin REF_CHARACTERISTIC CVT_CELL_VOLTAGE_OVER_DEVIATION_FAULT CaCVT_CellVoltageOverDeviationCurrentMapDimension_n CaCVT_CellVoltageOverDeviationCurrentMapZ_A CbCVT_CellOverVoltageEVMFaultEnable_flg CbCVT_CellOverVoltageFaultEnable_flg CbCVT_CellUnderVoltageEVMFaultEnable_flg CbCVT_CellUnderVoltageFaultEnable_flg CbCVT_CellVoltageOverDeviationEVMFaultEnable_flg CbCVT_CellVoltageOverDeviationFaultEnable_flg CcCVT_CSCSupplyPowerLowHysteresis_V CcCVT_CSCSupplyPowerLow_V CcCVT_CellOverVoltageEVMFaultFIC_n CcCVT_CellOverVoltageEVMFaultPIC_n CcCVT_CellOverVoltageEVMFault_mV CcCVT_CellOverVoltageFaultFIC_n CcCVT_CellOverVoltageFaultPIC_n CcCVT_CellOverVoltageFault_mV CcCVT_CellOverVoltageWarningDebounce_ms CcCVT_CellOverVoltageWarningFault_mV CcCVT_CellUnderVoltageEVMFaultFIC_n CcCVT_CellUnderVoltageEVMFaultPIC_n CcCVT_CellUnderVoltageEVMFault_mV CcCVT_CellUnderVoltageFaultFIC_n CcCVT_CellUnderVoltageFaultLevel2_mV CcCVT_CellUnderVoltageFaultPIC_n CcCVT_CellUnderVoltageFault_mV CcCVT_CellUnderVoltageLowTemp_C CcCVT_CellVoltageOverDeviationCurrentDelay_s CcCVT_CellVoltageOverDeviationDisableCrrnt_A CcCVT_CellVoltageOverDeviationEVMFaultFIC_n CcCVT_CellVoltageOverDeviationEVMFaultPIC_n CcCVT_CellVoltageOverDeviationEVMFault_mV CcCVT_CellVoltageOverDeviationFaultFIC_n CcCVT_CellVoltageOverDeviationFaultPIC_n CcCVT_CellVoltageOverDeviationFault_mV SAMPLE_TIME_TASK_D /end REF_CHARACTERISTIC
/end GROUP
/begin GROUP S999_Clear_Fault_Data "VBU0706/Function-Call Subsystem/Subsystem1/DSM/Subsystem10/Subsystem/Clear_Fault_Data" /begin REF_CHARACTERISTIC CbDSM_ClearFaultData_flg /end REF_CHARACTERISTIC /end GROUP
/begin GROUP S999_Determine_Abnormal_In_PeriodicalUpload "VBU0706/Function-Call Subsystem/Subsystem1/DSM/Subsystem10/Subsystem/Determine_Abnormal_In_PeriodicalUpload" /begin SUB_GROUP S1001_For_Iterator_Subsystem /end SUB_GROUP /begin REF_CHARACTERISTIC CbDSM_AbnormalEventOvrValue_flg CbDSM_AbnormalEventOvr_flg /end REF_CHARACTERISTIC /begin REF_MEASUREMENT DSM_flgCycleUploadAbnormalEvent /end REF_MEASUREMENT /end GROUP
/begin GROUP S999_Determine_CSC_Inhibit "VBU0706/Function-Call Subsystem/Subsystem1/DSM/Subsystem10/Subsystem/Determine_CSC_Inhibit" /begin SUB_GROUP S1002_For_Iterator_Subsystem /end SUB_GROUP
 /begin REF_CHARACTERISTIC CbDSM_CscValueUncertainOvrValue_flg CbDSM_CscValueUncertainOvr_flg /end REF_CHARACTERISTIC
 /begin REF_MEASUREMENT DSM_flgCscValueUncertain /end REF_MEASUREMENT
/end GROUP
/begin GROUP S999_Determine_Drive_Cycle "VBU0706/Function-Call Subsystem/Subsystem1/DSM/Subsystem10/Subsystem/Determine_Drive_Cycle" /begin REF_CHARACTERISTIC CcDSM_DiverCycleflgDelayTime_ms /end REF_CHARACTERISTIC /begin REF_MEASUREMENT DSM_flgDriverCycleActive /end REF_MEASUREMENT /end GROUP
/begin GROUP S999_Determine_Fault_Category "VBU0706/Function-Call Subsystem/Subsystem1/DSM/Subsystem10/Subsystem/Determine_Fault_Category" /begin SUB_GROUP S1004_Clear_Fault_Category /end SUB_GROUP /begin REF_CHARACTERISTIC CaDSM_FaultCat_enum /end REF_CHARACTERISTIC /end GROUP
/begin GROUP S999_Determine_MIL_Request "VBU0706/Function-Call Subsystem/Subsystem1/DSM/Subsystem10/Subsystem/Determine_MIL_Request" /begin SUB_GROUP S1006_Clear_MIL_Request S1006_Determine_Local_MILRequest /end SUB_GROUP /end GROUP
/begin GROUP S999_Determine_No_Charge "VBU0706/Function-Call Subsystem/Subsystem1/DSM/Subsystem10/Subsystem/Determine_No_Charge" /begin SUB_GROUP S1007_For_Iterator_Subsystem /end SUB_GROUP /begin REF_CHARACTERISTIC CbDSM_NoChargeOvrValue_flg CbDSM_NoChargeOvr_flg /end REF_CHARACTERISTIC /begin REF_MEASUREMENT DSM_flgNoCharge /end REF_MEASUREMENT /end GROUP
/begin GROUP S999_Determine_No_Restart "VBU0706/Function-Call Subsystem/Subsystem1/DSM/Subsystem10/Subsystem/Determine_No_Restart" /begin REF_CHARACTERISTIC CbDSM_NoRestartOverride_flg CbDSM_NoRestartOvrValue_flg /end REF_CHARACTERISTIC /begin REF_MEASUREMENT DSM_flgNoRestart /end REF_MEASUREMENT /end GROUP
/begin GROUP S1157_Fastcharge_State_Management "VBU0706/Function-Call Subsystem/Subsystem1/FCC /FCC/Subsystem/Fastcharge_State_Management"
 /begin REF_CHARACTERISTIC CTS_MAIN_CONTACTOR_COMMAND_CLOSE CTS_MAIN_CONTACTOR_COMMAND_OPEN SAMPLE_TIME_TASK_D /end REF_CHARACTERISTIC
/end GROUP
/begin GROUP S1491_Determine_Correction_Condition "VBU0706/Function-Call Subsystem/Subsystem1/SOC/Subsystem5/Subsystem/Determine_Correction_Condition" /begin REF_CHARACTERISTIC SAMPLE_TIME_TASK_D /end REF_CHARACTERISTIC /end GROUP
/begin GROUP S1669_Rate_Limit_and_Output "VBU0706/Function-Call Subsystem/Subsystem1/SOE/Subsystem2/Subsystem/Rate_Limit_and_Output" /begin REF_CHARACTERISTIC SAMPLE_TIME_TASK_D /end REF_CHARACTERISTIC /end GROUP
/begin GROUP S1669_Rate_Limit_and_Output_SOC "VBU0706/Function-Call Subsystem/Subsystem1/SOE/Subsystem2/Subsystem/Rate_Limit_and_Output_SOC" /begin REF_CHARACTERISTIC SAMPLE_TIME_TASK_D /end REF_CHARACTERISTIC /end GROUP
/begin GROUP S1721_Count_LowTempOverCurrent "VBU0706/Function-Call Subsystem/Subsystem1/SOF/Subsystem6/Subsystem/Count_LowTempOverCurrent" /begin REF_CHARACTERISTIC SAMPLE_TIME_TASK_D /end REF_CHARACTERISTIC /end GROUP
/begin GROUP S1721_Rate_CurrentLimit "VBU0706/Function-Call Subsystem/Subsystem1/SOF/Subsystem6/Subsystem/Rate_CurrentLimit" /begin REF_CHARACTERISTIC SAMPLE_TIME_TASK_D /end REF_CHARACTERISTIC /end GROUP
/begin GROUP S1721_Rate_PowerLimit "VBU0706/Function-Call Subsystem/Subsystem1/SOF/Subsystem6/Subsystem/Rate_PowerLimit" /begin REF_CHARACTERISTIC SAMPLE_TIME_TASK_D /end REF_CHARACTERISTIC /end GROUP
/begin GROUP S1721_SOF_Diagnostic "VBU0706/Function-Call Subsystem/Subsystem1/SOF/Subsystem6/Subsystem/SOF_Diagnostic" /begin REF_CHARACTERISTIC SAMPLE_TIME_TASK_D /end REF_CHARACTERISTIC /end GROUP
/begin GROUP S316_Correct_BatteryCurrent "VBU0706/Function-Call Subsystem/Subsystem1/BCV/BCV/Subsystem/Calculate_BatteryCurrent/Correct_BatteryCurrent"
 /begin REF_CHARACTERISTIC CTS_STATE_CLOSE_MNC_PRECHARGING_MONITORING CTS_STATE_CLOSE_MPC CTS_STATE_NORMAL_OPERATING CTS_STATE_OPEN_MPR_AND_DIAGNOSE_MPC_STUCKOPEN /end REF_CHARACTERISTIC
/end GROUP
/begin GROUP S331_Diagnose_BDM_FastChargeContactorOverCurrentAlarm "VBU0706/Function-Call Subsystem/Subsystem1/BCV/BCV/Subsystem/Monitor_BCV_Performance/Diagnose_BDM_FastChargeContactorOverCurrentAlarm" /begin REF_CHARACTERISTIC CcBCV_BDMOutputDelayTime_ms /end REF_CHARACTERISTIC /end GROUP
/begin GROUP S637_Cmd_Close "VBU0706/Function-Call Subsystem/Subsystem1/CTC/Subsystem1/Subsystem/DetermineRelayCommandStatus/Cmd_Close" /begin REF_CHARACTERISTIC CTS_MAIN_CONTACTOR_COMMAND_CLOSE /end REF_CHARACTERISTIC /end GROUP
/begin GROUP S637_Cmd_Open "VBU0706/Function-Call Subsystem/Subsystem1/CTC/Subsystem1/Subsystem/DetermineRelayCommandStatus/Cmd_Open" /begin REF_CHARACTERISTIC CTS_MAIN_CONTACTOR_COMMAND_OPEN /end REF_CHARACTERISTIC /end GROUP
/begin GROUP S653_Determine_Fail_Lockout "VBU0706/Function-Call Subsystem/Subsystem1/CTD/Subsystem/Subsystem4/Lockout_Precharge_Process/Determine_Fail_Lockout" /begin REF_CHARACTERISTIC CTD_PRECHARGE_STATUS_FAIL /end REF_CHARACTERISTIC /end GROUP
/begin GROUP S654_Determine_Diagnostic_Status "VBU0706/Function-Call Subsystem/Subsystem1/CTD/Subsystem/Subsystem4/MainFuseDiagnostic/Determine_Diagnostic_Status" /begin REF_CHARACTERISTIC DIAGNOSTIC_COMPLETE DIAGNOSTIC_CONDITION_NOT_MET /end REF_CHARACTERISTIC /end GROUP
/begin GROUP S655_Determine_Diagnostic_Status "VBU0706/Function-Call Subsystem/Subsystem1/CTD/Subsystem/Subsystem4/Precharge_Resistance_Diagnostic/Determine_Diagnostic_Status" /begin REF_CHARACTERISTIC DIAGNOSTIC_COMPLETE DIAGNOSTIC_CONDITION_NOT_MET /end REF_CHARACTERISTIC /end GROUP
/begin GROUP S656_Precharge_Timeout_Diagnostic "VBU0706/Function-Call Subsystem/Subsystem1/CTD/Subsystem/Subsystem4/PrechrgProcessMonitoring/Precharge_Timeout_Diagnostic" /begin REF_CHARACTERISTIC CTD_PRECHARGE_STATUS_FAIL /end REF_CHARACTERISTIC /end GROUP
/begin GROUP S826_CellThermalRunaway_FaultArrayCheck "VBU0706/Function-Call Subsystem/Subsystem1/CTM/CTM/Subsystem/Determine_Thermal_Runaway/CellThermalRunaway_FaultArrayCheck" /begin REF_CHARACTERISTIC SAMPLE_TIME_TASK_D /end REF_CHARACTERISTIC /end GROUP
/begin GROUP S826_TriggerCycle "VBU0706/Function-Call Subsystem/Subsystem1/CTM/CTM/Subsystem/Determine_Thermal_Runaway/TriggerCycle" /begin REF_CHARACTERISTIC SAMPLE_TIME_TASK_D /end REF_CHARACTERISTIC /end GROUP
/begin GROUP S898_Close_Comamnd "VBU0706/Function-Call Subsystem/Subsystem1/CTS/CTS/Subsystem/Determine_Contactor_Request/Close_Comamnd" /begin REF_CHARACTERISTIC CTS_MAIN_CONTACTOR_COMMAND_CLOSE /end REF_CHARACTERISTIC /end GROUP
/begin GROUP S898_Cmd_Close "VBU0706/Function-Call Subsystem/Subsystem1/CTS/CTS/Subsystem/Determine_Contactor_Request/Cmd_Close" /begin REF_CHARACTERISTIC CTS_MAIN_CONTACTOR_COMMAND_CLOSE /end REF_CHARACTERISTIC /end GROUP
/begin GROUP S898_Cmd_Open "VBU0706/Function-Call Subsystem/Subsystem1/CTS/CTS/Subsystem/Determine_Contactor_Request/Cmd_Open" /begin REF_CHARACTERISTIC CTS_MAIN_CONTACTOR_COMMAND_OPEN /end REF_CHARACTERISTIC /end GROUP
/begin GROUP S898_Open_Comamnd "VBU0706/Function-Call Subsystem/Subsystem1/CTS/CTS/Subsystem/Determine_Contactor_Request/Open_Comamnd" /begin REF_CHARACTERISTIC CTS_MAIN_CONTACTOR_COMMAND_OPEN /end REF_CHARACTERISTIC /end GROUP
/begin GROUP S1158_EightyPercentCustomSOC_EnableInvalidChargeTimeFlag "VBU0706/Function-Call Subsystem/Subsystem1/FCC /FCC/Subsystem/Calculate_Fastcharge_Time/EightyPercentCustomSOC_EnableInvalidChargeTimeFlag" /begin REF_CHARACTERISTIC SAMPLE_TIME_TASK_D /end REF_CHARACTERISTIC /end GROUP
/begin GROUP S1158_EightyPercentCustomSOC_UpdateChargeTimeFlag "VBU0706/Function-Call Subsystem/Subsystem1/FCC /FCC/Subsystem/Calculate_Fastcharge_Time/EightyPercentCustomSOC_UpdateChargeTimeFlag" /begin REF_CHARACTERISTIC SAMPLE_TIME_TASK_D /end REF_CHARACTERISTIC /end GROUP
/begin GROUP S1158_SendInvalidTime_flg "VBU0706/Function-Call Subsystem/Subsystem1/FCC /FCC/Subsystem/Calculate_Fastcharge_Time/SendInvalidTime_flg" /begin REF_CHARACTERISTIC SAMPLE_TIME_TASK_D /end REF_CHARACTERISTIC /end GROUP
/begin GROUP S1158_UpdateTimeTrigger "VBU0706/Function-Call Subsystem/Subsystem1/FCC /FCC/Subsystem/Calculate_Fastcharge_Time/UpdateTimeTrigger" /begin REF_CHARACTERISTIC SAMPLE_TIME_TASK_D /end REF_CHARACTERISTIC /end GROUP
/begin GROUP S1159_Charge_Request_Protection "VBU0706/Function-Call Subsystem/Subsystem1/FCC /FCC/Subsystem/Determine_Fastcharge_Request/Charge_Request_Protection" /begin REF_CHARACTERISTIC SAMPLE_TIME_TASK_D /end REF_CHARACTERISTIC /end GROUP
/begin GROUP S1670_Determine_History_Current_Data "VBU0706/Function-Call Subsystem/Subsystem1/SOE/Subsystem2/Subsystem/Calculate_History_Average_Current/Determine_History_Current_Data" /begin REF_CHARACTERISTIC SAMPLE_TIME_TASK_D /end REF_CHARACTERISTIC /end GROUP
/begin GROUP S1670_Time_Counter "VBU0706/Function-Call Subsystem/Subsystem1/SOE/Subsystem2/Subsystem/Calculate_History_Average_Current/Time_Counter" /begin REF_CHARACTERISTIC SAMPLE_TIME_TASK_D /end REF_CHARACTERISTIC /end GROUP
/begin GROUP S1723_Calculate_Pack_OCV "VBU0706/Function-Call Subsystem/Subsystem1/SOF/Subsystem6/Subsystem/Calculate_PowerLimit/Calculate_Pack_OCV" /begin REF_CHARACTERISTIC SAMPLE_TIME_TASK_D /end REF_CHARACTERISTIC /end GROUP
/begin GROUP S3744_TempTar "VBU0706/Task_10ms/Subsystem/VCU /THM/THM/ESSThermalMode/TempTar" /begin REF_CHARACTERISTIC PMM_stDCChMode_SY /end REF_CHARACTERISTIC /end GROUP
/begin GROUP S334_Calculate_BatteryCurrent_ZeroDrift "VBU0706/Function-Call Subsystem/Subsystem1/BCV/BCV/Subsystem/Calculate_BatteryCurrent/Correct_BatteryCurrent/Calculate_BatteryCurrent_ZeroDrift"
 /begin REF_CHARACTERISTIC CTS_STATE_CLOSE_MNC_PRECHARGING_MONITORING CTS_STATE_CLOSE_MPC CTS_STATE_NORMAL_OPERATING CTS_STATE_OPEN_MPR_AND_DIAGNOSE_MPC_STUCKOPEN /end REF_CHARACTERISTIC
/end GROUP
/begin GROUP S387_Equal_FASTCHARGE "VBU0706/Function-Call Subsystem/Subsystem1/BCV/BCV/Subsystem/Calculate_Lifetime_Data/Calculate_LifeTimeFastcharge/Equal_FASTCHARGE" /begin REF_CHARACTERISTIC BMM_VEHICLE_WAKEUP_MODE_FAST_CHARGE /end REF_CHARACTERISTIC /end GROUP
/begin GROUP S468_Equal_FASTCHARGE "VBU0706/Function-Call Subsystem/Subsystem1/BCV/BCV/Subsystem/Monitor_BCV_Performance/Diagnose_BDM_FastChargeContactorOverCurrentAlarm/Equal_FASTCHARGE" /begin REF_CHARACTERISTIC BMM_VEHICLE_WAKEUP_MODE_FAST_CHARGE /end REF_CHARACTERISTIC /end GROUP
/begin GROUP S663_Determine_Diagnostic_Status "VBU0706/Function-Call Subsystem/Subsystem1/CTD/Subsystem/Subsystem4/DiagnoseRelayWeld/MNC_Weld_Check/Determine_Diagnostic_Status" /begin REF_CHARACTERISTIC DIAGNOSTIC_COMPLETE DIAGNOSTIC_CONDITION_NOT_MET /end REF_CHARACTERISTIC /end GROUP
/begin GROUP S664_Determine_Diagnostic_Status "VBU0706/Function-Call Subsystem/Subsystem1/CTD/Subsystem/Subsystem4/DiagnoseRelayWeld/MPC_Weld_Check/Determine_Diagnostic_Status" /begin REF_CHARACTERISTIC DIAGNOSTIC_COMPLETE DIAGNOSTIC_CONDITION_NOT_MET /end REF_CHARACTERISTIC /end GROUP
/begin GROUP S704_Determine_LockPoint_AvaliableHeat "VBU0706/Function-Call Subsystem/Subsystem1/CTD/Subsystem/Subsystem4/Lockout_Precharge_Process/HeatProtection_Lockout/Determine_LockPoint_AvaliableHeat"
 /begin REF_CHARACTERISTIC CTS_STATE_CLOSE_MC_HSD_DIAGNOSE_LSD_STG CTS_STATE_OPEN_MPR_AND_DIAGNOSE_MPC_STUCKOPEN /end REF_CHARACTERISTIC
/end GROUP
/begin GROUP S732_Status_Fail "VBU0706/Function-Call Subsystem/Subsystem1/CTD/Subsystem/Subsystem4/PrechrgProcessMonitoring/Precharging_Process_Monitoring/Status_Fail" /begin REF_CHARACTERISTIC CTD_PRECHARGE_STATUS_FAIL /end REF_CHARACTERISTIC /end GROUP
/begin GROUP S732_Status_Success "VBU0706/Function-Call Subsystem/Subsystem1/CTD/Subsystem/Subsystem4/PrechrgProcessMonitoring/Precharging_Process_Monitoring/Status_Success" /begin REF_CHARACTERISTIC CTD_PRECHARGE_STATUS_SUCCESS /end REF_CHARACTERISTIC /end GROUP
/begin GROUP S754_Determine_Diagnostic_Status "VBU0706/Function-Call Subsystem/Subsystem1/CTD/Subsystem/Subsystem4/Stuck_Open_Diagnostic/MPR_Stuck_Open/Determine_Diagnostic_Status" /begin REF_CHARACTERISTIC DIAGNOSTIC_COMPLETE DIAGNOSTIC_CONDITION_NOT_MET /end REF_CHARACTERISTIC /end GROUP
/begin GROUP S907_Combine_Precharge_Conditions "VBU0706/Function-Call Subsystem/Subsystem1/CTS/CTS/Subsystem/DeterminePrechargeConditions/Precharge_Inhibit_Abort/Combine_Precharge_Conditions" /begin REF_CHARACTERISTIC CTD_PRECHARGE_STATUS_FAIL /end REF_CHARACTERISTIC /end GROUP
/begin GROUP S1214_Decrease_ChargeCurrentRequest "VBU0706/Function-Call Subsystem/Subsystem1/FCC /FCC/Subsystem/Determine_Fastcharge_Request/Charge_Request_Protection/Decrease_ChargeCurrentRequest" /begin REF_CHARACTERISTIC SAMPLE_TIME_TASK_D /end REF_CHARACTERISTIC /end GROUP
/begin GROUP S1215_Determine_ComputeResistanceCondition "VBU0706/Function-Call Subsystem/Subsystem1/FCC /FCC/Subsystem/Determine_Fastcharge_Request/DetermineComputeResistancePulseCurrent/Determine_ComputeResistanceCondition" /begin REF_CHARACTERISTIC SAMPLE_TIME_TASK_D /end REF_CHARACTERISTIC /end GROUP
/begin GROUP S1248_Cell_Temp_Protection "VBU0706/Function-Call Subsystem/Subsystem1/FCC /FCC/Subsystem/Fastcharge_Conditions_Check/Condition_Categorize/Cell_Temp_Protection" /begin REF_CHARACTERISTIC SAMPLE_TIME_TASK_D /end REF_CHARACTERISTIC /end GROUP
/begin GROUP S1248_Voltage_Protection "VBU0706/Function-Call Subsystem/Subsystem1/FCC /FCC/Subsystem/Fastcharge_Conditions_Check/Condition_Categorize/Voltage_Protection" /begin REF_CHARACTERISTIC SAMPLE_TIME_TASK_D /end REF_CHARACTERISTIC /end GROUP
/begin GROUP S1729_Rate_Limiter "VBU0706/Function-Call Subsystem/Subsystem1/SOF/Subsystem6/Subsystem/Calculate_PowerLimit/Calculate_Pack_OCV/Rate_Limiter" /begin REF_CHARACTERISTIC SAMPLE_TIME_TASK_D /end REF_CHARACTERISTIC /end GROUP
/begin GROUP S1761_Calculate_CurrentLimit_Base "VBU0706/Function-Call Subsystem/Subsystem1/SOF/Subsystem6/Subsystem/Determine_Currentlimit_Target/Calculate_CurrentLimit_Target/Calculate_CurrentLimit_Base" /begin REF_CHARACTERISTIC SAMPLE_TIME_TASK_D /end REF_CHARACTERISTIC /end GROUP
/begin GROUP S1964_Determine_SlowCharge "VBU0706/Function-Call Subsystem/Subsystem1/SOH/Subsystem4/Subsystem1/Calculate_Capacity/Determine_CalculateCellCapacity_Condition/Determine_SlowCharge" /begin REF_CHARACTERISTIC SAMPLE_TIME_TASK_D /end REF_CHARACTERISTIC /end GROUP
/begin GROUP S1964_Determine_SlowChargeStart "VBU0706/Function-Call Subsystem/Subsystem1/SOH/Subsystem4/Subsystem1/Calculate_Capacity/Determine_CalculateCellCapacity_Condition/Determine_SlowChargeStart" /begin REF_CHARACTERISTIC SAMPLE_TIME_TASK_D /end REF_CHARACTERISTIC /end GROUP
/begin GROUP S3348_ChargeConditon "VBU0706/Task_10ms/Subsystem/VCU /DSPL/DSPL/DriveRange/RemainingRange/ChargeConditon" /begin REF_CHARACTERISTIC PMM_stDCChMode_SY /end REF_CHARACTERISTIC /end GROUP
/begin GROUP S3599_LvWakeUp_Mode_Calc "VBU0706/Task_10ms/Subsystem/VCU /PMM/PMM_Ctrl/PMM/LvWakeUp_Ctrl/LvWakeUp_Mode_Calc" /begin REF_CHARACTERISTIC PMM_stDCChMode_SY /end REF_CHARACTERISTIC /end GROUP
/begin GROUP S756_Determine_Diagnostic_Status "VBU0706/Function-Call Subsystem/Subsystem1/CTD/Subsystem/Subsystem4/Stuck_Open_Diagnostic/MNC_Stuck_Open/MNC_Stuck_Open_With_VehicleSpeed/Determine_Diagnostic_Status" /begin REF_CHARACTERISTIC DIAGNOSTIC_COMPLETE DIAGNOSTIC_CONDITION_NOT_MET /end REF_CHARACTERISTIC /end GROUP
/begin GROUP S780_Determine_Diagnostic_Status "VBU0706/Function-Call Subsystem/Subsystem1/CTD/Subsystem/Subsystem4/Stuck_Open_Diagnostic/MPC_Stuck_Open/MPC_Stuck_Open_Without_VehicleSpeed/Determine_Diagnostic_Status" /begin REF_CHARACTERISTIC DIAGNOSTIC_COMPLETE DIAGNOSTIC_CONDITION_NOT_MET /end REF_CHARACTERISTIC /end GROUP
/begin GROUP S1257_FullCharge_criteria1 "VBU0706/Function-Call Subsystem/Subsystem1/FCC /FCC/Subsystem/Fastcharge_Conditions_Check/Condition_Categorize/Full_Charge_Determination/FullCharge_criteria1" /begin REF_CHARACTERISTIC SAMPLE_TIME_TASK_D /end REF_CHARACTERISTIC /end GROUP
/begin GROUP S1257_FullCharge_criteria2 "VBU0706/Function-Call Subsystem/Subsystem1/FCC /FCC/Subsystem/Fastcharge_Conditions_Check/Condition_Categorize/Full_Charge_Determination/FullCharge_criteria2" /begin REF_CHARACTERISTIC SAMPLE_TIME_TASK_D /end REF_CHARACTERISTIC /end GROUP
/begin GROUP S1257_FullCharge_criteria4 "VBU0706/Function-Call Subsystem/Subsystem1/FCC /FCC/Subsystem/Fastcharge_Conditions_Check/Condition_Categorize/Full_Charge_Determination/FullCharge_criteria4" /begin REF_CHARACTERISTIC SAMPLE_TIME_TASK_D /end REF_CHARACTERISTIC /end GROUP
/begin GROUP S1748_Determine_SOCP_Condition "VBU0706/Function-Call Subsystem/Subsystem1/SOF/Subsystem6/Subsystem/Calculate_PowerLimit/Determine_SOCP_PowerLimit/Determine_ContinuousDischargePowerLimitTarget/Determine_SOCP_Condition" /begin REF_CHARACTERISTIC SAMPLE_TIME_TASK_D /end REF_CHARACTERISTIC /end GROUP
/begin GROUP S1749_Determine_SOCP_Condition "VBU0706/Function-Call Subsystem/Subsystem1/SOF/Subsystem6/Subsystem/Calculate_PowerLimit/Determine_SOCP_PowerLimit/Determine_DischargePowerLimitTarget/Determine_SOCP_Condition" /begin REF_CHARACTERISTIC SAMPLE_TIME_TASK_D /end REF_CHARACTERISTIC /end GROUP
/begin GROUP S1763_Determine_LowVoltageLimitChargeCurrent "VBU0706/Function-Call Subsystem/Subsystem1/SOF/Subsystem6/Subsystem/Determine_Currentlimit_Target/Calculate_CurrentLimit_Target/Calculate_CurrentLimit_Base/Determine_LowVoltageLimitChargeCurrent" /begin REF_CHARACTERISTIC SAMPLE_TIME_TASK_D /end REF_CHARACTERISTIC /end GROUP
/begin GROUP S1765_FastChrgOneThirdRateCurrentLimitCheck "VBU0706/Function-Call Subsystem/Subsystem1/SOF/Subsystem6/Subsystem/Determine_Currentlimit_Target/Calculate_CurrentLimit_Target/CurrentLimit_FastCharge_Check/FastChrgOneThirdRateCurrentLimitCheck" /begin REF_CHARACTERISTIC SAMPLE_TIME_TASK_D /end REF_CHARACTERISTIC /end GROUP
/begin GROUP S1766_Determine_StopCharge_Condition "VBU0706/Function-Call Subsystem/Subsystem1/SOF/Subsystem6/Subsystem/Determine_Currentlimit_Target/Calculate_CurrentLimit_Target/CurrentLimit_Fault_Correct/Determine_StopCharge_Condition" /begin REF_CHARACTERISTIC SAMPLE_TIME_TASK_D /end REF_CHARACTERISTIC /end GROUP
/begin GROUP S2000_Determine_AhIntegral_Q "VBU0706/Function-Call Subsystem/Subsystem1/SOH/Subsystem4/Subsystem1/Calculate_Capacity/Calculate_CellCapacity_SlowCharge/Determine_AhIntegral_DeltaQ/Determine_AhIntegral_Q" /begin REF_CHARACTERISTIC SAMPLE_TIME_TASK_D /end REF_CHARACTERISTIC /end GROUP
/begin GROUP S2039_DuringStep_AfterStep_Check "VBU0706/Function-Call Subsystem/Subsystem1/SOH/Subsystem4/Subsystem1/Calculate_Resistance/BasicCellResistance_Calculation_Check/BeforStep_DuringStep_AfterStep_Check/DuringStep_AfterStep_Check" /begin REF_CHARACTERISTIC SAMPLE_TIME_TASK_D /end REF_CHARACTERISTIC /end GROUP
/begin GROUP S2055_Determine_FCCPulseCurrent_Condition "VBU0706/Function-Call Subsystem/Subsystem1/SOH/Subsystem4/Subsystem1/Calculate_Resistance/Determine_Condition_Calculate_Pulse_Average_CurrentVoltage/Determine_Condition/Determine_FCCPulseCurrent_Condition" /begin REF_CHARACTERISTIC SAMPLE_TIME_TASK_D /end REF_CHARACTERISTIC /end GROUP
/begin GROUP S1815_Calculate_Dynamic_DischargeCurrentLimit "VBU0706/Function-Call Subsystem/Subsystem1/SOF/Subsystem6/Subsystem/Determine_Currentlimit_Target/Calculate_CurrentLimit_Target/Calculate_Dynamic_CurrentLimit/Calculate_Dynamic_DischargeCurrentLimit/Calculate_Dynamic_DischargeCurrentLimit" /begin REF_CHARACTERISTIC SAMPLE_TIME_TASK_D /end REF_CHARACTERISTIC /end GROUP
/begin GROUP S1871_Calculate_CurrentLimit "VBU0706/Function-Call Subsystem/Subsystem1/SOF/Subsystem6/Subsystem/Determine_Currentlimit_Target/Calculate_CurrentLimit_Target/CurrentLimit_Voltage_Correct/Correct_CurrentLimit/Calculate_CurrentLimit" /begin REF_CHARACTERISTIC SAMPLE_TIME_TASK_D /end REF_CHARACTERISTIC /end GROUP
/begin GROUP S2006_Determine_Cell_Balanced_Capacity "VBU0706/Function-Call Subsystem/Subsystem1/SOH/Subsystem4/Subsystem1/Calculate_Capacity/Calculate_CellCapacity_SlowCharge/Determine_AhIntegral_DeltaQ/Determine_AhIntegral_Q/Determine_Cell_Balanced_Capacity" /begin REF_CHARACTERISTIC SAMPLE_TIME_TASK_D /end REF_CHARACTERISTIC /end GROUP
/begin GROUP S1816_Calculate_ChargeCurrentLimitBuffer_Use "VBU0706/Function-Call Subsystem/Subsystem1/SOF/Subsystem6/Subsystem/Determine_Currentlimit_Target/Calculate_CurrentLimit_Target/Calculate_Dynamic_CurrentLimit/Calculate_Dynamic_ChargeCurrentLimit/Calculate_ChargeCurrentLimit_Buff/Calculate_ChargeCurrentLimitBuffer_Use" /begin REF_CHARACTERISTIC SAMPLE_TIME_TASK_D /end REF_CHARACTERISTIC /end GROUP
/begin GROUP S1824_Calculate_DischargeCurrentLimitBuffer_Use "VBU0706/Function-Call Subsystem/Subsystem1/SOF/Subsystem6/Subsystem/Determine_Currentlimit_Target/Calculate_CurrentLimit_Target/Calculate_Dynamic_CurrentLimit/Calculate_Dynamic_DischargeCurrentLimit/Calculate_DischargeCurrentLimit_Buff/Calculate_DischargeCurrentLimitBuffer_Use" /begin REF_CHARACTERISTIC SAMPLE_TIME_TASK_D /end REF_CHARACTERISTIC /end GROUP
/begin GROUP S1825_Rate_Limiter "VBU0706/Function-Call Subsystem/Subsystem1/SOF/Subsystem6/Subsystem/Determine_Currentlimit_Target/Calculate_CurrentLimit_Target/Calculate_Dynamic_CurrentLimit/Calculate_Dynamic_DischargeCurrentLimit/Calculate_Dynamic_DischargeCurrentLimit/Rate_Limiter" /begin REF_CHARACTERISTIC SAMPLE_TIME_TASK_D /end REF_CHARACTERISTIC /end GROUP
/begin GROUP S1873_Rate_Limiter1 "VBU0706/Function-Call Subsystem/Subsystem1/SOF/Subsystem6/Subsystem/Determine_Currentlimit_Target/Calculate_CurrentLimit_Target/CurrentLimit_Voltage_Correct/Correct_CurrentLimit/Calculate_CurrentLimit/Rate_Limiter1" /begin REF_CHARACTERISTIC SAMPLE_TIME_TASK_D /end REF_CHARACTERISTIC /end GROUP
/begin GROUP S1874_Set_ChargeVoltageCorrect_level1 "VBU0706/Function-Call Subsystem/Subsystem1/SOF/Subsystem6/Subsystem/Determine_Currentlimit_Target/Calculate_CurrentLimit_Target/CurrentLimit_Voltage_Correct/Correct_CurrentLimit/Determine_VoltageCorrect_level/Set_ChargeVoltageCorrect_level1" /begin REF_CHARACTERISTIC SAMPLE_TIME_TASK_D /end REF_CHARACTERISTIC /end GROUP
/begin GROUP S1874_Set_ChargeVoltageCorrect_level2 "VBU0706/Function-Call Subsystem/Subsystem1/SOF/Subsystem6/Subsystem/Determine_Currentlimit_Target/Calculate_CurrentLimit_Target/CurrentLimit_Voltage_Correct/Correct_CurrentLimit/Determine_VoltageCorrect_level/Set_ChargeVoltageCorrect_level2" /begin REF_CHARACTERISTIC SAMPLE_TIME_TASK_D /end REF_CHARACTERISTIC /end GROUP
/begin GROUP S1874_Set_ChargeVoltageCorrect_level3 "VBU0706/Function-Call Subsystem/Subsystem1/SOF/Subsystem6/Subsystem/Determine_Currentlimit_Target/Calculate_CurrentLimit_Target/CurrentLimit_Voltage_Correct/Correct_CurrentLimit/Determine_VoltageCorrect_level/Set_ChargeVoltageCorrect_level3" /begin REF_CHARACTERISTIC SAMPLE_TIME_TASK_D /end REF_CHARACTERISTIC /end GROUP
/begin GROUP S1874_Set_ChargeVoltageCorrect_level4 "VBU0706/Function-Call Subsystem/Subsystem1/SOF/Subsystem6/Subsystem/Determine_Currentlimit_Target/Calculate_CurrentLimit_Target/CurrentLimit_Voltage_Correct/Correct_CurrentLimit/Determine_VoltageCorrect_level/Set_ChargeVoltageCorrect_level4" /begin REF_CHARACTERISTIC SAMPLE_TIME_TASK_D /end REF_CHARACTERISTIC /end GROUP
/begin GROUP S1874_Set_DischargeVoltageCorrect_level1 "VBU0706/Function-Call Subsystem/Subsystem1/SOF/Subsystem6/Subsystem/Determine_Currentlimit_Target/Calculate_CurrentLimit_Target/CurrentLimit_Voltage_Correct/Correct_CurrentLimit/Determine_VoltageCorrect_level/Set_DischargeVoltageCorrect_level1" /begin REF_CHARACTERISTIC SAMPLE_TIME_TASK_D /end REF_CHARACTERISTIC /end GROUP
/begin GROUP S1874_Set_DischargeVoltageCorrect_level2 "VBU0706/Function-Call Subsystem/Subsystem1/SOF/Subsystem6/Subsystem/Determine_Currentlimit_Target/Calculate_CurrentLimit_Target/CurrentLimit_Voltage_Correct/Correct_CurrentLimit/Determine_VoltageCorrect_level/Set_DischargeVoltageCorrect_level2" /begin REF_CHARACTERISTIC SAMPLE_TIME_TASK_D /end REF_CHARACTERISTIC /end GROUP
/begin GROUP S1874_Set_DischargeVoltageCorrect_level3 "VBU0706/Function-Call Subsystem/Subsystem1/SOF/Subsystem6/Subsystem/Determine_Currentlimit_Target/Calculate_CurrentLimit_Target/CurrentLimit_Voltage_Correct/Correct_CurrentLimit/Determine_VoltageCorrect_level/Set_DischargeVoltageCorrect_level3" /begin REF_CHARACTERISTIC SAMPLE_TIME_TASK_D /end REF_CHARACTERISTIC /end GROUP
/begin GROUP S1874_Set_DischargeVoltageCorrect_level4 "VBU0706/Function-Call Subsystem/Subsystem1/SOF/Subsystem6/Subsystem/Determine_Currentlimit_Target/Calculate_CurrentLimit_Target/CurrentLimit_Voltage_Correct/Correct_CurrentLimit/Determine_VoltageCorrect_level/Set_DischargeVoltageCorrect_level4" /begin REF_CHARACTERISTIC SAMPLE_TIME_TASK_D /end REF_CHARACTERISTIC /end GROUP
/end MODULE
/end PROJECT
