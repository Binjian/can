ASAP2_VERSION 1 31
/begin PROJECT ProjectName "Project Comment Goes Here"
/begin HEADER "Header Comments go here" /end HEADER
/begin MODULE ModuleName "Module Comment Goes Here"
/begin MOD_COMMON "Mod Common Comment Here" ALIGNMENT_WORD 1 ALIGNMENT_LONG 1 ALIGNMENT_FLOAT32_IEEE 1 ALIGNMENT_FLOAT64_IEEE 1 BYTE_ORDER MSB_LAST /end MOD_COMMON
/begin RECORD_LAYOUT Scalar_BOOLEAN FNC_VALUES 1 UBYTE COLUMN_DIR DIRECT /end RECORD_LAYOUT
/begin RECORD_LAYOUT Scalar_UBYTE FNC_VALUES 1 UBYTE COLUMN_DIR DIRECT /end RECORD_LAYOUT
/begin RECORD_LAYOUT Scalar_BYTE FNC_VALUES 1 SBYTE COLUMN_DIR DIRECT /end RECORD_LAYOUT
/begin RECORD_LAYOUT Scalar_UWORD FNC_VALUES 1 UWORD COLUMN_DIR DIRECT /end RECORD_LAYOUT
/begin RECORD_LAYOUT Scalar_ULONG FNC_VALUES 1 ULONG COLUMN_DIR DIRECT /end RECORD_LAYOUT
/begin RECORD_LAYOUT Scalar_FLOAT32_IEEE FNC_VALUES 1 FLOAT32_IEEE COLUMN_DIR DIRECT /end RECORD_LAYOUT
/begin RECORD_LAYOUT Lookup1D_UWORD FNC_VALUES 1 UWORD COLUMN_DIR DIRECT /end RECORD_LAYOUT
/begin RECORD_LAYOUT Lookup1D_WORD FNC_VALUES 1 SWORD COLUMN_DIR DIRECT /end RECORD_LAYOUT
/begin RECORD_LAYOUT Lookup1D_X_WORD AXIS_PTS_X 1 SWORD INDEX_INCR DIRECT /end RECORD_LAYOUT
/begin RECORD_LAYOUT Lookup1D_FLOAT32_IEEE FNC_VALUES 1 FLOAT32_IEEE COLUMN_DIR DIRECT /end RECORD_LAYOUT
/begin RECORD_LAYOUT Lookup1D_X_FLOAT32_IEEE AXIS_PTS_X 1 FLOAT32_IEEE INDEX_INCR DIRECT /end RECORD_LAYOUT
/begin RECORD_LAYOUT Lookup2D_X_UWORD AXIS_PTS_X 1 UWORD INDEX_INCR DIRECT /end RECORD_LAYOUT
/begin RECORD_LAYOUT Lookup2D_FLOAT32_IEEE FNC_VALUES 1 FLOAT32_IEEE COLUMN_DIR DIRECT /end RECORD_LAYOUT
/begin RECORD_LAYOUT Lookup2D_X_FLOAT32_IEEE AXIS_PTS_X 1 FLOAT32_IEEE INDEX_INCR DIRECT /end RECORD_LAYOUT
/begin CHARACTERISTIC CaFCC_ChargeCurrentOverFactorMapY_nbr "" CURVE 0x700015c6 Lookup1D_FLOAT32_IEEE 0 VBU0706_CM_single_cnt -3.4028234663852886E+38 3.4028234663852886E+38
 /begin AXIS_DESCR COM_AXIS CTM_tCellTempMin VBU0706_CM_single_cnt 4 -3.4028234663852886E+38 3.4028234663852886E+38 AXIS_PTS_REF CaFCC_ChargeCurrentOverFactorMapX_C /end AXIS_DESCR
/end CHARACTERISTIC
/begin AXIS_PTS CaFCC_ChargeCurrentOverFactorMapX_C "" 0x700015b6 CTM_tCellTempMin Lookup1D_X_FLOAT32_IEEE 0 VBU0706_CM_single_cnt 4 -3.4028234663852886E+38 3.4028234663852886E+38 /end AXIS_PTS
/begin CHARACTERISTIC CaOCV_RelaxationTimeCurveY_s "" CURVE 0x700029e4 Lookup1D_FLOAT32_IEEE 0 VBU0706_CM_single_cnt -3.4028234663852886E+38 3.4028234663852886E+38
 /begin AXIS_DESCR COM_AXIS CTM_tCellTempMin VBU0706_CM_single_cnt 12 -3.4028234663852886E+38 3.4028234663852886E+38 AXIS_PTS_REF CaOCV_RelaxationTimeCurveX_C /end AXIS_DESCR
/end CHARACTERISTIC
/begin AXIS_PTS CaOCV_RelaxationTimeCurveX_C "" 0x700029b4 CTM_tCellTempMin Lookup1D_X_FLOAT32_IEEE 0 VBU0706_CM_single_cnt 12 -3.4028234663852886E+38 3.4028234663852886E+38 /end AXIS_PTS
/begin CHARACTERISTIC CaOCV_RelaxaShortTimeCurveY_s "" CURVE 0x70001616 Lookup1D_FLOAT32_IEEE 0 VBU0706_CM_single_cnt -3.4028234663852886E+38 3.4028234663852886E+38
 /begin AXIS_DESCR COM_AXIS CTM_tCellTempMin VBU0706_CM_single_cnt 4 -3.4028234663852886E+38 3.4028234663852886E+38 AXIS_PTS_REF CaOCV_RelaxaShortTimeCurveX_C /end AXIS_DESCR
/end CHARACTERISTIC
/begin AXIS_PTS CaOCV_RelaxaShortTimeCurveX_C "" 0x70001606 CTM_tCellTempMin Lookup1D_X_FLOAT32_IEEE 0 VBU0706_CM_single_cnt 4 -3.4028234663852886E+38 3.4028234663852886E+38 /end AXIS_PTS
/begin CHARACTERISTIC CaSOC_SOCPLowY_pct "" CURVE 0x70001daa Lookup1D_FLOAT32_IEEE 0 VBU0706_CM_single_cnt -3.4028234663852886E+38 3.4028234663852886E+38
 /begin AXIS_DESCR COM_AXIS CTM_tCellTempMin VBU0706_CM_single_cnt 7 -3.4028234663852886E+38 3.4028234663852886E+38 AXIS_PTS_REF CaSOC_SOCPLowX_C /end AXIS_DESCR
/end CHARACTERISTIC
/begin AXIS_PTS CaSOC_SOCPLowX_C "" 0x70001d8e CTM_tCellTempMin Lookup1D_X_FLOAT32_IEEE 0 VBU0706_CM_single_cnt 7 -3.4028234663852886E+38 3.4028234663852886E+38 /end AXIS_PTS
/begin CHARACTERISTIC CaSOC_OcvShortTimeSocErrorCurveY_pct "" CURVE 0x70001636 Lookup1D_FLOAT32_IEEE 0 VBU0706_CM_single_cnt -3.4028234663852886E+38 3.4028234663852886E+38
 /begin AXIS_DESCR COM_AXIS CTM_tCellTempMin VBU0706_CM_single_cnt 4 -3.4028234663852886E+38 3.4028234663852886E+38 AXIS_PTS_REF CaSOC_OcvShortTimeSocErrorCurveX_C /end AXIS_DESCR
/end CHARACTERISTIC
/begin AXIS_PTS CaSOC_OcvShortTimeSocErrorCurveX_C "" 0x70001626 CTM_tCellTempMin Lookup1D_X_FLOAT32_IEEE 0 VBU0706_CM_single_cnt 4 -3.4028234663852886E+38 3.4028234663852886E+38 /end AXIS_PTS
/begin CHARACTERISTIC CaSOC_OcvShortTimeDischargeSocZ_pct "" MAP 0x70004b14 Lookup2D_FLOAT32_IEEE 0 VBU0706_CM_single_cnt -3.4028234663852886E+38 3.4028234663852886E+38
 /begin AXIS_DESCR COM_AXIS NO_INPUT_QUANTITY VBU0706_CM_uint16_cnt 11 0.0 65535.0 AXIS_PTS_REF CaSOC_OcvShortTimeDischargeVolY_mV /end AXIS_DESCR
 /begin AXIS_DESCR COM_AXIS CTM_tCellTempMin VBU0706_CM_single_cnt 4 -3.4028234663852886E+38 3.4028234663852886E+38 AXIS_PTS_REF CaSOC_OcvShortTimeTemX_C /end AXIS_DESCR
/end CHARACTERISTIC
/begin AXIS_PTS CaSOC_OcvShortTimeTemX_C "" 0x70001646 CTM_tCellTempMin Lookup2D_X_FLOAT32_IEEE 0 VBU0706_CM_single_cnt 4 -3.4028234663852886E+38 3.4028234663852886E+38 /end AXIS_PTS
/begin AXIS_PTS CaSOC_OcvShortTimeDischargeVolY_mV "" 0x700019a0 NO_INPUT_QUANTITY Lookup2D_X_UWORD 0 VBU0706_CM_uint16_cnt 11 0.0 65535.0 /end AXIS_PTS
/begin CHARACTERISTIC CaSOC_OcvShortTimeChargeSocZ_pct "" MAP 0x70004a64 Lookup2D_FLOAT32_IEEE 0 VBU0706_CM_single_cnt -3.4028234663852886E+38 3.4028234663852886E+38
 /begin AXIS_DESCR COM_AXIS NO_INPUT_QUANTITY VBU0706_CM_uint16_cnt 11 0.0 65535.0 AXIS_PTS_REF CaSOC_OcvShortTimeChargeVolY_mV /end AXIS_DESCR
 /begin AXIS_DESCR COM_AXIS CTM_tCellTempMin VBU0706_CM_single_cnt 4 -3.4028234663852886E+38 3.4028234663852886E+38 AXIS_PTS_REF CaSOC_OcvShortTimeTemX_C /end AXIS_DESCR
/end CHARACTERISTIC
/begin AXIS_PTS CaSOC_OcvShortTimeChargeVolY_mV "" 0x7000198a NO_INPUT_QUANTITY Lookup2D_X_UWORD 0 VBU0706_CM_uint16_cnt 11 0.0 65535.0 /end AXIS_PTS
/begin CHARACTERISTIC CaSOE_DispalySocFactorMapY_pct "" CURVE 0x70002a44 Lookup1D_FLOAT32_IEEE 0 VBU0706_CM_single_cnt -3.4028234663852886E+38 3.4028234663852886E+38
 /begin AXIS_DESCR COM_AXIS SOC_pctBatteryDisplaySoc VBU0706_CM_single_cnt 12 -3.4028234663852886E+38 3.4028234663852886E+38 AXIS_PTS_REF CaSOE_DispalySocFactorMapX_pct /end AXIS_DESCR
/end CHARACTERISTIC
/begin AXIS_PTS CaSOE_DispalySocFactorMapX_pct "" 0x70002a14 SOC_pctBatteryDisplaySoc Lookup1D_X_FLOAT32_IEEE 0 VBU0706_CM_single_cnt 12 -3.4028234663852886E+38 3.4028234663852886E+38 /end AXIS_PTS
/begin CHARACTERISTIC CaSOF_DischargePowerSlopeSocTempMapZ_Kw "" MAP 0x700084a4 Lookup2D_FLOAT32_IEEE 0 VBU0706_CM_single_cnt -3.4028234663852886E+38 3.4028234663852886E+38
 /begin AXIS_DESCR COM_AXIS SOC_pctCellSocMin VBU0706_CM_single_cnt 13 -3.4028234663852886E+38 3.4028234663852886E+38 AXIS_PTS_REF CaSOF_DischargePowerSlopeSocTempMapY_pct /end AXIS_DESCR
 /begin AXIS_DESCR COM_AXIS NO_INPUT_QUANTITY VBU0706_CM_single_cnt 14 -3.4028234663852886E+38 3.4028234663852886E+38 AXIS_PTS_REF CaSOF_DischargePowerSlopeSocTempMapX_C /end AXIS_DESCR
/end CHARACTERISTIC
/begin AXIS_PTS CaSOF_DischargePowerSlopeSocTempMapX_C "" 0x70003184 NO_INPUT_QUANTITY Lookup2D_X_FLOAT32_IEEE 0 VBU0706_CM_single_cnt 14 -3.4028234663852886E+38 3.4028234663852886E+38 /end AXIS_PTS
/begin AXIS_PTS CaSOF_DischargePowerSlopeSocTempMapY_pct "" 0x70002d98 SOC_pctCellSocMin Lookup2D_X_FLOAT32_IEEE 0 VBU0706_CM_single_cnt 13 -3.4028234663852886E+38 3.4028234663852886E+38 /end AXIS_PTS
/begin CHARACTERISTIC CaSOF_ChargePowerSlopeSocTempMapZ_Kw "" MAP 0x70007c1c Lookup2D_FLOAT32_IEEE 0 VBU0706_CM_single_cnt -3.4028234663852886E+38 3.4028234663852886E+38
 /begin AXIS_DESCR COM_AXIS SOC_pctCellSocMax VBU0706_CM_single_cnt 13 -3.4028234663852886E+38 3.4028234663852886E+38 AXIS_PTS_REF CaSOF_ChargePowerSlopeSocTempMapY_pct /end AXIS_DESCR
 /begin AXIS_DESCR COM_AXIS NO_INPUT_QUANTITY VBU0706_CM_single_cnt 14 -3.4028234663852886E+38 3.4028234663852886E+38 AXIS_PTS_REF CaSOF_ChargePowerSlopeSocTempMapX_C /end AXIS_DESCR
/end CHARACTERISTIC
/begin AXIS_PTS CaSOF_ChargePowerSlopeSocTempMapX_C "" 0x700030dc NO_INPUT_QUANTITY Lookup2D_X_FLOAT32_IEEE 0 VBU0706_CM_single_cnt 14 -3.4028234663852886E+38 3.4028234663852886E+38 /end AXIS_PTS
/begin AXIS_PTS CaSOF_ChargePowerSlopeSocTempMapY_pct "" 0x70002c94 SOC_pctCellSocMax Lookup2D_X_FLOAT32_IEEE 0 VBU0706_CM_single_cnt 13 -3.4028234663852886E+38 3.4028234663852886E+38 /end AXIS_PTS
/begin CHARACTERISTIC CaTHM_OutletCoolantTempMapZ_C "" MAP 0x7000488c Lookup2D_FLOAT32_IEEE 0 VBU0706_CM_single_cnt -40.0 80.0
 /begin AXIS_DESCR COM_AXIS THM_tInletCoolantTemp VBU0706_CM_single_cnt 5 -40.0 80.0 AXIS_PTS_REF CaTHM_InletCoolantTempMapY_C /end AXIS_DESCR
 /begin AXIS_DESCR COM_AXIS CTM_tCellTempAve VBU0706_CM_single_cnt 7 -40.0 80.0 AXIS_PTS_REF CaTHM_CellTempAveMapX_C /end AXIS_DESCR
/end CHARACTERISTIC
/begin AXIS_PTS CaTHM_CellTempAveMapX_C "" 0x70001de2 CTM_tCellTempAve Lookup2D_X_FLOAT32_IEEE 0 VBU0706_CM_single_cnt 7 -40.0 80.0 /end AXIS_PTS
/begin AXIS_PTS CaTHM_InletCoolantTempMapY_C "" 0x70001872 THM_tInletCoolantTemp Lookup2D_X_FLOAT32_IEEE 0 VBU0706_CM_single_cnt 5 -40.0 80.0 /end AXIS_PTS
/begin CHARACTERISTIC INP_pVacPres_CUR_v "" CURVE 0x70001ad6 Lookup1D_FLOAT32_IEEE 0 VBU0706_CM_single_Kpa 0.0 10000.0
 /begin AXIS_DESCR COM_AXIS NO_INPUT_QUANTITY VBU0706_CM_single_mV 6 0.0 5000.0 AXIS_PTS_REF INP_uVacPres_CUR_x /end AXIS_DESCR
/end CHARACTERISTIC
/begin AXIS_PTS INP_uVacPres_CUR_x "" 0x70001aee NO_INPUT_QUANTITY Lookup1D_X_FLOAT32_IEEE 0 VBU0706_CM_single_mV 6 0.0 5000.0 /end AXIS_PTS
/begin CHARACTERISTIC INP_tDCChPortTemp_CUR_v "" CURVE 0x700037d4 Lookup1D_FLOAT32_IEEE 0 VBU0706_CM_single_C -100.0 200.0
 /begin AXIS_DESCR COM_AXIS NO_INPUT_QUANTITY VBU0706_CM_single_mV 17 0.0 5.0 AXIS_PTS_REF INP_uDCChPortTemp_CUR_x /end AXIS_DESCR
/end CHARACTERISTIC
/begin AXIS_PTS INP_uDCChPortTemp_CUR_x "" 0x700038a0 NO_INPUT_QUANTITY Lookup1D_X_FLOAT32_IEEE 0 VBU0706_CM_single_mV 17 0.0 5.0 /end AXIS_PTS
/begin CHARACTERISTIC INP_tDCChPortTempNegative_CUR_v "" CURVE 0x70003790 Lookup1D_FLOAT32_IEEE 0 VBU0706_CM_single_C -100.0 200.0
 /begin AXIS_DESCR COM_AXIS NO_INPUT_QUANTITY VBU0706_CM_single_mV 17 0.0 5.0 AXIS_PTS_REF INP_uDCChPortTempNegative_CUR_x /end AXIS_DESCR
/end CHARACTERISTIC
/begin AXIS_PTS INP_uDCChPortTempNegative_CUR_x "" 0x7000385c NO_INPUT_QUANTITY Lookup1D_X_FLOAT32_IEEE 0 VBU0706_CM_single_mV 17 0.0 5.0 /end AXIS_PTS
/begin CHARACTERISTIC INP_tEDSOutTemp_CUR_v "" CURVE 0x70003818 Lookup1D_FLOAT32_IEEE 0 VBU0706_CM_single_C -100.0 200.0
 /begin AXIS_DESCR COM_AXIS NO_INPUT_QUANTITY VBU0706_CM_single_mV 17 0.0 5.0 AXIS_PTS_REF INP_uEDSOutTemp_CUR_x /end AXIS_DESCR
/end CHARACTERISTIC
/begin AXIS_PTS INP_uEDSOutTemp_CUR_x "" 0x700038e4 NO_INPUT_QUANTITY Lookup1D_X_FLOAT32_IEEE 0 VBU0706_CM_single_mV 17 0.0 5.0 /end AXIS_PTS
/begin CHARACTERISTIC APO_AxAccelerationOvrdVal_C "" VALUE 0x7000016c Scalar_FLOAT32_IEEE 0 VBU0706_CM_single_cnt -3.4028234663852886E+38 3.4028234663852886E+38 /end CHARACTERISTIC
/begin CHARACTERISTIC APO_AyAccelerationOvrdVal_C "" VALUE 0x70000170 Scalar_FLOAT32_IEEE 0 VBU0706_CM_single_cnt -3.4028234663852886E+38 3.4028234663852886E+38 /end CHARACTERISTIC
/begin CHARACTERISTIC APO_AzAccelerationOvrdVal_C "" VALUE 0x70000174 Scalar_FLOAT32_IEEE 0 VBU0706_CM_single_cnt -3.4028234663852886E+38 3.4028234663852886E+38 /end CHARACTERISTIC
/begin CHARACTERISTIC APO_HundredKmTripEnergyOvrdVal_C "" VALUE 0x70000194 Scalar_FLOAT32_IEEE 0 VBU0706_CM_single_cnt -3.4028234663852886E+38 3.4028234663852886E+38 /end CHARACTERISTIC
/begin CHARACTERISTIC APO_RemainingChargingTimeOvrdVal_C "" VALUE 0x700001a8 Scalar_FLOAT32_IEEE 0 VBU0706_CM_single_cnt -3.4028234663852886E+38 3.4028234663852886E+38 /end CHARACTERISTIC
/begin CHARACTERISTIC APO_RemainingDrivingRangeOvrdVal_C "" VALUE 0x700001ac Scalar_FLOAT32_IEEE 0 VBU0706_CM_single_cnt -3.4028234663852886E+38 3.4028234663852886E+38 /end CHARACTERISTIC
/begin CHARACTERISTIC APO_SOCLowWarningOvrdVal_C "" VALUE 0x700001b0 Scalar_FLOAT32_IEEE 0 VBU0706_CM_single_cnt -3.4028234663852886E+38 3.4028234663852886E+38 /end CHARACTERISTIC
/begin CHARACTERISTIC APO_TenkmTripEnergyOvrdVal_C "" VALUE 0x700001b4 Scalar_FLOAT32_IEEE 0 VBU0706_CM_single_cnt -3.4028234663852886E+38 3.4028234663852886E+38 /end CHARACTERISTIC
/begin CHARACTERISTIC APO_TotalChargeEnergyOvrdVal_C "" VALUE 0x700001b8 Scalar_FLOAT32_IEEE 0 VBU0706_CM_single_cnt -3.4028234663852886E+38 3.4028234663852886E+38 /end CHARACTERISTIC
/begin CHARACTERISTIC APO_TotalDischargeEnergyOvrdVal_C "" VALUE 0x700001bc Scalar_FLOAT32_IEEE 0 VBU0706_CM_single_cnt -3.4028234663852886E+38 3.4028234663852886E+38 /end CHARACTERISTIC
/begin CHARACTERISTIC APO_YawrateOvrdVal_C "" VALUE 0x700001c4 Scalar_FLOAT32_IEEE 0 VBU0706_CM_single_cnt -3.4028234663852886E+38 3.4028234663852886E+38 /end CHARACTERISTIC
/begin CHARACTERISTIC APO_flgBMSThermalRunawayOvrdVal_C "" VALUE 0x700001e0 Scalar_FLOAT32_IEEE 0 VBU0706_CM_single_cnt -3.4028234663852886E+38 3.4028234663852886E+38 /end CHARACTERISTIC
/begin CHARACTERISTIC APO_flgBrkSwtOvrdVal_C "" VALUE 0x700001e4 Scalar_FLOAT32_IEEE 0 VBU0706_CM_single_cnt -3.4028234663852886E+38 3.4028234663852886E+38 /end CHARACTERISTIC
/begin CHARACTERISTIC APO_iBMSPackCurrentOvrdVal_C "" VALUE 0x700001e8 Scalar_FLOAT32_IEEE 0 VBU0706_CM_single_cnt -3.4028234663852886E+38 3.4028234663852886E+38 /end CHARACTERISTIC
/begin CHARACTERISTIC APO_pBrkPressOvrdVal_C "" VALUE 0x700001ec Scalar_FLOAT32_IEEE 0 VBU0706_CM_single_cnt -3.4028234663852886E+38 3.4028234663852886E+38 /end CHARACTERISTIC
/begin CHARACTERISTIC APO_pctAccPedPosOvrdVal_C "" VALUE 0x700001f4 Scalar_FLOAT32_IEEE 0 VBU0706_CM_single_cnt -3.4028234663852886E+38 3.4028234663852886E+38 /end CHARACTERISTIC
/begin CHARACTERISTIC APO_pctBMSDIsplaySOCOvrdVal_C "" VALUE 0x700001f8 Scalar_FLOAT32_IEEE 0 VBU0706_CM_single_cnt -3.4028234663852886E+38 3.4028234663852886E+38 /end CHARACTERISTIC
/begin CHARACTERISTIC APO_pctBMSSOCOvrdVal_C "" VALUE 0x700001fc Scalar_FLOAT32_IEEE 0 VBU0706_CM_single_cnt -3.4028234663852886E+38 3.4028234663852886E+38 /end CHARACTERISTIC
/begin CHARACTERISTIC APO_pctEfcAccPdlOvrdVal_C "" VALUE 0x70000200 Scalar_FLOAT32_IEEE 0 VBU0706_CM_single_cnt -3.4028234663852886E+38 3.4028234663852886E+38 /end CHARACTERISTIC
/begin CHARACTERISTIC APO_tBMSInletTempOvrdVal_C "" VALUE 0x70000214 Scalar_FLOAT32_IEEE 0 VBU0706_CM_single_cnt -3.4028234663852886E+38 3.4028234663852886E+38 /end CHARACTERISTIC
/begin CHARACTERISTIC APO_tBMSOutletTempOvrdVal_C "" VALUE 0x70000218 Scalar_FLOAT32_IEEE 0 VBU0706_CM_single_cnt -3.4028234663852886E+38 3.4028234663852886E+38 /end CHARACTERISTIC
/begin CHARACTERISTIC APO_uLVBattOvrdVal_C "" VALUE 0x7000021c Scalar_FLOAT32_IEEE 0 VBU0706_CM_single_cnt -3.4028234663852886E+38 3.4028234663852886E+38 /end CHARACTERISTIC
/begin CHARACTERISTIC APO_vBMSPackVoltageOvrdVal_C "" VALUE 0x70000220 Scalar_FLOAT32_IEEE 0 VBU0706_CM_single_cnt -3.4028234663852886E+38 3.4028234663852886E+38 /end CHARACTERISTIC
/begin CHARACTERISTIC CcFCC_ChargeAbortDelayTime_s "" VALUE 0x700004d8 Scalar_FLOAT32_IEEE 0 VBU0706_CM_single_cnt -3.4028234663852886E+38 3.4028234663852886E+38 /end CHARACTERISTIC
/begin CHARACTERISTIC CcFCC_ChargeCurrentOverDelta_A "" VALUE 0x700004ec Scalar_FLOAT32_IEEE 0 VBU0706_CM_single_cnt -3.4028234663852886E+38 3.4028234663852886E+38 /end CHARACTERISTIC
/begin CHARACTERISTIC CcFCC_ChargeCurrentOver_A "" VALUE 0x700004f0 Scalar_FLOAT32_IEEE 0 VBU0706_CM_single_cnt -3.4028234663852886E+38 3.4028234663852886E+38 /end CHARACTERISTIC
/begin CHARACTERISTIC CcFCC_ChargeFaultDelayTime_s "" VALUE 0x700004f8 Scalar_FLOAT32_IEEE 0 VBU0706_CM_single_cnt -3.4028234663852886E+38 3.4028234663852886E+38 /end CHARACTERISTIC
/begin CHARACTERISTIC CcFCC_ChargeFullDelayTime_s "" VALUE 0x700004fc Scalar_FLOAT32_IEEE 0 VBU0706_CM_single_cnt -3.4028234663852886E+38 3.4028234663852886E+38 /end CHARACTERISTIC
/begin CHARACTERISTIC CcFCC_ChargeProtectDelayTime_s "" VALUE 0x70000508 Scalar_FLOAT32_IEEE 0 VBU0706_CM_single_cnt -3.4028234663852886E+38 3.4028234663852886E+38 /end CHARACTERISTIC
/begin CHARACTERISTIC CcFCC_EightyCustomSOC_pct "" VALUE 0x7000052c Scalar_FLOAT32_IEEE 0 VBU0706_CM_single_cnt -3.4028234663852886E+38 3.4028234663852886E+38 /end CHARACTERISTIC
/begin CHARACTERISTIC CcFCC_EstimateChargeInvalidTime_min "" VALUE 0x70000530 Scalar_FLOAT32_IEEE 0 VBU0706_CM_single_cnt -3.4028234663852886E+38 3.4028234663852886E+38 /end CHARACTERISTIC
/begin CHARACTERISTIC CcSOC_BatterySocHighFault10Cycles_pct "" VALUE 0x700005b8 Scalar_FLOAT32_IEEE 0 VBU0706_CM_single_cnt -3.4028234663852886E+38 3.4028234663852886E+38 /end CHARACTERISTIC
/begin CHARACTERISTIC CcSOC_BatterySocHighFault70Cycles_pct "" VALUE 0x700005bc Scalar_FLOAT32_IEEE 0 VBU0706_CM_single_cnt -3.4028234663852886E+38 3.4028234663852886E+38 /end CHARACTERISTIC
/begin CHARACTERISTIC CcSOC_BatterySocHighFault_pct "" VALUE 0x700005c0 Scalar_FLOAT32_IEEE 0 VBU0706_CM_single_cnt -3.4028234663852886E+38 3.4028234663852886E+38 /end CHARACTERISTIC
/begin CHARACTERISTIC CcSOC_BatterySocLowerLimit_pct "" VALUE 0x700005c4 Scalar_FLOAT32_IEEE 0 VBU0706_CM_single_cnt -3.4028234663852886E+38 3.4028234663852886E+38 /end CHARACTERISTIC
/begin CHARACTERISTIC CcSOC_BatterySocUpperLimit_pct "" VALUE 0x700005cc Scalar_FLOAT32_IEEE 0 VBU0706_CM_single_cnt -3.4028234663852886E+38 3.4028234663852886E+38 /end CHARACTERISTIC
/begin CHARACTERISTIC CcSOC_BatteryUsableSocLowerLimit10Cycles_pct "" VALUE 0x700005d0 Scalar_FLOAT32_IEEE 0 VBU0706_CM_single_cnt -3.4028234663852886E+38 3.4028234663852886E+38 /end CHARACTERISTIC
/begin CHARACTERISTIC CcSOC_BatteryUsableSocLowerLimit70Cycles_pct "" VALUE 0x700005d4 Scalar_FLOAT32_IEEE 0 VBU0706_CM_single_cnt -3.4028234663852886E+38 3.4028234663852886E+38 /end CHARACTERISTIC
/begin CHARACTERISTIC CcSOC_BatteryUsableSocLowerLimitHomo_pct "" VALUE 0x700005d8 Scalar_FLOAT32_IEEE 0 VBU0706_CM_single_cnt -3.4028234663852886E+38 3.4028234663852886E+38 /end CHARACTERISTIC
/begin CHARACTERISTIC CcSOC_BatteryUsableSocLowerLimit_pct "" VALUE 0x700005dc Scalar_FLOAT32_IEEE 0 VBU0706_CM_single_cnt -3.4028234663852886E+38 3.4028234663852886E+38 /end CHARACTERISTIC
/begin CHARACTERISTIC CcSOC_BatteryUsableSocUpperLimit10Cycles_pct "" VALUE 0x700005e0 Scalar_FLOAT32_IEEE 0 VBU0706_CM_single_cnt -3.4028234663852886E+38 3.4028234663852886E+38 /end CHARACTERISTIC
/begin CHARACTERISTIC CcSOC_BatteryUsableSocUpperLimit70Cycles_pct "" VALUE 0x700005e4 Scalar_FLOAT32_IEEE 0 VBU0706_CM_single_cnt -3.4028234663852886E+38 3.4028234663852886E+38 /end CHARACTERISTIC
/begin CHARACTERISTIC CcSOC_BatteryUsableSocUpperLimitHomo_pct "" VALUE 0x700005e8 Scalar_FLOAT32_IEEE 0 VBU0706_CM_single_cnt -3.4028234663852886E+38 3.4028234663852886E+38 /end CHARACTERISTIC
/begin CHARACTERISTIC CcSOC_BatteryUsableSocUpperLimit_pct "" VALUE 0x700005ec Scalar_FLOAT32_IEEE 0 VBU0706_CM_single_cnt -3.4028234663852886E+38 3.4028234663852886E+38 /end CHARACTERISTIC
/begin CHARACTERISTIC CcSOC_CellArraySOCOvrdVal_pct "" VALUE 0x700005f8 Scalar_FLOAT32_IEEE 0 VBU0706_CM_single_cnt -3.4028234663852886E+38 3.4028234663852886E+38 /end CHARACTERISTIC
/begin CHARACTERISTIC CcSOC_CellSocLowerLimit_pct "" VALUE 0x70000608 Scalar_FLOAT32_IEEE 0 VBU0706_CM_single_cnt -3.4028234663852886E+38 3.4028234663852886E+38 /end CHARACTERISTIC
/begin CHARACTERISTIC CcSOC_CellSocUpperLimit_pct "" VALUE 0x70000614 Scalar_FLOAT32_IEEE 0 VBU0706_CM_single_cnt -3.4028234663852886E+38 3.4028234663852886E+38 /end CHARACTERISTIC
/begin CHARACTERISTIC CcSOC_OcvShortTimeSocErrorThreshold_pct "" VALUE 0x70000660 Scalar_FLOAT32_IEEE 0 VBU0706_CM_single_cnt -3.4028234663852886E+38 3.4028234663852886E+38 /end CHARACTERISTIC
/begin CHARACTERISTIC CcSOC_OcvShortTimeVolDiffDis_mV "" VALUE 0x70000664 Scalar_FLOAT32_IEEE 0 VBU0706_CM_single_cnt -3.4028234663852886E+38 3.4028234663852886E+38 /end CHARACTERISTIC
/begin CHARACTERISTIC CcSOE_DischargeCutOffSoc_pct "" VALUE 0x70000680 Scalar_FLOAT32_IEEE 0 VBU0706_CM_single_cnt -3.4028234663852886E+38 3.4028234663852886E+38 /end CHARACTERISTIC
/begin CHARACTERISTIC CcSOE_EnergyDecRate_Kwh "" VALUE 0x70000684 Scalar_FLOAT32_IEEE 0 VBU0706_CM_single_cnt -3.4028234663852886E+38 3.4028234663852886E+38 /end CHARACTERISTIC
/begin CHARACTERISTIC CcSOE_EnergyIncRate_Kwh "" VALUE 0x70000688 Scalar_FLOAT32_IEEE 0 VBU0706_CM_single_cnt -3.4028234663852886E+38 3.4028234663852886E+38 /end CHARACTERISTIC
/begin CHARACTERISTIC CcSOF_CapacityScalingFactor_n "" VALUE 0x700006ac Scalar_FLOAT32_IEEE 0 VBU0706_CM_single_cnt -3.4028234663852886E+38 3.4028234663852886E+38 /end CHARACTERISTIC
/begin CHARACTERISTIC CcSOF_ChargeCurrentSlopeFccMode_A "" VALUE 0x700006bc Scalar_FLOAT32_IEEE 0 VBU0706_CM_single_cnt -3.4028234663852886E+38 3.4028234663852886E+38 /end CHARACTERISTIC
/begin CHARACTERISTIC CcSOF_ChargeCurrentSlope_A "" VALUE 0x700006c0 Scalar_FLOAT32_IEEE 0 VBU0706_CM_single_cnt -3.4028234663852886E+38 3.4028234663852886E+38 /end CHARACTERISTIC
/begin CHARACTERISTIC CcSOF_ChargePowerLimitViolationThreshold_Kws "" VALUE 0x700006c4 Scalar_FLOAT32_IEEE 0 VBU0706_CM_single_cnt -3.4028234663852886E+38 3.4028234663852886E+38 /end CHARACTERISTIC
/begin CHARACTERISTIC CcSOF_DischargeCurrentSlope_A "" VALUE 0x7000071c Scalar_FLOAT32_IEEE 0 VBU0706_CM_single_cnt -3.4028234663852886E+38 3.4028234663852886E+38 /end CHARACTERISTIC
/begin CHARACTERISTIC CcSOF_DischargePowerLimitViolationThreshold_Kws "" VALUE 0x70000734 Scalar_FLOAT32_IEEE 0 VBU0706_CM_single_cnt -3.4028234663852886E+38 3.4028234663852886E+38 /end CHARACTERISTIC
/begin CHARACTERISTIC CcSOF_LowTempOverCurrentBufferEmpty_As "" VALUE 0x70000798 Scalar_FLOAT32_IEEE 0 VBU0706_CM_single_cnt -3.4028234663852886E+38 3.4028234663852886E+38 /end CHARACTERISTIC
/begin CHARACTERISTIC CcSOF_LowTempOverCurrent_A "" VALUE 0x7000079c Scalar_FLOAT32_IEEE 0 VBU0706_CM_single_cnt -3.4028234663852886E+38 3.4028234663852886E+38 /end CHARACTERISTIC
/begin CHARACTERISTIC CcSYS_BatteryRatedVoltage_V "" VALUE 0x7000089c Scalar_FLOAT32_IEEE 0 VBU0706_CM_single_cnt -3.4028234663852886E+38 3.4028234663852886E+38 /end CHARACTERISTIC
/begin CHARACTERISTIC CcSYS_CellSOCLockedMax_pct "" VALUE 0x700008a0 Scalar_FLOAT32_IEEE 0 VBU0706_CM_single_cnt -3.4028234663852886E+38 3.4028234663852886E+38 /end CHARACTERISTIC
/begin CHARACTERISTIC CcSYS_CellSOCLockedMin_pct "" VALUE 0x700008a4 Scalar_FLOAT32_IEEE 0 VBU0706_CM_single_cnt -3.4028234663852886E+38 3.4028234663852886E+38 /end CHARACTERISTIC
/begin CHARACTERISTIC CcSYS_FullChargeSoc_pct "" VALUE 0x700008a8 Scalar_FLOAT32_IEEE 0 VBU0706_CM_single_pct -3.4028234663852886E+38 3.4028234663852886E+38 /end CHARACTERISTIC
/begin CHARACTERISTIC CcTHM_CoolantSensorOorHigh_C "" VALUE 0x700008cc Scalar_FLOAT32_IEEE 0 VBU0706_CM_single_cnt -3.4028234663852886E+38 3.4028234663852886E+38 /end CHARACTERISTIC
/begin CHARACTERISTIC CcTHM_CoolantSensorOorLow_C "" VALUE 0x700008d0 Scalar_FLOAT32_IEEE 0 VBU0706_CM_single_cnt -3.4028234663852886E+38 3.4028234663852886E+38 /end CHARACTERISTIC
/begin CHARACTERISTIC CcTHM_CoolingReponseCellTemp_C "" VALUE 0x700008d4 Scalar_FLOAT32_IEEE 0 VBU0706_CM_single_cnt -3.4028234663852886E+38 3.4028234663852886E+38 /end CHARACTERISTIC
/begin CHARACTERISTIC CcTHM_CoolingReponseInletTemp_C "" VALUE 0x700008d8 Scalar_FLOAT32_IEEE 0 VBU0706_CM_single_cnt -3.4028234663852886E+38 3.4028234663852886E+38 /end CHARACTERISTIC
/begin CHARACTERISTIC CcTHM_InletCoolingTempDeviation_C "" VALUE 0x700008f4 Scalar_FLOAT32_IEEE 0 VBU0706_CM_single_cnt -3.4028234663852886E+38 3.4028234663852886E+38 /end CHARACTERISTIC
/begin CHARACTERISTIC CcTHM_InletOutletTempDeltaThreshold_C "" VALUE 0x700008f8 Scalar_FLOAT32_IEEE 0 VBU0706_CM_single_cnt -3.4028234663852886E+38 3.4028234663852886E+38 /end CHARACTERISTIC
/begin CHARACTERISTIC CcVCT_SOCJumpSOCLow_pct "" VALUE 0x70000994 Scalar_FLOAT32_IEEE 0 VBU0706_CM_single_pct -3.4028234663852886E+38 3.4028234663852886E+38 /end CHARACTERISTIC
/begin CHARACTERISTIC CcVCT_SOCJumpThreshold_pct "" VALUE 0x70000998 Scalar_FLOAT32_IEEE 0 VBU0706_CM_single_pct -3.4028234663852886E+38 3.4028234663852886E+38 /end CHARACTERISTIC
/begin CHARACTERISTIC CcVCT_SOCLowWarningThreshold1_pct "" VALUE 0x7000099c Scalar_FLOAT32_IEEE 0 VBU0706_CM_single_pct -3.4028234663852886E+38 3.4028234663852886E+38 /end CHARACTERISTIC
/begin CHARACTERISTIC CcVCT_SOCLowWarningThreshold2_pct "" VALUE 0x700009a0 Scalar_FLOAT32_IEEE 0 VBU0706_CM_single_pct -3.4028234663852886E+38 3.4028234663852886E+38 /end CHARACTERISTIC
/begin CHARACTERISTIC CcVCT_SocInitializationMaxTime_ms "" VALUE 0x700009a4 Scalar_FLOAT32_IEEE 0 VBU0706_CM_single_ms -3.4028234663852886E+38 3.4028234663852886E+38 /end CHARACTERISTIC
/begin CHARACTERISTIC DCH_facLimitChrCrnntLvl0V_C "" VALUE 0x700009e4 Scalar_FLOAT32_IEEE 0 VBU0706_CM_single_cnt -3.4028234663852886E+38 3.4028234663852886E+38 /end CHARACTERISTIC
/begin CHARACTERISTIC DCH_facLimitChrCrnntLvl1V_C "" VALUE 0x700009e8 Scalar_FLOAT32_IEEE 0 VBU0706_CM_single_cnt -3.4028234663852886E+38 3.4028234663852886E+38 /end CHARACTERISTIC
/begin CHARACTERISTIC DCH_facLimitChrCrnntLvl2V_C "" VALUE 0x700009ec Scalar_FLOAT32_IEEE 0 VBU0706_CM_single_cnt -3.4028234663852886E+38 3.4028234663852886E+38 /end CHARACTERISTIC
/begin CHARACTERISTIC DCH_facLimitChrCrnntLvl3V_C "" VALUE 0x700009f0 Scalar_FLOAT32_IEEE 0 VBU0706_CM_single_cnt -3.4028234663852886E+38 3.4028234663852886E+38 /end CHARACTERISTIC
/begin CHARACTERISTIC DCH_iBCLCurrReqOvrdVal_C "" VALUE 0x700009f4 Scalar_FLOAT32_IEEE 0 VBU0706_CM_single_cnt -3.4028234663852886E+38 3.4028234663852886E+38 /end CHARACTERISTIC
/begin CHARACTERISTIC DCH_iCMLMinChCurr_C "" VALUE 0x70000a08 Scalar_FLOAT32_IEEE 0 VBU0706_CM_single_cnt -3.4028234663852886E+38 3.4028234663852886E+38 /end CHARACTERISTIC
/begin CHARACTERISTIC DCH_iDCChReqLowLim_C "" VALUE 0x70000a0c Scalar_FLOAT32_IEEE 0 VBU0706_CM_single_cnt -3.4028234663852886E+38 3.4028234663852886E+38 /end CHARACTERISTIC
/begin CHARACTERISTIC DCH_iDCChReqUpLim_C "" VALUE 0x70000a10 Scalar_FLOAT32_IEEE 0 VBU0706_CM_single_cnt -3.4028234663852886E+38 3.4028234663852886E+38 /end CHARACTERISTIC
/begin CHARACTERISTIC DCH_iStatnLackCrnntThres_C "" VALUE 0x70000a1c Scalar_FLOAT32_IEEE 0 VBU0706_CM_single_cnt -3.4028234663852886E+38 3.4028234663852886E+38 /end CHARACTERISTIC
/begin CHARACTERISTIC DCH_numBCSMaxCellNumLowLim_C "" VALUE 0x70000a20 Scalar_FLOAT32_IEEE 0 VBU0706_CM_single_cnt -3.4028234663852886E+38 3.4028234663852886E+38 /end CHARACTERISTIC
/begin CHARACTERISTIC DCH_numBCSMaxCellNumUpLim_C "" VALUE 0x70000a24 Scalar_FLOAT32_IEEE 0 VBU0706_CM_single_cnt -3.4028234663852886E+38 3.4028234663852886E+38 /end CHARACTERISTIC
/begin CHARACTERISTIC DCH_pctBSDChEndSocOvrdVal_C "" VALUE 0x70000a48 Scalar_FLOAT32_IEEE 0 VBU0706_CM_single_cnt -3.4028234663852886E+38 3.4028234663852886E+38 /end CHARACTERISTIC
/begin CHARACTERISTIC DCH_tBCPMaxPermitTempLowLim_C "" VALUE 0x70000a4c Scalar_FLOAT32_IEEE 0 VBU0706_CM_single_cnt -3.4028234663852886E+38 3.4028234663852886E+38 /end CHARACTERISTIC
/begin CHARACTERISTIC DCH_tBCPMaxPermitTempUpLim_C "" VALUE 0x70000a54 Scalar_FLOAT32_IEEE 0 VBU0706_CM_single_cnt -3.4028234663852886E+38 3.4028234663852886E+38 /end CHARACTERISTIC
/begin CHARACTERISTIC DCH_tBSDMaxCellTempOvrdVal_C "" VALUE 0x70000a58 Scalar_FLOAT32_IEEE 0 VBU0706_CM_single_cnt -3.4028234663852886E+38 3.4028234663852886E+38 /end CHARACTERISTIC
/begin CHARACTERISTIC DCH_tBSDMinCellTempOvrdVal_C "" VALUE 0x70000a5c Scalar_FLOAT32_IEEE 0 VBU0706_CM_single_cnt -3.4028234663852886E+38 3.4028234663852886E+38 /end CHARACTERISTIC
/begin CHARACTERISTIC DCH_tBSMMaxCellTempOvrdVal_C "" VALUE 0x70000a60 Scalar_FLOAT32_IEEE 0 VBU0706_CM_single_cnt -3.4028234663852886E+38 3.4028234663852886E+38 /end CHARACTERISTIC
/begin CHARACTERISTIC DCH_tBSMMinCellTempOvrdVal_C "" VALUE 0x70000a64 Scalar_FLOAT32_IEEE 0 VBU0706_CM_single_cnt -3.4028234663852886E+38 3.4028234663852886E+38 /end CHARACTERISTIC
/begin CHARACTERISTIC DCH_tLimitChrCrnntLvl1L_C "" VALUE 0x70000a6c Scalar_FLOAT32_IEEE 0 VBU0706_CM_single_cnt -3.4028234663852886E+38 3.4028234663852886E+38 /end CHARACTERISTIC
/begin CHARACTERISTIC DCH_tLimitChrCrnntLvl1R_C "" VALUE 0x70000a70 Scalar_FLOAT32_IEEE 0 VBU0706_CM_single_cnt -3.4028234663852886E+38 3.4028234663852886E+38 /end CHARACTERISTIC
/begin CHARACTERISTIC DCH_tLimitChrCrnntLvl2L_C "" VALUE 0x70000a74 Scalar_FLOAT32_IEEE 0 VBU0706_CM_single_cnt -3.4028234663852886E+38 3.4028234663852886E+38 /end CHARACTERISTIC
/begin CHARACTERISTIC DCH_tLimitChrCrnntLvl2R_C "" VALUE 0x70000a78 Scalar_FLOAT32_IEEE 0 VBU0706_CM_single_cnt -3.4028234663852886E+38 3.4028234663852886E+38 /end CHARACTERISTIC
/begin CHARACTERISTIC DCH_tLimitChrCrnntLvl3L_C "" VALUE 0x70000a7c Scalar_FLOAT32_IEEE 0 VBU0706_CM_single_cnt -3.4028234663852886E+38 3.4028234663852886E+38 /end CHARACTERISTIC
/begin CHARACTERISTIC DCH_tLimitChrCrnntLvl3R_C "" VALUE 0x70000a80 Scalar_FLOAT32_IEEE 0 VBU0706_CM_single_cnt -3.4028234663852886E+38 3.4028234663852886E+38 /end CHARACTERISTIC
/begin CHARACTERISTIC DCH_tiBCSEstChTiLowLim_C "" VALUE 0x70000a98 Scalar_FLOAT32_IEEE 0 VBU0706_CM_single_cnt -3.4028234663852886E+38 3.4028234663852886E+38 /end CHARACTERISTIC
/begin CHARACTERISTIC DCH_tiBCSEstChTiUpLim_C "" VALUE 0x70000a9c Scalar_FLOAT32_IEEE 0 VBU0706_CM_single_cnt -3.4028234663852886E+38 3.4028234663852886E+38 /end CHARACTERISTIC
/begin CHARACTERISTIC DCH_tiCCSTOut_C "" VALUE 0x70000ab0 Scalar_FLOAT32_IEEE 0 VBU0706_CM_single_cnt -3.4028234663852886E+38 3.4028234663852886E+38 /end CHARACTERISTIC
/begin CHARACTERISTIC DCH_tiCHMtoCRMTOut_C "" VALUE 0x70000ab4 Scalar_FLOAT32_IEEE 0 VBU0706_CM_single_cnt -3.4028234663852886E+38 3.4028234663852886E+38 /end CHARACTERISTIC
/begin CHARACTERISTIC DCH_tiCRM00TOutStrtFrmCHM_C "" VALUE 0x70000ab8 Scalar_FLOAT32_IEEE 0 VBU0706_CM_single_cnt -3.4028234663852886E+38 3.4028234663852886E+38 /end CHARACTERISTIC
/begin CHARACTERISTIC DCH_tiCRM00TOut_C "" VALUE 0x70000abc Scalar_FLOAT32_IEEE 0 VBU0706_CM_single_cnt -3.4028234663852886E+38 3.4028234663852886E+38 /end CHARACTERISTIC
/begin CHARACTERISTIC DCH_tiCRMAATOut_C "" VALUE 0x70000ac0 Scalar_FLOAT32_IEEE 0 VBU0706_CM_single_cnt -3.4028234663852886E+38 3.4028234663852886E+38 /end CHARACTERISTIC
/begin CHARACTERISTIC DCH_tiCROAATOutStrtFrmBRO_C "" VALUE 0x70000ac4 Scalar_FLOAT32_IEEE 0 VBU0706_CM_single_cnt -3.4028234663852886E+38 3.4028234663852886E+38 /end CHARACTERISTIC
/begin CHARACTERISTIC DCH_tiCROAATOut_C "" VALUE 0x70000ac8 Scalar_FLOAT32_IEEE 0 VBU0706_CM_single_cnt -3.4028234663852886E+38 3.4028234663852886E+38 /end CHARACTERISTIC
/begin CHARACTERISTIC DCH_tiCSTTOut_C "" VALUE 0x70000acc Scalar_FLOAT32_IEEE 0 VBU0706_CM_single_cnt -3.4028234663852886E+38 3.4028234663852886E+38 /end CHARACTERISTIC
/begin CHARACTERISTIC DCH_tiChCap_C "" VALUE 0x70000ad4 Scalar_FLOAT32_IEEE 0 VBU0706_CM_single_cnt -3.4028234663852886E+38 3.4028234663852886E+38 /end CHARACTERISTIC
/begin CHARACTERISTIC DCH_tiChRdy_C "" VALUE 0x70000ad8 Scalar_FLOAT32_IEEE 0 VBU0706_CM_single_cnt -3.4028234663852886E+38 3.4028234663852886E+38 /end CHARACTERISTIC
/begin CHARACTERISTIC DCH_tiChgrAvl_C "" VALUE 0x70000adc Scalar_FLOAT32_IEEE 0 VBU0706_CM_single_cnt -3.4028234663852886E+38 3.4028234663852886E+38 /end CHARACTERISTIC
/begin CHARACTERISTIC DCH_tiDCChRly_C "" VALUE 0x70000ae8 Scalar_FLOAT32_IEEE 0 VBU0706_CM_single_cnt -3.4028234663852886E+38 3.4028234663852886E+38 /end CHARACTERISTIC
/begin CHARACTERISTIC DCH_tiDCRlyDiagDly_C "" VALUE 0x70000aec Scalar_FLOAT32_IEEE 0 VBU0706_CM_single_cnt -3.4028234663852886E+38 3.4028234663852886E+38 /end CHARACTERISTIC
/begin CHARACTERISTIC DCH_tiDlyCCSnotChging_C "" VALUE 0x70000af4 Scalar_FLOAT32_IEEE 0 VBU0706_CM_single_cnt -3.4028234663852886E+38 3.4028234663852886E+38 /end CHARACTERISTIC
/begin CHARACTERISTIC DCH_tiOpenHvRly_C "" VALUE 0x70000af8 Scalar_FLOAT32_IEEE 0 VBU0706_CM_single_cnt -3.4028234663852886E+38 3.4028234663852886E+38 /end CHARACTERISTIC
/begin CHARACTERISTIC DCH_tiReStartChProcess_C "" VALUE 0x70000afc Scalar_FLOAT32_IEEE 0 VBU0706_CM_single_cnt -3.4028234663852886E+38 3.4028234663852886E+38 /end CHARACTERISTIC
/begin CHARACTERISTIC DCH_tiSmplT_SY "" VALUE 0x70000b00 Scalar_FLOAT32_IEEE 0 VBU0706_CM_single_cnt -3.4028234663852886E+38 3.4028234663852886E+38 /end CHARACTERISTIC
/begin CHARACTERISTIC DCH_tiStatnLackCrnntThres_C "" VALUE 0x70000b04 Scalar_FLOAT32_IEEE 0 VBU0706_CM_single_cnt -3.4028234663852886E+38 3.4028234663852886E+38 /end CHARACTERISTIC
/begin CHARACTERISTIC DCH_tisinceBEMCEMTOut_C "" VALUE 0x70000b08 Scalar_FLOAT32_IEEE 0 VBU0706_CM_single_cnt -3.4028234663852886E+38 3.4028234663852886E+38 /end CHARACTERISTIC
/begin CHARACTERISTIC DCH_tisinceBSTSentOutTOut_C "" VALUE 0x70000b0c Scalar_FLOAT32_IEEE 0 VBU0706_CM_single_cnt -3.4028234663852886E+38 3.4028234663852886E+38 /end CHARACTERISTIC
/begin CHARACTERISTIC DCH_uBCLVltgReqOvrdVal_C "" VALUE 0x70000b10 Scalar_FLOAT32_IEEE 0 VBU0706_CM_single_cnt -3.4028234663852886E+38 3.4028234663852886E+38 /end CHARACTERISTIC
/begin CHARACTERISTIC DCH_uBSDMaxCellVltgOvrdVal_C "" VALUE 0x70000b2c Scalar_FLOAT32_IEEE 0 VBU0706_CM_single_cnt -3.4028234663852886E+38 3.4028234663852886E+38 /end CHARACTERISTIC
/begin CHARACTERISTIC DCH_uBSDMinCellVltgOvrdVal_C "" VALUE 0x70000b30 Scalar_FLOAT32_IEEE 0 VBU0706_CM_single_cnt -3.4028234663852886E+38 3.4028234663852886E+38 /end CHARACTERISTIC
/begin CHARACTERISTIC DCH_uDCChReqLowLim_C "" VALUE 0x70000b34 Scalar_FLOAT32_IEEE 0 VBU0706_CM_single_cnt -3.4028234663852886E+38 3.4028234663852886E+38 /end CHARACTERISTIC
/begin CHARACTERISTIC DCH_uDCChReqUpLim_C "" VALUE 0x70000b38 Scalar_FLOAT32_IEEE 0 VBU0706_CM_single_cnt -3.4028234663852886E+38 3.4028234663852886E+38 /end CHARACTERISTIC
/begin CHARACTERISTIC INP_pVacPresCaliOvrdVal_C "" VALUE 0x70000dc4 Scalar_FLOAT32_IEEE 0 VBU0706_CM_single_bar 0.0 200.0 /end CHARACTERISTIC
/begin CHARACTERISTIC INP_tDCChPortTempCaliOvrdVal_C "" VALUE 0x70000dc8 Scalar_FLOAT32_IEEE 0 VBU0706_CM_single_C -100.0 200.0 /end CHARACTERISTIC
/begin CHARACTERISTIC INP_tDCChPortTempNegativeCaliOvrdVal_C "" VALUE 0x70000dcc Scalar_FLOAT32_IEEE 0 VBU0706_CM_single_cnt -3.4E+38 3.4E+38 /end CHARACTERISTIC
/begin CHARACTERISTIC INP_tDCChPortTempNegativeSafetyVal_C "" VALUE 0x70000dd0 Scalar_FLOAT32_IEEE 0 VBU0706_CM_single_cnt -3.4E+38 3.4E+38 /end CHARACTERISTIC
/begin CHARACTERISTIC INP_tDCChPortTempSafetyVal_C "" VALUE 0x70000dd4 Scalar_FLOAT32_IEEE 0 VBU0706_CM_single_cnt -3.4E+38 3.4E+38 /end CHARACTERISTIC
/begin CHARACTERISTIC INP_tEDSOutTempCaliOvrdVal_C "" VALUE 0x70000dd8 Scalar_FLOAT32_IEEE 0 VBU0706_CM_single_cnt -3.4E+38 3.4E+38 /end CHARACTERISTIC
/begin CHARACTERISTIC INP_tEDSOutTempSafetyVal_C "" VALUE 0x70000ddc Scalar_FLOAT32_IEEE 0 VBU0706_CM_single_cnt -3.4E+38 3.4E+38 /end CHARACTERISTIC
/begin CHARACTERISTIC INP_uAccPed1CaliOvrdVal_C "" VALUE 0x70000de0 Scalar_FLOAT32_IEEE 0 VBU0706_CM_single_cnt 0.0 30.0 /end CHARACTERISTIC
/begin CHARACTERISTIC INP_uAccPed1RangeMax_C "" VALUE 0x70000de4 Scalar_FLOAT32_IEEE 0 VBU0706_CM_single_cnt 0.0 30.0 /end CHARACTERISTIC
/begin CHARACTERISTIC INP_uAccPed1RangeMin_C "" VALUE 0x70000de8 Scalar_FLOAT32_IEEE 0 VBU0706_CM_single_cnt 0.0 30.0 /end CHARACTERISTIC
/begin CHARACTERISTIC INP_uAccPed1SafetyVal_C "" VALUE 0x70000dec Scalar_FLOAT32_IEEE 0 VBU0706_CM_single_cnt 0.0 30.0 /end CHARACTERISTIC
/begin CHARACTERISTIC INP_uAccPed2CaliOvrdVal_C "" VALUE 0x70000df0 Scalar_FLOAT32_IEEE 0 VBU0706_CM_single_cnt 0.0 30.0 /end CHARACTERISTIC
/begin CHARACTERISTIC INP_uAccPed2RangeMax_C "" VALUE 0x70000df4 Scalar_FLOAT32_IEEE 0 VBU0706_CM_single_cnt 0.0 30.0 /end CHARACTERISTIC
/begin CHARACTERISTIC INP_uAccPed2RangeMin_C "" VALUE 0x70000df8 Scalar_FLOAT32_IEEE 0 VBU0706_CM_single_cnt 0.0 30.0 /end CHARACTERISTIC
/begin CHARACTERISTIC INP_uAccPed2SafetyVal_C "" VALUE 0x70000dfc Scalar_FLOAT32_IEEE 0 VBU0706_CM_single_cnt 0.0 30.0 /end CHARACTERISTIC
/begin CHARACTERISTIC INP_uBrkPresCaliOvrdVal_C "" VALUE 0x70000e00 Scalar_FLOAT32_IEEE 0 VBU0706_CM_single_cnt 0.0 30.0 /end CHARACTERISTIC
/begin CHARACTERISTIC INP_uBrkPresRangeMax_C "" VALUE 0x70000e04 Scalar_FLOAT32_IEEE 0 VBU0706_CM_single_cnt 0.0 30.0 /end CHARACTERISTIC
/begin CHARACTERISTIC INP_uBrkPresRangeMin_C "" VALUE 0x70000e08 Scalar_FLOAT32_IEEE 0 VBU0706_CM_single_cnt 0.0 30.0 /end CHARACTERISTIC
/begin CHARACTERISTIC INP_uBrkPresSafetyVal_C "" VALUE 0x70000e0c Scalar_FLOAT32_IEEE 0 VBU0706_CM_single_cnt -3.4E+38 3.4E+38 /end CHARACTERISTIC
/begin CHARACTERISTIC INP_uDCChCC2CaliOvrdVal_C "" VALUE 0x70000e10 Scalar_FLOAT32_IEEE 0 VBU0706_CM_single_cnt 0.0 30.0 /end CHARACTERISTIC
/begin CHARACTERISTIC INP_uDCChCC2RangeMax_C "" VALUE 0x70000e14 Scalar_FLOAT32_IEEE 0 VBU0706_CM_single_cnt 0.0 30.0 /end CHARACTERISTIC
/begin CHARACTERISTIC INP_uDCChCC2RangeMin_C "" VALUE 0x70000e18 Scalar_FLOAT32_IEEE 0 VBU0706_CM_single_cnt 0.0 30.0 /end CHARACTERISTIC
/begin CHARACTERISTIC INP_uDCChCC2SafetyVal_C "" VALUE 0x70000e1c Scalar_FLOAT32_IEEE 0 VBU0706_CM_single_cnt 0.0 30.0 /end CHARACTERISTIC
/begin CHARACTERISTIC INP_uDCChPortTempNegativeRangeMax_C "" VALUE 0x70000e20 Scalar_FLOAT32_IEEE 0 VBU0706_CM_single_cnt 0.0 30.0 /end CHARACTERISTIC
/begin CHARACTERISTIC INP_uDCChPortTempNegativeRangeMin_C "" VALUE 0x70000e24 Scalar_FLOAT32_IEEE 0 VBU0706_CM_single_cnt 0.0 30.0 /end CHARACTERISTIC
/begin CHARACTERISTIC INP_uDCChPortTempRangeMax_C "" VALUE 0x70000e28 Scalar_FLOAT32_IEEE 0 VBU0706_CM_single_cnt 0.0 30.0 /end CHARACTERISTIC
/begin CHARACTERISTIC INP_uDCChPortTempRangeMin_C "" VALUE 0x70000e2c Scalar_FLOAT32_IEEE 0 VBU0706_CM_single_cnt 0.0 30.0 /end CHARACTERISTIC
/begin CHARACTERISTIC INP_uEDSOutTempRangeMax_C "" VALUE 0x70000e30 Scalar_FLOAT32_IEEE 0 VBU0706_CM_single_cnt 0.0 30.0 /end CHARACTERISTIC
/begin CHARACTERISTIC INP_uEDSOutTempRangeMin_C "" VALUE 0x70000e34 Scalar_FLOAT32_IEEE 0 VBU0706_CM_single_cnt 0.0 30.0 /end CHARACTERISTIC
/begin CHARACTERISTIC INP_uVacPresRangeMax_C "" VALUE 0x70000e38 Scalar_FLOAT32_IEEE 0 VBU0706_CM_single_mV 0.0 30.0 /end CHARACTERISTIC
/begin CHARACTERISTIC INP_uVacPresRangeMin_C "" VALUE 0x70000e3c Scalar_FLOAT32_IEEE 0 VBU0706_CM_single_mV 0.0 30.0 /end CHARACTERISTIC
/begin CHARACTERISTIC INP_uVacPresSafetyVal_C "" VALUE 0x70000e40 Scalar_FLOAT32_IEEE 0 VBU0706_CM_single_mV -3.4E+38 3.4E+38 /end CHARACTERISTIC
/begin CHARACTERISTIC CaSOC_OcvShortTimeChMapDimension_n "" VAL_BLK 0x700013de Scalar_ULONG 0 VBU0706_CM_uint32_cnt 0.0 4.294967295E+9 NUMBER 2 /end CHARACTERISTIC
/begin CHARACTERISTIC CaSOC_OcvShortTimeDisMapDimension_n "" VAL_BLK 0x700013e6 Scalar_ULONG 0 VBU0706_CM_uint32_cnt 0.0 4.294967295E+9 NUMBER 2 /end CHARACTERISTIC
/begin CHARACTERISTIC CaSOF_ChargePowerSlopeSocTempMapDimension_n "" VAL_BLK 0x7000140e Scalar_ULONG 0 VBU0706_CM_uint32_cnt 0.0 4.294967295E+9 NUMBER 2 /end CHARACTERISTIC
/begin CHARACTERISTIC CaSOF_DischargePowerSlopeSocTempMapDimension_n "" VAL_BLK 0x70001446 Scalar_ULONG 0 VBU0706_CM_uint32_cnt 0.0 4.294967295E+9 NUMBER 2 /end CHARACTERISTIC
/begin CHARACTERISTIC CcRTC_ActualTimeDeviationThreshold_s "" VALUE 0x70000594 Scalar_ULONG 0 VBU0706_CM_uint32_cnt 0.0 4.294967295E+9 /end CHARACTERISTIC
/begin CHARACTERISTIC CcSOC_BatteryCapacity10Cycles_n "" VALUE 0x70000598 Scalar_ULONG 0 VBU0706_CM_uint32_cnt 0.0 4.294967295E+9 /end CHARACTERISTIC
/begin CHARACTERISTIC CcSOC_BatteryCapacity70Cycles_n "" VALUE 0x7000059c Scalar_ULONG 0 VBU0706_CM_uint32_cnt 0.0 4.294967295E+9 /end CHARACTERISTIC
/begin CHARACTERISTIC CcSOC_OcvShortTimeDisChDiff_n "" VALUE 0x7000065c Scalar_ULONG 0 VBU0706_CM_uint32_cnt 0.0 4.294967295E+9 /end CHARACTERISTIC
/begin CHARACTERISTIC CcTHM_BatteryCapacityCycle_n "" VALUE 0x700008c4 Scalar_ULONG 0 VBU0706_CM_uint32_cnt 0.0 4.294967295E+9 /end CHARACTERISTIC
/begin CHARACTERISTIC DCH_numBSMMaxCellTempNumOvrdVal_C "" VALUE 0x70000a2c Scalar_ULONG 0 VBU0706_CM_uint32_cnt 0.0 4.294967295E+9 /end CHARACTERISTIC
/begin CHARACTERISTIC DCH_numBSMMaxCellVltgNumOvrdVal_C "" VALUE 0x70000a30 Scalar_ULONG 0 VBU0706_CM_uint32_cnt 0.0 4.294967295E+9 /end CHARACTERISTIC
/begin CHARACTERISTIC DCH_numBSMMinCellTempNumOvrdVal_C "" VALUE 0x70000a34 Scalar_ULONG 0 VBU0706_CM_uint32_cnt 0.0 4.294967295E+9 /end CHARACTERISTIC
/begin CHARACTERISTIC DCH_numMaxChErrReconn_C "" VALUE 0x70000a38 Scalar_ULONG 0 VBU0706_CM_uint32_cnt 0.0 4.294967295E+9 /end CHARACTERISTIC
/begin CHARACTERISTIC DCH_numTOutCnt_C "" VALUE 0x70000a3c Scalar_ULONG 0 VBU0706_CM_uint32_cnt 0.0 4.294967295E+9 /end CHARACTERISTIC
/begin CHARACTERISTIC THM_INLET_COOLANT_SENSOR_OOR_HIGH_FAULT "" VALUE 0x70001004 Scalar_ULONG 0 VBU0706_CM_uint32_cnt 0.0 4.294967295E+9 /end CHARACTERISTIC
/begin CHARACTERISTIC THM_INLET_COOLANT_SENSOR_OOR_LOW_FAULT "" VALUE 0x70001008 Scalar_ULONG 0 VBU0706_CM_uint32_cnt 0.0 4.294967295E+9 /end CHARACTERISTIC
/begin CHARACTERISTIC THM_INLET_OUTLET_TEMP_DELTA_FAULT "" VALUE 0x7000100c Scalar_ULONG 0 VBU0706_CM_uint32_cnt 0.0 4.294967295E+9 /end CHARACTERISTIC
/begin CHARACTERISTIC THM_OUTLET_COOLANT_SENSOR_OOR_HIGH_FAULT "" VALUE 0x70001010 Scalar_ULONG 0 VBU0706_CM_uint32_cnt 0.0 4.294967295E+9 /end CHARACTERISTIC
/begin CHARACTERISTIC THM_OUTLET_COOLANT_SENSOR_OOR_LOW_FAULT "" VALUE 0x70001014 Scalar_ULONG 0 VBU0706_CM_uint32_cnt 0.0 4.294967295E+9 /end CHARACTERISTIC
/begin CHARACTERISTIC CcFCC_ChargeCompleteComfirmDelay_ms "" VALUE 0x7000007c Scalar_UWORD 0 VBU0706_CM_uint16_cnt 0.0 65535.0 /end CHARACTERISTIC
/begin CHARACTERISTIC CcISO_DCStationFaultDelayTime_ms "" VALUE 0x70000092 Scalar_UWORD 0 VBU0706_CM_uint16_ms 0.0 65535.0 /end CHARACTERISTIC
/begin CHARACTERISTIC CcOCV_RelaxationMinRequiredTime_s "" VALUE 0x70000096 Scalar_UWORD 0 VBU0706_CM_uint16_cnt 0.0 65535.0 /end CHARACTERISTIC
/begin CHARACTERISTIC CcOCV_RelaxationRequiredShortTime_s "" VALUE 0x70000098 Scalar_UWORD 0 VBU0706_CM_uint16_cnt 0.0 65535.0 /end CHARACTERISTIC
/begin CHARACTERISTIC CcSOC_OcvCorrectionIntervalTime_s "" VALUE 0x700000a8 Scalar_UWORD 0 VBU0706_CM_uint16_cnt 0.0 65535.0 /end CHARACTERISTIC
/begin CHARACTERISTIC CcSOC_OcvShortTimeCorrIntervalTime_s "" VALUE 0x700000aa Scalar_UWORD 0 VBU0706_CM_uint16_cnt 0.0 65535.0 /end CHARACTERISTIC
/begin CHARACTERISTIC CcSOC_OcvShortTimeVolDiffCh_mV "" VALUE 0x700000ac Scalar_UWORD 0 VBU0706_CM_uint16_cnt 0.0 65535.0 /end CHARACTERISTIC
/begin CHARACTERISTIC CcSOC_OcvShortTimeVolDiffThreshold_mV "" VALUE 0x700000ae Scalar_UWORD 0 VBU0706_CM_uint16_cnt 0.0 65535.0 /end CHARACTERISTIC
/begin CHARACTERISTIC CcSOC_OcvShortTimeVolThreshold_mV "" VALUE 0x700000b0 Scalar_UWORD 0 VBU0706_CM_uint16_cnt 0.0 65535.0 /end CHARACTERISTIC
/begin CHARACTERISTIC CcSOC_SocInitializationDelayTime_ms "" VALUE 0x700000b6 Scalar_UWORD 0 VBU0706_CM_uint16_cnt 0.0 65535.0 /end CHARACTERISTIC
/begin CHARACTERISTIC CcSOC_SocInitializationMaxTime_ms "" VALUE 0x700000b8 Scalar_UWORD 0 VBU0706_CM_uint16_cnt 0.0 65535.0 /end CHARACTERISTIC
/begin CHARACTERISTIC CcSOE_SocInitializationMaxTime_ms "" VALUE 0x700000ba Scalar_UWORD 0 VBU0706_CM_uint16_cnt 0.0 65535.0 /end CHARACTERISTIC
/begin CHARACTERISTIC CcSOF_LowTempOverCurrentCount_C "" VALUE 0x700000ce Scalar_UWORD 0 VBU0706_CM_uint16_cnt 0.0 65535.0 /end CHARACTERISTIC
/begin CHARACTERISTIC CcTHM_BdmDelay_s "" VALUE 0x700000f2 Scalar_UWORD 0 VBU0706_CM_uint16_cnt 0.0 65535.0 /end CHARACTERISTIC
/begin CHARACTERISTIC CcTHM_CoolingResponseDelay_s "" VALUE 0x700000f8 Scalar_UWORD 0 VBU0706_CM_uint16_cnt 0.0 65535.0 /end CHARACTERISTIC
/begin CHARACTERISTIC CcTHM_InletResponseDebounce_s "" VALUE 0x700000fa Scalar_UWORD 0 VBU0706_CM_uint16_cnt 0.0 65535.0 /end CHARACTERISTIC
/begin CHARACTERISTIC SAMPLE_TIME_TASK_C "" VALUE 0x70000112 Scalar_UWORD 0 VBU0706_CM_uint16_cnt 0.0 65535.0 /end CHARACTERISTIC
/begin CHARACTERISTIC SAMPLE_TIME_TASK_E "" VALUE 0x70000116 Scalar_UWORD 0 VBU0706_CM_uint16_cnt 0.0 65535.0 /end CHARACTERISTIC
/begin CHARACTERISTIC SOC_BATTERY_SOC_HIGH_FAULT "" VALUE 0x7000011a Scalar_UWORD 0 VBU0706_CM_uint16_cnt 0.0 65535.0 /end CHARACTERISTIC
/begin CHARACTERISTIC APO_AyAccelerationOvrd_C "" VALUE 0x7001072c Scalar_BOOLEAN 0 VBU0706_CM_boolean_cnt 0.0 1.0 /end CHARACTERISTIC
/begin CHARACTERISTIC APO_AzAccelerationOvrd_C "" VALUE 0x7001072d Scalar_BOOLEAN 0 VBU0706_CM_boolean_cnt 0.0 1.0 /end CHARACTERISTIC
/begin CHARACTERISTIC APO_HundredKmTripEnergyOvrd_C "" VALUE 0x70010733 Scalar_BOOLEAN 0 VBU0706_CM_boolean_cnt 0.0 1.0 /end CHARACTERISTIC
/begin CHARACTERISTIC APO_RemainingChargingTimeOvrd_C "" VALUE 0x70010738 Scalar_BOOLEAN 0 VBU0706_CM_boolean_cnt 0.0 1.0 /end CHARACTERISTIC
/begin CHARACTERISTIC APO_RemainingDrivingRangeOvrd_C "" VALUE 0x70010739 Scalar_BOOLEAN 0 VBU0706_CM_boolean_cnt 0.0 1.0 /end CHARACTERISTIC
/begin CHARACTERISTIC APO_SOCLowWarningOvrd_C "" VALUE 0x7001073a Scalar_BOOLEAN 0 VBU0706_CM_boolean_cnt 0.0 1.0 /end CHARACTERISTIC
/begin CHARACTERISTIC APO_TenkmTripEnergyOvrd_C "" VALUE 0x7001073b Scalar_BOOLEAN 0 VBU0706_CM_boolean_cnt 0.0 1.0 /end CHARACTERISTIC
/begin CHARACTERISTIC APO_TotalChargeEnergyOvrd_C "" VALUE 0x7001073c Scalar_BOOLEAN 0 VBU0706_CM_boolean_cnt 0.0 1.0 /end CHARACTERISTIC
/begin CHARACTERISTIC APO_TotalDischargeEnergyOvrd_C "" VALUE 0x7001073d Scalar_BOOLEAN 0 VBU0706_CM_boolean_cnt 0.0 1.0 /end CHARACTERISTIC
/begin CHARACTERISTIC APO_YawrateOvrd_C "" VALUE 0x7001073f Scalar_BOOLEAN 0 VBU0706_CM_boolean_cnt 0.0 1.0 /end CHARACTERISTIC
/begin CHARACTERISTIC APO_flgAccPedPosOvrd_C "" VALUE 0x70010746 Scalar_BOOLEAN 0 VBU0706_CM_boolean_cnt 0.0 1.0 /end CHARACTERISTIC
/begin CHARACTERISTIC APO_flgAxAccelerationOvrd_C "" VALUE 0x70010747 Scalar_BOOLEAN 0 VBU0706_CM_boolean_cnt 0.0 1.0 /end CHARACTERISTIC
/begin CHARACTERISTIC APO_flgBMSCellTempHighAlarmOvrd_C "" VALUE 0x70010752 Scalar_BOOLEAN 0 VBU0706_CM_boolean_cnt 0.0 1.0 /end CHARACTERISTIC
/begin CHARACTERISTIC APO_flgBMSCellTempLowAlarmOvrd_C "" VALUE 0x70010753 Scalar_BOOLEAN 0 VBU0706_CM_boolean_cnt 0.0 1.0 /end CHARACTERISTIC
/begin CHARACTERISTIC APO_flgBMSDIsplaySOCOvrd_C "" VALUE 0x70010755 Scalar_BOOLEAN 0 VBU0706_CM_boolean_cnt 0.0 1.0 /end CHARACTERISTIC
/begin CHARACTERISTIC APO_flgBMSFaultLevelOvrd_C "" VALUE 0x70010756 Scalar_BOOLEAN 0 VBU0706_CM_boolean_cnt 0.0 1.0 /end CHARACTERISTIC
/begin CHARACTERISTIC APO_flgBMSInletTempOvrd_C "" VALUE 0x70010757 Scalar_BOOLEAN 0 VBU0706_CM_boolean_cnt 0.0 1.0 /end CHARACTERISTIC
/begin CHARACTERISTIC APO_flgBMSMainRelayStatusOvrd_C "" VALUE 0x70010758 Scalar_BOOLEAN 0 VBU0706_CM_boolean_cnt 0.0 1.0 /end CHARACTERISTIC
/begin CHARACTERISTIC APO_flgBMSOutletTempOvrd_C "" VALUE 0x70010759 Scalar_BOOLEAN 0 VBU0706_CM_boolean_cnt 0.0 1.0 /end CHARACTERISTIC
/begin CHARACTERISTIC APO_flgBMSPackCurrentOvrd_C "" VALUE 0x7001075a Scalar_BOOLEAN 0 VBU0706_CM_boolean_cnt 0.0 1.0 /end CHARACTERISTIC
/begin CHARACTERISTIC APO_flgBMSPackVoltageOvrd_C "" VALUE 0x7001075b Scalar_BOOLEAN 0 VBU0706_CM_boolean_cnt 0.0 1.0 /end CHARACTERISTIC
/begin CHARACTERISTIC APO_flgBMSSOCOvrd_C "" VALUE 0x7001075c Scalar_BOOLEAN 0 VBU0706_CM_boolean_cnt 0.0 1.0 /end CHARACTERISTIC
/begin CHARACTERISTIC APO_flgBMSThermalRunawayOvrd_C "" VALUE 0x7001075d Scalar_BOOLEAN 0 VBU0706_CM_boolean_cnt 0.0 1.0 /end CHARACTERISTIC
/begin CHARACTERISTIC APO_flgBrkPressOvrd_C "" VALUE 0x70010769 Scalar_BOOLEAN 0 VBU0706_CM_boolean_cnt 0.0 1.0 /end CHARACTERISTIC
/begin CHARACTERISTIC APO_flgBrkSwtOvrd_C "" VALUE 0x7001076a Scalar_BOOLEAN 0 VBU0706_CM_boolean_cnt 0.0 1.0 /end CHARACTERISTIC
/begin CHARACTERISTIC APO_flgCellTempHighAlarmOvrdVal_C "" VALUE 0x7001076b Scalar_BOOLEAN 0 VBU0706_CM_boolean_cnt 0.0 1.0 /end CHARACTERISTIC
/begin CHARACTERISTIC APO_flgCellTempLowAlarmOvrdVal_C "" VALUE 0x7001076c Scalar_BOOLEAN 0 VBU0706_CM_boolean_cnt 0.0 1.0 /end CHARACTERISTIC
/begin CHARACTERISTIC APO_flgEfcAccPdlOvrd_C "" VALUE 0x70010771 Scalar_BOOLEAN 0 VBU0706_CM_boolean_cnt 0.0 1.0 /end CHARACTERISTIC
/begin CHARACTERISTIC APO_flgLVBattOvrd_C "" VALUE 0x70010777 Scalar_BOOLEAN 0 VBU0706_CM_boolean_cnt 0.0 1.0 /end CHARACTERISTIC
/begin CHARACTERISTIC BSWIN_flgACMidOvrdVal_C "" VALUE 0x700107ac Scalar_BOOLEAN 0 VBU0706_CM_boolean 0 1 /end CHARACTERISTIC
/begin CHARACTERISTIC BSWIN_flgACMidOvrd_C "" VALUE 0x700107ad Scalar_BOOLEAN 0 VBU0706_CM_boolean 0 1 /end CHARACTERISTIC
/begin CHARACTERISTIC BSWIN_flgACPreSWOvrdVal_C "" VALUE 0x700107ae Scalar_BOOLEAN 0 VBU0706_CM_boolean 0 1 /end CHARACTERISTIC
/begin CHARACTERISTIC BSWIN_flgACPreSWOvrd_C "" VALUE 0x700107af Scalar_BOOLEAN 0 VBU0706_CM_boolean 0 1 /end CHARACTERISTIC
/begin CHARACTERISTIC BSWIN_flgAplusOvrdVal_C "" VALUE 0x700107b0 Scalar_BOOLEAN 0 VBU0706_CM_boolean 0 1 /end CHARACTERISTIC
/begin CHARACTERISTIC BSWIN_flgAplusOvrd_C "" VALUE 0x700107b1 Scalar_BOOLEAN 0 VBU0706_CM_boolean 0 1 /end CHARACTERISTIC
/begin CHARACTERISTIC BSWIN_flgIgnOnOvrdVal_C "" VALUE 0x700107b2 Scalar_BOOLEAN 0 VBU0706_CM_boolean 0 1 /end CHARACTERISTIC
/begin CHARACTERISTIC BSWIN_flgIgnOnOvrd_C "" VALUE 0x700107b3 Scalar_BOOLEAN 0 VBU0706_CM_boolean 0 1 /end CHARACTERISTIC
/begin CHARACTERISTIC CbFCC_ChargeCurrentOverFaultEnable_flg "" VALUE 0x70010863 Scalar_BOOLEAN 0 VBU0706_CM_boolean_cnt 0.0 1.0 /end CHARACTERISTIC
/begin CHARACTERISTIC CbNVM_FirstRun_flg "" VALUE 0x7001086a Scalar_BOOLEAN 0 VBU0706_CM_boolean_cnt 0.0 1.0 /end CHARACTERISTIC
/begin CHARACTERISTIC CbRTC_flgActualTimeCheckEnable "" VALUE 0x7001086c Scalar_BOOLEAN 0 VBU0706_CM_boolean_cnt 0.0 1.0 /end CHARACTERISTIC
/begin CHARACTERISTIC CbSOC_BatterySocHighFaultEnable_flg "" VALUE 0x7001086e Scalar_BOOLEAN 0 VBU0706_CM_boolean_cnt 0.0 1.0 /end CHARACTERISTIC
/begin CHARACTERISTIC CbSOC_CellArraySOCOvrdFlg_flg "" VALUE 0x7001086f Scalar_BOOLEAN 0 VBU0706_CM_boolean_cnt 0.0 1.0 /end CHARACTERISTIC
/begin CHARACTERISTIC CbSOC_OcvShortTime_flg "" VALUE 0x70010873 Scalar_BOOLEAN 0 VBU0706_CM_boolean_cnt 0.0 1.0 /end CHARACTERISTIC
/begin CHARACTERISTIC CbSOF_ChargePowerLimitViolationFaultEnable_flg "" VALUE 0x70010875 Scalar_BOOLEAN 0 VBU0706_CM_boolean_cnt 0.0 1.0 /end CHARACTERISTIC
/begin CHARACTERISTIC CbSOF_CurrentLimitFastChargeCheckEnable_flg "" VALUE 0x70010876 Scalar_BOOLEAN 0 VBU0706_CM_boolean_cnt 0.0 1.0 /end CHARACTERISTIC
/begin CHARACTERISTIC CbSOF_DischargePowerLimitViolationFaultEnable_flg "" VALUE 0x70010877 Scalar_BOOLEAN 0 VBU0706_CM_boolean_cnt 0.0 1.0 /end CHARACTERISTIC
/begin CHARACTERISTIC CbSYS_HomoTestEnable_flg "" VALUE 0x7001087f Scalar_BOOLEAN 0 VBU0706_CM_boolean_cnt 0.0 1.0 /end CHARACTERISTIC
/begin CHARACTERISTIC CbTHM_InletCoolantSensorOorHighFaultEnable_flg "" VALUE 0x70010881 Scalar_BOOLEAN 0 VBU0706_CM_boolean_cnt 0.0 1.0 /end CHARACTERISTIC
/begin CHARACTERISTIC CbTHM_InletCoolantSensorOorLowFaultEnable_flg "" VALUE 0x70010882 Scalar_BOOLEAN 0 VBU0706_CM_boolean_cnt 0.0 1.0 /end CHARACTERISTIC
/begin CHARACTERISTIC CbTHM_InletOutletTempDeltaFaultEnable_flg "" VALUE 0x70010883 Scalar_BOOLEAN 0 VBU0706_CM_boolean_cnt 0.0 1.0 /end CHARACTERISTIC
/begin CHARACTERISTIC CbTHM_OutletCoolantSensorOorHighFaultEnable_flg "" VALUE 0x70010884 Scalar_BOOLEAN 0 VBU0706_CM_boolean_cnt 0.0 1.0 /end CHARACTERISTIC
/begin CHARACTERISTIC CbTHM_OutletCoolantSensorOorLowFaultEnable_flg "" VALUE 0x70010885 Scalar_BOOLEAN 0 VBU0706_CM_boolean_cnt 0.0 1.0 /end CHARACTERISTIC
/begin CHARACTERISTIC CcRTC_EnableVCURtcCrection_flg "" VALUE 0x7001094f Scalar_BOOLEAN 0 VBU0706_CM_boolean_cnt 0.0 1.0 /end CHARACTERISTIC
/begin CHARACTERISTIC CcSOC_SOCPEnable_flg "" VALUE 0x70010952 Scalar_BOOLEAN 0 VBU0706_CM_boolean_cnt 0.0 1.0 /end CHARACTERISTIC
/begin CHARACTERISTIC CcTHM_TempRequestEnable_flg "" VALUE 0x7001096e Scalar_BOOLEAN 0 VBU0706_CM_boolean_cnt 0.0 1.0 /end CHARACTERISTIC
/begin CHARACTERISTIC DCH_flgBCLChModeReqOvrd_C "" VALUE 0x700109a1 Scalar_BOOLEAN 0 VBU0706_CM_boolean_cnt 0.0 1.0 /end CHARACTERISTIC
/begin CHARACTERISTIC DCH_flgBCLCurrReqOvrd_C "" VALUE 0x700109a2 Scalar_BOOLEAN 0 VBU0706_CM_boolean_cnt 0.0 1.0 /end CHARACTERISTIC
/begin CHARACTERISTIC DCH_flgBCLVltgReqOvrd_C "" VALUE 0x700109a3 Scalar_BOOLEAN 0 VBU0706_CM_boolean_cnt 0.0 1.0 /end CHARACTERISTIC
/begin CHARACTERISTIC DCH_flgBCPBattVltgOvrd_C "" VALUE 0x700109a4 Scalar_BOOLEAN 0 VBU0706_CM_boolean_cnt 0.0 1.0 /end CHARACTERISTIC
/begin CHARACTERISTIC DCH_flgBCPMaxCellVltgForChOvrd_C "" VALUE 0x700109a5 Scalar_BOOLEAN 0 VBU0706_CM_boolean_cnt 0.0 1.0 /end CHARACTERISTIC
/begin CHARACTERISTIC DCH_flgBCPMaxChCurrOvrd_C "" VALUE 0x700109a6 Scalar_BOOLEAN 0 VBU0706_CM_boolean_cnt 0.0 1.0 /end CHARACTERISTIC
/begin CHARACTERISTIC DCH_flgBCPMaxPermitTempOvrd_C "" VALUE 0x700109a7 Scalar_BOOLEAN 0 VBU0706_CM_boolean_cnt 0.0 1.0 /end CHARACTERISTIC
/begin CHARACTERISTIC DCH_flgBCPMaxVltgForChOvrd_C "" VALUE 0x700109a8 Scalar_BOOLEAN 0 VBU0706_CM_boolean_cnt 0.0 1.0 /end CHARACTERISTIC
/begin CHARACTERISTIC DCH_flgBCPNrmCapOvrd_C "" VALUE 0x700109a9 Scalar_BOOLEAN 0 VBU0706_CM_boolean_cnt 0.0 1.0 /end CHARACTERISTIC
/begin CHARACTERISTIC DCH_flgBCPSocOvrd_C "" VALUE 0x700109aa Scalar_BOOLEAN 0 VBU0706_CM_boolean_cnt 0.0 1.0 /end CHARACTERISTIC
/begin CHARACTERISTIC DCH_flgBCSChCurrMeasureOvrd_C "" VALUE 0x700109ab Scalar_BOOLEAN 0 VBU0706_CM_boolean_cnt 0.0 1.0 /end CHARACTERISTIC
/begin CHARACTERISTIC DCH_flgBCSChNeedTOvrd_C "" VALUE 0x700109ac Scalar_BOOLEAN 0 VBU0706_CM_boolean_cnt 0.0 1.0 /end CHARACTERISTIC
/begin CHARACTERISTIC DCH_flgBCSChVltgMeasureOvrd_C "" VALUE 0x700109ad Scalar_BOOLEAN 0 VBU0706_CM_boolean_cnt 0.0 1.0 /end CHARACTERISTIC
/begin CHARACTERISTIC DCH_flgBCSCurrSocOvrd_C "" VALUE 0x700109ae Scalar_BOOLEAN 0 VBU0706_CM_boolean_cnt 0.0 1.0 /end CHARACTERISTIC
/begin CHARACTERISTIC DCH_flgBCSMaxCellVltgNumOvrd_C "" VALUE 0x700109af Scalar_BOOLEAN 0 VBU0706_CM_boolean_cnt 0.0 1.0 /end CHARACTERISTIC
/begin CHARACTERISTIC DCH_flgBCSMaxCellVltgOvrd_C "" VALUE 0x700109b0 Scalar_BOOLEAN 0 VBU0706_CM_boolean_cnt 0.0 1.0 /end CHARACTERISTIC
/begin CHARACTERISTIC DCH_flgBEMChCapTOutOvrd_C "" VALUE 0x700109b1 Scalar_BOOLEAN 0 VBU0706_CM_boolean_cnt 0.0 1.0 /end CHARACTERISTIC
/begin CHARACTERISTIC DCH_flgBEMChRdyTOutOvrd_C "" VALUE 0x700109b2 Scalar_BOOLEAN 0 VBU0706_CM_boolean_cnt 0.0 1.0 /end CHARACTERISTIC
/begin CHARACTERISTIC DCH_flgBEMChStTOutOvrd_C "" VALUE 0x700109b3 Scalar_BOOLEAN 0 VBU0706_CM_boolean_cnt 0.0 1.0 /end CHARACTERISTIC
/begin CHARACTERISTIC DCH_flgBEMChgrStopTOutOvrd_C "" VALUE 0x700109b4 Scalar_BOOLEAN 0 VBU0706_CM_boolean_cnt 0.0 1.0 /end CHARACTERISTIC
/begin CHARACTERISTIC DCH_flgBEMId00TOutOvrd_C "" VALUE 0x700109b5 Scalar_BOOLEAN 0 VBU0706_CM_boolean_cnt 0.0 1.0 /end CHARACTERISTIC
/begin CHARACTERISTIC DCH_flgBEMIdAATOutOvrd_C "" VALUE 0x700109b6 Scalar_BOOLEAN 0 VBU0706_CM_boolean_cnt 0.0 1.0 /end CHARACTERISTIC
/begin CHARACTERISTIC DCH_flgBEMStatsDataTOutOvrd_C "" VALUE 0x700109b7 Scalar_BOOLEAN 0 VBU0706_CM_boolean_cnt 0.0 1.0 /end CHARACTERISTIC
/begin CHARACTERISTIC DCH_flgBROBattChRdyOvrd_C "" VALUE 0x700109b8 Scalar_BOOLEAN 0 VBU0706_CM_boolean_cnt 0.0 1.0 /end CHARACTERISTIC
/begin CHARACTERISTIC DCH_flgBSDChEndSocOvrd_C "" VALUE 0x700109b9 Scalar_BOOLEAN 0 VBU0706_CM_boolean_cnt 0.0 1.0 /end CHARACTERISTIC
/begin CHARACTERISTIC DCH_flgBSDMaxCellTempOvrd_C "" VALUE 0x700109ba Scalar_BOOLEAN 0 VBU0706_CM_boolean_cnt 0.0 1.0 /end CHARACTERISTIC
/begin CHARACTERISTIC DCH_flgBSDMaxCellVltgOvrd_C "" VALUE 0x700109bb Scalar_BOOLEAN 0 VBU0706_CM_boolean_cnt 0.0 1.0 /end CHARACTERISTIC
/begin CHARACTERISTIC DCH_flgBSDMinCellTempOvrd_C "" VALUE 0x700109bc Scalar_BOOLEAN 0 VBU0706_CM_boolean_cnt 0.0 1.0 /end CHARACTERISTIC
/begin CHARACTERISTIC DCH_flgBSDMinCellVltgOvrd_C "" VALUE 0x700109bd Scalar_BOOLEAN 0 VBU0706_CM_boolean_cnt 0.0 1.0 /end CHARACTERISTIC
/begin CHARACTERISTIC DCH_flgBSMBattOutConnStOvrdVal_C "" VALUE 0x700109be Scalar_BOOLEAN 0 VBU0706_CM_boolean_cnt 0.0 1.0 /end CHARACTERISTIC
/begin CHARACTERISTIC DCH_flgBSMBattOutConnStOvrd_C "" VALUE 0x700109bf Scalar_BOOLEAN 0 VBU0706_CM_boolean_cnt 0.0 1.0 /end CHARACTERISTIC
/begin CHARACTERISTIC DCH_flgBSMCellVltgOverUndOvrdVal_C "" VALUE 0x700109c0 Scalar_BOOLEAN 0 VBU0706_CM_boolean_cnt 0.0 1.0 /end CHARACTERISTIC
/begin CHARACTERISTIC DCH_flgBSMCellVltgOverUndOvrd_C "" VALUE 0x700109c1 Scalar_BOOLEAN 0 VBU0706_CM_boolean_cnt 0.0 1.0 /end CHARACTERISTIC
/begin CHARACTERISTIC DCH_flgBSMChCurrOverOvrdVal_C "" VALUE 0x700109c2 Scalar_BOOLEAN 0 VBU0706_CM_boolean_cnt 0.0 1.0 /end CHARACTERISTIC
/begin CHARACTERISTIC DCH_flgBSMChCurrOverOvrd_C "" VALUE 0x700109c3 Scalar_BOOLEAN 0 VBU0706_CM_boolean_cnt 0.0 1.0 /end CHARACTERISTIC
/begin CHARACTERISTIC DCH_flgBSMChPermitOvrdVal_C "" VALUE 0x700109c4 Scalar_BOOLEAN 0 VBU0706_CM_boolean_cnt 0.0 1.0 /end CHARACTERISTIC
/begin CHARACTERISTIC DCH_flgBSMChPermitOvrd_C "" VALUE 0x700109c5 Scalar_BOOLEAN 0 VBU0706_CM_boolean_cnt 0.0 1.0 /end CHARACTERISTIC
/begin CHARACTERISTIC DCH_flgBSMIsoStOvrdVal_C "" VALUE 0x700109c6 Scalar_BOOLEAN 0 VBU0706_CM_boolean_cnt 0.0 1.0 /end CHARACTERISTIC
/begin CHARACTERISTIC DCH_flgBSMIsoStOvrd_C "" VALUE 0x700109c7 Scalar_BOOLEAN 0 VBU0706_CM_boolean_cnt 0.0 1.0 /end CHARACTERISTIC
/begin CHARACTERISTIC DCH_flgBSMMaxCellTempNumOvrd_C "" VALUE 0x700109c8 Scalar_BOOLEAN 0 VBU0706_CM_boolean_cnt 0.0 1.0 /end CHARACTERISTIC
/begin CHARACTERISTIC DCH_flgBSMMaxCellTempOvrd_C "" VALUE 0x700109c9 Scalar_BOOLEAN 0 VBU0706_CM_boolean_cnt 0.0 1.0 /end CHARACTERISTIC
/begin CHARACTERISTIC DCH_flgBSMMaxCellVltgNumOvrd_C "" VALUE 0x700109ca Scalar_BOOLEAN 0 VBU0706_CM_boolean_cnt 0.0 1.0 /end CHARACTERISTIC
/begin CHARACTERISTIC DCH_flgBSMMinCellTempNumOvrd_C "" VALUE 0x700109cb Scalar_BOOLEAN 0 VBU0706_CM_boolean_cnt 0.0 1.0 /end CHARACTERISTIC
/begin CHARACTERISTIC DCH_flgBSMMinCellTempOvrd_C "" VALUE 0x700109cc Scalar_BOOLEAN 0 VBU0706_CM_boolean_cnt 0.0 1.0 /end CHARACTERISTIC
/begin CHARACTERISTIC DCH_flgBSMSocOverUndOvrdVal_C "" VALUE 0x700109cd Scalar_BOOLEAN 0 VBU0706_CM_boolean_cnt 0.0 1.0 /end CHARACTERISTIC
/begin CHARACTERISTIC DCH_flgBSMSocOverUndOvrd_C "" VALUE 0x700109ce Scalar_BOOLEAN 0 VBU0706_CM_boolean_cnt 0.0 1.0 /end CHARACTERISTIC
/begin CHARACTERISTIC DCH_flgBSMTempOverOvrdVal_C "" VALUE 0x700109cf Scalar_BOOLEAN 0 VBU0706_CM_boolean_cnt 0.0 1.0 /end CHARACTERISTIC
/begin CHARACTERISTIC DCH_flgBSMTempOverOvrd_C "" VALUE 0x700109d0 Scalar_BOOLEAN 0 VBU0706_CM_boolean_cnt 0.0 1.0 /end CHARACTERISTIC
/begin CHARACTERISTIC DCH_flgBSTChStopForBMSConnOverTempOvrdVal_C "" VALUE 0x700109d1 Scalar_BOOLEAN 0 VBU0706_CM_boolean_cnt 0.0 1.0 /end CHARACTERISTIC
/begin CHARACTERISTIC DCH_flgBSTChStopForBMSConnOverTempOvrd_C "" VALUE 0x700109d2 Scalar_BOOLEAN 0 VBU0706_CM_boolean_cnt 0.0 1.0 /end CHARACTERISTIC
/begin CHARACTERISTIC DCH_flgBSTChStopForBattOverTempOvrdVal_C "" VALUE 0x700109d3 Scalar_BOOLEAN 0 VBU0706_CM_boolean_cnt 0.0 1.0 /end CHARACTERISTIC
/begin CHARACTERISTIC DCH_flgBSTChStopForBattOverTempOvrd_C "" VALUE 0x700109d4 Scalar_BOOLEAN 0 VBU0706_CM_boolean_cnt 0.0 1.0 /end CHARACTERISTIC
/begin CHARACTERISTIC DCH_flgBSTChStopForCCToVltgFaultOvrdVal_C "" VALUE 0x700109d5 Scalar_BOOLEAN 0 VBU0706_CM_boolean_cnt 0.0 1.0 /end CHARACTERISTIC
/begin CHARACTERISTIC DCH_flgBSTChStopForCCToVltgFaultOvrd_C "" VALUE 0x700109d6 Scalar_BOOLEAN 0 VBU0706_CM_boolean_cnt 0.0 1.0 /end CHARACTERISTIC
/begin CHARACTERISTIC DCH_flgBSTChStopForCellVltgOvrdVal_C "" VALUE 0x700109d7 Scalar_BOOLEAN 0 VBU0706_CM_boolean_cnt 0.0 1.0 /end CHARACTERISTIC
/begin CHARACTERISTIC DCH_flgBSTChStopForCellVltgOvrd_C "" VALUE 0x700109d8 Scalar_BOOLEAN 0 VBU0706_CM_boolean_cnt 0.0 1.0 /end CHARACTERISTIC
/begin CHARACTERISTIC DCH_flgBSTChStopForChgrReqStopOvrdVal_C "" VALUE 0x700109d9 Scalar_BOOLEAN 0 VBU0706_CM_boolean_cnt 0.0 1.0 /end CHARACTERISTIC
/begin CHARACTERISTIC DCH_flgBSTChStopForChgrReqStopOvrd_C "" VALUE 0x700109da Scalar_BOOLEAN 0 VBU0706_CM_boolean_cnt 0.0 1.0 /end CHARACTERISTIC
/begin CHARACTERISTIC DCH_flgBSTChStopForConnFaultOvrdVal_C "" VALUE 0x700109db Scalar_BOOLEAN 0 VBU0706_CM_boolean_cnt 0.0 1.0 /end CHARACTERISTIC
/begin CHARACTERISTIC DCH_flgBSTChStopForConnFaultOvrd_C "" VALUE 0x700109dc Scalar_BOOLEAN 0 VBU0706_CM_boolean_cnt 0.0 1.0 /end CHARACTERISTIC
/begin CHARACTERISTIC DCH_flgBSTChStopForConnOverTempOvrdVal_C "" VALUE 0x700109dd Scalar_BOOLEAN 0 VBU0706_CM_boolean_cnt 0.0 1.0 /end CHARACTERISTIC
/begin CHARACTERISTIC DCH_flgBSTChStopForConnOverTempOvrd_C "" VALUE 0x700109de Scalar_BOOLEAN 0 VBU0706_CM_boolean_cnt 0.0 1.0 /end CHARACTERISTIC
/begin CHARACTERISTIC DCH_flgBSTChStopForHvRlyFaultOvrdVal_C "" VALUE 0x700109df Scalar_BOOLEAN 0 VBU0706_CM_boolean_cnt 0.0 1.0 /end CHARACTERISTIC
/begin CHARACTERISTIC DCH_flgBSTChStopForHvRlyFaultOvrd_C "" VALUE 0x700109e0 Scalar_BOOLEAN 0 VBU0706_CM_boolean_cnt 0.0 1.0 /end CHARACTERISTIC
/begin CHARACTERISTIC DCH_flgBSTChStopForIsoFaultOvrdVal_C "" VALUE 0x700109e1 Scalar_BOOLEAN 0 VBU0706_CM_boolean_cnt 0.0 1.0 /end CHARACTERISTIC
/begin CHARACTERISTIC DCH_flgBSTChStopForIsoFaultOvrd_C "" VALUE 0x700109e2 Scalar_BOOLEAN 0 VBU0706_CM_boolean_cnt 0.0 1.0 /end CHARACTERISTIC
/begin CHARACTERISTIC DCH_flgBSTChStopForOtherFaultOvrdVal_C "" VALUE 0x700109e3 Scalar_BOOLEAN 0 VBU0706_CM_boolean_cnt 0.0 1.0 /end CHARACTERISTIC
/begin CHARACTERISTIC DCH_flgBSTChStopForOtherFaultOvrd_C "" VALUE 0x700109e4 Scalar_BOOLEAN 0 VBU0706_CM_boolean_cnt 0.0 1.0 /end CHARACTERISTIC
/begin CHARACTERISTIC DCH_flgBSTChStopForOverCurrOvrdVal_C "" VALUE 0x700109e5 Scalar_BOOLEAN 0 VBU0706_CM_boolean_cnt 0.0 1.0 /end CHARACTERISTIC
/begin CHARACTERISTIC DCH_flgBSTChStopForOverCurrOvrd_C "" VALUE 0x700109e6 Scalar_BOOLEAN 0 VBU0706_CM_boolean_cnt 0.0 1.0 /end CHARACTERISTIC
/begin CHARACTERISTIC DCH_flgBSTChStopForSocOvrdVal_C "" VALUE 0x700109e7 Scalar_BOOLEAN 0 VBU0706_CM_boolean_cnt 0.0 1.0 /end CHARACTERISTIC
/begin CHARACTERISTIC DCH_flgBSTChStopForSocOvrd_C "" VALUE 0x700109e8 Scalar_BOOLEAN 0 VBU0706_CM_boolean_cnt 0.0 1.0 /end CHARACTERISTIC
/begin CHARACTERISTIC DCH_flgBSTChStopForTotalVltgOvrdVal_C "" VALUE 0x700109e9 Scalar_BOOLEAN 0 VBU0706_CM_boolean_cnt 0.0 1.0 /end CHARACTERISTIC
/begin CHARACTERISTIC DCH_flgBSTChStopForTotalVltgOvrd_C "" VALUE 0x700109ea Scalar_BOOLEAN 0 VBU0706_CM_boolean_cnt 0.0 1.0 /end CHARACTERISTIC
/begin CHARACTERISTIC DCH_flgBSTChStopForVltgAbNrmOvrdVal_C "" VALUE 0x700109eb Scalar_BOOLEAN 0 VBU0706_CM_boolean_cnt 0.0 1.0 /end CHARACTERISTIC
/begin CHARACTERISTIC DCH_flgBSTChStopForVltgAbNrmOvrd_C "" VALUE 0x700109ec Scalar_BOOLEAN 0 VBU0706_CM_boolean_cnt 0.0 1.0 /end CHARACTERISTIC
/begin CHARACTERISTIC DCH_flgDCChRlyClose_SY "" VALUE 0x700109ef Scalar_BOOLEAN 0 VBU0706_CM_boolean_cnt 0.0 1.0 /end CHARACTERISTIC
/begin CHARACTERISTIC DCH_flgDCChRlyOpen_SY "" VALUE 0x700109f0 Scalar_BOOLEAN 0 VBU0706_CM_boolean_cnt 0.0 1.0 /end CHARACTERISTIC
/begin CHARACTERISTIC DCH_flgHvRlyClose_SY "" VALUE 0x700109f2 Scalar_BOOLEAN 0 VBU0706_CM_boolean_cnt 0.0 1.0 /end CHARACTERISTIC
/begin CHARACTERISTIC DCH_flgHvRlyOpen_SY "" VALUE 0x700109f3 Scalar_BOOLEAN 0 VBU0706_CM_boolean_cnt 0.0 1.0 /end CHARACTERISTIC
/begin CHARACTERISTIC DCH_flgOvrdReceiveCCS_C "" VALUE 0x700109f4 Scalar_BOOLEAN 0 VBU0706_CM_boolean_cnt 0.0 1.0 /end CHARACTERISTIC
/begin CHARACTERISTIC DCH_flgOvrdReceiveCEM_C "" VALUE 0x700109f5 Scalar_BOOLEAN 0 VBU0706_CM_boolean_cnt 0.0 1.0 /end CHARACTERISTIC
/begin CHARACTERISTIC DCH_flgOvrdReceiveCHM_C "" VALUE 0x700109f6 Scalar_BOOLEAN 0 VBU0706_CM_boolean_cnt 0.0 1.0 /end CHARACTERISTIC
/begin CHARACTERISTIC DCH_flgOvrdReceiveCML_C "" VALUE 0x700109f7 Scalar_BOOLEAN 0 VBU0706_CM_boolean_cnt 0.0 1.0 /end CHARACTERISTIC
/begin CHARACTERISTIC DCH_flgOvrdReceiveCRM_C "" VALUE 0x700109f8 Scalar_BOOLEAN 0 VBU0706_CM_boolean_cnt 0.0 1.0 /end CHARACTERISTIC
/begin CHARACTERISTIC DCH_flgOvrdReceiveCRO_C "" VALUE 0x700109f9 Scalar_BOOLEAN 0 VBU0706_CM_boolean_cnt 0.0 1.0 /end CHARACTERISTIC
/begin CHARACTERISTIC DCH_flgOvrdReceiveCSD_C "" VALUE 0x700109fa Scalar_BOOLEAN 0 VBU0706_CM_boolean_cnt 0.0 1.0 /end CHARACTERISTIC
/begin CHARACTERISTIC DCH_flgOvrdReceiveCST_C "" VALUE 0x700109fb Scalar_BOOLEAN 0 VBU0706_CM_boolean_cnt 0.0 1.0 /end CHARACTERISTIC
/begin CHARACTERISTIC DCH_flgOvrdValReceiveCCS_C "" VALUE 0x700109fc Scalar_BOOLEAN 0 VBU0706_CM_boolean_cnt 0.0 1.0 /end CHARACTERISTIC
/begin CHARACTERISTIC DCH_flgOvrdValReceiveCEM_C "" VALUE 0x700109fd Scalar_BOOLEAN 0 VBU0706_CM_boolean_cnt 0.0 1.0 /end CHARACTERISTIC
/begin CHARACTERISTIC DCH_flgOvrdValReceiveCHM_C "" VALUE 0x700109fe Scalar_BOOLEAN 0 VBU0706_CM_boolean_cnt 0.0 1.0 /end CHARACTERISTIC
/begin CHARACTERISTIC DCH_flgOvrdValReceiveCML_C "" VALUE 0x700109ff Scalar_BOOLEAN 0 VBU0706_CM_boolean_cnt 0.0 1.0 /end CHARACTERISTIC
/begin CHARACTERISTIC DCH_flgOvrdValReceiveCRM_C "" VALUE 0x70010a00 Scalar_BOOLEAN 0 VBU0706_CM_boolean_cnt 0.0 1.0 /end CHARACTERISTIC
/begin CHARACTERISTIC DCH_flgOvrdValReceiveCRO_C "" VALUE 0x70010a01 Scalar_BOOLEAN 0 VBU0706_CM_boolean_cnt 0.0 1.0 /end CHARACTERISTIC
/begin CHARACTERISTIC DCH_flgOvrdValReceiveCSD_C "" VALUE 0x70010a02 Scalar_BOOLEAN 0 VBU0706_CM_boolean_cnt 0.0 1.0 /end CHARACTERISTIC
/begin CHARACTERISTIC DCH_flgOvrdValReceiveCST_C "" VALUE 0x70010a03 Scalar_BOOLEAN 0 VBU0706_CM_boolean_cnt 0.0 1.0 /end CHARACTERISTIC
/begin CHARACTERISTIC INP_flgAccPed1CaliOvrd_C "" VALUE 0x70010ae2 Scalar_BOOLEAN 0 VBU0706_CM_boolean_cnt 0.0 1.0 /end CHARACTERISTIC
/begin CHARACTERISTIC INP_flgAccPed1SafetyEnable_C "" VALUE 0x70010ae3 Scalar_BOOLEAN 0 VBU0706_CM_boolean_cnt 0.0 1.0 /end CHARACTERISTIC
/begin CHARACTERISTIC INP_flgAccPed2CaliOvrd_C "" VALUE 0x70010ae4 Scalar_BOOLEAN 0 VBU0706_CM_boolean_cnt 0.0 1.0 /end CHARACTERISTIC
/begin CHARACTERISTIC INP_flgAccPed2SafetyEnable_C "" VALUE 0x70010ae5 Scalar_BOOLEAN 0 VBU0706_CM_boolean_cnt 0.0 1.0 /end CHARACTERISTIC
/begin CHARACTERISTIC INP_flgBrkPresCaliOvrd_C "" VALUE 0x70010ae6 Scalar_BOOLEAN 0 VBU0706_CM_boolean_cnt 0.0 1.0 /end CHARACTERISTIC
/begin CHARACTERISTIC INP_flgBrkPresSafetyEnable_C "" VALUE 0x70010ae7 Scalar_BOOLEAN 0 VBU0706_CM_boolean_cnt 0.0 1.0 /end CHARACTERISTIC
/begin CHARACTERISTIC INP_flgDCChCC2CaliOvrd_C "" VALUE 0x70010ae8 Scalar_BOOLEAN 0 VBU0706_CM_boolean_cnt 0.0 1.0 /end CHARACTERISTIC
/begin CHARACTERISTIC INP_flgDCChCC2SafetyEnable_C "" VALUE 0x70010ae9 Scalar_BOOLEAN 0 VBU0706_CM_boolean_cnt 0.0 1.0 /end CHARACTERISTIC
/begin CHARACTERISTIC INP_flgDCChPortTempCaliOvrd_C "" VALUE 0x70010aea Scalar_BOOLEAN 0 VBU0706_CM_boolean_C 0.0 1.0 /end CHARACTERISTIC
/begin CHARACTERISTIC INP_flgDCChPortTempNegativeCaliOvrd_C "" VALUE 0x70010aeb Scalar_BOOLEAN 0 VBU0706_CM_boolean_cnt 0.0 1.0 /end CHARACTERISTIC
/begin CHARACTERISTIC INP_flgDCChPortTempNegativeSafetyEnable_C "" VALUE 0x70010aec Scalar_BOOLEAN 0 VBU0706_CM_boolean_cnt 0.0 1.0 /end CHARACTERISTIC
/begin CHARACTERISTIC INP_flgDCChPortTempSafetyEnable_C "" VALUE 0x70010aed Scalar_BOOLEAN 0 VBU0706_CM_boolean_cnt 0.0 1.0 /end CHARACTERISTIC
/begin CHARACTERISTIC INP_flgEDSOutTempCaliOvrd_C "" VALUE 0x70010aee Scalar_BOOLEAN 0 VBU0706_CM_boolean_cnt 0.0 1.0 /end CHARACTERISTIC
/begin CHARACTERISTIC INP_flgEDSOutTempSafetyEnable_C "" VALUE 0x70010aef Scalar_BOOLEAN 0 VBU0706_CM_boolean_cnt 0.0 1.0 /end CHARACTERISTIC
/begin CHARACTERISTIC INP_flgVacPresCaliOvrd_C "" VALUE 0x70010af0 Scalar_BOOLEAN 0 VBU0706_CM_boolean_cnt 0.0 1.0 /end CHARACTERISTIC
/begin CHARACTERISTIC INP_flgVacPresSafetyEnable_C "" VALUE 0x70010af1 Scalar_BOOLEAN 0 VBU0706_CM_boolean_cnt 0.0 1.0 /end CHARACTERISTIC
/begin CHARACTERISTIC NVM_READ_SUCCESS "" VALUE 0x70010b34 Scalar_BOOLEAN 0 VBU0706_CM_boolean_cnt 0.0 1.0 /end CHARACTERISTIC
/begin CHARACTERISTIC SOC_flgOCVCorrection_C "" VALUE 0x70010b81 Scalar_BOOLEAN 0 VBU0706_CM_boolean_cnt 0.0 1.0 /end CHARACTERISTIC
/begin CHARACTERISTIC SOC_flgOCValidOvrd_C "" VALUE 0x70010b82 Scalar_BOOLEAN 0 VBU0706_CM_boolean_cnt 0.0 1.0 /end CHARACTERISTIC
/begin CHARACTERISTIC CcFCC_ChargeCurrentOverFaultFIC_n "" VALUE 0x70010945 Scalar_BYTE 0 VBU0706_CM_int8_cnt -128.0 127.0 /end CHARACTERISTIC
/begin CHARACTERISTIC CcFCC_ChargeCurrentOverFaultPIC_n "" VALUE 0x70010946 Scalar_BYTE 0 VBU0706_CM_int8_cnt -128.0 127.0 /end CHARACTERISTIC
/begin CHARACTERISTIC CcSOC_BatterySocHighFaultFIC_n "" VALUE 0x70010950 Scalar_BYTE 0 VBU0706_CM_int8_cnt -128.0 127.0 /end CHARACTERISTIC
/begin CHARACTERISTIC CcSOC_BatterySocHighFaultPIC_n "" VALUE 0x70010951 Scalar_BYTE 0 VBU0706_CM_int8_cnt -128.0 127.0 /end CHARACTERISTIC
/begin CHARACTERISTIC CcSOF_ChargePowerLimitViolationFIC_n "" VALUE 0x70010955 Scalar_BYTE 0 VBU0706_CM_int8_cnt -128.0 127.0 /end CHARACTERISTIC
/begin CHARACTERISTIC CcSOF_ChargePowerLimitViolationPIC_n "" VALUE 0x70010956 Scalar_BYTE 0 VBU0706_CM_int8_cnt -128.0 127.0 /end CHARACTERISTIC
/begin CHARACTERISTIC CcSOF_DischargePowerLimitViolationFIC_n "" VALUE 0x70010958 Scalar_BYTE 0 VBU0706_CM_int8_cnt -128.0 127.0 /end CHARACTERISTIC
/begin CHARACTERISTIC CcSOF_DischargePowerLimitViolationPIC_n "" VALUE 0x70010959 Scalar_BYTE 0 VBU0706_CM_int8_cnt -128.0 127.0 /end CHARACTERISTIC
/begin CHARACTERISTIC CcTHM_InletCoolantSensorOorHighFIC_n "" VALUE 0x70010963 Scalar_BYTE 0 VBU0706_CM_int8_cnt -128.0 127.0 /end CHARACTERISTIC
/begin CHARACTERISTIC CcTHM_InletCoolantSensorOorHighPIC_n "" VALUE 0x70010964 Scalar_BYTE 0 VBU0706_CM_int8_cnt -128.0 127.0 /end CHARACTERISTIC
/begin CHARACTERISTIC CcTHM_InletCoolantSensorOorLowFIC_n "" VALUE 0x70010965 Scalar_BYTE 0 VBU0706_CM_int8_cnt -128.0 127.0 /end CHARACTERISTIC
/begin CHARACTERISTIC CcTHM_InletCoolantSensorOorLowPIC_n "" VALUE 0x70010966 Scalar_BYTE 0 VBU0706_CM_int8_cnt -128.0 127.0 /end CHARACTERISTIC
/begin CHARACTERISTIC CcTHM_InletOutletTempDeltaFIC_n "" VALUE 0x70010967 Scalar_BYTE 0 VBU0706_CM_int8_cnt -128.0 127.0 /end CHARACTERISTIC
/begin CHARACTERISTIC CcTHM_InletOutletTempDeltaPIC_n "" VALUE 0x70010968 Scalar_BYTE 0 VBU0706_CM_int8_cnt -128.0 127.0 /end CHARACTERISTIC
/begin CHARACTERISTIC CcTHM_OutletCoolantSensorOorHighFIC_n "" VALUE 0x70010969 Scalar_BYTE 0 VBU0706_CM_int8_cnt -128.0 127.0 /end CHARACTERISTIC
/begin CHARACTERISTIC CcTHM_OutletCoolantSensorOorHighPIC_n "" VALUE 0x7001096a Scalar_BYTE 0 VBU0706_CM_int8_cnt -128.0 127.0 /end CHARACTERISTIC
/begin CHARACTERISTIC CcTHM_OutletCoolantSensorOorLowFIC_n "" VALUE 0x7001096b Scalar_BYTE 0 VBU0706_CM_int8_cnt -128.0 127.0 /end CHARACTERISTIC
/begin CHARACTERISTIC CcTHM_OutletCoolantSensorOorLowPIC_n "" VALUE 0x7001096c Scalar_BYTE 0 VBU0706_CM_int8_cnt -128.0 127.0 /end CHARACTERISTIC
/begin CHARACTERISTIC APO_stBMSFaultLevelOvrdVal_C "" VALUE 0x70010782 Scalar_UBYTE 0 VBU0706_CM_uint8_cnt 0.0 255.0 /end CHARACTERISTIC
/begin CHARACTERISTIC APO_stBMSMainRelayStatusOvrdVal_C "" VALUE 0x70010783 Scalar_UBYTE 0 VBU0706_CM_uint8_cnt 0.0 255.0 /end CHARACTERISTIC
/begin CHARACTERISTIC CbSYS_AbnormalResetRecoverEnable_flg "" VALUE 0x7001087e Scalar_UBYTE 0 VBU0706_CM_uint8_cnt 0.0 255.0 /end CHARACTERISTIC
/begin CHARACTERISTIC CcSYS_NoOfInvalidCellTemps_n "" VALUE 0x70010960 Scalar_UBYTE 0 VBU0706_CM_uint8_cnt 0.0 255.0 /end CHARACTERISTIC
/begin CHARACTERISTIC DCH_stBCLChModeReqOvrdVal_C "" VALUE 0x70010a0d Scalar_UBYTE 0 VBU0706_CM_uint8_cnt 0.0 15.0 /end CHARACTERISTIC
/begin CHARACTERISTIC DCH_stBCLConstantCurrMode_C "" VALUE 0x70010a0e Scalar_UBYTE 0 VBU0706_CM_uint8_cnt 0.0 15.0 /end CHARACTERISTIC
/begin CHARACTERISTIC DCH_stBCLConstantVltgMode_C "" VALUE 0x70010a0f Scalar_UBYTE 0 VBU0706_CM_uint8_cnt 0.0 15.0 /end CHARACTERISTIC
/begin CHARACTERISTIC DCH_stBCLMode_SY "" VALUE 0x70010a10 Scalar_UBYTE 0 VBU0706_CM_uint8_cnt 0.0 255.0 /end CHARACTERISTIC
/begin CHARACTERISTIC DCH_stBCPMode_SY "" VALUE 0x70010a11 Scalar_UBYTE 0 VBU0706_CM_uint8_cnt 0.0 255.0 /end CHARACTERISTIC
/begin CHARACTERISTIC DCH_stBEMChCapTOutOvrdVal_C "" VALUE 0x70010a15 Scalar_UBYTE 0 VBU0706_CM_uint8_cnt 0.0 15.0 /end CHARACTERISTIC
/begin CHARACTERISTIC DCH_stBEMChRdyTOutOvrdVal_C "" VALUE 0x70010a17 Scalar_UBYTE 0 VBU0706_CM_uint8_cnt 0.0 15.0 /end CHARACTERISTIC
/begin CHARACTERISTIC DCH_stBEMChStTOutOvrdVal_C "" VALUE 0x70010a19 Scalar_UBYTE 0 VBU0706_CM_uint8_cnt 0.0 15.0 /end CHARACTERISTIC
/begin CHARACTERISTIC DCH_stBEMChgrStopTOutOvrdVal_C "" VALUE 0x70010a1b Scalar_UBYTE 0 VBU0706_CM_uint8_cnt 0.0 15.0 /end CHARACTERISTIC
/begin CHARACTERISTIC DCH_stBEMId00TOutOvrdVal_C "" VALUE 0x70010a1c Scalar_UBYTE 0 VBU0706_CM_uint8_cnt 0.0 15.0 /end CHARACTERISTIC
/begin CHARACTERISTIC DCH_stBEMIdAATOutOvrdVal_C "" VALUE 0x70010a1d Scalar_UBYTE 0 VBU0706_CM_uint8_cnt 0.0 15.0 /end CHARACTERISTIC
/begin CHARACTERISTIC DCH_stBEMStatsDataTOutOvrdVal_C "" VALUE 0x70010a1f Scalar_UBYTE 0 VBU0706_CM_uint8_cnt 0.0 15.0 /end CHARACTERISTIC
/begin CHARACTERISTIC DCH_stBRMMode_SY "" VALUE 0x70010a22 Scalar_UBYTE 0 VBU0706_CM_uint8_cnt 0.0 255.0 /end CHARACTERISTIC
/begin CHARACTERISTIC DCH_stBROBattChRdyOvrdVal_C "" VALUE 0x70010a23 Scalar_UBYTE 0 VBU0706_CM_uint8_cnt 0.0 15.0 /end CHARACTERISTIC
/begin CHARACTERISTIC DCH_stBRONoRdyMode_SY "" VALUE 0x70010a24 Scalar_UBYTE 0 VBU0706_CM_uint8_cnt 0.0 255.0 /end CHARACTERISTIC
/begin CHARACTERISTIC DCH_stBRORdyMode_SY "" VALUE 0x70010a25 Scalar_UBYTE 0 VBU0706_CM_uint8_cnt 0.0 255.0 /end CHARACTERISTIC
/begin CHARACTERISTIC DCH_stBSTForNrmMode_SY "" VALUE 0x70010a26 Scalar_UBYTE 0 VBU0706_CM_uint8_cnt 0.0 255.0 /end CHARACTERISTIC
/begin CHARACTERISTIC DCH_stCC2AplusConnect_SY "" VALUE 0x70010a27 Scalar_UBYTE 0 VBU0706_CM_uint8_cnt 0.0 255.0 /end CHARACTERISTIC
/begin CHARACTERISTIC DCH_stChStopChgrErr_SY "" VALUE 0x70010a29 Scalar_UBYTE 0 VBU0706_CM_uint8_cnt 0.0 255.0 /end CHARACTERISTIC
/begin CHARACTERISTIC DCH_stChStopChgrManual_SY "" VALUE 0x70010a2a Scalar_UBYTE 0 VBU0706_CM_uint8_cnt 0.0 255.0 /end CHARACTERISTIC
/begin CHARACTERISTIC DCH_stChStopIso_SY "" VALUE 0x70010a2b Scalar_UBYTE 0 VBU0706_CM_uint8_cnt 0.0 255.0 /end CHARACTERISTIC
/begin CHARACTERISTIC DCH_stChStopVehCmpt_SY "" VALUE 0x70010a2c Scalar_UBYTE 0 VBU0706_CM_uint8_cnt 0.0 255.0 /end CHARACTERISTIC
/begin CHARACTERISTIC DCH_stChStopVehErr_SY "" VALUE 0x70010a2d Scalar_UBYTE 0 VBU0706_CM_uint8_cnt 0.0 255.0 /end CHARACTERISTIC
/begin CHARACTERISTIC DCH_stChargeFinishMode_SY "" VALUE 0x70010a2e Scalar_UBYTE 0 VBU0706_CM_uint8_cnt 0.0 255.0 /end CHARACTERISTIC
/begin CHARACTERISTIC DCH_stCharging_SY "" VALUE 0x70010a2f Scalar_UBYTE 0 VBU0706_CM_uint8_cnt 0.0 255.0 /end CHARACTERISTIC
/begin CHARACTERISTIC DCH_stChrgPortSnglSnsr_SY "" VALUE 0x70010a30 Scalar_UBYTE 0 VBU0706_CM_uint8_cnt 0.0 255.0 /end CHARACTERISTIC
/begin CHARACTERISTIC DCH_stChrgPortSnsrConfig_C "" VALUE 0x70010a31 Scalar_UBYTE 0 VBU0706_CM_uint8_cnt 0.0 15.0 /end CHARACTERISTIC
/begin CHARACTERISTIC DCH_stClDCChRlyMode_SY "" VALUE 0x70010a32 Scalar_UBYTE 0 VBU0706_CM_uint8_cnt 0.0 255.0 /end CHARACTERISTIC
/begin CHARACTERISTIC DCH_stComTOut_SY "" VALUE 0x70010a33 Scalar_UBYTE 0 VBU0706_CM_uint8_cnt 0.0 255.0 /end CHARACTERISTIC
/begin CHARACTERISTIC DCH_stHandshake_SY "" VALUE 0x70010a39 Scalar_UBYTE 0 VBU0706_CM_uint8_cnt 0.0 255.0 /end CHARACTERISTIC
/begin CHARACTERISTIC DCH_stHvRlyMode_SY "" VALUE 0x70010a3a Scalar_UBYTE 0 VBU0706_CM_uint8_cnt 0.0 255.0 /end CHARACTERISTIC
/begin CHARACTERISTIC DCH_stInitMode_SY "" VALUE 0x70010a3b Scalar_UBYTE 0 VBU0706_CM_uint8_cnt 0.0 255.0 /end CHARACTERISTIC
/begin CHARACTERISTIC DCH_stInit_SY "" VALUE 0x70010a3c Scalar_UBYTE 0 VBU0706_CM_uint8_cnt 0.0 255.0 /end CHARACTERISTIC
/begin CHARACTERISTIC DCH_stLvShutDownForNrmMode_SY "" VALUE 0x70010a3e Scalar_UBYTE 0 VBU0706_CM_uint8_cnt 0.0 255.0 /end CHARACTERISTIC
/begin CHARACTERISTIC DCH_stOpenDCRlyForBMSTOutMode_SY "" VALUE 0x70010a40 Scalar_UBYTE 0 VBU0706_CM_uint8_cnt 0.0 255.0 /end CHARACTERISTIC
/begin CHARACTERISTIC DCH_stOpenDCRlyForNrmMode_SY "" VALUE 0x70010a41 Scalar_UBYTE 0 VBU0706_CM_uint8_cnt 0.0 255.0 /end CHARACTERISTIC
/begin CHARACTERISTIC DCH_stOpenHvForBMSTOutMode_SY "" VALUE 0x70010a42 Scalar_UBYTE 0 VBU0706_CM_uint8_cnt 0.0 255.0 /end CHARACTERISTIC
/begin CHARACTERISTIC DCH_stParConfig_SY "" VALUE 0x70010a45 Scalar_UBYTE 0 VBU0706_CM_uint8_cnt 0.0 255.0 /end CHARACTERISTIC
/begin CHARACTERISTIC DCH_stPreOpenDCRly_SY "" VALUE 0x70010a46 Scalar_UBYTE 0 VBU0706_CM_uint8_cnt 0.0 255.0 /end CHARACTERISTIC
/begin CHARACTERISTIC DCH_stReConnectChProcessMode_SY "" VALUE 0x70010a47 Scalar_UBYTE 0 VBU0706_CM_uint8_cnt 0.0 255.0 /end CHARACTERISTIC
/begin CHARACTERISTIC DCH_stStopBMS_SY "" VALUE 0x70010a4d Scalar_UBYTE 0 VBU0706_CM_uint8_cnt 0.0 255.0 /end CHARACTERISTIC
/begin CHARACTERISTIC DCH_stStopCC2ConnErr_SY "" VALUE 0x70010a4e Scalar_UBYTE 0 VBU0706_CM_uint8_cnt 0.0 255.0 /end CHARACTERISTIC
/begin CHARACTERISTIC DCH_stStopChAvlErr_SY "" VALUE 0x70010a4f Scalar_UBYTE 0 VBU0706_CM_uint8_cnt 0.0 255.0 /end CHARACTERISTIC
/begin CHARACTERISTIC DCH_stStopChRdyTout_SY "" VALUE 0x70010a50 Scalar_UBYTE 0 VBU0706_CM_uint8_cnt 0.0 255.0 /end CHARACTERISTIC
/begin CHARACTERISTIC DCH_stStopChgrAvl_SY "" VALUE 0x70010a51 Scalar_UBYTE 0 VBU0706_CM_uint8_cnt 0.0 255.0 /end CHARACTERISTIC
/begin CHARACTERISTIC DCH_stStopChgrErr_SY "" VALUE 0x70010a52 Scalar_UBYTE 0 VBU0706_CM_uint8_cnt 0.0 255.0 /end CHARACTERISTIC
/begin CHARACTERISTIC DCH_stStopCrntLrgErr_SY "" VALUE 0x70010a53 Scalar_UBYTE 0 VBU0706_CM_uint8_cnt 0.0 255.0 /end CHARACTERISTIC
/begin CHARACTERISTIC DCH_stStopCrntOvr_SY "" VALUE 0x70010a54 Scalar_UBYTE 0 VBU0706_CM_uint8_cnt 0.0 255.0 /end CHARACTERISTIC
/begin CHARACTERISTIC DCH_stStopDCRlyClTout_SY "" VALUE 0x70010a55 Scalar_UBYTE 0 VBU0706_CM_uint8_cnt 0.0 255.0 /end CHARACTERISTIC
/begin CHARACTERISTIC DCH_stStopDCRlyOpErr_SY "" VALUE 0x70010a56 Scalar_UBYTE 0 VBU0706_CM_uint8_cnt 0.0 255.0 /end CHARACTERISTIC
/begin CHARACTERISTIC DCH_stStopFidErr_SY "" VALUE 0x70010a57 Scalar_UBYTE 0 VBU0706_CM_uint8_cnt 0.0 255.0 /end CHARACTERISTIC
/begin CHARACTERISTIC DCH_stStopHVRlyOpErr_SY "" VALUE 0x70010a58 Scalar_UBYTE 0 VBU0706_CM_uint8_cnt 0.0 255.0 /end CHARACTERISTIC
/begin CHARACTERISTIC DCH_stStopHlfConnErr_SY "" VALUE 0x70010a59 Scalar_UBYTE 0 VBU0706_CM_uint8_cnt 0.0 255.0 /end CHARACTERISTIC
/begin CHARACTERISTIC DCH_stStopIso_SY "" VALUE 0x70010a5a Scalar_UBYTE 0 VBU0706_CM_uint8_cnt 0.0 255.0 /end CHARACTERISTIC
/begin CHARACTERISTIC DCH_stStopManual_SY "" VALUE 0x70010a5b Scalar_UBYTE 0 VBU0706_CM_uint8_cnt 0.0 255.0 /end CHARACTERISTIC
/begin CHARACTERISTIC DCH_stStopToutOvr3_SY "" VALUE 0x70010a5c Scalar_UBYTE 0 VBU0706_CM_uint8_cnt 0.0 255.0 /end CHARACTERISTIC
/begin CHARACTERISTIC DCH_stStopZeroCrnt_SY "" VALUE 0x70010a5d Scalar_UBYTE 0 VBU0706_CM_uint8_cnt 0.0 255.0 /end CHARACTERISTIC
/begin CHARACTERISTIC DCH_stTimeOutInTimeOut_SY "" VALUE 0x70010a5f Scalar_UBYTE 0 VBU0706_CM_uint8_cnt 0.0 255.0 /end CHARACTERISTIC
/begin CHARACTERISTIC DCH_stWaitCHMMode_SY "" VALUE 0x70010a63 Scalar_UBYTE 0 VBU0706_CM_uint8_cnt 0.0 255.0 /end CHARACTERISTIC
/begin CHARACTERISTIC DCH_stWaitCRMMode_SY "" VALUE 0x70010a64 Scalar_UBYTE 0 VBU0706_CM_uint8_cnt 0.0 255.0 /end CHARACTERISTIC
/begin CHARACTERISTIC DCH_stWaitCSDForNrmMode_SY "" VALUE 0x70010a65 Scalar_UBYTE 0 VBU0706_CM_uint8_cnt 0.0 255.0 /end CHARACTERISTIC
/begin CHARACTERISTIC FCC_STATE_ABORT_CHARGE "" VALUE 0x70010a96 Scalar_UBYTE 0 VBU0706_CM_uint8_cnt 0.0 255.0 /end CHARACTERISTIC
/begin CHARACTERISTIC FCC_STATE_BMS_CLOSE_CONTACTORS "" VALUE 0x70010a97 Scalar_UBYTE 0 VBU0706_CM_uint8_cnt 0.0 255.0 /end CHARACTERISTIC
/begin CHARACTERISTIC FCC_STATE_CHARGE_PROTECTION "" VALUE 0x70010a9a Scalar_UBYTE 0 VBU0706_CM_uint8_cnt 0.0 255.0 /end CHARACTERISTIC
/begin CHARACTERISTIC FCC_STATE_DEACTIVATE_DEVICES "" VALUE 0x70010a9c Scalar_UBYTE 0 VBU0706_CM_uint8_cnt 0.0 255.0 /end CHARACTERISTIC
/begin CHARACTERISTIC FCC_STATE_STANDBY "" VALUE 0x70010a9d Scalar_UBYTE 0 VBU0706_CM_uint8_cnt 0.0 255.0 /end CHARACTERISTIC
/begin CHARACTERISTIC FCC_STATE_SYSTEM_STATUS_CHECK "" VALUE 0x70010a9e Scalar_UBYTE 0 VBU0706_CM_uint8_cnt 0.0 255.0 /end CHARACTERISTIC
/begin CHARACTERISTIC FCC_STATE_WAIT_VCU_COMMAND "" VALUE 0x70010a9f Scalar_UBYTE 0 VBU0706_CM_uint8_cnt 0.0 255.0 /end CHARACTERISTIC
/begin CHARACTERISTIC INP_numAccPed1CounterLim_C "" VALUE 0x70010af2 Scalar_UBYTE 0 VBU0706_CM_uint8_cnt 0.0 100.0 /end CHARACTERISTIC
/begin CHARACTERISTIC INP_numAccPed1DecCounter_C "" VALUE 0x70010af3 Scalar_UBYTE 0 VBU0706_CM_uint8_cnt 0.0 100.0 /end CHARACTERISTIC
/begin CHARACTERISTIC INP_numAccPed1IncCounter_C "" VALUE 0x70010af4 Scalar_UBYTE 0 VBU0706_CM_uint8_cnt 0.0 100.0 /end CHARACTERISTIC
/begin CHARACTERISTIC INP_numAccPed2CounterLim_C "" VALUE 0x70010af5 Scalar_UBYTE 0 VBU0706_CM_uint8_cnt 0.0 100.0 /end CHARACTERISTIC
/begin CHARACTERISTIC INP_numAccPed2DecCounter_C "" VALUE 0x70010af6 Scalar_UBYTE 0 VBU0706_CM_uint8_cnt 0.0 100.0 /end CHARACTERISTIC
/begin CHARACTERISTIC INP_numAccPed2IncCounter_C "" VALUE 0x70010af7 Scalar_UBYTE 0 VBU0706_CM_uint8_cnt 0.0 100.0 /end CHARACTERISTIC
/begin CHARACTERISTIC INP_numBrkPresCounterLim_C "" VALUE 0x70010af8 Scalar_UBYTE 0 VBU0706_CM_uint8_cnt 0.0 100.0 /end CHARACTERISTIC
/begin CHARACTERISTIC INP_numBrkPresDecCounter_C "" VALUE 0x70010af9 Scalar_UBYTE 0 VBU0706_CM_uint8_cnt 0.0 100.0 /end CHARACTERISTIC
/begin CHARACTERISTIC INP_numBrkPresIncCounter_C "" VALUE 0x70010afa Scalar_UBYTE 0 VBU0706_CM_uint8_cnt 0.0 100.0 /end CHARACTERISTIC
/begin CHARACTERISTIC INP_numDCChCC2CounterLim_C "" VALUE 0x70010afb Scalar_UBYTE 0 VBU0706_CM_uint8_cnt 0.0 100.0 /end CHARACTERISTIC
/begin CHARACTERISTIC INP_numDCChCC2DecCounter_C "" VALUE 0x70010afc Scalar_UBYTE 0 VBU0706_CM_uint8_cnt 0.0 100.0 /end CHARACTERISTIC
/begin CHARACTERISTIC INP_numDCChCC2IncCounter_C "" VALUE 0x70010afd Scalar_UBYTE 0 VBU0706_CM_uint8_cnt 0.0 100.0 /end CHARACTERISTIC
/begin CHARACTERISTIC INP_numDCChPortTempCounterLim_C "" VALUE 0x70010afe Scalar_UBYTE 0 VBU0706_CM_uint8_cnt 0.0 100.0 /end CHARACTERISTIC
/begin CHARACTERISTIC INP_numDCChPortTempDecCounter_C "" VALUE 0x70010aff Scalar_UBYTE 0 VBU0706_CM_uint8_cnt 0.0 100.0 /end CHARACTERISTIC
/begin CHARACTERISTIC INP_numDCChPortTempIncCounter_C "" VALUE 0x70010b00 Scalar_UBYTE 0 VBU0706_CM_uint8_cnt 0.0 100.0 /end CHARACTERISTIC
/begin CHARACTERISTIC INP_numDCChPortTempNegativeCounterLim_C "" VALUE 0x70010b01 Scalar_UBYTE 0 VBU0706_CM_uint8_cnt 0.0 100.0 /end CHARACTERISTIC
/begin CHARACTERISTIC INP_numDCChPortTempNegativeDecCounter_C "" VALUE 0x70010b02 Scalar_UBYTE 0 VBU0706_CM_uint8_cnt 0.0 100.0 /end CHARACTERISTIC
/begin CHARACTERISTIC INP_numDCChPortTempNegativeIncCounter_C "" VALUE 0x70010b03 Scalar_UBYTE 0 VBU0706_CM_uint8_cnt 0.0 100.0 /end CHARACTERISTIC
/begin CHARACTERISTIC INP_numEDSOutTempCounterLim_C "" VALUE 0x70010b04 Scalar_UBYTE 0 VBU0706_CM_uint8_cnt 0.0 100.0 /end CHARACTERISTIC
/begin CHARACTERISTIC INP_numEDSOutTempDecCounter_C "" VALUE 0x70010b05 Scalar_UBYTE 0 VBU0706_CM_uint8_cnt 0.0 100.0 /end CHARACTERISTIC
/begin CHARACTERISTIC INP_numEDSOutTempIncCounter_C "" VALUE 0x70010b06 Scalar_UBYTE 0 VBU0706_CM_uint8_cnt 0.0 100.0 /end CHARACTERISTIC
/begin CHARACTERISTIC INP_numVacPresCounterLim_C "" VALUE 0x70010b07 Scalar_UBYTE 0 VBU0706_CM_uint8_cnt 0.0 100.0 /end CHARACTERISTIC
/begin CHARACTERISTIC INP_numVacPresDecCounter_C "" VALUE 0x70010b08 Scalar_UBYTE 0 VBU0706_CM_uint8_cnt 0.0 100.0 /end CHARACTERISTIC
/begin CHARACTERISTIC INP_numVacPresIncCounter_C "" VALUE 0x70010b09 Scalar_UBYTE 0 VBU0706_CM_uint8_cnt 0.0 100.0 /end CHARACTERISTIC
/begin CHARACTERISTIC NVM_READ_CRC_FAIL "" VALUE 0x70010b32 Scalar_UBYTE 0 VBU0706_CM_uint8_cnt 0.0 255.0 /end CHARACTERISTIC
/begin CHARACTERISTIC NVM_READ_HARDWARE_FAIL "" VALUE 0x70010b33 Scalar_UBYTE 0 VBU0706_CM_uint8_cnt 0.0 255.0 /end CHARACTERISTIC
/begin CHARACTERISTIC SOF_DISCHARGE_OVER_POWER_FAULT "" VALUE 0x70010b83 Scalar_UBYTE 0 VBU0706_CM_uint8_cnt 0.0 255.0 /end CHARACTERISTIC
/begin MEASUREMENT OCV_tisRelaxationElapsedTime "" ULONG VBU0706_CM_uint32 0 0 0 4294967295 ECU_ADDRESS 0x70011752 /end MEASUREMENT
/begin MEASUREMENT SOC_numLoadDefaultSOCCnt "" ULONG VBU0706_CM_uint32 0 0 0 4294967295 ECU_ADDRESS 0x700117a6 /end MEASUREMENT
/begin MEASUREMENT FCC_timinEstimateChargeTime "" ULONG VBU0706_CM_uint32 0 0 0 4294967295 ECU_ADDRESS 0x7001163e /end MEASUREMENT
/begin MEASUREMENT FCC_timinEstimatePercTime "" ULONG VBU0706_CM_uint32 0 0 0 4294967295 ECU_ADDRESS 0x70011642 /end MEASUREMENT
/begin MEASUREMENT SOC_pctCellSocMax "" FLOAT32_IEEE VBU0706_CM_single 0 0 -3.4E+38 3.4E+38 ECU_ADDRESS 0x700117ce /end MEASUREMENT
/begin MEASUREMENT SOC_pctCellSocMin "" FLOAT32_IEEE VBU0706_CM_single 0 0 -3.4E+38 3.4E+38 ECU_ADDRESS 0x700117d2 /end MEASUREMENT
/begin MEASUREMENT SOC_pctCellSocAve "" FLOAT32_IEEE VBU0706_CM_single 0 0 -3.4E+38 3.4E+38 ECU_ADDRESS 0x700117ca /end MEASUREMENT
/begin MEASUREMENT THM_tInletTempRequest "" FLOAT32_IEEE VBU0706_CM_single 0 0 -3.4E+38 3.4E+38 ECU_ADDRESS 0x70011976 /end MEASUREMENT
/begin MEASUREMENT DCH_iBMSDCChReqLim "" FLOAT32_IEEE VBU0706_CM_single 0 0 -3.4E+38 3.4E+38 ECU_ADDRESS 0x70011506 /end MEASUREMENT
/begin MEASUREMENT SOF_kwsChargePowerLimitDeltaTotal "" FLOAT32_IEEE VBU0706_CM_single 0 0 -3.4E+38 3.4E+38 ECU_ADDRESS 0x700118d6 /end MEASUREMENT
/begin MEASUREMENT SOF_kwDischargePowerShortPulseRated "" FLOAT32_IEEE VBU0706_CM_single 0 0 -3.4E+38 3.4E+38 ECU_ADDRESS 0x700118ca /end MEASUREMENT
/begin MEASUREMENT SOF_kwDischargePowerContinuousRated "" FLOAT32_IEEE VBU0706_CM_single 0 0 -3.4E+38 3.4E+38 ECU_ADDRESS 0x700118b6 /end MEASUREMENT
/begin MEASUREMENT SOF_kwDischargePowerLimitRated "" FLOAT32_IEEE VBU0706_CM_single 0 0 -3.4E+38 3.4E+38 ECU_ADDRESS 0x700118c2 /end MEASUREMENT
/begin MEASUREMENT SOF_kwChargePowerShortPulseRated "" FLOAT32_IEEE VBU0706_CM_single 0 0 -3.4E+38 3.4E+38 ECU_ADDRESS 0x700118a2 /end MEASUREMENT
/begin MEASUREMENT SOF_kwChargePowerContinuousRated "" FLOAT32_IEEE VBU0706_CM_single 0 0 -3.4E+38 3.4E+38 ECU_ADDRESS 0x70011892 /end MEASUREMENT
/begin MEASUREMENT SOF_kwChargePowerLimitRated "" FLOAT32_IEEE VBU0706_CM_single 0 0 -3.4E+38 3.4E+38 ECU_ADDRESS 0x7001189a /end MEASUREMENT
/begin MEASUREMENT SOF_iAShortPulseDischargeCurrentRatedLimit "" FLOAT32_IEEE VBU0706_CM_single 0 0 -3.4E+38 3.4E+38 ECU_ADDRESS 0x7001188a /end MEASUREMENT
/begin MEASUREMENT SOF_iAContinuousDischargeCurrentRatedLimit "" FLOAT32_IEEE VBU0706_CM_single 0 0 -3.4E+38 3.4E+38 ECU_ADDRESS 0x70011832 /end MEASUREMENT
/begin MEASUREMENT SOF_iAShortPulseChargeCurrentRatedLimit "" FLOAT32_IEEE VBU0706_CM_single 0 0 -3.4E+38 3.4E+38 ECU_ADDRESS 0x70011876 /end MEASUREMENT
/begin MEASUREMENT SOF_iAChargeContinuousCurrentRatedLimit "" FLOAT32_IEEE VBU0706_CM_single 0 0 -3.4E+38 3.4E+38 ECU_ADDRESS 0x70011802 /end MEASUREMENT
/begin MEASUREMENT SOF_iADischargeCurrentRatedLimit "" FLOAT32_IEEE VBU0706_CM_single 0 0 -3.4E+38 3.4E+38 ECU_ADDRESS 0x70011836 /end MEASUREMENT
/begin MEASUREMENT SOF_iAChargeCurrentRatedLimit "" FLOAT32_IEEE VBU0706_CM_single 0 0 -3.4E+38 3.4E+38 ECU_ADDRESS 0x70011806 /end MEASUREMENT
/begin MEASUREMENT SOF_kwContinuousDischargePowerLimitBefoTarget "" FLOAT32_IEEE VBU0706_CM_single 0 0 -3.4E+38 3.4E+38 ECU_ADDRESS 0x700118aa /end MEASUREMENT
/begin MEASUREMENT SOF_kwDischargePowerLimitBefoTarget "" FLOAT32_IEEE VBU0706_CM_single 0 0 -3.4E+38 3.4E+38 ECU_ADDRESS 0x700118ba /end MEASUREMENT
/begin MEASUREMENT SOF_kwShortPulseDischargePowerLimitTarget "" FLOAT32_IEEE VBU0706_CM_single 0 0 -3.4E+38 3.4E+38 ECU_ADDRESS 0x700118d2 /end MEASUREMENT
/begin MEASUREMENT SOF_kwShortPulseChargePowerLimitTarget "" FLOAT32_IEEE VBU0706_CM_single 0 0 -3.4E+38 3.4E+38 ECU_ADDRESS 0x700118ce /end MEASUREMENT
/begin MEASUREMENT SOF_kwContinuousChargePowerLimitTarget "" FLOAT32_IEEE VBU0706_CM_single 0 0 -3.4E+38 3.4E+38 ECU_ADDRESS 0x700118a6 /end MEASUREMENT
/begin MEASUREMENT SOF_kwChargePowerLimitTarget "" FLOAT32_IEEE VBU0706_CM_single 0 0 -3.4E+38 3.4E+38 ECU_ADDRESS 0x7001189e /end MEASUREMENT
/begin MEASUREMENT SOF_kwChargePowerActual "" FLOAT32_IEEE VBU0706_CM_single 0 0 -3.4E+38 3.4E+38 ECU_ADDRESS 0x7001188e /end MEASUREMENT
/begin MEASUREMENT SOF_kwChargePowerLimitDelta "" FLOAT32_IEEE VBU0706_CM_single 0 0 -3.4E+38 3.4E+38 ECU_ADDRESS 0x70011896 /end MEASUREMENT
/begin MEASUREMENT SOF_kwDischargePowerActual "" FLOAT32_IEEE VBU0706_CM_single 0 0 -3.4E+38 3.4E+38 ECU_ADDRESS 0x700118b2 /end MEASUREMENT
/begin MEASUREMENT SOF_kwDischargePowerLimitDelta "" FLOAT32_IEEE VBU0706_CM_single 0 0 -3.4E+38 3.4E+38 ECU_ADDRESS 0x700118be /end MEASUREMENT
/begin MEASUREMENT SOE_pctCellSocEndPredict "" FLOAT32_IEEE VBU0706_CM_single 0 0 -3.4E+38 3.4E+38 ECU_ADDRESS 0x700117e6 /end MEASUREMENT
/begin MEASUREMENT SOE_kwhPackRemainingEnergy "" FLOAT32_IEEE VBU0706_CM_single 0 0 -3.4E+38 3.4E+38 ECU_ADDRESS 0x700117de /end MEASUREMENT
/begin MEASUREMENT SOC_pctNoJumpBatterySoc "" FLOAT32_IEEE VBU0706_CM_single 0 0 0.0 100.0 ECU_ADDRESS 0x700117da /end MEASUREMENT
/begin MEASUREMENT SOC_pctBatteryDisplaySoc "" FLOAT32_IEEE VBU0706_CM_single 0 0 -3.4E+38 3.4E+38 ECU_ADDRESS 0x700117aa /end MEASUREMENT
/begin MEASUREMENT SOC_pctBatterySoc "" FLOAT32_IEEE VBU0706_CM_single 0 0 -3.4E+38 3.4E+38 ECU_ADDRESS 0x700117be /end MEASUREMENT
/begin MEASUREMENT SOC_pctBatteryUsableSoc "" FLOAT32_IEEE VBU0706_CM_single 0 0 0.0 100.0 ECU_ADDRESS 0x700117c2 /end MEASUREMENT
/begin MEASUREMENT FCC_tisChargeFaultTimer "" FLOAT32_IEEE VBU0706_CM_single 0 0 -3.4E+38 3.4E+38 ECU_ADDRESS 0x7001164e /end MEASUREMENT
/begin MEASUREMENT FCC_tisChargeProtectTimer "" FLOAT32_IEEE VBU0706_CM_single 0 0 -3.4E+38 3.4E+38 ECU_ADDRESS 0x70011656 /end MEASUREMENT
/begin MEASUREMENT FCC_tisChargeFullTimer "" FLOAT32_IEEE VBU0706_CM_single 0 0 -3.4E+38 3.4E+38 ECU_ADDRESS 0x70011652 /end MEASUREMENT
/begin MEASUREMENT FCC_tisChargeAbortTimer "" FLOAT32_IEEE VBU0706_CM_single 0 0 -3.4E+38 3.4E+38 ECU_ADDRESS 0x7001164a /end MEASUREMENT
/begin MEASUREMENT FCC_timinActualRemainChargeTime "" FLOAT32_IEEE VBU0706_CM_single 0 0 -3.4E+38 3.4E+38 ECU_ADDRESS 0x7001163a /end MEASUREMENT
/begin MEASUREMENT SOC_numCellSocMaxID "" UWORD VBU0706_CM_uint16 0 0 0 65535 ECU_ADDRESS 0x700113d2 /end MEASUREMENT
/begin MEASUREMENT THM_ftInletCoolantSensorOorHigh "" UWORD VBU0706_CM_uint16 0 0 0 65535 ECU_ADDRESS 0x700113da /end MEASUREMENT
/begin MEASUREMENT THM_ftInletCoolantSensorOorLow "" UWORD VBU0706_CM_uint16 0 0 0 65535 ECU_ADDRESS 0x700113dc /end MEASUREMENT
/begin MEASUREMENT THM_ftInletOutletTempDelta "" UWORD VBU0706_CM_uint16 0 0 0 65535 ECU_ADDRESS 0x700113de /end MEASUREMENT
/begin MEASUREMENT THM_ftOutletCoolantSensorOorHigh "" UWORD VBU0706_CM_uint16 0 0 0 65535 ECU_ADDRESS 0x700113e0 /end MEASUREMENT
/begin MEASUREMENT THM_ftOutletCoolantSensorOorLow "" UWORD VBU0706_CM_uint16 0 0 0 65535 ECU_ADDRESS 0x700113e2 /end MEASUREMENT
/begin MEASUREMENT SOF_stDischargePowerLimitViolationFault "" UWORD VBU0706_CM_uint16 0 0 0 65535 ECU_ADDRESS 0x700113d8 /end MEASUREMENT
/begin MEASUREMENT SOF_stChargePowerLimitViolationFault "" UWORD VBU0706_CM_uint16 0 0 0 65535 ECU_ADDRESS 0x700113d6 /end MEASUREMENT
/begin MEASUREMENT LcSOC_SocCounter_numb "" UWORD VBU0706_CM_uint16 0 0 0 65535 ECU_ADDRESS 0x700113ba /end MEASUREMENT
/begin MEASUREMENT DCH_stChStopReason "" UWORD VBU0706_CM_uint16 0 0 0 65535 ECU_ADDRESS 0x7001139c /end MEASUREMENT
/begin MEASUREMENT SOH_stSohMonitor "" UBYTE VBU0706_CM_uint8 0 0 0 255 ECU_ADDRESS 0x70011eef /end MEASUREMENT
/begin MEASUREMENT SOH_stResistanceIncRatio "" UBYTE VBU0706_CM_uint8 0 0 0 255 ECU_ADDRESS 0x70011eee /end MEASUREMENT
/begin MEASUREMENT SOC_numCellSocMinID "" UBYTE VBU0706_CM_uint8 0 0 0 255 ECU_ADDRESS 0x70011ee3 /end MEASUREMENT
/begin MEASUREMENT ISO_stIsolationEVM "" UBYTE VBU0706_CM_uint8 0 0 0.0 15.0 ECU_ADDRESS 0x70011e47 /end MEASUREMENT
/begin MEASUREMENT ISO_stIsolationLevel "" UBYTE VBU0706_CM_uint8 0 0 0.0 15.0 ECU_ADDRESS 0x70011e48 /end MEASUREMENT
/begin MEASUREMENT FCC_stChargeState "" UBYTE VBU0706_CM_uint8 0 0 0 255 ECU_ADDRESS 0x70011dea /end MEASUREMENT
/begin MEASUREMENT FCC_stContactorRequest "" UBYTE VBU0706_CM_uint8 0 0 0 255 ECU_ADDRESS 0x70011deb /end MEASUREMENT
/begin MEASUREMENT DCH_stBEMChCapTOut "" UBYTE VBU0706_CM_uint8 0 0 0 255 ECU_ADDRESS 0x70011d9d /end MEASUREMENT
/begin MEASUREMENT DCH_stBEMChRdyTOut "" UBYTE VBU0706_CM_uint8 0 0 0 255 ECU_ADDRESS 0x70011d9e /end MEASUREMENT
/begin MEASUREMENT DCH_stBEMChStTOut "" UBYTE VBU0706_CM_uint8 0 0 0 255 ECU_ADDRESS 0x70011d9f /end MEASUREMENT
/begin MEASUREMENT DCH_stBEMChgrStopTOut "" UBYTE VBU0706_CM_uint8 0 0 0 255 ECU_ADDRESS 0x70011da0 /end MEASUREMENT
/begin MEASUREMENT DCH_stBEMId00TOut "" UBYTE VBU0706_CM_uint8 0 0 0 255 ECU_ADDRESS 0x70011da1 /end MEASUREMENT
/begin MEASUREMENT DCH_stBEMIdAATOut "" UBYTE VBU0706_CM_uint8 0 0 0 255 ECU_ADDRESS 0x70011da2 /end MEASUREMENT
/begin MEASUREMENT DCH_stBEMStatsDataTOut "" UBYTE VBU0706_CM_uint8 0 0 0 255 ECU_ADDRESS 0x70011da3 /end MEASUREMENT
/begin MEASUREMENT DCH_stBROBattChRdy "" UBYTE VBU0706_CM_uint8 0 0 0 255 ECU_ADDRESS 0x70011da4 /end MEASUREMENT
/begin MEASUREMENT DCH_stSup "" UBYTE VBU0706_CM_uint8 0 0 0 255 ECU_ADDRESS 0x70011da6 /end MEASUREMENT
/begin MEASUREMENT DCH_stChStateGen "" UBYTE VBU0706_CM_uint8 0 0 0 255 ECU_ADDRESS 0x70011da5 /end MEASUREMENT
/begin MEASUREMENT OCV_flgOcvValid "" UBYTE VBU0706_CM_boolean 0 0 0 1 ECU_ADDRESS 0x70011e87 /end MEASUREMENT
/begin MEASUREMENT OCV_flgQuasiOcvValid "" UBYTE VBU0706_CM_boolean 0 0 0 1 ECU_ADDRESS 0x70011e89 /end MEASUREMENT
/begin MEASUREMENT OCV_flgOcvShortTimeValid "" UBYTE VBU0706_CM_boolean 0 0 0.0 1.0 ECU_ADDRESS 0x70011e86 /end MEASUREMENT
/begin MEASUREMENT SOC_flgOcvShortTimeCorrectionComplete "" UBYTE VBU0706_CM_boolean 0 0 0.0 1.0 ECU_ADDRESS 0x70011ed9 /end MEASUREMENT
/begin MEASUREMENT ISO_flgIsolationStatus "" UBYTE VBU0706_CM_boolean 0 0 0.0 1.0 ECU_ADDRESS 0x70011e46 /end MEASUREMENT
/begin MEASUREMENT THM_flgTempRequestValid "" UBYTE VBU0706_CM_boolean 0 0 0 1 ECU_ADDRESS 0x70011f04 /end MEASUREMENT
/begin MEASUREMENT DCH_flgReceiveCEM "" UBYTE VBU0706_CM_boolean 0 0 0.0 1.0 ECU_ADDRESS 0x70011d91 /end MEASUREMENT
/begin MEASUREMENT DCH_flgReceiveCHM "" UBYTE VBU0706_CM_boolean 0 0 0.0 1.0 ECU_ADDRESS 0x70011d92 /end MEASUREMENT
/begin MEASUREMENT DCH_flgReceiveCML "" UBYTE VBU0706_CM_boolean 0 0 0.0 1.0 ECU_ADDRESS 0x70011d93 /end MEASUREMENT
/begin MEASUREMENT DCH_flgReceiveCRM "" UBYTE VBU0706_CM_boolean 0 0 0.0 1.0 ECU_ADDRESS 0x70011d94 /end MEASUREMENT
/begin MEASUREMENT DCH_flgReceiveCRO "" UBYTE VBU0706_CM_boolean 0 0 0.0 1.0 ECU_ADDRESS 0x70011d95 /end MEASUREMENT
/begin MEASUREMENT DCH_flgReceiveCSD "" UBYTE VBU0706_CM_boolean 0 0 0.0 1.0 ECU_ADDRESS 0x70011d96 /end MEASUREMENT
/begin MEASUREMENT DCH_flgReceiveCCS "" UBYTE VBU0706_CM_boolean 0 0 0.0 1.0 ECU_ADDRESS 0x70011d90 /end MEASUREMENT
/begin MEASUREMENT DCH_flgReceiveCST "" UBYTE VBU0706_CM_boolean 0 0 0.0 1.0 ECU_ADDRESS 0x70011d97 /end MEASUREMENT
/begin MEASUREMENT DCH_flgReceiveCTS "" UBYTE VBU0706_CM_boolean 0 0 0.0 1.0 ECU_ADDRESS 0x70011d98 /end MEASUREMENT
/begin MEASUREMENT SOC_flgOcvShortTimeDisChDiff "" UBYTE VBU0706_CM_boolean 0 0 0.0 1.0 ECU_ADDRESS 0x70011edb /end MEASUREMENT
/begin MEASUREMENT SOC_flgOcvShortTimeCorrection "" UBYTE VBU0706_CM_boolean 0 0 0.0 1.0 ECU_ADDRESS 0x70011ed8 /end MEASUREMENT
/begin MEASUREMENT SOC_flgOcvShortTimeVolDirection "" UBYTE VBU0706_CM_boolean 0 0 0.0 1.0 ECU_ADDRESS 0x70011edc /end MEASUREMENT
/begin MEASUREMENT SOC_flgStartupFilterDelay "" UBYTE VBU0706_CM_boolean 0 0 0.0 1.0 ECU_ADDRESS 0x70011ee2 /end MEASUREMENT
/begin MEASUREMENT SOC_flgSocInitializationDelay "" UBYTE VBU0706_CM_boolean 0 0 0.0 1.0 ECU_ADDRESS 0x70011ee0 /end MEASUREMENT
/begin MEASUREMENT SOC_flgCellSocCorrectionFinished "" UBYTE VBU0706_CM_boolean 0 0 0.0 1.0 ECU_ADDRESS 0x70011ed4 /end MEASUREMENT
/begin MEASUREMENT SOC_flgSocInitializeComplete "" UBYTE VBU0706_CM_boolean 0 0 0.0 1.0 ECU_ADDRESS 0x70011ee1 /end MEASUREMENT
/begin MEASUREMENT SOC_flgOcvCorrection "" UBYTE VBU0706_CM_boolean 0 0 0.0 1.0 ECU_ADDRESS 0x70011ed7 /end MEASUREMENT
/begin MEASUREMENT SOC_flgCellDataValid "" UBYTE VBU0706_CM_boolean 0 0 0.0 1.0 ECU_ADDRESS 0x70011ed2 /end MEASUREMENT
/begin MEASUREMENT NVM_flgActualTimeInit "" UBYTE VBU0706_CM_boolean 0 0 0 1 ECU_ADDRESS 0x70011e81 /end MEASUREMENT
/begin MEASUREMENT NVM_flgNVMRestoreRequest "" UBYTE VBU0706_CM_boolean 0 0 0.0 1.0 ECU_ADDRESS 0x70011e83 /end MEASUREMENT
/begin MEASUREMENT NVM_flgNVMReadComplete "" UBYTE VBU0706_CM_boolean 0 0 0 1 ECU_ADDRESS 0x70011e82 /end MEASUREMENT
/begin MEASUREMENT FCC_flgChargeTerminated "" UBYTE VBU0706_CM_boolean 0 0 0.0 1.0 ECU_ADDRESS 0x70011dde /end MEASUREMENT
/begin MEASUREMENT DCH_flgBEMTxEna "" UBYTE VBU0706_CM_boolean 0 0 0.0 1.0 ECU_ADDRESS 0x70011d72 /end MEASUREMENT
/begin MEASUREMENT DCH_flgBSTTxEna "" UBYTE VBU0706_CM_boolean 0 0 0.0 1.0 ECU_ADDRESS 0x70011d79 /end MEASUREMENT
/begin MEASUREMENT DCH_flgBHMTxEna "" UBYTE VBU0706_CM_boolean 0 0 0.0 1.0 ECU_ADDRESS 0x70011d73 /end MEASUREMENT
/begin MEASUREMENT DCH_flgBRMTxEna "" UBYTE VBU0706_CM_boolean 0 0 0.0 1.0 ECU_ADDRESS 0x70011d75 /end MEASUREMENT
/begin MEASUREMENT DCH_flgBCPTxEna "" UBYTE VBU0706_CM_boolean 0 0 0.0 1.0 ECU_ADDRESS 0x70011d70 /end MEASUREMENT
/begin MEASUREMENT DCH_flgBROTxEna "" UBYTE VBU0706_CM_boolean 0 0 0.0 1.0 ECU_ADDRESS 0x70011d76 /end MEASUREMENT
/begin MEASUREMENT DCH_flgBCLTxEna "" UBYTE VBU0706_CM_boolean 0 0 0.0 1.0 ECU_ADDRESS 0x70011d6f /end MEASUREMENT
/begin MEASUREMENT DCH_flgBCSTxEna "" UBYTE VBU0706_CM_boolean 0 0 0.0 1.0 ECU_ADDRESS 0x70011d71 /end MEASUREMENT
/begin MEASUREMENT DCH_flgBSMTxEna "" UBYTE VBU0706_CM_boolean 0 0 0.0 1.0 ECU_ADDRESS 0x70011d78 /end MEASUREMENT
/begin MEASUREMENT DCH_flgBSDTxEna "" UBYTE VBU0706_CM_boolean 0 0 0.0 1.0 ECU_ADDRESS 0x70011d77 /end MEASUREMENT
/begin MEASUREMENT DCH_flgHvRlyReq "" UBYTE VBU0706_CM_boolean 0 0 0.0 1.0 ECU_ADDRESS 0x70011d8b /end MEASUREMENT
/begin MEASUREMENT DCH_flgDCChWakeUp "" UBYTE VBU0706_CM_boolean 0 0 0.0 1.0 ECU_ADDRESS 0x70011d85 /end MEASUREMENT
/begin MEASUREMENT DCH_flgNwOldCNReg "" UBYTE VBU0706_CM_boolean 0 0 0.0 1.0 ECU_ADDRESS 0x70011d8e /end MEASUREMENT
/begin MEASUREMENT DCH_flgOffLoadTOut "" UBYTE VBU0706_CM_boolean 0 0 0.0 1.0 ECU_ADDRESS 0x70011d8f /end MEASUREMENT
/begin MEASUREMENT DCH_flgDftDCChZeroCrntDlyEna "" UBYTE VBU0706_CM_boolean 0 0 0.0 1.0 ECU_ADDRESS 0x70011d88 /end MEASUREMENT
/begin MEASUREMENT DCH_flgDCChRlyReq "" UBYTE VBU0706_CM_boolean 0 0 0.0 1.0 ECU_ADDRESS 0x70011d84 /end MEASUREMENT
/begin MEASUREMENT TP_CM_RX_CANActv_flg "" UBYTE VBU0706_CM_boolean 0 0 0 1 ECU_ADDRESS 0x70011cca /end MEASUREMENT
/begin MEASUREMENT EcOCV_RelaxationStartTime_s "" ULONG VBU0706_CM_uint32 0 0 0 4294967295 ECU_ADDRESS 0x70011602 /end MEASUREMENT
/begin MEASUREMENT DCH_numTOutCnt "" FLOAT32_IEEE VBU0706_CM_single 0 0 -3.4E+38 3.4E+38 ECU_ADDRESS 0x7001150e /end MEASUREMENT
/begin MEASUREMENT DCH_tiDurInChStop "" FLOAT32_IEEE VBU0706_CM_single 0 0 -3.4E+38 3.4E+38 ECU_ADDRESS 0x70011512 /end MEASUREMENT
/begin MEASUREMENT DCH_tiDurTBRO0xAA "" FLOAT32_IEEE VBU0706_CM_single 0 0 -3.4E+38 3.4E+38 ECU_ADDRESS 0x70011516 /end MEASUREMENT
/begin MEASUREMENT DCH_tiDurTBROCloseDCRly "" FLOAT32_IEEE VBU0706_CM_single 0 0 -3.4E+38 3.4E+38 ECU_ADDRESS 0x7001151a /end MEASUREMENT
/begin MEASUREMENT DCH_tiDurTBROCloseHVRly "" FLOAT32_IEEE VBU0706_CM_single 0 0 -3.4E+38 3.4E+38 ECU_ADDRESS 0x7001151e /end MEASUREMENT
/begin MEASUREMENT DCH_tiDurTBRONotReady "" FLOAT32_IEEE VBU0706_CM_single 0 0 -3.4E+38 3.4E+38 ECU_ADDRESS 0x70011522 /end MEASUREMENT
/begin MEASUREMENT DCH_tiDurTHandshake "" FLOAT32_IEEE VBU0706_CM_single 0 0 -3.4E+38 3.4E+38 ECU_ADDRESS 0x70011526 /end MEASUREMENT
/begin MEASUREMENT DCH_tiDurTOpenDCRly "" FLOAT32_IEEE VBU0706_CM_single 0 0 -3.4E+38 3.4E+38 ECU_ADDRESS 0x7001152a /end MEASUREMENT
/begin MEASUREMENT DCH_tiDurTOpenHVRly "" FLOAT32_IEEE VBU0706_CM_single 0 0 -3.4E+38 3.4E+38 ECU_ADDRESS 0x7001152e /end MEASUREMENT
/begin MEASUREMENT DCH_tiDurTWaitCCS "" FLOAT32_IEEE VBU0706_CM_single 0 0 -3.4E+38 3.4E+38 ECU_ADDRESS 0x70011532 /end MEASUREMENT
/begin MEASUREMENT DCH_tiDurTWaitCHM "" FLOAT32_IEEE VBU0706_CM_single 0 0 -3.4E+38 3.4E+38 ECU_ADDRESS 0x70011536 /end MEASUREMENT
/begin MEASUREMENT DCH_tiDurTWaitCML "" FLOAT32_IEEE VBU0706_CM_single 0 0 -3.4E+38 3.4E+38 ECU_ADDRESS 0x7001153a /end MEASUREMENT
/begin MEASUREMENT DCH_tiDurTWaitCRM "" FLOAT32_IEEE VBU0706_CM_single 0 0 -3.4E+38 3.4E+38 ECU_ADDRESS 0x7001153e /end MEASUREMENT
/begin MEASUREMENT DCH_tiDurTWaitCRM0xAA "" FLOAT32_IEEE VBU0706_CM_single 0 0 -3.4E+38 3.4E+38 ECU_ADDRESS 0x70011542 /end MEASUREMENT
/begin MEASUREMENT DCH_tiDurTWaitCRO0xAA "" FLOAT32_IEEE VBU0706_CM_single 0 0 -3.4E+38 3.4E+38 ECU_ADDRESS 0x70011546 /end MEASUREMENT
/begin MEASUREMENT DCH_tiDurTWaitCST "" FLOAT32_IEEE VBU0706_CM_single 0 0 -3.4E+38 3.4E+38 ECU_ADDRESS 0x7001154a /end MEASUREMENT
/begin MEASUREMENT DCH_tiDurTWaitDCRlyOff "" FLOAT32_IEEE VBU0706_CM_single 0 0 -3.4E+38 3.4E+38 ECU_ADDRESS 0x7001154e /end MEASUREMENT
/begin MEASUREMENT DCH_tiDurTZeroCrnt "" FLOAT32_IEEE VBU0706_CM_single 0 0 -3.4E+38 3.4E+38 ECU_ADDRESS 0x70011552 /end MEASUREMENT
/begin MEASUREMENT DCH_tiDurTimeOut "" FLOAT32_IEEE VBU0706_CM_single 0 0 -3.4E+38 3.4E+38 ECU_ADDRESS 0x70011556 /end MEASUREMENT
/begin MEASUREMENT DCH_numChErrCnt "" FLOAT32_IEEE VBU0706_CM_single 0 0 -3.4E+38 3.4E+38 ECU_ADDRESS 0x7001150a /end MEASUREMENT
/begin MEASUREMENT DCH_flgChgrAvlTOut "" UBYTE VBU0706_CM_boolean 0 0 0.0 1.0 ECU_ADDRESS 0x70011d7f /end MEASUREMENT
/begin MEASUREMENT DCH_flgDCChRlyCloseTOut "" UBYTE VBU0706_CM_boolean 0 0 0.0 1.0 ECU_ADDRESS 0x70011d83 /end MEASUREMENT
/begin MEASUREMENT DCH_flgVehChRdyTOut "" UBYTE VBU0706_CM_boolean 0 0 0.0 1.0 ECU_ADDRESS 0x70011d9c /end MEASUREMENT
/begin MEASUREMENT DCH_flgRlyAccidentOpn "" UBYTE VBU0706_CM_boolean 0 0 0.0 1.0 ECU_ADDRESS 0x70011d99 /end MEASUREMENT
/begin COMPU_METHOD VBU0706_CM_single_cnt "Q = V" RAT_FUNC "%8.6" "cnt" COEFFS 0 1 0 0 0 1 /end COMPU_METHOD
/begin COMPU_METHOD VBU0706_CM_uint16_cnt "Q = V" RAT_FUNC "%5.0" "cnt" COEFFS 0 1 0 0 0 1 /end COMPU_METHOD
/begin COMPU_METHOD VBU0706_CM_single_Kpa "Q = V" RAT_FUNC "%8.6" "Kpa" COEFFS 0 1 0 0 0 1 /end COMPU_METHOD
/begin COMPU_METHOD VBU0706_CM_single_mV "Q = V" RAT_FUNC "%8.6" "mV" COEFFS 0 1 0 0 0 1 /end COMPU_METHOD
/begin COMPU_METHOD VBU0706_CM_single_C "Q = V" RAT_FUNC "%8.6" "C" COEFFS 0 1 0 0 0 1 /end COMPU_METHOD
/begin COMPU_METHOD VBU0706_CM_single_bar "Q = V" RAT_FUNC "%8.6" "bar" COEFFS 0 1 0 0 0 1 /end COMPU_METHOD
/begin COMPU_METHOD VBU0706_CM_single_pct "Q = V" RAT_FUNC "%8.6" "pct" COEFFS 0 1 0 0 0 1 /end COMPU_METHOD
/begin COMPU_METHOD VBU0706_CM_uint16 "Q = V" RAT_FUNC "%5.0" "" COEFFS 0 1 0 0 0 1 /end COMPU_METHOD
/begin COMPU_METHOD VBU0706_CM_uint8 "Q = V" RAT_FUNC "%3.0" "" COEFFS 0 1 0 0 0 1 /end COMPU_METHOD
/begin COMPU_METHOD VBU0706_CM_single "Q = V" RAT_FUNC "%8.6" "" COEFFS 0 1 0 0 0 1 /end COMPU_METHOD
/begin COMPU_METHOD VBU0706_CM_single_ms "Q = V" RAT_FUNC "%8.6" "ms" COEFFS 0 1 0 0 0 1 /end COMPU_METHOD
/begin COMPU_METHOD VBU0706_CM_uint32_cnt "Q = V" RAT_FUNC "%10.0" "cnt" COEFFS 0 1 0 0 0 1 /end COMPU_METHOD
/begin COMPU_METHOD VBU0706_CM_uint16_ms "Q = V" RAT_FUNC "%5.0" "ms" COEFFS 0 1 0 0 0 1 /end COMPU_METHOD
/begin COMPU_METHOD VBU0706_CM_boolean "Q = V" RAT_FUNC "%1.0" "" COEFFS 0 1 0 0 0 1 /end COMPU_METHOD
/begin COMPU_METHOD VBU0706_CM_boolean_cnt "Q = V" RAT_FUNC "%1.0" "cnt" COEFFS 0 1 0 0 0 1 /end COMPU_METHOD
/begin COMPU_METHOD VBU0706_CM_boolean_C "Q = V" RAT_FUNC "%1.0" "C" COEFFS 0 1 0 0 0 1 /end COMPU_METHOD
/begin COMPU_METHOD VBU0706_CM_int8_cnt "Q = V" RAT_FUNC "%3.0" "cnt" COEFFS 0 1 0 0 0 1 /end COMPU_METHOD
/begin COMPU_METHOD VBU0706_CM_uint8_cnt "Q = V" RAT_FUNC "%3.0" "cnt" COEFFS 0 1 0 0 0 1 /end COMPU_METHOD
/begin COMPU_METHOD VBU0706_CM_uint32 "Q = V" RAT_FUNC "%10.0" "" COEFFS 0 1 0 0 0 1 /end COMPU_METHOD
/begin GROUP S1034_DCH_BMSChgrReq "VBU0706/Function-Call Subsystem/Subsystem1/FCC /DCH_Overall/DCH_DCChargeCtrlOverall/DCH_BMSChgrReq" /begin SUB_GROUP S1037_Turn_On_Delay_Time S1037_Turn_On_Delay_Time1 /end SUB_GROUP
 /begin REF_CHARACTERISTIC DCH_facLimitChrCrnntLvl0V_C DCH_facLimitChrCrnntLvl1V_C DCH_facLimitChrCrnntLvl2V_C DCH_facLimitChrCrnntLvl3V_C DCH_facOneTmpSnsrInvldLmt_C DCH_iCMLMinChCurr_C DCH_iDCChOneSnsrInvldCrntLmt_C DCH_iDCChPortFailureChCurr_C DCH_iDCChReqLowLim_C DCH_iDCChReqUpLim_C DCH_iStatnLackCrnntThres_C DCH_stBCLMode_SY DCH_stChrgPortSnglSnsr_SY DCH_stChrgPortSnsrConfig_C DCH_stWaitCHMMode_SY DCH_tLimitChrCrnntLvl1L_C DCH_tLimitChrCrnntLvl1R_C DCH_tLimitChrCrnntLvl2L_C DCH_tLimitChrCrnntLvl2R_C DCH_tLimitChrCrnntLvl3L_C DCH_tLimitChrCrnntLvl3R_C DCH_tiSmplT_SY DCH_tiStatnLackCrnntThres_C /end REF_CHARACTERISTIC
 /begin REF_MEASUREMENT DCH_iBMSDCChReqLim /end REF_MEASUREMENT
/end GROUP
/begin GROUP S1034_DCH_DCChargeCtrlStateflow "VBU0706/Function-Call Subsystem/Subsystem1/FCC /DCH_Overall/DCH_DCChargeCtrlOverall/DCH_DCChargeCtrlStateflow"
 /begin SUB_GROUP S1038_DCH_CtrlStateflowPostProcess S1038_DCH_InputSignalPreProcess S1038_DCH_SignalPreProcessForStateflow /end SUB_GROUP
 /begin REF_CHARACTERISTIC DCH_flgDCChRlyClose_SY DCH_flgDCChRlyOpen_SY DCH_flgHvRlyClose_SY DCH_flgHvRlyOpen_SY DCH_numMaxChErrReconn_C DCH_numTOutCnt_C DCH_stBCLMode_SY DCH_stBCPMode_SY DCH_stBRMMode_SY DCH_stBRONoRdyMode_SY DCH_stBRORdyMode_SY DCH_stBSTForNrmMode_SY DCH_stCC2AplusConnect_SY DCH_stChStopChgrErr_SY DCH_stChStopChgrManual_SY DCH_stChStopIso_SY DCH_stChStopVehCmpt_SY DCH_stChStopVehErr_SY DCH_stChargeFinishMode_SY DCH_stCharging_SY DCH_stClDCChRlyMode_SY DCH_stComTOut_SY DCH_stHandshake_SY DCH_stHvRlyMode_SY DCH_stInitMode_SY DCH_stInit_SY DCH_stLvShutDownForNrmMode_SY DCH_stOpenDCRlyForBMSTOutMode_SY DCH_stOpenDCRlyForNrmMode_SY DCH_stOpenHvForBMSTOutMode_SY DCH_stParConfig_SY DCH_stPreOpenDCRly_SY DCH_stReConnectChProcessMode_SY DCH_stStopBMS_SY DCH_stStopCC2ConnErr_SY DCH_stStopChAvlErr_SY DCH_stStopChRdyTout_SY DCH_stStopChgrAvl_SY DCH_stStopChgrErr_SY DCH_stStopCrntLrgErr_SY DCH_stStopCrntOvr_SY DCH_stStopDCRlyClTout_SY DCH_stStopDCRlyOpErr_SY DCH_stStopFidErr_SY DCH_stStopHVRlyOpErr_SY DCH_stStopHlfConnErr_SY DCH_stStopIso_SY DCH_stStopManual_SY DCH_stStopToutOvr3_SY DCH_stStopZeroCrnt_SY DCH_stTimeOutInTimeOut_SY DCH_stWaitCHMMode_SY DCH_stWaitCRMMode_SY DCH_stWaitCSDForNrmMode_SY DCH_tiCCSTOut_C DCH_tiCHMtoCRMTOut_C DCH_tiCRM00TOutStrtFrmCHM_C DCH_tiCRM00TOut_C DCH_tiCRMAATOut_C DCH_tiCROAATOutStrtFrmBRO_C DCH_tiCROAATOut_C DCH_tiCSTTOut_C DCH_tiChCap_C DCH_tiChRdy_C DCH_tiChgrAvl_C DCH_tiDCChRly_C DCH_tiDCRlyDiagDly_C DCH_tiDlyCCSnotChging_C DCH_tiOpenHvRly_C DCH_tiReStartChProcess_C DCH_tiSmplT_SY DCH_tisinceBEMCEMTOut_C DCH_tisinceBSTSentOutTOut_C /end REF_CHARACTERISTIC
 /begin REF_MEASUREMENT DCH_flgBCLTxEna DCH_flgBCPTxEna DCH_flgBCSTxEna DCH_flgBEMTxEna DCH_flgBHMTxEna DCH_flgBRMTxEna DCH_flgBROTxEna DCH_flgBSDTxEna DCH_flgBSMTxEna DCH_flgBSTTxEna DCH_flgChgrAvlTOut DCH_flgDCChRlyCloseTOut DCH_flgDCChRlyReq DCH_flgDCChWakeUp DCH_flgDftDCChZeroCrntDlyEna DCH_flgHvRlyReq DCH_flgNwOldCNReg DCH_flgOffLoadTOut DCH_flgRlyAccidentOpn DCH_flgVehChRdyTOut DCH_numChErrCnt DCH_numTOutCnt DCH_stBEMChCapTOut DCH_stBEMChRdyTOut DCH_stBEMChStTOut DCH_stBEMChgrStopTOut DCH_stBEMId00TOut DCH_stBEMIdAATOut DCH_stBEMStatsDataTOut DCH_stBROBattChRdy DCH_stChStateGen DCH_stChStopReason DCH_stSup DCH_tiDurInChStop DCH_tiDurTBRO0xAA DCH_tiDurTBROCloseDCRly DCH_tiDurTBROCloseHVRly DCH_tiDurTBRONotReady DCH_tiDurTHandshake DCH_tiDurTOpenDCRly DCH_tiDurTOpenHVRly DCH_tiDurTWaitCCS DCH_tiDurTWaitCHM DCH_tiDurTWaitCML DCH_tiDurTWaitCRM DCH_tiDurTWaitCRM0xAA DCH_tiDurTWaitCRO0xAA DCH_tiDurTWaitCST DCH_tiDurTWaitDCRlyOff DCH_tiDurTZeroCrnt DCH_tiDurTimeOut /end REF_MEASUREMENT
/end GROUP
/begin GROUP S1034_DCH_Diagnose "VBU0706/Function-Call Subsystem/Subsystem1/FCC /DCH_Overall/DCH_DCChargeCtrlOverall/DCH_Diagnose"
 /begin SUB_GROUP S1039_DCH_BmsVoltagCurrentDiagnose S1039_DCH_ChargeErrDetect S1039_DCH_VehErrDetect /end SUB_GROUP
/end GROUP
/begin GROUP S1034_DCH_EepromStore "VBU0706/Function-Call Subsystem/Subsystem1/FCC /DCH_Overall/DCH_DCChargeCtrlOverall/DCH_EepromStore"
 /begin SUB_GROUP S1040_DCH_ChargeStopErrDiagnose S1040_DCH_ChargeTimeOutDiagnose S1040_DataConvertandCSTEEPROM /end SUB_GROUP
/end GROUP
/begin GROUP S1034_DSPLLight "VBU0706/Function-Call Subsystem/Subsystem1/FCC /DCH_Overall/DCH_DCChargeCtrlOverall/DSPLLight"
 /begin REF_CHARACTERISTIC DCH_stChStopChgrErr_SY DCH_stChStopChgrManual_SY DCH_stChStopIso_SY DCH_stChStopVehCmpt_SY DCH_stChStopVehErr_SY DCH_stChargeFinishMode_SY DCH_stInit_SY DCH_stWaitCHMMode_SY /end REF_CHARACTERISTIC
/end GROUP
/begin GROUP S1035_DCH_J1939ReceiveProcess "VBU0706/Function-Call Subsystem/Subsystem1/FCC /DCH_Overall/DCH_J1939InputProcess/DCH_J1939ReceiveProcess"
 /begin REF_CHARACTERISTIC DCH_flgOvrdReceiveCCS_C DCH_flgOvrdReceiveCEM_C DCH_flgOvrdReceiveCHM_C DCH_flgOvrdReceiveCML_C DCH_flgOvrdReceiveCRM_C DCH_flgOvrdReceiveCRO_C DCH_flgOvrdReceiveCSD_C DCH_flgOvrdReceiveCST_C DCH_flgOvrdValReceiveCCS_C DCH_flgOvrdValReceiveCEM_C DCH_flgOvrdValReceiveCHM_C DCH_flgOvrdValReceiveCML_C DCH_flgOvrdValReceiveCRM_C DCH_flgOvrdValReceiveCRO_C DCH_flgOvrdValReceiveCSD_C DCH_flgOvrdValReceiveCST_C /end REF_CHARACTERISTIC
 /begin REF_MEASUREMENT DCH_flgReceiveCCS DCH_flgReceiveCEM DCH_flgReceiveCHM DCH_flgReceiveCML DCH_flgReceiveCRM DCH_flgReceiveCRO DCH_flgReceiveCSD DCH_flgReceiveCST DCH_flgReceiveCTS /end REF_MEASUREMENT
/end GROUP
/begin GROUP S1036_DCH_J1939OutputProcessBCL "VBU0706/Function-Call Subsystem/Subsystem1/FCC /DCH_Overall/DCH_J1939OutputSignalProcess/DCH_J1939OutputProcessBCL"
 /begin REF_CHARACTERISTIC DCH_flgBCLChModeReqOvrd_C DCH_flgBCLCurrReqOvrd_C DCH_flgBCLVltgReqOvrd_C DCH_iBCLCurrReqOvrdVal_C DCH_stBCLChModeReqOvrdVal_C DCH_stBCLConstantCurrMode_C DCH_stBCLConstantVltgMode_C DCH_uBCLVltgReqOvrdVal_C DCH_uDCChReqLowLim_C DCH_uDCChReqUpLim_C /end REF_CHARACTERISTIC
/end GROUP
/begin GROUP S1036_DCH_J1939OutputProcessBCP "VBU0706/Function-Call Subsystem/Subsystem1/FCC /DCH_Overall/DCH_J1939OutputSignalProcess/DCH_J1939OutputProcessBCP"
 /begin REF_CHARACTERISTIC DCH_flgBCPBattVltgOvrd_C DCH_flgBCPMaxCellVltgForChOvrd_C DCH_flgBCPMaxChCurrOvrd_C DCH_flgBCPMaxPermitTempOvrd_C DCH_flgBCPMaxVltgForChOvrd_C DCH_flgBCPNrmCapOvrd_C DCH_flgBCPSocOvrd_C DCH_tBCPMaxPermitTempLowLim_C DCH_tBCPMaxPermitTempUpLim_C /end REF_CHARACTERISTIC
/end GROUP
/begin GROUP S1036_DCH_J1939OutputProcessBCS "VBU0706/Function-Call Subsystem/Subsystem1/FCC /DCH_Overall/DCH_J1939OutputSignalProcess/DCH_J1939OutputProcessBCS"
 /begin REF_CHARACTERISTIC DCH_flgBCSChCurrMeasureOvrd_C DCH_flgBCSChNeedTOvrd_C DCH_flgBCSChVltgMeasureOvrd_C DCH_flgBCSCurrSocOvrd_C DCH_flgBCSMaxCellVltgNumOvrd_C DCH_flgBCSMaxCellVltgOvrd_C DCH_numBCSMaxCellNumLowLim_C DCH_numBCSMaxCellNumUpLim_C DCH_tiBCSEstChTiLowLim_C DCH_tiBCSEstChTiUpLim_C /end REF_CHARACTERISTIC
/end GROUP
/begin GROUP S1036_DCH_J1939OutputProcessBEM "VBU0706/Function-Call Subsystem/Subsystem1/FCC /DCH_Overall/DCH_J1939OutputSignalProcess/DCH_J1939OutputProcessBEM"
 /begin REF_CHARACTERISTIC DCH_flgBEMChCapTOutOvrd_C DCH_flgBEMChRdyTOutOvrd_C DCH_flgBEMChStTOutOvrd_C DCH_flgBEMChgrStopTOutOvrd_C DCH_flgBEMId00TOutOvrd_C DCH_flgBEMIdAATOutOvrd_C DCH_flgBEMStatsDataTOutOvrd_C DCH_stBEMChCapTOutOvrdVal_C DCH_stBEMChRdyTOutOvrdVal_C DCH_stBEMChStTOutOvrdVal_C DCH_stBEMChgrStopTOutOvrdVal_C DCH_stBEMId00TOutOvrdVal_C DCH_stBEMIdAATOutOvrdVal_C DCH_stBEMStatsDataTOutOvrdVal_C /end REF_CHARACTERISTIC
/end GROUP
/begin GROUP S1036_DCH_J1939OutputProcessBRO "VBU0706/Function-Call Subsystem/Subsystem1/FCC /DCH_Overall/DCH_J1939OutputSignalProcess/DCH_J1939OutputProcessBRO" /begin REF_CHARACTERISTIC DCH_flgBROBattChRdyOvrd_C DCH_stBROBattChRdyOvrdVal_C /end REF_CHARACTERISTIC /end GROUP
/begin GROUP S1036_DCH_J1939OutputProcessBSD "VBU0706/Function-Call Subsystem/Subsystem1/FCC /DCH_Overall/DCH_J1939OutputSignalProcess/DCH_J1939OutputProcessBSD"
 /begin REF_CHARACTERISTIC DCH_flgBSDChEndSocOvrd_C DCH_flgBSDMaxCellTempOvrd_C DCH_flgBSDMaxCellVltgOvrd_C DCH_flgBSDMinCellTempOvrd_C DCH_flgBSDMinCellVltgOvrd_C DCH_pctBSDChEndSocOvrdVal_C DCH_tBSDMaxCellTempOvrdVal_C DCH_tBSDMinCellTempOvrdVal_C DCH_uBSDMaxCellVltgOvrdVal_C DCH_uBSDMinCellVltgOvrdVal_C /end REF_CHARACTERISTIC
/end GROUP
/begin GROUP S1036_DCH_J1939OutputProcessBSM "VBU0706/Function-Call Subsystem/Subsystem1/FCC /DCH_Overall/DCH_J1939OutputSignalProcess/DCH_J1939OutputProcessBSM"
 /begin REF_CHARACTERISTIC DCH_flgBSMBattOutConnStOvrdVal_C DCH_flgBSMBattOutConnStOvrd_C DCH_flgBSMCellVltgOverUndOvrdVal_C DCH_flgBSMCellVltgOverUndOvrd_C DCH_flgBSMChCurrOverOvrdVal_C DCH_flgBSMChCurrOverOvrd_C DCH_flgBSMChPermitOvrdVal_C DCH_flgBSMChPermitOvrd_C DCH_flgBSMIsoStOvrdVal_C DCH_flgBSMIsoStOvrd_C DCH_flgBSMMaxCellTempNumOvrd_C DCH_flgBSMMaxCellTempOvrd_C DCH_flgBSMMaxCellVltgNumOvrd_C DCH_flgBSMMinCellTempNumOvrd_C DCH_flgBSMMinCellTempOvrd_C DCH_flgBSMSocOverUndOvrdVal_C DCH_flgBSMSocOverUndOvrd_C DCH_flgBSMTempOverOvrdVal_C DCH_flgBSMTempOverOvrd_C DCH_numBSMMaxCellTempNumOvrdVal_C DCH_numBSMMaxCellVltgNumOvrdVal_C DCH_numBSMMinCellTempNumOvrdVal_C DCH_tBSMMaxCellTempOvrdVal_C DCH_tBSMMinCellTempOvrdVal_C /end REF_CHARACTERISTIC
/end GROUP
/begin GROUP S1036_DCH_J1939OutputProcessBST "VBU0706/Function-Call Subsystem/Subsystem1/FCC /DCH_Overall/DCH_J1939OutputSignalProcess/DCH_J1939OutputProcessBST"
 /begin REF_CHARACTERISTIC DCH_flgBSTChStopForBMSConnOverTempOvrdVal_C DCH_flgBSTChStopForBMSConnOverTempOvrd_C DCH_flgBSTChStopForBattOverTempOvrdVal_C DCH_flgBSTChStopForBattOverTempOvrd_C DCH_flgBSTChStopForCCToVltgFaultOvrdVal_C DCH_flgBSTChStopForCCToVltgFaultOvrd_C DCH_flgBSTChStopForCellVltgOvrdVal_C DCH_flgBSTChStopForCellVltgOvrd_C DCH_flgBSTChStopForChgrReqStopOvrdVal_C DCH_flgBSTChStopForChgrReqStopOvrd_C DCH_flgBSTChStopForConnFaultOvrdVal_C DCH_flgBSTChStopForConnFaultOvrd_C DCH_flgBSTChStopForConnOverTempOvrdVal_C DCH_flgBSTChStopForConnOverTempOvrd_C DCH_flgBSTChStopForHvRlyFaultOvrdVal_C DCH_flgBSTChStopForHvRlyFaultOvrd_C DCH_flgBSTChStopForIsoFaultOvrdVal_C DCH_flgBSTChStopForIsoFaultOvrd_C DCH_flgBSTChStopForOtherFaultOvrdVal_C DCH_flgBSTChStopForOtherFaultOvrd_C DCH_flgBSTChStopForOverCurrOvrdVal_C DCH_flgBSTChStopForOverCurrOvrd_C DCH_flgBSTChStopForSocOvrdVal_C DCH_flgBSTChStopForSocOvrd_C DCH_flgBSTChStopForTotalVltgOvrdVal_C DCH_flgBSTChStopForTotalVltgOvrd_C DCH_flgBSTChStopForVltgAbNrmOvrdVal_C DCH_flgBSTChStopForVltgAbNrmOvrd_C DCH_stWaitCHMMode_SY /end REF_CHARACTERISTIC
/end GROUP
/begin GROUP S1157_Calculate_Fastcharge_Time "VBU0706/Function-Call Subsystem/Subsystem1/FCC /FCC/Subsystem/Calculate_Fastcharge_Time"
 /begin SUB_GROUP S1158_Calculate_FastChargeBaseRemainTime S1158_EightyPercentCustomSOC_CaculateChargeTime S1158_EightyPercentCustomSOC_EnableInvalidChargeTimeFlag S1158_EightyPercentCustomSOC_UpdateChargeTimeFlag S1158_EstimateChargeTime_CellVoltageMax_Coefficient S1158_EstimateChargeTime_CellVoltageMax_Slop S1158_SOC_Mapping S1158_SendInvalidTime_flg S1158_UpdateTimeTrigger S1158_Update_CustomSOC100RemainTime S1158_Update_CustomSOC80RemainTime /end SUB_GROUP
 /begin REF_CHARACTERISTIC CcFCC_EightyCustomSOC_pct CcFCC_EstimateChargeInvalidTime_min /end REF_CHARACTERISTIC
 /begin REF_MEASUREMENT FCC_timinActualRemainChargeTime FCC_timinEstimateChargeTime FCC_timinEstimatePercTime /end REF_MEASUREMENT
/end GROUP
/begin GROUP S1157_Determine_Fastcharge_Request "VBU0706/Function-Call Subsystem/Subsystem1/FCC /FCC/Subsystem/Determine_Fastcharge_Request"
 /begin SUB_GROUP S1159_Charge_Request_Protection S1159_DetermineComputeResistancePulseCurrent S1159_Determine_Base_ChargeRequest S1159_Determine_DiagnosedAndLimitedChargeRequestCurrent /end SUB_GROUP
/end GROUP
/begin GROUP S1157_Fastcharge_Conditions_Check "VBU0706/Function-Call Subsystem/Subsystem1/FCC /FCC/Subsystem/Fastcharge_Conditions_Check" /begin SUB_GROUP S1160_Condition_Categorize S1160_Determine_NoCharge_Cause /end SUB_GROUP /end GROUP
/begin GROUP S1157_Fastcharge_State_Management "VBU0706/Function-Call Subsystem/Subsystem1/FCC /FCC/Subsystem/Fastcharge_State_Management"
 /begin REF_CHARACTERISTIC CcFCC_ChargeAbortDelayTime_s CcFCC_ChargeCompleteComfirmDelay_ms CcFCC_ChargeFaultDelayTime_s CcFCC_ChargeFullDelayTime_s CcFCC_ChargeProtectDelayTime_s FCC_STATE_ABORT_CHARGE FCC_STATE_BMS_CLOSE_CONTACTORS FCC_STATE_CHARGE_PROTECTION FCC_STATE_DEACTIVATE_DEVICES FCC_STATE_STANDBY FCC_STATE_SYSTEM_STATUS_CHECK FCC_STATE_WAIT_VCU_COMMAND /end REF_CHARACTERISTIC
 /begin REF_MEASUREMENT FCC_flgChargeTerminated FCC_stChargeState FCC_stContactorRequest FCC_tisChargeAbortTimer FCC_tisChargeFaultTimer FCC_tisChargeFullTimer FCC_tisChargeProtectTimer /end REF_MEASUREMENT
/end GROUP
/begin GROUP S1157_Fastcharge_Violation_Diagnostic "VBU0706/Function-Call Subsystem/Subsystem1/FCC /FCC/Subsystem/Fastcharge_Violation_Diagnostic"
 /begin REF_CHARACTERISTIC CaFCC_ChargeCurrentOverFactorMapY_nbr CbFCC_ChargeCurrentOverFaultEnable_flg CcFCC_ChargeCurrentOverDelta_A CcFCC_ChargeCurrentOverFaultFIC_n CcFCC_ChargeCurrentOverFaultPIC_n CcFCC_ChargeCurrentOver_A /end REF_CHARACTERISTIC
/end GROUP
/begin GROUP S1157_MapingSOC "VBU0706/Function-Call Subsystem/Subsystem1/FCC /FCC/Subsystem/MapingSOC" /begin REF_CHARACTERISTIC CcSYS_CellSOCLockedMax_pct CcSYS_CellSOCLockedMin_pct /end REF_CHARACTERISTIC /end GROUP
/begin GROUP S1403_Determine_EVMandStatus "VBU0706/Function-Call Subsystem/Subsystem1/ISO/Determine_FaultDetection_Check/Status_Process/Determine_EVMandStatus" /begin REF_MEASUREMENT ISO_flgIsolationStatus ISO_stIsolationEVM /end REF_MEASUREMENT /end GROUP
/begin GROUP S1403_Determine_IsolationLevel "VBU0706/Function-Call Subsystem/Subsystem1/ISO/Determine_FaultDetection_Check/Status_Process/Determine_IsolationLevel" /begin REF_CHARACTERISTIC CcISO_DCStationFaultDelayTime_ms /end REF_CHARACTERISTIC /begin REF_MEASUREMENT ISO_stIsolationLevel /end REF_MEASUREMENT /end GROUP
/begin GROUP S1436_Check_First_Run "VBU0706/Function-Call Subsystem/Subsystem1/NVM /Subsystem3/Read_NVM_Data/Check_First_Run" /begin REF_CHARACTERISTIC CbNVM_FirstRun_flg /end REF_CHARACTERISTIC /begin REF_MEASUREMENT NVM_flgActualTimeInit NVM_flgNVMRestoreRequest /end REF_MEASUREMENT /end GROUP
/begin GROUP S1436_Check_NVM_Read "VBU0706/Function-Call Subsystem/Subsystem1/NVM /Subsystem3/Read_NVM_Data/Check_NVM_Read" /begin REF_CHARACTERISTIC NVM_READ_CRC_FAIL NVM_READ_HARDWARE_FAIL NVM_READ_SUCCESS /end REF_CHARACTERISTIC /begin REF_MEASUREMENT NVM_flgNVMReadComplete /end REF_MEASUREMENT /end GROUP
/begin GROUP S1455_Determine_Criteria "VBU0706/Function-Call Subsystem/Subsystem1/OCV/OCV/Subsystem/Determine_Criteria" /begin SUB_GROUP S1456_Determine_OCV_Criteria S1456_Determine_QOCV_Criteria /end SUB_GROUP /end GROUP
/begin GROUP S1455_Determine_Relax_ElapsedTime "VBU0706/Function-Call Subsystem/Subsystem1/OCV/OCV/Subsystem/Determine_Relax_ElapsedTime" /begin REF_MEASUREMENT EcOCV_RelaxationStartTime_s OCV_tisRelaxationElapsedTime /end REF_MEASUREMENT /end GROUP
/begin GROUP S1455_Determine_Relax_MinTime "VBU0706/Function-Call Subsystem/Subsystem1/OCV/OCV/Subsystem/Determine_Relax_MinTime"
 /begin REF_CHARACTERISTIC CaOCV_RelaxaShortTimeCurveY_s CaOCV_RelaxationTimeCurveY_s CcOCV_RelaxationMinRequiredTime_s CcOCV_RelaxationRequiredShortTime_s CcSYS_NoOfInvalidCellTemps_n /end REF_CHARACTERISTIC
/end GROUP
/begin GROUP S1455_OCV_Valid_Check "VBU0706/Function-Call Subsystem/Subsystem1/OCV/OCV/Subsystem/OCV_Valid_Check"
 /begin REF_MEASUREMENT OCV_flgOcvShortTimeValid OCV_flgOcvValid OCV_flgQuasiOcvValid /end REF_MEASUREMENT
/end GROUP
/begin GROUP S1464_Initialize_Actual_Time "VBU0706/Function-Call Subsystem/Subsystem1/RTC/RTC/Calculate_Actual_Time/Initialize_Actual_Time" /begin REF_CHARACTERISTIC CbRTC_flgActualTimeCheckEnable /end REF_CHARACTERISTIC /end GROUP
/begin GROUP S1466_Calculate_Time_Deviation "VBU0706/Function-Call Subsystem/Subsystem1/RTC/RTC/Determine_VCU_ActualTime/Calculate_Time_Deviation"
 /begin REF_CHARACTERISTIC CcRTC_ActualTimeDeviationThreshold_s CcRTC_EnableVCURtcCrection_flg /end REF_CHARACTERISTIC
/end GROUP
/begin GROUP S1491_Battery_SoC_Diagnostic "VBU0706/Function-Call Subsystem/Subsystem1/SOC/Subsystem5/Subsystem/Battery_SoC_Diagnostic"
 /begin REF_CHARACTERISTIC CbSOC_BatterySocHighFaultEnable_flg CcSOC_BatteryCapacity10Cycles_n CcSOC_BatteryCapacity70Cycles_n CcSOC_BatterySocHighFault10Cycles_pct CcSOC_BatterySocHighFault70Cycles_pct CcSOC_BatterySocHighFaultFIC_n CcSOC_BatterySocHighFaultPIC_n CcSOC_BatterySocHighFault_pct SOC_BATTERY_SOC_HIGH_FAULT /end REF_CHARACTERISTIC
/end GROUP
/begin GROUP S1491_Determine_AhIntegral_SoC "VBU0706/Function-Call Subsystem/Subsystem1/SOC/Subsystem5/Subsystem/Determine_AhIntegral_SoC"
 /begin SUB_GROUP S1493_Determine_AhIntegral_Capacity S1493_Determine_AhIntegral_SOC S1493_Determine_Module_Current /end SUB_GROUP
/end GROUP
/begin GROUP S1491_Determine_Battery_SOC "VBU0706/Function-Call Subsystem/Subsystem1/SOC/Subsystem5/Subsystem/Determine_Battery_SOC"
 /begin REF_CHARACTERISTIC CaSOC_SOCPLowY_pct CbSYS_HomoTestEnable_flg CcSOC_BatteryCapacity10Cycles_n CcSOC_BatteryCapacity70Cycles_n CcSOC_BatterySocLowerLimit_pct CcSOC_BatterySocUpperLimit_pct CcSOC_BatteryUsableSocLowerLimit10Cycles_pct CcSOC_BatteryUsableSocLowerLimit70Cycles_pct CcSOC_BatteryUsableSocLowerLimitHomo_pct CcSOC_BatteryUsableSocLowerLimit_pct CcSOC_BatteryUsableSocUpperLimit10Cycles_pct CcSOC_BatteryUsableSocUpperLimit70Cycles_pct CcSOC_BatteryUsableSocUpperLimitHomo_pct CcSOC_BatteryUsableSocUpperLimit_pct CcSOC_SOCPEnable_flg CcSYS_CellSOCLockedMax_pct CcSYS_CellSOCLockedMin_pct /end REF_CHARACTERISTIC
 /begin REF_MEASUREMENT SOC_pctBatterySoc SOC_pctBatteryUsableSoc /end REF_MEASUREMENT
/end GROUP
/begin GROUP S1491_Determine_CellData_Validation "VBU0706/Function-Call Subsystem/Subsystem1/SOC/Subsystem5/Subsystem/Determine_CellData_Validation" /begin REF_MEASUREMENT SOC_flgCellDataValid /end REF_MEASUREMENT /end GROUP
/begin GROUP S1491_Determine_Cell_SOC "VBU0706/Function-Call Subsystem/Subsystem1/SOC/Subsystem5/Subsystem/Determine_Cell_SOC"
 /begin REF_CHARACTERISTIC CbSOC_CellArraySOCOvrdFlg_flg CcSOC_CellArraySOCOvrdVal_pct CcSOC_CellSocLowerLimit_pct CcSOC_CellSocUpperLimit_pct /end REF_CHARACTERISTIC
 /begin REF_MEASUREMENT SOC_numCellSocMaxID SOC_numCellSocMinID SOC_pctCellSocAve SOC_pctCellSocMax SOC_pctCellSocMin /end REF_MEASUREMENT
/end GROUP
/begin GROUP S1491_Determine_Correction_Condition "VBU0706/Function-Call Subsystem/Subsystem1/SOC/Subsystem5/Subsystem/Determine_Correction_Condition"
 /begin REF_CHARACTERISTIC CcSOC_OcvCorrectionIntervalTime_s SOC_flgOCVCorrection_C SOC_flgOCValidOvrd_C /end REF_CHARACTERISTIC
 /begin REF_MEASUREMENT SOC_flgOcvCorrection /end REF_MEASUREMENT
/end GROUP
/begin GROUP S1491_Determine_Display_SOC "VBU0706/Function-Call Subsystem/Subsystem1/SOC/Subsystem5/Subsystem/Determine_Display_SOC"
 /begin SUB_GROUP S1498_Determine_BatterySOC_ChangeRate S1498_DisplaySOC_Driving_Calculation S1498_DisplaySOC_Startup_Calculation S1498_NoJumpSOC_Driving_Calculation S1498_NoJumpSOC_Startup_Calculation /end SUB_GROUP
 /begin REF_CHARACTERISTIC CcSOC_BatterySocLowerLimit_pct CcSOC_BatterySocUpperLimit_pct CcSYS_CellSOCLockedMax_pct CcSYS_CellSOCLockedMin_pct /end REF_CHARACTERISTIC
 /begin REF_MEASUREMENT SOC_pctBatteryDisplaySoc SOC_pctNoJumpBatterySoc /end REF_MEASUREMENT
/end GROUP
/begin GROUP S1491_Determine_FastChargeCorrection_Soc "VBU0706/Function-Call Subsystem/Subsystem1/SOC/Subsystem5/Subsystem/Determine_FastChargeCorrection_Soc"
 /begin SUB_GROUP S1499_Determine_FastChargeCorrectionEnable S1499_Determine_InternalResistanceCausedDevCellVoltage S1499_FastCharge_DynamicCorrection S1499_FastCharge_PreCorrection S1499_FastCharge_TopofChargeCorrection /end SUB_GROUP
/end GROUP
/begin GROUP S1491_Determine_Initial_SoC "VBU0706/Function-Call Subsystem/Subsystem1/SOC/Subsystem5/Subsystem/Determine_Initial_SoC"
 /begin SUB_GROUP S1500_CellSOC_Startup_AbnormalPoweroff S1500_CellSOC_Startup_AbnormalReset S1500_CellSOC_Startup_EolFlashing S1500_CellSOC_Startup_Normal S1500_Determine_EOL_Flashing S1500_Determine_Soc_Jump /end SUB_GROUP
 /begin REF_CHARACTERISTIC CbSYS_AbnormalResetRecoverEnable_flg /end REF_CHARACTERISTIC
 /begin REF_MEASUREMENT SOC_flgCellSocCorrectionFinished SOC_flgSocInitializeComplete SOC_numLoadDefaultSOCCnt /end REF_MEASUREMENT
/end GROUP
/begin GROUP S1491_Determine_Initialization_Condition "VBU0706/Function-Call Subsystem/Subsystem1/SOC/Subsystem5/Subsystem/Determine_Initialization_Condition"
 /begin REF_CHARACTERISTIC CcSOC_SocInitializationDelayTime_ms CcSOC_SocInitializationMaxTime_ms SAMPLE_TIME_TASK_C /end REF_CHARACTERISTIC
 /begin REF_MEASUREMENT LcSOC_SocCounter_numb SOC_flgSocInitializationDelay SOC_flgStartupFilterDelay /end REF_MEASUREMENT
/end GROUP
/begin GROUP S1491_Determine_OcvSoc "VBU0706/Function-Call Subsystem/Subsystem1/SOC/Subsystem5/Subsystem/Determine_OcvSoc" /begin SUB_GROUP S1502_Replace_Invalid_CellVoltage /end SUB_GROUP /end GROUP
/begin GROUP S1491_Determine_ShortTimeCorrection_Condition "VBU0706/Function-Call Subsystem/Subsystem1/SOC/Subsystem5/Subsystem/Determine_ShortTimeCorrection_Condition" /begin SUB_GROUP S1503_Current_Limit_Condition /end SUB_GROUP
 /begin REF_CHARACTERISTIC CcSOC_OcvShortTimeCorrIntervalTime_s CcSOC_OcvShortTimeDisChDiff_n CcSOC_OcvShortTimeVolDiffCh_mV CcSOC_OcvShortTimeVolDiffDis_mV CcSOC_OcvShortTimeVolDiffThreshold_mV /end REF_CHARACTERISTIC
 /begin REF_MEASUREMENT SOC_flgOcvShortTimeCorrection SOC_flgOcvShortTimeDisChDiff SOC_flgOcvShortTimeVolDirection /end REF_MEASUREMENT
/end GROUP
/begin GROUP S1491_Ocv_ShortTimeCorrection "VBU0706/Function-Call Subsystem/Subsystem1/SOC/Subsystem5/Subsystem/Ocv_ShortTimeCorrection"
 /begin REF_CHARACTERISTIC CaSOC_OcvShortTimeChMapDimension_n CaSOC_OcvShortTimeChargeSocZ_pct CaSOC_OcvShortTimeDisMapDimension_n CaSOC_OcvShortTimeDischargeSocZ_pct CaSOC_OcvShortTimeSocErrorCurveY_pct CbSOC_OcvShortTime_flg CcSOC_OcvShortTimeSocErrorThreshold_pct CcSOC_OcvShortTimeVolThreshold_mV CcSYS_NoOfInvalidCellTemps_n /end REF_CHARACTERISTIC
 /begin REF_MEASUREMENT SOC_flgOcvShortTimeCorrectionComplete /end REF_MEASUREMENT
/end GROUP
/begin GROUP S1491_Soc_Data_Storage "VBU0706/Function-Call Subsystem/Subsystem1/SOC/Subsystem5/Subsystem/Soc_Data_Storage" /begin SUB_GROUP S1506_Data_Storage /end SUB_GROUP /end GROUP
/begin GROUP S1669_Calculate_History_Average_Current "VBU0706/Function-Call Subsystem/Subsystem1/SOE/Subsystem2/Subsystem/Calculate_History_Average_Current" /begin SUB_GROUP S1670_Determine_History_Current_Data S1670_Time_Counter /end SUB_GROUP /end GROUP
/begin GROUP S1669_Calculate_Pack_Remaining_Energy "VBU0706/Function-Call Subsystem/Subsystem1/SOE/Subsystem2/Subsystem/Calculate_Pack_Remaining_Energy" /begin SUB_GROUP S1671_Charge_and_Idle_Mode S1671_Discharge_Mode /end SUB_GROUP /begin REF_MEASUREMENT SOE_kwhPackRemainingEnergy SOE_pctCellSocEndPredict /end REF_MEASUREMENT /end GROUP
/begin GROUP S1669_Calculate_Pack_Remaining_Energy_SOC "VBU0706/Function-Call Subsystem/Subsystem1/SOE/Subsystem2/Subsystem/Calculate_Pack_Remaining_Energy_SOC"
 /begin REF_CHARACTERISTIC CaSOE_DispalySocFactorMapY_pct CcSOE_DischargeCutOffSoc_pct CcSYS_BatteryRatedVoltage_V CcSYS_CellSOCLockedMax_pct CcSYS_CellSOCLockedMin_pct CcSYS_FullChargeSoc_pct /end REF_CHARACTERISTIC
/end GROUP
/begin GROUP S1669_Rate_Limit_and_Output "VBU0706/Function-Call Subsystem/Subsystem1/SOE/Subsystem2/Subsystem/Rate_Limit_and_Output"
 /begin REF_CHARACTERISTIC CcSOE_EnergyDecRate_Kwh CcSOE_EnergyIncRate_Kwh CcSOE_SocInitializationMaxTime_ms /end REF_CHARACTERISTIC
/end GROUP
/begin GROUP S1669_Rate_Limit_and_Output_SOC "VBU0706/Function-Call Subsystem/Subsystem1/SOE/Subsystem2/Subsystem/Rate_Limit_and_Output_SOC" /begin SUB_GROUP S1674_Rate_Limiter_Reset1 /end SUB_GROUP
 /begin REF_CHARACTERISTIC CcSOE_EnergyDecRate_Kwh CcSOE_EnergyIncRate_Kwh CcSOE_SocInitializationMaxTime_ms /end REF_CHARACTERISTIC
/end GROUP
/begin GROUP S1721_Calculate_ActualPower "VBU0706/Function-Call Subsystem/Subsystem1/SOF/Subsystem6/Subsystem/Calculate_ActualPower"
 /begin REF_MEASUREMENT SOF_kwChargePowerActual SOF_kwChargePowerLimitDelta SOF_kwDischargePowerActual SOF_kwDischargePowerLimitDelta /end REF_MEASUREMENT
/end GROUP
/begin GROUP S1721_Calculate_PowerLimit "VBU0706/Function-Call Subsystem/Subsystem1/SOF/Subsystem6/Subsystem/Calculate_PowerLimit"
 /begin SUB_GROUP S1723_Calculate_Pack_OCV S1723_Determine_Capacity_Cycle_PowerLimit S1723_Determine_SOCP_PowerLimit /end SUB_GROUP
 /begin REF_MEASUREMENT SOF_kwChargePowerLimitTarget SOF_kwContinuousChargePowerLimitTarget SOF_kwContinuousDischargePowerLimitBefoTarget SOF_kwDischargePowerLimitBefoTarget SOF_kwShortPulseChargePowerLimitTarget SOF_kwShortPulseDischargePowerLimitTarget /end REF_MEASUREMENT
/end GROUP
/begin GROUP S1721_Count_LowTempOverCurrent "VBU0706/Function-Call Subsystem/Subsystem1/SOF/Subsystem6/Subsystem/Count_LowTempOverCurrent"
 /begin REF_CHARACTERISTIC CcSOF_LowTempOverCurrentBufferEmpty_As CcSOF_LowTempOverCurrentCount_C CcSOF_LowTempOverCurrent_A /end REF_CHARACTERISTIC
/end GROUP
/begin GROUP S1721_Determine_Currentlimit_Target "VBU0706/Function-Call Subsystem/Subsystem1/SOF/Subsystem6/Subsystem/Determine_Currentlimit_Target"
 /begin SUB_GROUP S1725_Calculate_CurrentLimit_Target S1725_Determine_CurrentLimitTarget_Enable /end SUB_GROUP
/end GROUP
/begin GROUP S1721_Rate_CurrentLimit "VBU0706/Function-Call Subsystem/Subsystem1/SOF/Subsystem6/Subsystem/Rate_CurrentLimit" /begin SUB_GROUP S1726_FCC_CHARGE_MODE1 /end SUB_GROUP
 /begin REF_CHARACTERISTIC CbSOF_CurrentLimitFastChargeCheckEnable_flg CcSOF_CapacityScalingFactor_n CcSOF_ChargeCurrentSlopeFccMode_A CcSOF_ChargeCurrentSlope_A CcSOF_DischargeCurrentSlope_A /end REF_CHARACTERISTIC
 /begin REF_MEASUREMENT SOF_iAChargeContinuousCurrentRatedLimit SOF_iAChargeCurrentRatedLimit SOF_iAContinuousDischargeCurrentRatedLimit SOF_iADischargeCurrentRatedLimit SOF_iAShortPulseChargeCurrentRatedLimit SOF_iAShortPulseDischargeCurrentRatedLimit /end REF_MEASUREMENT
/end GROUP
/begin GROUP S1721_Rate_PowerLimit "VBU0706/Function-Call Subsystem/Subsystem1/SOF/Subsystem6/Subsystem/Rate_PowerLimit"
 /begin REF_CHARACTERISTIC CaSOF_ChargePowerSlopeSocTempMapDimension_n CaSOF_ChargePowerSlopeSocTempMapZ_Kw CaSOF_DischargePowerSlopeSocTempMapDimension_n CaSOF_DischargePowerSlopeSocTempMapZ_Kw /end REF_CHARACTERISTIC
 /begin REF_MEASUREMENT SOF_kwChargePowerContinuousRated SOF_kwChargePowerLimitRated SOF_kwChargePowerShortPulseRated SOF_kwDischargePowerContinuousRated SOF_kwDischargePowerLimitRated SOF_kwDischargePowerShortPulseRated /end REF_MEASUREMENT
/end GROUP
/begin GROUP S1721_SOF_Diagnostic "VBU0706/Function-Call Subsystem/Subsystem1/SOF/Subsystem6/Subsystem/SOF_Diagnostic"
 /begin REF_CHARACTERISTIC CbSOF_ChargePowerLimitViolationFaultEnable_flg CbSOF_DischargePowerLimitViolationFaultEnable_flg CcSOF_ChargePowerLimitViolationFIC_n CcSOF_ChargePowerLimitViolationPIC_n CcSOF_ChargePowerLimitViolationThreshold_Kws CcSOF_DischargePowerLimitViolationFIC_n CcSOF_DischargePowerLimitViolationPIC_n CcSOF_DischargePowerLimitViolationThreshold_Kws SOF_DISCHARGE_OVER_POWER_FAULT /end REF_CHARACTERISTIC
 /begin REF_MEASUREMENT SOF_kwsChargePowerLimitDeltaTotal SOF_stChargePowerLimitViolationFault SOF_stDischargePowerLimitViolationFault /end REF_MEASUREMENT
/end GROUP
/begin GROUP S1954_Calculate_Capacity "VBU0706/Function-Call Subsystem/Subsystem1/SOH/Subsystem4/Subsystem1/Calculate_Capacity"
 /begin SUB_GROUP S1955_Calculate_CellCapacity S1955_Calculate_CellCapacity_SlowCharge S1955_Calculate_MinCellCapacity274_SlowCharge S1955_Determine_CalculateCellCapacity_Condition /end SUB_GROUP
/end GROUP
/begin GROUP S1954_Calculate_Resistance "VBU0706/Function-Call Subsystem/Subsystem1/SOH/Subsystem4/Subsystem1/Calculate_Resistance"
 /begin SUB_GROUP S1956_BasicCellResistance_Calculation_Check S1956_Caculate_CellResistance S1956_Calculate_ModuleCurrent S1956_Calculate_Relaxation_Average_CurrentVoltage S1956_Compute_Resistance_Request S1956_Determine_Condition_Calculate_Pulse_Average_CurrentVoltage /end SUB_GROUP
/end GROUP
/begin GROUP S1954_Monitor_SOH "VBU0706/Function-Call Subsystem/Subsystem1/SOH/Subsystem4/Subsystem1/Monitor_SOH" /begin REF_MEASUREMENT SOH_stResistanceIncRatio SOH_stSohMonitor /end REF_MEASUREMENT /end GROUP
/begin GROUP S1954_SOH_Diagnositic "VBU0706/Function-Call Subsystem/Subsystem1/SOH/Subsystem4/Subsystem1/SOH_Diagnositic" /begin SUB_GROUP S1959_CellCapacity_Diagnostic /end SUB_GROUP /end GROUP
/begin GROUP S2085_Calculate_PipeTemperature "VBU0706/Function-Call Subsystem/Subsystem1/THM/Subsystem/Subsystem/Calculate_PipeTemperature" /begin SUB_GROUP S2086_Determine_CoolantSensorTemp_Validation /end SUB_GROUP /end GROUP
/begin GROUP S2085_Charge_Mode_Temp_Request "VBU0706/Function-Call Subsystem/Subsystem1/THM/Subsystem/Subsystem/Charge_Mode_Temp_Request"
 /begin SUB_GROUP S2087_FCC_Temp_Request S2087_Invaild_Temp_Request S2087_OBC_Temp_Request /end SUB_GROUP
 /begin REF_MEASUREMENT THM_tInletTempRequest /end REF_MEASUREMENT
/end GROUP
/begin GROUP S2085_Cooling_Request_Respond_Check "VBU0706/Function-Call Subsystem/Subsystem1/THM/Subsystem/Subsystem/Cooling_Request_Respond_Check"
 /begin REF_CHARACTERISTIC CcTHM_CoolingReponseCellTemp_C CcTHM_CoolingReponseInletTemp_C CcTHM_CoolingResponseDelay_s CcTHM_InletResponseDebounce_s SAMPLE_TIME_TASK_E /end REF_CHARACTERISTIC
/end GROUP
/begin GROUP S2085_Diagnose_InletCoolingHighTemperture_Fault "VBU0706/Function-Call Subsystem/Subsystem1/THM/Subsystem/Subsystem/Diagnose_InletCoolingHighTemperture_Fault"
 /begin REF_CHARACTERISTIC CbTHM_InletCoolantSensorOorHighFaultEnable_flg CcTHM_CoolantSensorOorHigh_C CcTHM_InletCoolantSensorOorHighFIC_n CcTHM_InletCoolantSensorOorHighPIC_n THM_INLET_COOLANT_SENSOR_OOR_HIGH_FAULT /end REF_CHARACTERISTIC
 /begin REF_MEASUREMENT THM_ftInletCoolantSensorOorHigh /end REF_MEASUREMENT
/end GROUP
/begin GROUP S2085_Diagnose_InletCoolingLowTemperture_Fault "VBU0706/Function-Call Subsystem/Subsystem1/THM/Subsystem/Subsystem/Diagnose_InletCoolingLowTemperture_Fault"
 /begin REF_CHARACTERISTIC CbTHM_InletCoolantSensorOorLowFaultEnable_flg CcTHM_CoolantSensorOorLow_C CcTHM_InletCoolantSensorOorLowFIC_n CcTHM_InletCoolantSensorOorLowPIC_n THM_INLET_COOLANT_SENSOR_OOR_LOW_FAULT /end REF_CHARACTERISTIC
 /begin REF_MEASUREMENT THM_ftInletCoolantSensorOorLow /end REF_MEASUREMENT
/end GROUP
/begin GROUP S2085_Diagnose_InletOutletTempDelta_Fault "VBU0706/Function-Call Subsystem/Subsystem1/THM/Subsystem/Subsystem/Diagnose_InletOutletTempDelta_Fault"
 /begin REF_CHARACTERISTIC CbTHM_InletOutletTempDeltaFaultEnable_flg CcTHM_InletOutletTempDeltaFIC_n CcTHM_InletOutletTempDeltaPIC_n CcTHM_InletOutletTempDeltaThreshold_C THM_INLET_OUTLET_TEMP_DELTA_FAULT /end REF_CHARACTERISTIC
 /begin REF_MEASUREMENT THM_ftInletOutletTempDelta /end REF_MEASUREMENT
/end GROUP
/begin GROUP S2085_Diagnose_OutletCoolingHighTemperture_Fault "VBU0706/Function-Call Subsystem/Subsystem1/THM/Subsystem/Subsystem/Diagnose_OutletCoolingHighTemperture_Fault"
 /begin REF_CHARACTERISTIC CbTHM_OutletCoolantSensorOorHighFaultEnable_flg CcTHM_CoolantSensorOorHigh_C CcTHM_OutletCoolantSensorOorHighFIC_n CcTHM_OutletCoolantSensorOorHighPIC_n THM_OUTLET_COOLANT_SENSOR_OOR_HIGH_FAULT /end REF_CHARACTERISTIC
 /begin REF_MEASUREMENT THM_ftOutletCoolantSensorOorHigh /end REF_MEASUREMENT
/end GROUP
/begin GROUP S2085_Diagnose_OutletCoolingLowTemperture_Fault "VBU0706/Function-Call Subsystem/Subsystem1/THM/Subsystem/Subsystem/Diagnose_OutletCoolingLowTemperture_Fault"
 /begin REF_CHARACTERISTIC CbTHM_OutletCoolantSensorOorLowFaultEnable_flg CcTHM_CoolantSensorOorLow_C CcTHM_OutletCoolantSensorOorLowFIC_n CcTHM_OutletCoolantSensorOorLowPIC_n THM_OUTLET_COOLANT_SENSOR_OOR_LOW_FAULT /end REF_CHARACTERISTIC
 /begin REF_MEASUREMENT THM_ftOutletCoolantSensorOorLow /end REF_MEASUREMENT
/end GROUP
/begin GROUP S2085_Thermal_System_Damage_Judgement "VBU0706/Function-Call Subsystem/Subsystem1/THM/Subsystem/Subsystem/Thermal_System_Damage_Judgement" /begin SUB_GROUP S2094_Delay_FallingEdge /end SUB_GROUP
 /begin REF_CHARACTERISTIC CaTHM_OutletCoolantTempMapZ_C CcTHM_BdmDelay_s CcTHM_CoolingReponseCellTemp_C CcTHM_InletCoolingTempDeviation_C SAMPLE_TIME_TASK_E /end REF_CHARACTERISTIC
/end GROUP
/begin GROUP S2085_Valid_Condition_Determination "VBU0706/Function-Call Subsystem/Subsystem1/THM/Subsystem/Subsystem/Valid_Condition_Determination" /begin SUB_GROUP S2095_FCC_Temp_Valid S2095_OBC_Temp_Valid /end SUB_GROUP /begin REF_CHARACTERISTIC CcTHM_BatteryCapacityCycle_n CcTHM_TempRequestEnable_flg /end REF_CHARACTERISTIC /begin REF_MEASUREMENT THM_flgTempRequestValid /end REF_MEASUREMENT /end GROUP
/begin GROUP S2159_Determine_BMS_VCU_267 "VBU0706/Function-Call Subsystem/Subsystem1/VCT/Subsystem/Subsystem/Determine_BMS_VCU_267" /begin SUB_GROUP S2160_Override /end SUB_GROUP /end GROUP
/begin GROUP S2159_Determine_BMS_VCU_268 "VBU0706/Function-Call Subsystem/Subsystem1/VCT/Subsystem/Subsystem/Determine_BMS_VCU_268" /begin SUB_GROUP S2161_Override /end SUB_GROUP /end GROUP
/begin GROUP S2159_Determine_BMS_VCU_269 "VBU0706/Function-Call Subsystem/Subsystem1/VCT/Subsystem/Subsystem/Determine_BMS_VCU_269" /begin SUB_GROUP S2162_Override /end SUB_GROUP /end GROUP
/begin GROUP S2159_Determine_BMS_VCU_26A "VBU0706/Function-Call Subsystem/Subsystem1/VCT/Subsystem/Subsystem/Determine_BMS_VCU_26A" /begin SUB_GROUP S2163_Override /end SUB_GROUP /end GROUP
/begin GROUP S2159_Determine_BMS_VCU_271 "VBU0706/Function-Call Subsystem/Subsystem1/VCT/Subsystem/Subsystem/Determine_BMS_VCU_271" /begin SUB_GROUP S2164_Override /end SUB_GROUP /begin REF_CHARACTERISTIC CcSYS_FullChargeSoc_pct /end REF_CHARACTERISTIC /end GROUP
/begin GROUP S2159_Determine_BMS_VCU_272 "VBU0706/Function-Call Subsystem/Subsystem1/VCT/Subsystem/Subsystem/Determine_BMS_VCU_272" /begin SUB_GROUP S2165_Override /end SUB_GROUP
 /begin REF_CHARACTERISTIC CcVCT_SOCJumpSOCLow_pct CcVCT_SOCJumpThreshold_pct CcVCT_SocInitializationMaxTime_ms /end REF_CHARACTERISTIC
/end GROUP
/begin GROUP S2159_Determine_BMS_VCU_34 "VBU0706/Function-Call Subsystem/Subsystem1/VCT/Subsystem/Subsystem/Determine_BMS_VCU_34"
 /begin SUB_GROUP S2166_CONTACTOR_STATUS_CLOSED1 S2166_CONTACTOR_STATUS_CLOSED2 S2166_CONTACTOR_STATUS_CLOSED3 S2166_CONTACTOR_STATUS_CLOSED4 S2166_CONTACTOR_STATUS_OPENED2 S2166_Override /end SUB_GROUP
/end GROUP
/begin GROUP S2159_Determine_BMS_VCU_373 "VBU0706/Function-Call Subsystem/Subsystem1/VCT/Subsystem/Subsystem/Determine_BMS_VCU_373" /begin SUB_GROUP S2167_Override /end SUB_GROUP /end GROUP
/begin GROUP S2159_Determine_BMS_VCU_AC "VBU0706/Function-Call Subsystem/Subsystem1/VCT/Subsystem/Subsystem/Determine_BMS_VCU_AC" /begin SUB_GROUP S2168_FCC_CHARGE_MODE1 S2168_Override /end SUB_GROUP
 /begin REF_CHARACTERISTIC CcVCT_SOCLowWarningThreshold1_pct CcVCT_SOCLowWarningThreshold2_pct /end REF_CHARACTERISTIC
/end GROUP
/begin GROUP S2330_CANRX_Active "VBU0706/Task_10ms/J1939/FCHG/TP_CM_RX/TP_CM RX/CANRX_Active" /begin SUB_GROUP S2331_CANRX_Cnt /end SUB_GROUP /begin REF_MEASUREMENT TP_CM_RX_CANActv_flg /end REF_MEASUREMENT /end GROUP
/begin GROUP S2340_Input_HW_Signal_Range_Check2 "VBU0706/Task_10ms/Subsystem/HALIn/HW/Subsystem/Input_HW_Signal_Range_Check2" /begin SUB_GROUP S2344_override_signal_Status /end SUB_GROUP
 /begin REF_CHARACTERISTIC INP_flgAccPed1CaliOvrd_C INP_flgAccPed1SafetyEnable_C INP_numAccPed1CounterLim_C INP_numAccPed1DecCounter_C INP_numAccPed1IncCounter_C INP_uAccPed1CaliOvrdVal_C INP_uAccPed1RangeMax_C INP_uAccPed1RangeMin_C INP_uAccPed1SafetyVal_C /end REF_CHARACTERISTIC
/end GROUP
/begin GROUP S2340_Input_HW_Signal_Range_Check3 "VBU0706/Task_10ms/Subsystem/HALIn/HW/Subsystem/Input_HW_Signal_Range_Check3" /begin SUB_GROUP S2345_override_signal_Status /end SUB_GROUP
 /begin REF_CHARACTERISTIC INP_flgBrkPresCaliOvrd_C INP_flgBrkPresSafetyEnable_C INP_numBrkPresCounterLim_C INP_numBrkPresDecCounter_C INP_numBrkPresIncCounter_C INP_uBrkPresCaliOvrdVal_C INP_uBrkPresRangeMax_C INP_uBrkPresRangeMin_C INP_uBrkPresSafetyVal_C /end REF_CHARACTERISTIC
/end GROUP
/begin GROUP S2340_Input_HW_Signal_Range_Check4 "VBU0706/Task_10ms/Subsystem/HALIn/HW/Subsystem/Input_HW_Signal_Range_Check4" /begin SUB_GROUP S2346_override_signal_Status /end SUB_GROUP
 /begin REF_CHARACTERISTIC INP_flgAccPed2CaliOvrd_C INP_flgAccPed2SafetyEnable_C INP_numAccPed2CounterLim_C INP_numAccPed2DecCounter_C INP_numAccPed2IncCounter_C INP_uAccPed2CaliOvrdVal_C INP_uAccPed2RangeMax_C INP_uAccPed2RangeMin_C INP_uAccPed2SafetyVal_C /end REF_CHARACTERISTIC
/end GROUP
/begin GROUP S2340_Input_HW_Signal_Range_Check6 "VBU0706/Task_10ms/Subsystem/HALIn/HW/Subsystem/Input_HW_Signal_Range_Check6" /begin SUB_GROUP S2347_override_signal_Status /end SUB_GROUP
 /begin REF_CHARACTERISTIC INP_flgDCChCC2CaliOvrd_C INP_flgDCChCC2SafetyEnable_C INP_numDCChCC2CounterLim_C INP_numDCChCC2DecCounter_C INP_numDCChCC2IncCounter_C INP_uDCChCC2CaliOvrdVal_C INP_uDCChCC2RangeMax_C INP_uDCChCC2RangeMin_C INP_uDCChCC2SafetyVal_C /end REF_CHARACTERISTIC
/end GROUP
/begin GROUP S2340_Input_HW_Signal_Range_Check_Table1 "VBU0706/Task_10ms/Subsystem/HALIn/HW/Subsystem/Input_HW_Signal_Range_Check_Table1" /begin SUB_GROUP S2348_override_signal_Status /end SUB_GROUP
 /begin REF_CHARACTERISTIC INP_flgVacPresCaliOvrd_C INP_flgVacPresSafetyEnable_C INP_numVacPresCounterLim_C INP_numVacPresDecCounter_C INP_numVacPresIncCounter_C INP_pVacPresCaliOvrdVal_C INP_pVacPres_CUR_v INP_uVacPresRangeMax_C INP_uVacPresRangeMin_C INP_uVacPresSafetyVal_C /end REF_CHARACTERISTIC
/end GROUP
/begin GROUP S2340_Input_HW_Signal_Range_Check_Table2 "VBU0706/Task_10ms/Subsystem/HALIn/HW/Subsystem/Input_HW_Signal_Range_Check_Table2" /begin SUB_GROUP S2349_override_signal_Status /end SUB_GROUP
 /begin REF_CHARACTERISTIC INP_flgDCChPortTempCaliOvrd_C INP_flgDCChPortTempSafetyEnable_C INP_numDCChPortTempCounterLim_C INP_numDCChPortTempDecCounter_C INP_numDCChPortTempIncCounter_C INP_tDCChPortTempCaliOvrdVal_C INP_tDCChPortTempSafetyVal_C INP_tDCChPortTemp_CUR_v INP_uDCChPortTempRangeMax_C INP_uDCChPortTempRangeMin_C /end REF_CHARACTERISTIC
/end GROUP
/begin GROUP S2340_Input_HW_Signal_Range_Check_Table4 "VBU0706/Task_10ms/Subsystem/HALIn/HW/Subsystem/Input_HW_Signal_Range_Check_Table4" /begin SUB_GROUP S2350_override_signal_Status /end SUB_GROUP
 /begin REF_CHARACTERISTIC INP_flgDCChPortTempNegativeCaliOvrd_C INP_flgDCChPortTempNegativeSafetyEnable_C INP_numDCChPortTempNegativeCounterLim_C INP_numDCChPortTempNegativeDecCounter_C INP_numDCChPortTempNegativeIncCounter_C INP_tDCChPortTempNegativeCaliOvrdVal_C INP_tDCChPortTempNegativeSafetyVal_C INP_tDCChPortTempNegative_CUR_v INP_uDCChPortTempNegativeRangeMax_C INP_uDCChPortTempNegativeRangeMin_C /end REF_CHARACTERISTIC
/end GROUP
/begin GROUP S2340_Input_HW_Signal_Range_Check_Table5 "VBU0706/Task_10ms/Subsystem/HALIn/HW/Subsystem/Input_HW_Signal_Range_Check_Table5" /begin SUB_GROUP S2351_override_signal_Status /end SUB_GROUP
 /begin REF_CHARACTERISTIC INP_flgEDSOutTempCaliOvrd_C INP_flgEDSOutTempSafetyEnable_C INP_numEDSOutTempCounterLim_C INP_numEDSOutTempDecCounter_C INP_numEDSOutTempIncCounter_C INP_tEDSOutTempCaliOvrdVal_C INP_tEDSOutTempSafetyVal_C INP_tEDSOutTemp_CUR_v INP_uEDSOutTempRangeMax_C INP_uEDSOutTempRangeMin_C /end REF_CHARACTERISTIC
/end GROUP
/begin GROUP S2341_BrkLmpSwtConfirm "VBU0706/Task_10ms/Subsystem/HALIn/HW/Subsystem1/BrkLmpSwtConfirm" /begin SUB_GROUP S2425_override_signal /end SUB_GROUP /end GROUP
/begin GROUP S2341_BrkLmpSwtConfirm1 "VBU0706/Task_10ms/Subsystem/HALIn/HW/Subsystem1/BrkLmpSwtConfirm1" /begin SUB_GROUP S2426_override_signal /end SUB_GROUP /end GROUP
/begin GROUP S2341_INP_flgGearH1Confirm "VBU0706/Task_10ms/Subsystem/HALIn/HW/Subsystem1/INP_flgGearH1Confirm" /begin SUB_GROUP S2427_override_signal /end SUB_GROUP /end GROUP
/begin GROUP S2341_INP_flgGearH2Confirm "VBU0706/Task_10ms/Subsystem/HALIn/HW/Subsystem1/INP_flgGearH2Confirm" /begin SUB_GROUP S2428_override_signal /end SUB_GROUP /end GROUP
/begin GROUP S2341_INP_flgGearH3Confirm "VBU0706/Task_10ms/Subsystem/HALIn/HW/Subsystem1/INP_flgGearH3Confirm" /begin SUB_GROUP S2429_override_signal /end SUB_GROUP /end GROUP
/begin GROUP S2341_INP_flgIgnOnConfirm "VBU0706/Task_10ms/Subsystem/HALIn/HW/Subsystem1/INP_flgIgnOnConfirm" /begin REF_CHARACTERISTIC BSWIN_flgIgnOnOvrdVal_C BSWIN_flgIgnOnOvrd_C /end REF_CHARACTERISTIC /end GROUP
/begin GROUP S2341_INP_flgIgnOnConfirm1 "VBU0706/Task_10ms/Subsystem/HALIn/HW/Subsystem1/INP_flgIgnOnConfirm1" /begin REF_CHARACTERISTIC BSWIN_flgAplusOvrdVal_C BSWIN_flgAplusOvrd_C /end REF_CHARACTERISTIC /end GROUP
/begin GROUP S2341_IN_ACMidPreConfirm "VBU0706/Task_10ms/Subsystem/HALIn/HW/Subsystem1/IN_ACMidPreConfirm" /begin SUB_GROUP S2432_override_signal /end SUB_GROUP /begin REF_CHARACTERISTIC BSWIN_flgACMidOvrdVal_C BSWIN_flgACMidOvrd_C /end REF_CHARACTERISTIC /end GROUP
/begin GROUP S2341_IN_CrankConfirm "VBU0706/Task_10ms/Subsystem/HALIn/HW/Subsystem1/IN_CrankConfirm" /begin SUB_GROUP S2433_override_signal /end SUB_GROUP /end GROUP
/begin GROUP S2341_IN_DriverACOnConfirm "VBU0706/Task_10ms/Subsystem/HALIn/HW/Subsystem1/IN_DriverACOnConfirm" /begin SUB_GROUP S2434_override_signal /end SUB_GROUP /begin REF_CHARACTERISTIC BSWIN_flgACPreSWOvrdVal_C BSWIN_flgACPreSWOvrd_C /end REF_CHARACTERISTIC /end GROUP
/begin GROUP S2342_Input_HW_Signal_Range_Check1 "VBU0706/Task_10ms/Subsystem/HALIn/HW/Subsystem2/Input_HW_Signal_Range_Check1" /begin SUB_GROUP S2455_override_signal_Status /end SUB_GROUP /end GROUP
/begin GROUP S2342_Input_HW_Signal_Range_Check2 "VBU0706/Task_10ms/Subsystem/HALIn/HW/Subsystem2/Input_HW_Signal_Range_Check2" /begin SUB_GROUP S2456_override_signal_Status /end SUB_GROUP /end GROUP
/begin GROUP S2342_Input_HW_Signal_Range_Check3 "VBU0706/Task_10ms/Subsystem/HALIn/HW/Subsystem2/Input_HW_Signal_Range_Check3" /begin SUB_GROUP S2457_override_signal_Status /end SUB_GROUP /end GROUP
/begin GROUP S2342_Input_HW_Signal_Range_Check7 "VBU0706/Task_10ms/Subsystem/HALIn/HW/Subsystem2/Input_HW_Signal_Range_Check7" /begin SUB_GROUP S2458_override_signal_Status /end SUB_GROUP /end GROUP
/begin GROUP S2495_CanRxData_Unpack "VBU0706/Task_10ms/Subsystem/HALIn/LIN/MsgRxData_Unpack1/CanRxData_Unpack" /begin SUB_GROUP S2497_EXV /end SUB_GROUP /end GROUP
/begin GROUP S2495_CanRxData_Unpack1 "VBU0706/Task_10ms/Subsystem/HALIn/LIN/MsgRxData_Unpack1/CanRxData_Unpack1" /begin SUB_GROUP S2498_FPV /end SUB_GROUP /end GROUP
/begin GROUP S2505_20ms "VBU0706/Task_10ms/Subsystem/HALIn/PTCAN/Subsystem/20ms"
 /begin SUB_GROUP S2506_ABS_0x068 S2506_ABS_0x75 S2506_ABS_0x79 S2506_EPB_0x80 S2506_EPS_0x70 S2506_MCU_205 /end SUB_GROUP
/end GROUP
/begin GROUP S2505_50ms "VBU0706/Task_10ms/Subsystem/HALIn/PTCAN/Subsystem/50ms" /begin SUB_GROUP S2507_MCU_305 /end SUB_GROUP /end GROUP
/begin GROUP S2505_CanMsgUnpack "VBU0706/Task_10ms/Subsystem/HALIn/PTCAN/Subsystem/CanMsgUnpack"
 /begin SUB_GROUP S2510_MsgRxData_Unpack1 S2510_MsgRxData_Unpack10 S2510_MsgRxData_Unpack11 S2510_MsgRxData_Unpack12 S2510_MsgRxData_Unpack13 S2510_MsgRxData_Unpack14 S2510_MsgRxData_Unpack19 S2510_MsgRxData_Unpack2 S2510_MsgRxData_Unpack20 S2510_MsgRxData_Unpack3 S2510_MsgRxData_Unpack4 S2510_MsgRxData_Unpack5 S2510_MsgRxData_Unpack6 S2510_MsgRxData_Unpack7 S2510_MsgRxData_Unpack8 S2510_MsgRxData_Unpack9 /end SUB_GROUP
/end GROUP
/begin GROUP S2505_Subsystem2 "VBU0706/Task_10ms/Subsystem/HALIn/PTCAN/Subsystem/Subsystem2" /begin SUB_GROUP S2512_IC_401 S2512_MCU_505 /end SUB_GROUP /end GROUP
/begin GROUP S2505_Subsystem3 "VBU0706/Task_10ms/Subsystem/HALIn/PTCAN/Subsystem/Subsystem3" /begin SUB_GROUP S2513_DCDC_509 /end SUB_GROUP /end GROUP
/begin GROUP S2505_Subsystem4 "VBU0706/Task_10ms/Subsystem/HALIn/PTCAN/Subsystem/Subsystem4" /begin SUB_GROUP S2514_CDC_220 S2514_DCDC_303 S2514_MCU_405 /end SUB_GROUP /end GROUP
/begin GROUP S3240_VCU_151 "VBU0706/Task_10ms/Subsystem/VCU /APO2HAL/PTCAN1Transmit/VCU_151"
 /begin REF_CHARACTERISTIC APO_flgAccPedPosOvrd_C APO_flgBrkPressOvrd_C APO_flgBrkSwtOvrdVal_C APO_flgBrkSwtOvrd_C APO_flgEfcAccPdlOvrd_C APO_pBrkPressOvrdVal_C APO_pctAccPedPosOvrdVal_C APO_pctEfcAccPdlOvrdVal_C /end REF_CHARACTERISTIC
/end GROUP
/begin GROUP S3240_VCU_153 "VBU0706/Task_10ms/Subsystem/VCU /APO2HAL/PTCAN1Transmit/VCU_153"
 /begin REF_CHARACTERISTIC APO_flgBMSCellTempHighAlarmOvrd_C APO_flgBMSCellTempLowAlarmOvrd_C APO_flgBMSDIsplaySOCOvrd_C APO_flgBMSFaultLevelOvrd_C APO_flgBMSInletTempOvrd_C APO_flgBMSMainRelayStatusOvrd_C APO_flgBMSOutletTempOvrd_C APO_flgBMSPackCurrentOvrd_C APO_flgBMSPackVoltageOvrd_C APO_flgBMSSOCOvrd_C APO_flgBMSThermalRunawayOvrdVal_C APO_flgBMSThermalRunawayOvrd_C APO_flgCellTempHighAlarmOvrdVal_C APO_flgCellTempLowAlarmOvrdVal_C APO_iBMSPackCurrentOvrdVal_C APO_pctBMSDIsplaySOCOvrdVal_C APO_pctBMSSOCOvrdVal_C APO_stBMSFaultLevelOvrdVal_C APO_stBMSMainRelayStatusOvrdVal_C APO_tBMSInletTempOvrdVal_C APO_tBMSOutletTempOvrdVal_C APO_vBMSPackVoltageOvrdVal_C /end REF_CHARACTERISTIC
/end GROUP
/begin GROUP S3240_VCU_201 "VBU0706/Task_10ms/Subsystem/VCU /APO2HAL/PTCAN1Transmit/VCU_201"
 /begin REF_CHARACTERISTIC APO_AxAccelerationOvrdVal_C APO_AyAccelerationOvrdVal_C APO_AyAccelerationOvrd_C APO_AzAccelerationOvrdVal_C APO_AzAccelerationOvrd_C APO_YawrateOvrdVal_C APO_YawrateOvrd_C APO_flgAxAccelerationOvrd_C /end REF_CHARACTERISTIC
/end GROUP
/begin GROUP S3240_VCU_501 "VBU0706/Task_10ms/Subsystem/VCU /APO2HAL/PTCAN1Transmit/VCU_501"
 /begin REF_CHARACTERISTIC APO_HundredKmTripEnergyOvrdVal_C APO_HundredKmTripEnergyOvrd_C APO_RemainingChargingTimeOvrdVal_C APO_RemainingChargingTimeOvrd_C APO_RemainingDrivingRangeOvrdVal_C APO_RemainingDrivingRangeOvrd_C APO_SOCLowWarningOvrdVal_C APO_SOCLowWarningOvrd_C APO_TenkmTripEnergyOvrdVal_C APO_TenkmTripEnergyOvrd_C APO_flgLVBattOvrd_C APO_uLVBattOvrdVal_C /end REF_CHARACTERISTIC
/end GROUP
/begin GROUP S3240_VCU_502 "VBU0706/Task_10ms/Subsystem/VCU /APO2HAL/PTCAN1Transmit/VCU_502"
 /begin REF_CHARACTERISTIC APO_TotalChargeEnergyOvrdVal_C APO_TotalChargeEnergyOvrd_C APO_TotalDischargeEnergyOvrdVal_C APO_TotalDischargeEnergyOvrd_C /end REF_CHARACTERISTIC
/end GROUP
/begin GROUP S564_DetermineSOCBalance_EnableCondition "VBU0706/Function-Call Subsystem/Subsystem1/CBL/Subsystem8/Subsystem/Balance_EnableCondition/DetermineSOCBalance_EnableCondition" /begin REF_CHARACTERISTIC SAMPLE_TIME_TASK_E /end REF_CHARACTERISTIC /end GROUP
/begin GROUP S564_DetermineVoltaageBalance_EnableCondition "VBU0706/Function-Call Subsystem/Subsystem1/CBL/Subsystem8/Subsystem/Balance_EnableCondition/DetermineVoltaageBalance_EnableCondition" /begin REF_CHARACTERISTIC SAMPLE_TIME_TASK_E /end REF_CHARACTERISTIC /end GROUP
/begin GROUP S897_Cell_DataValid_Check "VBU0706/Function-Call Subsystem/Subsystem1/CTS/CTS/Subsystem/DeterminePrechargeConditions/Cell_DataValid_Check" /begin REF_CHARACTERISTIC CcSYS_NoOfInvalidCellTemps_n /end REF_CHARACTERISTIC /end GROUP
/begin GROUP S1038_DCH_CtrlStateflowPostProcess "VBU0706/Function-Call Subsystem/Subsystem1/FCC /DCH_Overall/DCH_DCChargeCtrlOverall/DCH_DCChargeCtrlStateflow/DCH_CtrlStateflowPostProcess"
 /begin REF_CHARACTERISTIC DCH_stChStopChgrErr_SY DCH_stChStopChgrManual_SY DCH_tiSmplT_SY /end REF_CHARACTERISTIC
/end GROUP
/begin GROUP S1039_DCH_ChargeErrDetect "VBU0706/Function-Call Subsystem/Subsystem1/FCC /DCH_Overall/DCH_DCChargeCtrlOverall/DCH_Diagnose/DCH_ChargeErrDetect" /begin REF_CHARACTERISTIC DCH_tiSmplT_SY /end REF_CHARACTERISTIC /end GROUP
/begin GROUP S1039_DCH_VehErrDetect "VBU0706/Function-Call Subsystem/Subsystem1/FCC /DCH_Overall/DCH_DCChargeCtrlOverall/DCH_Diagnose/DCH_VehErrDetect" /begin REF_CHARACTERISTIC DCH_stChrgPortSnglSnsr_SY DCH_stChrgPortSnsrConfig_C /end REF_CHARACTERISTIC /end GROUP
/begin GROUP S1158_EightyPercentCustomSOC_EnableInvalidChargeTimeFlag "VBU0706/Function-Call Subsystem/Subsystem1/FCC /FCC/Subsystem/Calculate_Fastcharge_Time/EightyPercentCustomSOC_EnableInvalidChargeTimeFlag" /begin REF_CHARACTERISTIC CcFCC_EightyCustomSOC_pct /end REF_CHARACTERISTIC /end GROUP
/begin GROUP S1158_EightyPercentCustomSOC_UpdateChargeTimeFlag "VBU0706/Function-Call Subsystem/Subsystem1/FCC /FCC/Subsystem/Calculate_Fastcharge_Time/EightyPercentCustomSOC_UpdateChargeTimeFlag" /begin REF_CHARACTERISTIC CcFCC_EightyCustomSOC_pct /end REF_CHARACTERISTIC /end GROUP
/begin GROUP S1158_SOC_Mapping "VBU0706/Function-Call Subsystem/Subsystem1/FCC /FCC/Subsystem/Calculate_Fastcharge_Time/SOC_Mapping" /begin REF_CHARACTERISTIC CcSYS_CellSOCLockedMax_pct CcSYS_CellSOCLockedMin_pct /end REF_CHARACTERISTIC /end GROUP
/begin GROUP S1493_Determine_AhIntegral_Capacity "VBU0706/Function-Call Subsystem/Subsystem1/SOC/Subsystem5/Subsystem/Determine_AhIntegral_SoC/Determine_AhIntegral_Capacity" /begin REF_CHARACTERISTIC SAMPLE_TIME_TASK_C /end REF_CHARACTERISTIC /end GROUP
/begin GROUP S1498_Determine_BatterySOC_ChangeRate "VBU0706/Function-Call Subsystem/Subsystem1/SOC/Subsystem5/Subsystem/Determine_Display_SOC/Determine_BatterySOC_ChangeRate"
 /begin REF_CHARACTERISTIC CcSOC_BatteryUsableSocLowerLimit_pct CcSOC_BatteryUsableSocUpperLimit_pct CcSYS_CellSOCLockedMax_pct CcSYS_CellSOCLockedMin_pct SAMPLE_TIME_TASK_C /end REF_CHARACTERISTIC
/end GROUP
/begin GROUP S1498_DisplaySOC_Driving_Calculation "VBU0706/Function-Call Subsystem/Subsystem1/SOC/Subsystem5/Subsystem/Determine_Display_SOC/DisplaySOC_Driving_Calculation" /begin REF_CHARACTERISTIC CbSOC_CellArraySOCOvrdFlg_flg SAMPLE_TIME_TASK_C /end REF_CHARACTERISTIC /end GROUP
/begin GROUP S1499_Determine_FastChargeCorrectionEnable "VBU0706/Function-Call Subsystem/Subsystem1/SOC/Subsystem5/Subsystem/Determine_FastChargeCorrection_Soc/Determine_FastChargeCorrectionEnable" /begin REF_CHARACTERISTIC SAMPLE_TIME_TASK_C /end REF_CHARACTERISTIC /end GROUP
/begin GROUP S1499_FastCharge_PreCorrection "VBU0706/Function-Call Subsystem/Subsystem1/SOC/Subsystem5/Subsystem/Determine_FastChargeCorrection_Soc/FastCharge_PreCorrection" /begin REF_CHARACTERISTIC SAMPLE_TIME_TASK_C /end REF_CHARACTERISTIC /end GROUP
/begin GROUP S1499_FastCharge_TopofChargeCorrection "VBU0706/Function-Call Subsystem/Subsystem1/SOC/Subsystem5/Subsystem/Determine_FastChargeCorrection_Soc/FastCharge_TopofChargeCorrection" /begin REF_CHARACTERISTIC CcSOC_CellSocUpperLimit_pct SAMPLE_TIME_TASK_C /end REF_CHARACTERISTIC /end GROUP
/begin GROUP S1503_Current_Limit_Condition "VBU0706/Function-Call Subsystem/Subsystem1/SOC/Subsystem5/Subsystem/Determine_ShortTimeCorrection_Condition/Current_Limit_Condition" /begin REF_CHARACTERISTIC SAMPLE_TIME_TASK_C /end REF_CHARACTERISTIC /end GROUP
/begin GROUP S1506_Data_Storage "VBU0706/Function-Call Subsystem/Subsystem1/SOC/Subsystem5/Subsystem/Soc_Data_Storage/Data_Storage" /begin REF_CHARACTERISTIC SAMPLE_TIME_TASK_C /end REF_CHARACTERISTIC /end GROUP
/begin GROUP S1671_Charge_and_Idle_Mode "VBU0706/Function-Call Subsystem/Subsystem1/SOE/Subsystem2/Subsystem/Calculate_Pack_Remaining_Energy/Charge_and_Idle_Mode"
 /begin REF_CHARACTERISTIC CcSOE_DischargeCutOffSoc_pct CcSYS_CellSOCLockedMax_pct CcSYS_CellSOCLockedMin_pct /end REF_CHARACTERISTIC
/end GROUP
/begin GROUP S1671_Discharge_Mode "VBU0706/Function-Call Subsystem/Subsystem1/SOE/Subsystem2/Subsystem/Calculate_Pack_Remaining_Energy/Discharge_Mode"
 /begin REF_CHARACTERISTIC CcSOE_DischargeCutOffSoc_pct CcSYS_CellSOCLockedMax_pct CcSYS_CellSOCLockedMin_pct /end REF_CHARACTERISTIC
/end GROUP
/begin GROUP S1725_Determine_CurrentLimitTarget_Enable "VBU0706/Function-Call Subsystem/Subsystem1/SOF/Subsystem6/Subsystem/Determine_Currentlimit_Target/Determine_CurrentLimitTarget_Enable" /begin REF_CHARACTERISTIC CcSYS_NoOfInvalidCellTemps_n /end REF_CHARACTERISTIC /end GROUP
/begin GROUP S1053_DCH_BMSChAvlDebounce "VBU0706/Function-Call Subsystem/Subsystem1/FCC /DCH_Overall/DCH_DCChargeCtrlOverall/DCH_DCChargeCtrlStateflow/DCH_InputSignalPreProcess/DCH_BMSChAvlDebounce" /begin REF_CHARACTERISTIC DCH_tiSmplT_SY /end REF_CHARACTERISTIC /end GROUP
/begin GROUP S1053_DCH_DCRelayCloseDiagnose "VBU0706/Function-Call Subsystem/Subsystem1/FCC /DCH_Overall/DCH_DCChargeCtrlOverall/DCH_DCChargeCtrlStateflow/DCH_InputSignalPreProcess/DCH_DCRelayCloseDiagnose" /begin REF_CHARACTERISTIC DCH_tiSmplT_SY /end REF_CHARACTERISTIC /end GROUP
/begin GROUP S1053_DCH_VehStateAnalyze "VBU0706/Function-Call Subsystem/Subsystem1/FCC /DCH_Overall/DCH_DCChargeCtrlOverall/DCH_DCChargeCtrlStateflow/DCH_InputSignalPreProcess/DCH_VehStateAnalyze" /begin REF_CHARACTERISTIC DCH_tiSmplT_SY /end REF_CHARACTERISTIC /end GROUP
/begin GROUP S1054_DCH_OpenPDURelayValid "VBU0706/Function-Call Subsystem/Subsystem1/FCC /DCH_Overall/DCH_DCChargeCtrlOverall/DCH_DCChargeCtrlStateflow/DCH_SignalPreProcessForStateflow/DCH_OpenPDURelayValid" /begin REF_CHARACTERISTIC DCH_tiSmplT_SY /end REF_CHARACTERISTIC /end GROUP
/begin GROUP S1097_DCH_BSTOrCSTTrigger "VBU0706/Function-Call Subsystem/Subsystem1/FCC /DCH_Overall/DCH_DCChargeCtrlOverall/DCH_EepromStore/DCH_ChargeStopErrDiagnose/DCH_BSTOrCSTTrigger" /begin REF_CHARACTERISTIC DCH_tiSmplT_SY /end REF_CHARACTERISTIC /end GROUP
/begin GROUP S1099_CSTTrigDly "VBU0706/Function-Call Subsystem/Subsystem1/FCC /DCH_Overall/DCH_DCChargeCtrlOverall/DCH_EepromStore/DataConvertandCSTEEPROM/CSTTrigDly" /begin REF_CHARACTERISTIC DCH_tiSmplT_SY /end REF_CHARACTERISTIC /end GROUP
/begin GROUP S1214_Decrease_ChargeCurrentRequest "VBU0706/Function-Call Subsystem/Subsystem1/FCC /FCC/Subsystem/Determine_Fastcharge_Request/Charge_Request_Protection/Decrease_ChargeCurrentRequest" /begin REF_CHARACTERISTIC CcFCC_ChargeCurrentOver_A /end REF_CHARACTERISTIC /end GROUP
/begin GROUP S1518_Determine_Cell_Balanced_Capacity "VBU0706/Function-Call Subsystem/Subsystem1/SOC/Subsystem5/Subsystem/Determine_AhIntegral_SoC/Determine_AhIntegral_Capacity/Determine_Cell_Balanced_Capacity" /begin REF_CHARACTERISTIC SAMPLE_TIME_TASK_C /end REF_CHARACTERISTIC /end GROUP
/begin GROUP S1579_Calculate_WindowAverage_BatteryCurrent "VBU0706/Function-Call Subsystem/Subsystem1/SOC/Subsystem5/Subsystem/Determine_FastChargeCorrection_Soc/FastCharge_PreCorrection/Calculate_WindowAverage_BatteryCurrent" /begin REF_CHARACTERISTIC SAMPLE_TIME_TASK_C /end REF_CHARACTERISTIC /end GROUP
/begin GROUP S1579_FastCharge_PreCorrectionMain "VBU0706/Function-Call Subsystem/Subsystem1/SOC/Subsystem5/Subsystem/Determine_FastChargeCorrection_Soc/FastCharge_PreCorrection/FastCharge_PreCorrectionMain" /begin REF_CHARACTERISTIC SAMPLE_TIME_TASK_C /end REF_CHARACTERISTIC /end GROUP
/begin GROUP S1580_Calculate_WindowAverage_BatteryCurrent "VBU0706/Function-Call Subsystem/Subsystem1/SOC/Subsystem5/Subsystem/Determine_FastChargeCorrection_Soc/FastCharge_TopofChargeCorrection/Calculate_WindowAverage_BatteryCurrent" /begin REF_CHARACTERISTIC SAMPLE_TIME_TASK_C /end REF_CHARACTERISTIC /end GROUP
/begin GROUP S1580_FastCharge_TOCAdjustAllSOC "VBU0706/Function-Call Subsystem/Subsystem1/SOC/Subsystem5/Subsystem/Determine_FastChargeCorrection_Soc/FastCharge_TopofChargeCorrection/FastCharge_TOCAdjustAllSOC" /begin REF_CHARACTERISTIC CcSOC_CellSocUpperLimit_pct /end REF_CHARACTERISTIC /end GROUP
/begin GROUP S1615_Battery_SOC_Calculation "VBU0706/Function-Call Subsystem/Subsystem1/SOC/Subsystem5/Subsystem/Determine_Initial_SoC/CellSOC_Startup_AbnormalReset/Battery_SOC_Calculation"
 /begin REF_CHARACTERISTIC CcSOC_BatterySocLowerLimit_pct CcSOC_BatterySocUpperLimit_pct /end REF_CHARACTERISTIC
/end GROUP
/begin GROUP S1617_Battery_SOC_Calculation "VBU0706/Function-Call Subsystem/Subsystem1/SOC/Subsystem5/Subsystem/Determine_Initial_SoC/CellSOC_Startup_Normal/Battery SOC Calculation"
 /begin REF_CHARACTERISTIC CcSOC_BatterySocLowerLimit_pct CcSOC_BatterySocUpperLimit_pct /end REF_CHARACTERISTIC
/end GROUP
/begin GROUP S1682_Predict_SOC_End "VBU0706/Function-Call Subsystem/Subsystem1/SOE/Subsystem2/Subsystem/Calculate_Pack_Remaining_Energy/Discharge_Mode/Predict_SOC_End"
 /begin REF_CHARACTERISTIC CcSOE_DischargeCutOffSoc_pct CcSYS_CellSOCLockedMax_pct CcSYS_CellSOCLockedMin_pct /end REF_CHARACTERISTIC
/end GROUP
/begin GROUP S1729_Calculate_Locked_SOC "VBU0706/Function-Call Subsystem/Subsystem1/SOF/Subsystem6/Subsystem/Calculate_PowerLimit/Calculate_Pack_OCV/Calculate_Locked_SOC" /begin REF_CHARACTERISTIC CcSYS_CellSOCLockedMax_pct CcSYS_CellSOCLockedMin_pct /end REF_CHARACTERISTIC /end GROUP
/begin GROUP S1731_Calculate_Locked_SOC "VBU0706/Function-Call Subsystem/Subsystem1/SOF/Subsystem6/Subsystem/Calculate_PowerLimit/Determine_SOCP_PowerLimit/Calculate_Locked_SOC" /begin REF_CHARACTERISTIC CcSYS_CellSOCLockedMax_pct CcSYS_CellSOCLockedMin_pct /end REF_CHARACTERISTIC /end GROUP
/begin GROUP S1964_Determine_SlowCharge "VBU0706/Function-Call Subsystem/Subsystem1/SOH/Subsystem4/Subsystem1/Calculate_Capacity/Determine_CalculateCellCapacity_Condition/Determine_SlowCharge" /begin REF_CHARACTERISTIC CcSYS_NoOfInvalidCellTemps_n /end REF_CHARACTERISTIC /end GROUP
/begin GROUP S1964_Determine_SlowChargeEnd "VBU0706/Function-Call Subsystem/Subsystem1/SOH/Subsystem4/Subsystem1/Calculate_Capacity/Determine_CalculateCellCapacity_Condition/Determine_SlowChargeEnd" /begin REF_CHARACTERISTIC CcSYS_NoOfInvalidCellTemps_n /end REF_CHARACTERISTIC /end GROUP
/begin GROUP S1964_Determine_SlowChargeStart "VBU0706/Function-Call Subsystem/Subsystem1/SOH/Subsystem4/Subsystem1/Calculate_Capacity/Determine_CalculateCellCapacity_Condition/Determine_SlowChargeStart" /begin REF_CHARACTERISTIC CcSYS_NoOfInvalidCellTemps_n /end REF_CHARACTERISTIC /end GROUP
/begin GROUP S2030_ResistanceCalc_Check "VBU0706/Function-Call Subsystem/Subsystem1/SOH/Subsystem4/Subsystem1/Calculate_Resistance/BasicCellResistance_Calculation_Check/ResistanceCalc_Check" /begin REF_CHARACTERISTIC CcSYS_NoOfInvalidCellTemps_n /end REF_CHARACTERISTIC /end GROUP
/begin GROUP S2096_Determine_InletTemp_Validation "VBU0706/Function-Call Subsystem/Subsystem1/THM/Subsystem/Subsystem/Calculate_PipeTemperature/Determine_CoolantSensorTemp_Validation/Determine_InletTemp_Validation" /begin REF_CHARACTERISTIC SAMPLE_TIME_TASK_E /end REF_CHARACTERISTIC /end GROUP
/begin GROUP S2096_Determine_OutletTemp_Validation "VBU0706/Function-Call Subsystem/Subsystem1/THM/Subsystem/Subsystem/Calculate_PipeTemperature/Determine_CoolantSensorTemp_Validation/Determine_OutletTemp_Validation" /begin REF_CHARACTERISTIC SAMPLE_TIME_TASK_E /end REF_CHARACTERISTIC /end GROUP
/begin GROUP S1257_FullCharge_criteria4 "VBU0706/Function-Call Subsystem/Subsystem1/FCC /FCC/Subsystem/Fastcharge_Conditions_Check/Condition_Categorize/Full_Charge_Determination/FullCharge_criteria4" /begin REF_CHARACTERISTIC CbSYS_HomoTestEnable_flg /end REF_CHARACTERISTIC /end GROUP
/begin GROUP S1588_Calculate_WindowAverage_BatteryCurrent "VBU0706/Function-Call Subsystem/Subsystem1/SOC/Subsystem5/Subsystem/Determine_FastChargeCorrection_Soc/FastCharge_DynamicCorrection/FastCharge_DynamicCorrection_Enable/Calculate_WindowAverage_BatteryCurrent" /begin REF_CHARACTERISTIC SAMPLE_TIME_TASK_C /end REF_CHARACTERISTIC /end GROUP
/begin GROUP S1588_Determine_CurrentStable_Condition "VBU0706/Function-Call Subsystem/Subsystem1/SOC/Subsystem5/Subsystem/Determine_FastChargeCorrection_Soc/FastCharge_DynamicCorrection/FastCharge_DynamicCorrection_Enable/Determine_CurrentStable_Condition" /begin REF_CHARACTERISTIC SAMPLE_TIME_TASK_C /end REF_CHARACTERISTIC /end GROUP
/begin GROUP S1763_Calculate_ContinuousChargeCurrent "VBU0706/Function-Call Subsystem/Subsystem1/SOF/Subsystem6/Subsystem/Determine_Currentlimit_Target/Calculate_CurrentLimit_Target/Calculate_CurrentLimit_Base/Calculate_ContinuousChargeCurrent" /begin REF_CHARACTERISTIC CbSYS_HomoTestEnable_flg /end REF_CHARACTERISTIC /end GROUP
/begin GROUP S1765_SegmentChargeCheck "VBU0706/Function-Call Subsystem/Subsystem1/SOF/Subsystem6/Subsystem/Determine_Currentlimit_Target/Calculate_CurrentLimit_Target/CurrentLimit_FastCharge_Check/SegmentChargeCheck" /begin REF_CHARACTERISTIC CbSOF_CurrentLimitFastChargeCheckEnable_flg /end REF_CHARACTERISTIC /end GROUP
/begin GROUP S2097_Determinate_InletTempValidationDelay "VBU0706/Function-Call Subsystem/Subsystem1/THM/Subsystem/Subsystem/Calculate_PipeTemperature/Determine_CoolantSensorTemp_Validation/Determine_InletTemp_Validation/Determinate_InletTempValidationDelay" /begin REF_CHARACTERISTIC SAMPLE_TIME_TASK_E /end REF_CHARACTERISTIC /end GROUP
/begin GROUP S2098_Determinate_OutletTempValidationDelay "VBU0706/Function-Call Subsystem/Subsystem1/THM/Subsystem/Subsystem/Calculate_PipeTemperature/Determine_CoolantSensorTemp_Validation/Determine_OutletTemp_Validation/Determinate_OutletTempValidationDelay" /begin REF_CHARACTERISTIC SAMPLE_TIME_TASK_E /end REF_CHARACTERISTIC /end GROUP
/begin GROUP S1769_Calculate_Locked_SOC "VBU0706/Function-Call Subsystem/Subsystem1/SOF/Subsystem6/Subsystem/Determine_Currentlimit_Target/Calculate_CurrentLimit_Target/Calculate_CurrentLimit_Base/Calculate_ContinuousChargeCurrent/Calculate_Locked_SOC" /begin REF_CHARACTERISTIC CcSYS_CellSOCLockedMax_pct CcSYS_CellSOCLockedMin_pct /end REF_CHARACTERISTIC /end GROUP
/begin GROUP S1769_Calculate_Locked_SOC1 "VBU0706/Function-Call Subsystem/Subsystem1/SOF/Subsystem6/Subsystem/Determine_Currentlimit_Target/Calculate_CurrentLimit_Target/Calculate_CurrentLimit_Base/Calculate_ContinuousChargeCurrent/Calculate_Locked_SOC1" /begin REF_CHARACTERISTIC CcSYS_CellSOCLockedMax_pct CcSYS_CellSOCLockedMin_pct /end REF_CHARACTERISTIC /end GROUP
/begin GROUP S1769_Calculate_Locked_SOC2 "VBU0706/Function-Call Subsystem/Subsystem1/SOF/Subsystem6/Subsystem/Determine_Currentlimit_Target/Calculate_CurrentLimit_Target/Calculate_CurrentLimit_Base/Calculate_ContinuousChargeCurrent/Calculate_Locked_SOC2" /begin REF_CHARACTERISTIC CcSYS_CellSOCLockedMax_pct CcSYS_CellSOCLockedMin_pct /end REF_CHARACTERISTIC /end GROUP
/begin GROUP S1770_Calculate_Locked_SOC "VBU0706/Function-Call Subsystem/Subsystem1/SOF/Subsystem6/Subsystem/Determine_Currentlimit_Target/Calculate_CurrentLimit_Target/Calculate_CurrentLimit_Base/Calculate_ContinuousDischargeCurrent/Calculate_Locked_SOC" /begin REF_CHARACTERISTIC CcSYS_CellSOCLockedMax_pct CcSYS_CellSOCLockedMin_pct /end REF_CHARACTERISTIC /end GROUP
/begin GROUP S1770_Calculate_Locked_SOC1 "VBU0706/Function-Call Subsystem/Subsystem1/SOF/Subsystem6/Subsystem/Determine_Currentlimit_Target/Calculate_CurrentLimit_Target/Calculate_CurrentLimit_Base/Calculate_ContinuousDischargeCurrent/Calculate_Locked_SOC1" /begin REF_CHARACTERISTIC CcSYS_CellSOCLockedMax_pct CcSYS_CellSOCLockedMin_pct /end REF_CHARACTERISTIC /end GROUP
/begin GROUP S1771_Calculate_Locked_SOC "VBU0706/Function-Call Subsystem/Subsystem1/SOF/Subsystem6/Subsystem/Determine_Currentlimit_Target/Calculate_CurrentLimit_Target/Calculate_CurrentLimit_Base/Calculate_ShortPulseChargeCurrent/Calculate_Locked_SOC" /begin REF_CHARACTERISTIC CcSYS_CellSOCLockedMax_pct CcSYS_CellSOCLockedMin_pct /end REF_CHARACTERISTIC /end GROUP
/begin GROUP S1771_Calculate_Locked_SOC1 "VBU0706/Function-Call Subsystem/Subsystem1/SOF/Subsystem6/Subsystem/Determine_Currentlimit_Target/Calculate_CurrentLimit_Target/Calculate_CurrentLimit_Base/Calculate_ShortPulseChargeCurrent/Calculate_Locked_SOC1" /begin REF_CHARACTERISTIC CcSYS_CellSOCLockedMax_pct CcSYS_CellSOCLockedMin_pct /end REF_CHARACTERISTIC /end GROUP
/begin GROUP S1772_Calculate_Locked_SOC "VBU0706/Function-Call Subsystem/Subsystem1/SOF/Subsystem6/Subsystem/Determine_Currentlimit_Target/Calculate_CurrentLimit_Target/Calculate_CurrentLimit_Base/Calculate_ShortPulseDischargeCurrent/Calculate_Locked_SOC" /begin REF_CHARACTERISTIC CcSYS_CellSOCLockedMax_pct CcSYS_CellSOCLockedMin_pct /end REF_CHARACTERISTIC /end GROUP
/begin GROUP S1772_Calculate_Locked_SOC1 "VBU0706/Function-Call Subsystem/Subsystem1/SOF/Subsystem6/Subsystem/Determine_Currentlimit_Target/Calculate_CurrentLimit_Target/Calculate_CurrentLimit_Base/Calculate_ShortPulseDischargeCurrent/Calculate_Locked_SOC1" /begin REF_CHARACTERISTIC CcSYS_CellSOCLockedMax_pct CcSYS_CellSOCLockedMin_pct /end REF_CHARACTERISTIC /end GROUP
/end MODULE
/end PROJECT
