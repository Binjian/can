ASAP2_VERSION 1 31
/begin PROJECT ProjectName "Project Comment Goes Here"
/begin HEADER "Header Comments go here" /end HEADER
/begin MODULE ModuleName "Module Comment Goes Here"
/begin MOD_COMMON "Mod Common Comment Here" ALIGNMENT_WORD 1 ALIGNMENT_LONG 1 ALIGNMENT_FLOAT32_IEEE 1 ALIGNMENT_FLOAT64_IEEE 1 BYTE_ORDER MSB_LAST /end MOD_COMMON
/begin RECORD_LAYOUT Scalar_BOOLEAN FNC_VALUES 1 UBYTE COLUMN_DIR DIRECT /end RECORD_LAYOUT
/begin RECORD_LAYOUT Scalar_UBYTE FNC_VALUES 1 UBYTE COLUMN_DIR DIRECT /end RECORD_LAYOUT
/begin RECORD_LAYOUT Scalar_UWORD FNC_VALUES 1 UWORD COLUMN_DIR DIRECT /end RECORD_LAYOUT
/begin RECORD_LAYOUT Scalar_ULONG FNC_VALUES 1 ULONG COLUMN_DIR DIRECT /end RECORD_LAYOUT
/begin RECORD_LAYOUT Scalar_FLOAT32_IEEE FNC_VALUES 1 FLOAT32_IEEE COLUMN_DIR DIRECT /end RECORD_LAYOUT
/begin RECORD_LAYOUT Lookup1D_FLOAT32_IEEE FNC_VALUES 1 FLOAT32_IEEE COLUMN_DIR DIRECT /end RECORD_LAYOUT
/begin RECORD_LAYOUT Lookup1D_X_FLOAT32_IEEE AXIS_PTS_X 1 FLOAT32_IEEE INDEX_INCR DIRECT /end RECORD_LAYOUT
/begin RECORD_LAYOUT Lookup1D_X_FLOAT64_IEEE AXIS_PTS_X 1 FLOAT64_IEEE INDEX_INCR DIRECT /end RECORD_LAYOUT
/begin RECORD_LAYOUT Lookup2D_UWORD FNC_VALUES 1 UWORD COLUMN_DIR DIRECT /end RECORD_LAYOUT
/begin RECORD_LAYOUT Lookup2D_WORD FNC_VALUES 1 SWORD COLUMN_DIR DIRECT /end RECORD_LAYOUT
/begin RECORD_LAYOUT Lookup2D_X_WORD AXIS_PTS_X 1 SWORD INDEX_INCR DIRECT /end RECORD_LAYOUT
/begin RECORD_LAYOUT Lookup2D_ULONG FNC_VALUES 1 ULONG COLUMN_DIR DIRECT /end RECORD_LAYOUT
/begin RECORD_LAYOUT Lookup2D_FLOAT32_IEEE FNC_VALUES 1 FLOAT32_IEEE COLUMN_DIR DIRECT /end RECORD_LAYOUT
/begin RECORD_LAYOUT Lookup2D_X_FLOAT32_IEEE AXIS_PTS_X 1 FLOAT32_IEEE INDEX_INCR DIRECT /end RECORD_LAYOUT
/begin RECORD_LAYOUT Lookup2D_FLOAT64_IEEE FNC_VALUES 1 FLOAT64_IEEE COLUMN_DIR DIRECT /end RECORD_LAYOUT
/begin AXIS_PTS TQD_vSgndSpd_CUR_x "" 0x70004294 TQD_vVehSpd Lookup1D_X_FLOAT32_IEEE 0 VBU0706_CM_single_kph 21 -250.0 250.0 /end AXIS_PTS
/begin CHARACTERISTIC SPD_pctSlope_CUR_v "" CURVE 0x70001b1e Lookup1D_FLOAT32_IEEE 0 VBU0706_CM_single_cnt -3.4028234663852886E+38 3.4028234663852886E+38
 /begin AXIS_DESCR COM_AXIS SPD_aXSlope VBU0706_CM_single_cnt 6 -3.4028234663852886E+38 3.4028234663852886E+38 AXIS_PTS_REF SPD_aXSlope_CUR_x /end AXIS_DESCR
/end CHARACTERISTIC
/begin AXIS_PTS SPD_aXSlope_CUR_x "" 0x70001b06 SPD_aXSlope Lookup1D_X_FLOAT32_IEEE 0 VBU0706_CM_single_cnt 6 -3.4028234663852886E+38 3.4028234663852886E+38 /end AXIS_PTS
/begin CHARACTERISTIC VM_aMSLimHomeD_CUR_v "" CURVE 0x70003344 Lookup1D_FLOAT32_IEEE 0 VBU0706_CM_single_cnt -3.4028234663852886E+38 3.4028234663852886E+38
 /begin AXIS_DESCR COM_AXIS NO_INPUT_QUANTITY VBU0706_CM_single_cnt 14 -3.4028234663852886E+38 3.4028234663852886E+38 AXIS_PTS_REF VM_vMSLimHomeD_CUR_x /end AXIS_DESCR
/end CHARACTERISTIC
/begin AXIS_PTS VM_vMSLimHomeD_CUR_x "" 0x700033b4 NO_INPUT_QUANTITY Lookup1D_X_FLOAT32_IEEE 0 VBU0706_CM_single_cnt 14 -3.4028234663852886E+38 3.4028234663852886E+38 /end AXIS_PTS
/begin CHARACTERISTIC VM_aMSLimHomeR_CUR_v "" CURVE 0x70001d2e Lookup1D_FLOAT32_IEEE 0 VBU0706_CM_single_cnt -3.4028234663852886E+38 3.4028234663852886E+38
 /begin AXIS_DESCR COM_AXIS NO_INPUT_QUANTITY VBU0706_CM_single_cnt 6 -3.4028234663852886E+38 3.4028234663852886E+38 AXIS_PTS_REF VM_vMSLimHomeR_CUR_x /end AXIS_DESCR
/end CHARACTERISTIC
/begin AXIS_PTS VM_vMSLimHomeR_CUR_x "" 0x70001d5e NO_INPUT_QUANTITY Lookup1D_X_FLOAT32_IEEE 0 VBU0706_CM_single_cnt 6 -3.4028234663852886E+38 3.4028234663852886E+38 /end AXIS_PTS
/begin CHARACTERISTIC VM_aMSLimR_CUR_v "" CURVE 0x70001d46 Lookup1D_FLOAT32_IEEE 0 VBU0706_CM_single_cnt -3.4028234663852886E+38 3.4028234663852886E+38
 /begin AXIS_DESCR COM_AXIS NO_INPUT_QUANTITY VBU0706_CM_single_cnt 6 -3.4028234663852886E+38 3.4028234663852886E+38 AXIS_PTS_REF VM_vMSLimR_CUR_x /end AXIS_DESCR
/end CHARACTERISTIC
/begin AXIS_PTS VM_vMSLimR_CUR_x "" 0x70001d76 NO_INPUT_QUANTITY Lookup1D_X_FLOAT32_IEEE 0 VBU0706_CM_single_cnt 6 -3.4028234663852886E+38 3.4028234663852886E+38 /end AXIS_PTS
/begin CHARACTERISTIC VM_aMSLimD_CUR_v "" CURVE 0x7000330c Lookup1D_FLOAT32_IEEE 0 VBU0706_CM_single_cnt -3.4028234663852886E+38 3.4028234663852886E+38
 /begin AXIS_DESCR COM_AXIS NO_INPUT_QUANTITY VBU0706_CM_single_cnt 14 -3.4028234663852886E+38 3.4028234663852886E+38 AXIS_PTS_REF VM_vMSLimD_CUR_x /end AXIS_DESCR
/end CHARACTERISTIC
/begin AXIS_PTS VM_vMSLimD_CUR_x "" 0x7000337c NO_INPUT_QUANTITY Lookup1D_X_FLOAT32_IEEE 0 VBU0706_CM_single_cnt 14 -3.4028234663852886E+38 3.4028234663852886E+38 /end AXIS_PTS
/begin CHARACTERISTIC CrCtl_facDragSpeed_MAP_v "" MAP 0x700071a4 Lookup2D_FLOAT32_IEEE 0 VBU0706_CM_single_cnt -3.4028234663852886E+38 3.4028234663852886E+38
 /begin AXIS_DESCR COM_AXIS SPD_vVehSpd VBU0706_CM_single_cnt 14 -3.4028234663852886E+38 3.4028234663852886E+38 AXIS_PTS_REF CrCtl_vDragSpeed_MAP_y /end AXIS_DESCR
 /begin AXIS_DESCR COM_AXIS APD_pctAccPedPos VBU0706_CM_single_cnt 11 -3.4028234663852886E+38 3.4028234663852886E+38 AXIS_PTS_REF CrCtl_pctDragSpeed_MAP_x /end AXIS_DESCR
/end CHARACTERISTIC
/begin AXIS_PTS CrCtl_pctDragSpeed_MAP_x "" 0x700026c2 APD_pctAccPedPos Lookup2D_X_FLOAT32_IEEE 0 VBU0706_CM_single_cnt 11 -3.4028234663852886E+38 3.4028234663852886E+38 /end AXIS_PTS
/begin AXIS_PTS CrCtl_vDragSpeed_MAP_y "" 0x700032d4 SPD_vVehSpd Lookup2D_X_FLOAT32_IEEE 0 VBU0706_CM_single_cnt 14 -3.4028234663852886E+38 3.4028234663852886E+38 /end AXIS_PTS
/begin CHARACTERISTIC TQD_pctCrpCtrlBrkPctS_CUR_v "" CURVE 0x7000207a Lookup1D_FLOAT32_IEEE 0 VBU0706_CM_single_fac 0.0 2.0
 /begin AXIS_DESCR COM_AXIS BPD_pctBrkPos VBU0706_CM_single_cnt 8 0.0 100.0 AXIS_PTS_REF TQD_rCrpCtrlBrkPct_CUR_x /end AXIS_DESCR
/end CHARACTERISTIC
/begin AXIS_PTS TQD_rCrpCtrlBrkPct_CUR_x "" 0x700020da BPD_pctBrkPos Lookup1D_X_FLOAT32_IEEE 0 VBU0706_CM_single_cnt 8 0.0 100.0 /end AXIS_PTS
/begin CHARACTERISTIC TQD_pctCrpCtrlBrkPct_MAP_v "" MAP 0x70004c84 Lookup2D_FLOAT32_IEEE 0 VBU0706_CM_single_pct 0.0 1.0
 /begin AXIS_DESCR COM_AXIS BPD_pctBrkPos VBU0706_CM_single_pct 8 0.0 25.0 AXIS_PTS_REF TQD_pctCrpCtrlBrkPct_MAP_y /end AXIS_DESCR
 /begin AXIS_DESCR COM_AXIS SPD_pctSlope VBU0706_CM_single_fac 6 -5.0 20.0 AXIS_PTS_REF TQD_rCrpCtrlBrkPct_MAP_x /end AXIS_DESCR
/end CHARACTERISTIC
/begin AXIS_PTS TQD_rCrpCtrlBrkPct_MAP_x "" 0x70001cb6 SPD_pctSlope Lookup2D_X_FLOAT32_IEEE 0 VBU0706_CM_single_fac 6 -5.0 20.0 /end AXIS_PTS
/begin AXIS_PTS TQD_pctCrpCtrlBrkPct_MAP_y "" 0x7000209a BPD_pctBrkPos Lookup2D_X_FLOAT32_IEEE 0 VBU0706_CM_single_pct 8 0.0 25.0 /end AXIS_PTS
/begin CHARACTERISTIC TQD_pctCrpCtrlBrkPresS_CUR_v "" CURVE 0x700020ba Lookup1D_FLOAT32_IEEE 0 VBU0706_CM_single_p 0.0 2.0
 /begin AXIS_DESCR COM_AXIS TQD_pBrkPressFlt VBU0706_CM_single_p 8 0.0 20.0 AXIS_PTS_REF TQD_pCrpCtrlBrkPres_CUR_x /end AXIS_DESCR
/end CHARACTERISTIC
/begin AXIS_PTS TQD_pCrpCtrlBrkPres_CUR_x "" 0x7000203a TQD_pBrkPressFlt Lookup1D_X_FLOAT32_IEEE 0 VBU0706_CM_single_p 8 0.0 20.0 /end AXIS_PTS
/begin CHARACTERISTIC TQD_pctCrpCtrlBrkPres_MAP_v "" MAP 0x70004d44 Lookup2D_FLOAT32_IEEE 0 VBU0706_CM_single_pct 0.0 1.0
 /begin AXIS_DESCR COM_AXIS TQD_pBrkPressFlt VBU0706_CM_single_pct 8 0.0 100.0 AXIS_PTS_REF TQD_pCrpCtrlBrkPres_MAP_y /end AXIS_DESCR
 /begin AXIS_DESCR COM_AXIS SPD_pctSlope VBU0706_CM_single_fac 6 -5.0 20.0 AXIS_PTS_REF TQD_rCrpCtrlBrkPct_MAP_x /end AXIS_DESCR
/end CHARACTERISTIC
/begin AXIS_PTS TQD_pCrpCtrlBrkPres_MAP_y "" 0x7000205a TQD_pBrkPressFlt Lookup2D_X_FLOAT32_IEEE 0 VBU0706_CM_single_pct 8 0.0 100.0 /end AXIS_PTS
/begin CHARACTERISTIC TQD_trqCrpCstModeA_CUR_v "" CURVE 0x700040f0 Lookup1D_FLOAT32_IEEE 0 VBU0706_CM_single_Nm -10000.0 10000.0
 /begin AXIS_DESCR COM_AXIS TQD_vVehSpd VBU0706_CM_single_kph 21 -250.0 250.0 AXIS_PTS_REF TQD_vSgndSpd_CUR_x /end AXIS_DESCR
/end CHARACTERISTIC
/begin CHARACTERISTIC TQD_trqCrpCstModeB_CUR_v "" CURVE 0x70004144 Lookup1D_FLOAT32_IEEE 0 VBU0706_CM_single_Nm -10000.0 10000.0
 /begin AXIS_DESCR COM_AXIS TQD_vVehSpd VBU0706_CM_single_kph 21 -250.0 250.0 AXIS_PTS_REF TQD_vSgndSpd_CUR_x /end AXIS_DESCR
/end CHARACTERISTIC
/begin CHARACTERISTIC TQD_trqCrpCstModeC_CUR_v "" CURVE 0x70004198 Lookup1D_FLOAT32_IEEE 0 VBU0706_CM_single_Nm -10000.0 10000.0
 /begin AXIS_DESCR COM_AXIS TQD_vVehSpd VBU0706_CM_single_kph 21 -250.0 250.0 AXIS_PTS_REF TQD_vSgndSpd_CUR_x /end AXIS_DESCR
/end CHARACTERISTIC
/begin CHARACTERISTIC TQD_trqCrpCstModeD_CUR_v "" CURVE 0x700041ec Lookup1D_FLOAT32_IEEE 0 VBU0706_CM_single_Nm -10000.0 10000.0
 /begin AXIS_DESCR COM_AXIS TQD_vVehSpd VBU0706_CM_single_kph 21 -250.0 250.0 AXIS_PTS_REF TQD_vSgndSpd_CUR_x /end AXIS_DESCR
/end CHARACTERISTIC
/begin CHARACTERISTIC APD_uThdDiff12_CUR_v "" CURVE 0x70003644 Lookup1D_FLOAT32_IEEE 0 VBU0706_CM_single_cnt -3.4028234663852886E+38 3.4028234663852886E+38
 /begin AXIS_DESCR COM_AXIS NO_INPUT_QUANTITY VBU0706_CM_single_cnt 16 -3.4028234663852886E+38 3.4028234663852886E+38 AXIS_PTS_REF APD_uThdDiff12_CUR_x /end AXIS_DESCR
/end CHARACTERISTIC
/begin AXIS_PTS APD_uThdDiff12_CUR_x "" 0x70003684 NO_INPUT_QUANTITY Lookup1D_X_FLOAT32_IEEE 0 VBU0706_CM_single_cnt 16 -3.4028234663852886E+38 3.4028234663852886E+38 /end AXIS_PTS
/begin CHARACTERISTIC BPD_pctBrkPress_CUR_v "" CURVE 0x70001f1a Lookup1D_FLOAT32_IEEE 0 VBU0706_CM_single_cnt -3.4028234663852886E+38 3.4028234663852886E+38
 /begin AXIS_DESCR COM_AXIS BPD_pBrkPress VBU0706_CM_double_cnt 8 -3.4028234663852886E+38 3.4028234663852886E+38 AXIS_PTS_REF BPD_pBrkPress_CUR_x /end AXIS_DESCR
/end CHARACTERISTIC
/begin AXIS_PTS BPD_pBrkPress_CUR_x "" 0x70001efa BPD_pBrkPress Lookup1D_X_FLOAT64_IEEE 0 VBU0706_CM_double_cnt 8 -3.4028234663852886E+38 3.4028234663852886E+38 /end AXIS_PTS
/begin CHARACTERISTIC BCU_pBrkPres "" CURVE 0x70001746 Lookup1D_FLOAT32_IEEE 0 VBU0706_CM_single_MPa 0.0 1000.0
 /begin AXIS_DESCR COM_AXIS INP_uBrkPresFlt1 VBU0706_CM_single_V 5 0.0 100.0 AXIS_PTS_REF INP_uBrkPresFlt /end AXIS_DESCR
/end CHARACTERISTIC
/begin AXIS_PTS INP_uBrkPresFlt "" 0x700018ae INP_uBrkPresFlt1 Lookup1D_X_FLOAT32_IEEE 0 VBU0706_CM_single_V 5 0.0 100.0 /end AXIS_PTS
/begin CHARACTERISTIC CaSYS_FullChargeOcvMapZ_mV "" MAP 0x700046c0 Lookup2D_FLOAT32_IEEE 0 VBU0706_CM_single_cnt -3.4028234663852886E+38 3.4028234663852886E+38
 /begin AXIS_DESCR COM_AXIS NO_INPUT_QUANTITY VBU0706_CM_single_cnt 3 -3.4028234663852886E+38 3.4028234663852886E+38 AXIS_PTS_REF CaSYS_FullChargeOcvMapY_pct /end AXIS_DESCR
 /begin AXIS_DESCR COM_AXIS NO_INPUT_QUANTITY VBU0706_CM_single_cnt 8 -3.4028234663852886E+38 3.4028234663852886E+38 AXIS_PTS_REF CaSYS_FullChargeOcvMapX_C /end AXIS_DESCR
/end CHARACTERISTIC
/begin AXIS_PTS CaSYS_FullChargeOcvMapX_C "" 0x70001f9a NO_INPUT_QUANTITY Lookup2D_X_FLOAT32_IEEE 0 VBU0706_CM_single_cnt 8 -3.4028234663852886E+38 3.4028234663852886E+38 /end AXIS_PTS
/begin AXIS_PTS CaSYS_FullChargeOcvMapY_pct "" 0x7000150c NO_INPUT_QUANTITY Lookup2D_X_FLOAT32_IEEE 0 VBU0706_CM_single_cnt 3 -3.4028234663852886E+38 3.4028234663852886E+38 /end AXIS_PTS
/begin CHARACTERISTIC CaFCC_FullChargeVoltageSOHAttenuationMapZ_mV "" MAP 0x70004660 Lookup2D_FLOAT32_IEEE 0 VBU0706_CM_single_cnt -3.4028234663852886E+38 3.4028234663852886E+38
 /begin AXIS_DESCR COM_AXIS NO_INPUT_QUANTITY VBU0706_CM_single_cnt 3 -3.4028234663852886E+38 3.4028234663852886E+38 AXIS_PTS_REF CaFCC_FullChargeVoltageSOHAttenuationMapY_pct /end AXIS_DESCR
 /begin AXIS_DESCR COM_AXIS NO_INPUT_QUANTITY VBU0706_CM_single_cnt 8 -3.4028234663852886E+38 3.4028234663852886E+38 AXIS_PTS_REF CaFCC_FullChargeVoltageSOHAttenuationMapX_C /end AXIS_DESCR
/end CHARACTERISTIC
/begin AXIS_PTS CaFCC_FullChargeVoltageSOHAttenuationMapX_C "" 0x70001f7a NO_INPUT_QUANTITY Lookup2D_X_FLOAT32_IEEE 0 VBU0706_CM_single_cnt 8 -3.4028234663852886E+38 3.4028234663852886E+38 /end AXIS_PTS
/begin AXIS_PTS CaFCC_FullChargeVoltageSOHAttenuationMapY_pct "" 0x70001500 NO_INPUT_QUANTITY Lookup2D_X_FLOAT32_IEEE 0 VBU0706_CM_single_cnt 3 -3.4028234663852886E+38 3.4028234663852886E+38 /end AXIS_PTS
/begin CHARACTERISTIC CaFCC_FullChargeVoltageHysteresisMapZ_mV "" MAP 0x70004600 Lookup2D_FLOAT32_IEEE 0 VBU0706_CM_single_cnt -3.4028234663852886E+38 3.4028234663852886E+38
 /begin AXIS_DESCR COM_AXIS SOH_pctPackSoh VBU0706_CM_single_cnt 3 -3.4028234663852886E+38 3.4028234663852886E+38 AXIS_PTS_REF CaFCC_FullChargeVoltageHysteresisMapY_pct /end AXIS_DESCR
 /begin AXIS_DESCR COM_AXIS NO_INPUT_QUANTITY VBU0706_CM_single_cnt 8 -3.4028234663852886E+38 3.4028234663852886E+38 AXIS_PTS_REF CaFCC_FullChargeVoltageHysteresisMapX_C /end AXIS_DESCR
/end CHARACTERISTIC
/begin AXIS_PTS CaFCC_FullChargeVoltageHysteresisMapX_C "" 0x70001f5a NO_INPUT_QUANTITY Lookup2D_X_FLOAT32_IEEE 0 VBU0706_CM_single_cnt 8 -3.4028234663852886E+38 3.4028234663852886E+38 /end AXIS_PTS
/begin AXIS_PTS CaFCC_FullChargeVoltageHysteresisMapY_pct "" 0x700014f4 SOH_pctPackSoh Lookup2D_X_FLOAT32_IEEE 0 VBU0706_CM_single_cnt 3 -3.4028234663852886E+38 3.4028234663852886E+38 /end AXIS_PTS
/begin CHARACTERISTIC CaSOF_ContinuousChargeSocTempMapZ_A "" MAP 0x7000d37c Lookup2D_FLOAT32_IEEE 0 VBU0706_CM_single_A 0.0 200.0
 /begin AXIS_DESCR COM_AXIS SOC_pctCellSocMax VBU0706_CM_single_pct 21 0.0 100.0 AXIS_PTS_REF CaSOF_ContinuousChargeSocTempMapY_pct /end AXIS_DESCR
 /begin AXIS_DESCR COM_AXIS NO_INPUT_QUANTITY VBU0706_CM_single_t 22 -40.0 120.0 AXIS_PTS_REF CaSOF_ContinuousChargeSocTempMapX_C /end AXIS_DESCR
/end CHARACTERISTIC
/begin AXIS_PTS CaSOF_ContinuousChargeSocTempMapX_C "" 0x700043ec NO_INPUT_QUANTITY Lookup2D_X_FLOAT32_IEEE 0 VBU0706_CM_single_t 22 -40.0 120.0 /end AXIS_PTS
/begin AXIS_PTS CaSOF_ContinuousChargeSocTempMapY_pct "" 0x70003d54 SOC_pctCellSocMax Lookup2D_X_FLOAT32_IEEE 0 VBU0706_CM_single_pct 21 0.0 100.0 /end AXIS_PTS
/begin CHARACTERISTIC CaSOF_ContinuousChargeLockedSocTempMapZ_A "" MAP 0x7000cc44 Lookup2D_FLOAT64_IEEE 0 VBU0706_CM_double_A 0.0 400.0
 /begin AXIS_DESCR COM_AXIS NO_INPUT_QUANTITY VBU0706_CM_single_pct 21 0.0 100.0 AXIS_PTS_REF CaSOF_ContinuousChargeLockedSocTempMapY_pct /end AXIS_DESCR
 /begin AXIS_DESCR COM_AXIS NO_INPUT_QUANTITY VBU0706_CM_single_t 22 -40.0 120.0 AXIS_PTS_REF CaSOF_ContinuousChargeLockedSocTempMapX_C /end AXIS_DESCR
/end CHARACTERISTIC
/begin AXIS_PTS CaSOF_ContinuousChargeLockedSocTempMapX_C "" 0x7000433c NO_INPUT_QUANTITY Lookup2D_X_FLOAT32_IEEE 0 VBU0706_CM_single_t 22 -40.0 120.0 /end AXIS_PTS
/begin AXIS_PTS CaSOF_ContinuousChargeLockedSocTempMapY_pct "" 0x70003d00 NO_INPUT_QUANTITY Lookup2D_X_FLOAT32_IEEE 0 VBU0706_CM_single_pct 21 0.0 100.0 /end AXIS_PTS
/begin CHARACTERISTIC CaSOF_ContinuousChargeEolMap_v "" MAP 0x7000f068 Lookup2D_FLOAT32_IEEE 0 VBU0706_CM_single_i 0.0 200.0
 /begin AXIS_DESCR COM_AXIS NO_INPUT_QUANTITY VBU0706_CM_single_pct 22 0.0 100.0 AXIS_PTS_REF CaSOF_ContinuousChargeSocMap_y /end AXIS_DESCR
 /begin AXIS_DESCR COM_AXIS NO_INPUT_QUANTITY VBU0706_CM_single_t 22 -40.0 120.0 AXIS_PTS_REF CaSOF_ContinuousChargeTempMap_x /end AXIS_DESCR
/end CHARACTERISTIC
/begin AXIS_PTS CaSOF_ContinuousChargeTempMap_x "" 0x70004444 NO_INPUT_QUANTITY Lookup2D_X_FLOAT32_IEEE 0 VBU0706_CM_single_t 22 -40.0 120.0 /end AXIS_PTS
/begin AXIS_PTS CaSOF_ContinuousChargeSocMap_y "" 0x70004394 NO_INPUT_QUANTITY Lookup2D_X_FLOAT32_IEEE 0 VBU0706_CM_single_pct 22 0.0 100.0 /end AXIS_PTS
/begin CHARACTERISTIC CaSOF_ContinuousChargeHomoMap_v "" MAP 0x7000f7f8 Lookup2D_FLOAT32_IEEE 0 VBU0706_CM_single_i 0.0 200.0
 /begin AXIS_DESCR COM_AXIS SOC_pctCellSocMax VBU0706_CM_single_pct 22 0.0 100.0 AXIS_PTS_REF CaSOF_ContinuousChargeSocMap_y /end AXIS_DESCR
 /begin AXIS_DESCR COM_AXIS NO_INPUT_QUANTITY VBU0706_CM_single_t 22 -40.0 120.0 AXIS_PTS_REF CaSOF_ContinuousChargeTempMap_x /end AXIS_DESCR
/end CHARACTERISTIC
/begin CHARACTERISTIC CaSOF_ContinuousChargeLockedHomoMap_v "" MAP 0x7000ff88 Lookup2D_FLOAT32_IEEE 0 VBU0706_CM_single_i 0.0 200.0
 /begin AXIS_DESCR COM_AXIS NO_INPUT_QUANTITY VBU0706_CM_single_pct 22 0.0 100.0 AXIS_PTS_REF CaSOF_ContinuousChargeSocMap_y /end AXIS_DESCR
 /begin AXIS_DESCR COM_AXIS NO_INPUT_QUANTITY VBU0706_CM_single_t 22 -40.0 120.0 AXIS_PTS_REF CaSOF_ContinuousChargeTempMap_x /end AXIS_DESCR
/end CHARACTERISTIC
/begin CHARACTERISTIC CaSOF_ContinuousChargeFactorMap_v "" MAP 0x70006f3c Lookup2D_FLOAT32_IEEE 0 VBU0706_CM_single_i 0.0 1.0
 /begin AXIS_DESCR COM_AXIS SOC_pctCellSocMax VBU0706_CM_single_pct 22 0.0 100.0 AXIS_PTS_REF CaSOF_ContinuousChargeSocMap_y /end AXIS_DESCR
 /begin AXIS_DESCR FIX_AXIS NO_INPUT_QUANTITY VBU0706_CM_uint16 7 0 500 /begin FIX_AXIS_PAR_LIST 0 50 100 200 300 400 500 /end FIX_AXIS_PAR_LIST /end AXIS_DESCR
/end CHARACTERISTIC
/begin CHARACTERISTIC CaSOF_ContinuousDischargeSocTempMapZ_A "" MAP 0x70009054 Lookup2D_FLOAT32_IEEE 0 VBU0706_CM_single_cnt -3.4028234663852886E+38 3.4028234663852886E+38
 /begin AXIS_DESCR COM_AXIS SOC_pctCellSocMin VBU0706_CM_single_cnt 13 -3.4028234663852886E+38 3.4028234663852886E+38 AXIS_PTS_REF CaSOF_ContinuousDischargeSocTempMapY_pct /end AXIS_DESCR
 /begin AXIS_DESCR COM_AXIS NO_INPUT_QUANTITY VBU0706_CM_single_cnt 15 -3.4028234663852886E+38 3.4028234663852886E+38 AXIS_PTS_REF CaSOF_ContinuousDischargeSocTempMapX_C /end AXIS_DESCR
/end CHARACTERISTIC
/begin AXIS_PTS CaSOF_ContinuousDischargeSocTempMapX_C "" 0x70003464 NO_INPUT_QUANTITY Lookup2D_X_FLOAT32_IEEE 0 VBU0706_CM_single_cnt 15 -3.4028234663852886E+38 3.4028234663852886E+38 /end AXIS_PTS
/begin AXIS_PTS CaSOF_ContinuousDischargeSocTempMapY_pct "" 0x70002d30 SOC_pctCellSocMin Lookup2D_X_FLOAT32_IEEE 0 VBU0706_CM_single_cnt 13 -3.4028234663852886E+38 3.4028234663852886E+38 /end AXIS_PTS
/begin CHARACTERISTIC CaSOF_ContinuousDischargeLockedSocTempMapZ_A "" MAP 0x70008d48 Lookup2D_FLOAT32_IEEE 0 VBU0706_CM_single_cnt -3.4028234663852886E+38 3.4028234663852886E+38
 /begin AXIS_DESCR COM_AXIS NO_INPUT_QUANTITY VBU0706_CM_single_cnt 13 -3.4028234663852886E+38 3.4028234663852886E+38 AXIS_PTS_REF CaSOF_ContinuousDischargeLockedSocTempMapY_pct /end AXIS_DESCR
 /begin AXIS_DESCR COM_AXIS NO_INPUT_QUANTITY VBU0706_CM_single_cnt 15 -3.4028234663852886E+38 3.4028234663852886E+38 AXIS_PTS_REF CaSOF_ContinuousDischargeLockedSocTempMapX_C /end AXIS_DESCR
/end CHARACTERISTIC
/begin AXIS_PTS CaSOF_ContinuousDischargeLockedSocTempMapX_C "" 0x70003428 NO_INPUT_QUANTITY Lookup2D_X_FLOAT32_IEEE 0 VBU0706_CM_single_cnt 15 -3.4028234663852886E+38 3.4028234663852886E+38 /end AXIS_PTS
/begin AXIS_PTS CaSOF_ContinuousDischargeLockedSocTempMapY_pct "" 0x70002cfc NO_INPUT_QUANTITY Lookup2D_X_FLOAT32_IEEE 0 VBU0706_CM_single_cnt 13 -3.4028234663852886E+38 3.4028234663852886E+38 /end AXIS_PTS
/begin CHARACTERISTIC CaSOF_ContinuousDischargeEolSocTempMapZ_A "" MAP 0x70007ef4 Lookup2D_FLOAT32_IEEE 0 VBU0706_CM_single_cnt -3.4028234663852886E+38 3.4028234663852886E+38
 /begin AXIS_DESCR COM_AXIS NO_INPUT_QUANTITY VBU0706_CM_single_cnt 13 -3.4028234663852886E+38 3.4028234663852886E+38 AXIS_PTS_REF CaSOF_ContinuousDischargeEolSocTempMapY_pct /end AXIS_DESCR
 /begin AXIS_DESCR COM_AXIS NO_INPUT_QUANTITY VBU0706_CM_single_cnt 14 -3.4028234663852886E+38 3.4028234663852886E+38 AXIS_PTS_REF CaSOF_ContinuousDischargeEolSocTempMapX_C /end AXIS_DESCR
/end CHARACTERISTIC
/begin AXIS_PTS CaSOF_ContinuousDischargeEolSocTempMapX_C "" 0x70003114 NO_INPUT_QUANTITY Lookup2D_X_FLOAT32_IEEE 0 VBU0706_CM_single_cnt 14 -3.4028234663852886E+38 3.4028234663852886E+38 /end AXIS_PTS
/begin AXIS_PTS CaSOF_ContinuousDischargeEolSocTempMapY_pct "" 0x70002cc8 NO_INPUT_QUANTITY Lookup2D_X_FLOAT32_IEEE 0 VBU0706_CM_single_cnt 13 -3.4028234663852886E+38 3.4028234663852886E+38 /end AXIS_PTS
/begin CHARACTERISTIC CaSOF_ShortPulseChargeSocTempMapZ_A "" MAP 0x7000e1ec Lookup2D_FLOAT32_IEEE 0 VBU0706_CM_single_A 0.0 500.0
 /begin AXIS_DESCR COM_AXIS SOC_pctCellSocMax VBU0706_CM_single_pct 21 0.0 100.0 AXIS_PTS_REF CaSOF_ShortPulseChargeSocTempMapY_pct /end AXIS_DESCR
 /begin AXIS_DESCR COM_AXIS NO_INPUT_QUANTITY VBU0706_CM_single_t 22 -40.0 120.0 AXIS_PTS_REF CaSOF_ShortPulseChargeSocTempMapX_C /end AXIS_DESCR
/end CHARACTERISTIC
/begin AXIS_PTS CaSOF_ShortPulseChargeSocTempMapX_C "" 0x700044f4 NO_INPUT_QUANTITY Lookup2D_X_FLOAT32_IEEE 0 VBU0706_CM_single_t 22 -40.0 120.0 /end AXIS_PTS
/begin AXIS_PTS CaSOF_ShortPulseChargeSocTempMapY_pct "" 0x70003e50 SOC_pctCellSocMax Lookup2D_X_FLOAT32_IEEE 0 VBU0706_CM_single_pct 21 0.0 100.0 /end AXIS_PTS
/begin CHARACTERISTIC CaSOF_ShortPulseChargeLockedSocTempMapZ_A "" MAP 0x7000dab4 Lookup2D_FLOAT32_IEEE 0 VBU0706_CM_single_A 0.0 500.0
 /begin AXIS_DESCR COM_AXIS NO_INPUT_QUANTITY VBU0706_CM_single_pct 21 0.0 100.0 AXIS_PTS_REF CaSOF_ShortPulseChargeLockedSocTempMapY_pct /end AXIS_DESCR
 /begin AXIS_DESCR COM_AXIS NO_INPUT_QUANTITY VBU0706_CM_single_C 22 -40.0 120.0 AXIS_PTS_REF CaSOF_ShortPulseChargeLockedSocTempMapX_C /end AXIS_DESCR
/end CHARACTERISTIC
/begin AXIS_PTS CaSOF_ShortPulseChargeLockedSocTempMapX_C "" 0x7000449c NO_INPUT_QUANTITY Lookup2D_X_FLOAT32_IEEE 0 VBU0706_CM_single_C 22 -40.0 120.0 /end AXIS_PTS
/begin AXIS_PTS CaSOF_ShortPulseChargeLockedSocTempMapY_pct "" 0x70003dfc NO_INPUT_QUANTITY Lookup2D_X_FLOAT32_IEEE 0 VBU0706_CM_single_pct 21 0.0 100.0 /end AXIS_PTS
/begin CHARACTERISTIC CaSOF_ShortPulseChargeEolSocTempMapZ_A "" MAP 0x700076a0 Lookup2D_FLOAT32_IEEE 0 VBU0706_CM_single_cnt -3.4028234663852886E+38 3.4028234663852886E+38
 /begin AXIS_DESCR COM_AXIS NO_INPUT_QUANTITY VBU0706_CM_single_cnt 13 -3.4028234663852886E+38 3.4028234663852886E+38 AXIS_PTS_REF CaSOF_ShortPulseChargeEolSocTempMapY_pct /end AXIS_DESCR
 /begin AXIS_DESCR COM_AXIS NO_INPUT_QUANTITY VBU0706_CM_single_cnt 13 -3.4028234663852886E+38 3.4028234663852886E+38 AXIS_PTS_REF CaSOF_ShortPulseChargeEolSocTempMapX_C /end AXIS_DESCR
/end CHARACTERISTIC
/begin AXIS_PTS CaSOF_ShortPulseChargeEolSocTempMapX_C "" 0x70002dcc NO_INPUT_QUANTITY Lookup2D_X_FLOAT32_IEEE 0 VBU0706_CM_single_cnt 13 -3.4028234663852886E+38 3.4028234663852886E+38 /end AXIS_PTS
/begin AXIS_PTS CaSOF_ShortPulseChargeEolSocTempMapY_pct "" 0x70002e00 NO_INPUT_QUANTITY Lookup2D_X_FLOAT32_IEEE 0 VBU0706_CM_single_cnt 13 -3.4028234663852886E+38 3.4028234663852886E+38 /end AXIS_PTS
/begin CHARACTERISTIC CaSOF_ShortPulseDischargeSocTempMapZ_A "" MAP 0x7000966c Lookup2D_FLOAT32_IEEE 0 VBU0706_CM_single_cnt -3.4028234663852886E+38 3.4028234663852886E+38
 /begin AXIS_DESCR COM_AXIS SOC_pctCellSocMin VBU0706_CM_single_cnt 13 -3.4028234663852886E+38 3.4028234663852886E+38 AXIS_PTS_REF CaSOF_ShortPulseDischargeSocTempMapY_pct /end AXIS_DESCR
 /begin AXIS_DESCR COM_AXIS NO_INPUT_QUANTITY VBU0706_CM_single_cnt 15 -3.4028234663852886E+38 3.4028234663852886E+38 AXIS_PTS_REF CaSOF_ShortPulseDischargeSocTempMapX_C /end AXIS_DESCR
/end CHARACTERISTIC
/begin AXIS_PTS CaSOF_ShortPulseDischargeSocTempMapX_C "" 0x70003518 NO_INPUT_QUANTITY Lookup2D_X_FLOAT32_IEEE 0 VBU0706_CM_single_cnt 15 -3.4028234663852886E+38 3.4028234663852886E+38 /end AXIS_PTS
/begin AXIS_PTS CaSOF_ShortPulseDischargeSocTempMapY_pct "" 0x70002e9c SOC_pctCellSocMin Lookup2D_X_FLOAT32_IEEE 0 VBU0706_CM_single_cnt 13 -3.4028234663852886E+38 3.4028234663852886E+38 /end AXIS_PTS
/begin CHARACTERISTIC CaSOF_ShortPulseDischargeLockedSocTempMapZ_A "" MAP 0x70009360 Lookup2D_FLOAT32_IEEE 0 VBU0706_CM_single_cnt -3.4028234663852886E+38 3.4028234663852886E+38
 /begin AXIS_DESCR COM_AXIS NO_INPUT_QUANTITY VBU0706_CM_single_cnt 13 -3.4028234663852886E+38 3.4028234663852886E+38 AXIS_PTS_REF CaSOF_ShortPulseDischargeLockedSocTempMapY_pct /end AXIS_DESCR
 /begin AXIS_DESCR COM_AXIS NO_INPUT_QUANTITY VBU0706_CM_single_cnt 15 -3.4028234663852886E+38 3.4028234663852886E+38 AXIS_PTS_REF CaSOF_ShortPulseDischargeLockedSocTempMapX_C /end AXIS_DESCR
/end CHARACTERISTIC
/begin AXIS_PTS CaSOF_ShortPulseDischargeLockedSocTempMapX_C "" 0x700034dc NO_INPUT_QUANTITY Lookup2D_X_FLOAT32_IEEE 0 VBU0706_CM_single_cnt 15 -3.4028234663852886E+38 3.4028234663852886E+38 /end AXIS_PTS
/begin AXIS_PTS CaSOF_ShortPulseDischargeLockedSocTempMapY_pct "" 0x70002e68 NO_INPUT_QUANTITY Lookup2D_X_FLOAT32_IEEE 0 VBU0706_CM_single_cnt 13 -3.4028234663852886E+38 3.4028234663852886E+38 /end AXIS_PTS
/begin CHARACTERISTIC CaSOF_ShortPulseDischargeEolSocTempMapZ_A "" MAP 0x7000877c Lookup2D_FLOAT32_IEEE 0 VBU0706_CM_single_cnt -3.4028234663852886E+38 3.4028234663852886E+38
 /begin AXIS_DESCR COM_AXIS NO_INPUT_QUANTITY VBU0706_CM_single_cnt 13 -3.4028234663852886E+38 3.4028234663852886E+38 AXIS_PTS_REF CaSOF_ShortPulseDischargeEolSocTempMapY_pct /end AXIS_DESCR
 /begin AXIS_DESCR COM_AXIS NO_INPUT_QUANTITY VBU0706_CM_single_cnt 14 -3.4028234663852886E+38 3.4028234663852886E+38 AXIS_PTS_REF CaSOF_ShortPulseDischargeEolSocTempMapX_C /end AXIS_DESCR
/end CHARACTERISTIC
/begin AXIS_PTS CaSOF_ShortPulseDischargeEolSocTempMapX_C "" 0x7000329c NO_INPUT_QUANTITY Lookup2D_X_FLOAT32_IEEE 0 VBU0706_CM_single_cnt 14 -3.4028234663852886E+38 3.4028234663852886E+38 /end AXIS_PTS
/begin AXIS_PTS CaSOF_ShortPulseDischargeEolSocTempMapY_pct "" 0x70002e34 NO_INPUT_QUANTITY Lookup2D_X_FLOAT32_IEEE 0 VBU0706_CM_single_cnt 13 -3.4028234663852886E+38 3.4028234663852886E+38 /end AXIS_PTS
/begin CHARACTERISTIC CaSOF_FastChargeCurrentDropEOLCellVoltageMapZ_mV "" MAP 0x700045a6 Lookup2D_UWORD 0 VBU0706_CM_uint16_cnt 0.0 65535.0
 /begin AXIS_DESCR COM_AXIS NO_INPUT_QUANTITY VBU0706_CM_single_cnt 5 -3.4028234663852886E+38 3.4028234663852886E+38 AXIS_PTS_REF CaSOF_FastChargeCurrentDropEOLCellVoltageMapY_pct /end AXIS_DESCR
 /begin AXIS_DESCR COM_AXIS NO_INPUT_QUANTITY VBU0706_CM_single_cnt 9 -3.4028234663852886E+38 3.4028234663852886E+38 AXIS_PTS_REF CaSOF_FastChargeCurrentDropEOLCellVoltageMapX_C /end AXIS_DESCR
/end CHARACTERISTIC
/begin AXIS_PTS CaSOF_FastChargeCurrentDropEOLCellVoltageMapX_C "" 0x700021ce NO_INPUT_QUANTITY Lookup2D_X_FLOAT32_IEEE 0 VBU0706_CM_single_cnt 9 -3.4028234663852886E+38 3.4028234663852886E+38 /end AXIS_PTS
/begin AXIS_PTS CaSOF_FastChargeCurrentDropEOLCellVoltageMapY_pct "" 0x700017be NO_INPUT_QUANTITY Lookup2D_X_FLOAT32_IEEE 0 VBU0706_CM_single_cnt 5 -3.4028234663852886E+38 3.4028234663852886E+38 /end AXIS_PTS
/begin CHARACTERISTIC CaSOF_FastChargeCurrentDropBOLCellVoltageMapZ_mV "" MAP 0x7000454c Lookup2D_UWORD 0 VBU0706_CM_uint16_cnt 0.0 65535.0
 /begin AXIS_DESCR COM_AXIS NO_INPUT_QUANTITY VBU0706_CM_single_cnt 5 -3.4028234663852886E+38 3.4028234663852886E+38 AXIS_PTS_REF CaSOF_FastChargeCurrentDropBOLCellVoltageMapY_pct /end AXIS_DESCR
 /begin AXIS_DESCR COM_AXIS NO_INPUT_QUANTITY VBU0706_CM_single_cnt 9 -3.4028234663852886E+38 3.4028234663852886E+38 AXIS_PTS_REF CaSOF_FastChargeCurrentDropBOLCellVoltageMapX_C /end AXIS_DESCR
/end CHARACTERISTIC
/begin AXIS_PTS CaSOF_FastChargeCurrentDropBOLCellVoltageMapX_C "" 0x700021aa NO_INPUT_QUANTITY Lookup2D_X_FLOAT32_IEEE 0 VBU0706_CM_single_cnt 9 -3.4028234663852886E+38 3.4028234663852886E+38 /end AXIS_PTS
/begin AXIS_PTS CaSOF_FastChargeCurrentDropBOLCellVoltageMapY_pct "" 0x700017aa NO_INPUT_QUANTITY Lookup2D_X_FLOAT32_IEEE 0 VBU0706_CM_single_cnt 5 -3.4028234663852886E+38 3.4028234663852886E+38 /end AXIS_PTS
/begin CHARACTERISTIC CaSOF_FastChargeClv1LookUpCurrY_A "" CURVE 0x700031bc Lookup1D_FLOAT32_IEEE 0 VBU0706_CM_single_cnt -3.4028234663852886E+38 3.4028234663852886E+38
 /begin AXIS_DESCR COM_AXIS NO_INPUT_QUANTITY VBU0706_CM_single_cnt 14 -3.4028234663852886E+38 3.4028234663852886E+38 AXIS_PTS_REF CaSOF_FastChargeClv1LookUpTempX_C /end AXIS_DESCR
/end CHARACTERISTIC
/begin AXIS_PTS CaSOF_FastChargeClv1LookUpTempX_C "" 0x700031f4 NO_INPUT_QUANTITY Lookup1D_X_FLOAT32_IEEE 0 VBU0706_CM_single_cnt 14 -3.4028234663852886E+38 3.4028234663852886E+38 /end AXIS_PTS
/begin CHARACTERISTIC CaSOF_FastChargeClv2LookUpCurrY_A "" CURVE 0x7000322c Lookup1D_FLOAT32_IEEE 0 VBU0706_CM_single_cnt -3.4028234663852886E+38 3.4028234663852886E+38
 /begin AXIS_DESCR COM_AXIS NO_INPUT_QUANTITY VBU0706_CM_single_cnt 14 -3.4028234663852886E+38 3.4028234663852886E+38 AXIS_PTS_REF CaSOF_FastChargeClv2LookUpTempX_C /end AXIS_DESCR
/end CHARACTERISTIC
/begin AXIS_PTS CaSOF_FastChargeClv2LookUpTempX_C "" 0x70003264 NO_INPUT_QUANTITY Lookup1D_X_FLOAT32_IEEE 0 VBU0706_CM_single_cnt 14 -3.4028234663852886E+38 3.4028234663852886E+38 /end AXIS_PTS
/begin CHARACTERISTIC CaSOF_FastChargeSocTempMapZ_A "" MAP 0x7000b0ec Lookup2D_FLOAT32_IEEE 0 VBU0706_CM_single_A 0.0 500.0
 /begin AXIS_DESCR COM_AXIS SOC_pctCellSocMax VBU0706_CM_single_pct 19 0.0 255.0 AXIS_PTS_REF CaSOF_FastChargeSocTempMapY_pct /end AXIS_DESCR
 /begin AXIS_DESCR COM_AXIS NO_INPUT_QUANTITY VBU0706_CM_single_t 15 -40.0 120.0 AXIS_PTS_REF CaSOF_FastChargeSocTempMapX_C /end AXIS_DESCR
/end CHARACTERISTIC
/begin AXIS_PTS CaSOF_FastChargeSocTempMapX_C "" 0x700034a0 NO_INPUT_QUANTITY Lookup2D_X_FLOAT32_IEEE 0 VBU0706_CM_single_t 15 -40.0 120.0 /end AXIS_PTS
/begin AXIS_PTS CaSOF_FastChargeSocTempMapY_pct "" 0x700039f4 SOC_pctCellSocMax Lookup2D_X_FLOAT32_IEEE 0 VBU0706_CM_single_pct 19 0.0 255.0 /end AXIS_PTS
/begin CHARACTERISTIC CaSOH_DecreaseCapacityMapY_pct "" CURVE 0x70001822 Lookup1D_FLOAT32_IEEE 0 VBU0706_CM_single_cnt -3.4028234663852886E+38 3.4028234663852886E+38
 /begin AXIS_DESCR COM_AXIS NO_INPUT_QUANTITY VBU0706_CM_single_cnt 5 -3.4028234663852886E+38 3.4028234663852886E+38 AXIS_PTS_REF CaSOH_DecreaseCapacityMapX_Ah /end AXIS_DESCR
/end CHARACTERISTIC
/begin AXIS_PTS CaSOH_DecreaseCapacityMapX_Ah "" 0x7000180e NO_INPUT_QUANTITY Lookup1D_X_FLOAT32_IEEE 0 VBU0706_CM_single_cnt 5 -3.4028234663852886E+38 3.4028234663852886E+38 /end AXIS_PTS
/begin CHARACTERISTIC DSPL_kmRngNEDCMAP_CUR_y_Md_Default "" CURVE 0x700026ee Lookup1D_FLOAT32_IEEE 0 VBU0706_CM_single_km 0.0 1.0E+10
 /begin AXIS_DESCR COM_AXIS NO_INPUT_QUANTITY VBU0706_CM_single_pct 11 0.0 1.0E+23 AXIS_PTS_REF DSPL_pctSOCNEDCMAP_CUR_x /end AXIS_DESCR
/end CHARACTERISTIC
/begin AXIS_PTS DSPL_pctSOCNEDCMAP_CUR_x "" 0x7000271a NO_INPUT_QUANTITY Lookup1D_X_FLOAT32_IEEE 0 VBU0706_CM_single_pct 11 0.0 1.0E+23 /end AXIS_PTS
/begin CHARACTERISTIC EDIS_facMaxBMSCh_CUR_v "" CURVE 0x700023fe Lookup1D_FLOAT32_IEEE 0 VBU0706_CM_single_cnt -3.4028234663852886E+38 3.4028234663852886E+38
 /begin AXIS_DESCR COM_AXIS NO_INPUT_QUANTITY VBU0706_CM_single_cnt 10 -3.4028234663852886E+38 3.4028234663852886E+38 AXIS_PTS_REF EDIS_tMaxBMSCh_CUR_x /end AXIS_DESCR
/end CHARACTERISTIC
/begin AXIS_PTS EDIS_tMaxBMSCh_CUR_x "" 0x7000249e NO_INPUT_QUANTITY Lookup1D_X_FLOAT32_IEEE 0 VBU0706_CM_single_cnt 10 -3.4028234663852886E+38 3.4028234663852886E+38 /end AXIS_PTS
/begin CHARACTERISTIC EDIS_facMinBMSCh_CUR_v "" CURVE 0x7000244e Lookup1D_FLOAT32_IEEE 0 VBU0706_CM_single_cnt -3.4028234663852886E+38 3.4028234663852886E+38
 /begin AXIS_DESCR COM_AXIS NO_INPUT_QUANTITY VBU0706_CM_single_cnt 10 -3.4028234663852886E+38 3.4028234663852886E+38 AXIS_PTS_REF EDIS_tMinBMSCh_CUR_x /end AXIS_DESCR
/end CHARACTERISTIC
/begin AXIS_PTS EDIS_tMinBMSCh_CUR_x "" 0x700024ee NO_INPUT_QUANTITY Lookup1D_X_FLOAT32_IEEE 0 VBU0706_CM_single_cnt 10 -3.4028234663852886E+38 3.4028234663852886E+38 /end AXIS_PTS
/begin CHARACTERISTIC EDIS_facRgnReqCapDelta_CUR_v "" CURVE 0x700027ca Lookup1D_FLOAT32_IEEE 0 VBU0706_CM_single_cnt -3.4028234663852886E+38 3.4028234663852886E+38
 /begin AXIS_DESCR COM_AXIS NO_INPUT_QUANTITY VBU0706_CM_single_cnt 11 -3.4028234663852886E+38 3.4028234663852886E+38 AXIS_PTS_REF EDIS_facRgnReqCapDelta_CUR_x /end AXIS_DESCR
/end CHARACTERISTIC
/begin AXIS_PTS EDIS_facRgnReqCapDelta_CUR_x "" 0x700027f6 NO_INPUT_QUANTITY Lookup1D_X_FLOAT32_IEEE 0 VBU0706_CM_single_cnt 11 -3.4028234663852886E+38 3.4028234663852886E+38 /end AXIS_PTS
/begin CHARACTERISTIC EDIS_facBMSSOCCh_CUR_v "" CURVE 0x70003a8c Lookup1D_FLOAT32_IEEE 0 VBU0706_CM_single_cnt -3.4028234663852886E+38 3.4028234663852886E+38
 /begin AXIS_DESCR COM_AXIS NO_INPUT_QUANTITY VBU0706_CM_single_cnt 19 -3.4028234663852886E+38 3.4028234663852886E+38 AXIS_PTS_REF EDIS_pctBMSSOCCh_CUR_x /end AXIS_DESCR
/end CHARACTERISTIC
/begin AXIS_PTS EDIS_pctBMSSOCCh_CUR_x "" 0x70003b24 NO_INPUT_QUANTITY Lookup1D_X_FLOAT32_IEEE 0 VBU0706_CM_single_cnt 19 -3.4028234663852886E+38 3.4028234663852886E+38 /end AXIS_PTS
/begin CHARACTERISTIC EDIS_pwrSpBaseChDyn_CUR_v "" CURVE 0x70001696 Lookup1D_FLOAT32_IEEE 0 VBU0706_CM_single_cnt -3.4028234663852886E+38 3.4028234663852886E+38
 /begin AXIS_DESCR COM_AXIS EDIS_pwrChLimDynRaw VBU0706_CM_single_cnt 4 -3.4028234663852886E+38 3.4028234663852886E+38 AXIS_PTS_REF EDIS_pwrSpBaseChDyn_CUR_x /end AXIS_DESCR
/end CHARACTERISTIC
/begin AXIS_PTS EDIS_pwrSpBaseChDyn_CUR_x "" 0x700016a6 EDIS_pwrChLimDynRaw Lookup1D_X_FLOAT32_IEEE 0 VBU0706_CM_single_cnt 4 -3.4028234663852886E+38 3.4028234663852886E+38 /end AXIS_PTS
/begin CHARACTERISTIC EDIS_facChPwrDeltaBaseDiff_CUR_v "" CURVE 0x70003f4c Lookup1D_FLOAT32_IEEE 0 VBU0706_CM_single_cnt -3.4028234663852886E+38 3.4028234663852886E+38
 /begin AXIS_DESCR COM_AXIS NO_INPUT_QUANTITY VBU0706_CM_single_cnt 21 -3.4028234663852886E+38 3.4028234663852886E+38 AXIS_PTS_REF EDIS_pwrChPwrDeltaBaseDiff_CUR_x /end AXIS_DESCR
/end CHARACTERISTIC
/begin AXIS_PTS EDIS_pwrChPwrDeltaBaseDiff_CUR_x "" 0x70004048 NO_INPUT_QUANTITY Lookup1D_X_FLOAT32_IEEE 0 VBU0706_CM_single_cnt 21 -3.4028234663852886E+38 3.4028234663852886E+38 /end AXIS_PTS
/begin CHARACTERISTIC APD_numPlausibilityDec_C "" VALUE 0x7000012c Scalar_FLOAT32_IEEE 0 VBU0706_CM_single_cnt -3.4028234663852886E+38 3.4028234663852886E+38 /end CHARACTERISTIC
/begin CHARACTERISTIC APD_numPlausibilityInc_C "" VALUE 0x70000130 Scalar_FLOAT32_IEEE 0 VBU0706_CM_single_cnt -3.4028234663852886E+38 3.4028234663852886E+38 /end CHARACTERISTIC
/begin CHARACTERISTIC APD_numPlausibilityLim_C "" VALUE 0x70000134 Scalar_FLOAT32_IEEE 0 VBU0706_CM_single_cnt -3.4028234663852886E+38 3.4028234663852886E+38 /end CHARACTERISTIC
/begin CHARACTERISTIC APD_pctAccPedPosLimit_C "" VALUE 0x70000138 Scalar_FLOAT32_IEEE 0 VBU0706_CM_single_cnt -3.4028234663852886E+38 3.4028234663852886E+38 /end CHARACTERISTIC
/begin CHARACTERISTIC APD_pctAccPedPosOverrideVal_C "" VALUE 0x7000013c Scalar_FLOAT32_IEEE 0 VBU0706_CM_single_cnt -3.4028234663852886E+38 3.4028234663852886E+38 /end CHARACTERISTIC
/begin CHARACTERISTIC APD_pctAccPedPosOverride_C "" VALUE 0x70000140 Scalar_FLOAT32_IEEE 0 VBU0706_CM_single_cnt -3.4028234663852886E+38 3.4028234663852886E+38 /end CHARACTERISTIC
/begin CHARACTERISTIC APD_uJitterFil1_C "" VALUE 0x70000148 Scalar_FLOAT32_IEEE 0 VBU0706_CM_single_cnt -3.4028234663852886E+38 3.4028234663852886E+38 /end CHARACTERISTIC
/begin CHARACTERISTIC APD_uJitterFil2_C "" VALUE 0x7000014c Scalar_FLOAT32_IEEE 0 VBU0706_CM_single_cnt -3.4028234663852886E+38 3.4028234663852886E+38 /end CHARACTERISTIC
/begin CHARACTERISTIC APD_uSetPoint1Max_C "" VALUE 0x70000150 Scalar_FLOAT32_IEEE 0 VBU0706_CM_single_cnt -3.4028234663852886E+38 3.4028234663852886E+38 /end CHARACTERISTIC
/begin CHARACTERISTIC APD_uSetPoint1Min_C "" VALUE 0x70000154 Scalar_FLOAT32_IEEE 0 VBU0706_CM_single_cnt -3.4028234663852886E+38 3.4028234663852886E+38 /end CHARACTERISTIC
/begin CHARACTERISTIC APD_uSetPoint2Max_C "" VALUE 0x70000158 Scalar_FLOAT32_IEEE 0 VBU0706_CM_single_cnt -3.4028234663852886E+38 3.4028234663852886E+38 /end CHARACTERISTIC
/begin CHARACTERISTIC APD_uSetPoint2Min_C "" VALUE 0x7000015c Scalar_FLOAT32_IEEE 0 VBU0706_CM_single_cnt -3.4028234663852886E+38 3.4028234663852886E+38 /end CHARACTERISTIC
/begin CHARACTERISTIC BPD_facBrkPresVoltFilt_C "" VALUE 0x70000284 Scalar_FLOAT32_IEEE 0 VBU0706_CM_single_cnt -3.4028234663852886E+38 3.4028234663852886E+38 /end CHARACTERISTIC
/begin CHARACTERISTIC BPD_pctBrkPedalDownStep_C "" VALUE 0x70000288 Scalar_FLOAT32_IEEE 0 VBU0706_CM_single_cnt -3.4028234663852886E+38 3.4028234663852886E+38 /end CHARACTERISTIC
/begin CHARACTERISTIC BPD_pctBrkPedalPressedZero_C "" VALUE 0x7000028c Scalar_FLOAT32_IEEE 0 VBU0706_CM_single_cnt -3.4028234663852886E+38 3.4028234663852886E+38 /end CHARACTERISTIC
/begin CHARACTERISTIC BPD_pctBrkPedalPressed_C "" VALUE 0x70000290 Scalar_FLOAT32_IEEE 0 VBU0706_CM_single_cnt -3.4028234663852886E+38 3.4028234663852886E+38 /end CHARACTERISTIC
/begin CHARACTERISTIC CcFCC_ChargeVoltageOvRValue_V "" VALUE 0x70000510 Scalar_FLOAT32_IEEE 0 VBU0706_CM_single_cnt -3.4028234663852886E+38 3.4028234663852886E+38 /end CHARACTERISTIC
/begin CHARACTERISTIC CcFCC_FullChargePackVoltageDelta_V "" VALUE 0x70000538 Scalar_FLOAT32_IEEE 0 VBU0706_CM_single_cnt -3.4028234663852886E+38 3.4028234663852886E+38 /end CHARACTERISTIC
/begin CHARACTERISTIC CcFCC_FullChargeSocDelta_pct "" VALUE 0x70000548 Scalar_FLOAT32_IEEE 0 VBU0706_CM_single_cnt -3.4028234663852886E+38 3.4028234663852886E+38 /end CHARACTERISTIC
/begin CHARACTERISTIC CcFCC_HomoFullChargeSoc_pct "" VALUE 0x7000054c Scalar_FLOAT32_IEEE 0 VBU0706_CM_single_cnt -3.4028234663852886E+38 3.4028234663852886E+38 /end CHARACTERISTIC
/begin CHARACTERISTIC CcSOC_FastChargePreCorrectionSOC_pct "" VALUE 0x70000620 Scalar_FLOAT32_IEEE 0 VBU0706_CM_single_cnt -3.4028234663852886E+38 3.4028234663852886E+38 /end CHARACTERISTIC
/begin CHARACTERISTIC CcSOF_BaseCurrentLimitFactor_pct "" VALUE 0x70000694 Scalar_FLOAT32_IEEE 0 VBU0706_CM_single_cnt -3.4028234663852886E+38 3.4028234663852886E+38 /end CHARACTERISTIC
/begin CHARACTERISTIC CcSOF_ClvLookUp1CellSoc_pct "" VALUE 0x700006cc Scalar_FLOAT32_IEEE 0 VBU0706_CM_single_pct -3.4028234663852886E+38 3.4028234663852886E+38 /end CHARACTERISTIC
/begin CHARACTERISTIC CcSOF_ClvLookUp1Volt_mV "" VALUE 0x700006d0 Scalar_FLOAT32_IEEE 0 VBU0706_CM_single_mV -3.4028234663852886E+38 3.4028234663852886E+38 /end CHARACTERISTIC
/begin CHARACTERISTIC CcSOF_ClvLookUp2Volt_mV "" VALUE 0x700006d4 Scalar_FLOAT32_IEEE 0 VBU0706_CM_single_mV -3.4028234663852886E+38 3.4028234663852886E+38 /end CHARACTERISTIC
/begin CHARACTERISTIC CcSOF_ContinuousChargeCurrentLimp_A "" VALUE 0x700006d8 Scalar_FLOAT32_IEEE 0 VBU0706_CM_single_cnt -3.4028234663852886E+38 3.4028234663852886E+38 /end CHARACTERISTIC
/begin CHARACTERISTIC CcSOF_ContinuousDischargeCurrentLimp_A "" VALUE 0x700006dc Scalar_FLOAT32_IEEE 0 VBU0706_CM_single_cnt -3.4028234663852886E+38 3.4028234663852886E+38 /end CHARACTERISTIC
/begin CHARACTERISTIC CcSOF_CyclePowerLimitCharge_Kw "" VALUE 0x700006e0 Scalar_FLOAT32_IEEE 0 VBU0706_CM_single_cnt -3.4028234663852886E+38 3.4028234663852886E+38 /end CHARACTERISTIC
/begin CHARACTERISTIC CcSOF_CyclePowerLimitLevel1Discharge_Kw "" VALUE 0x700006e4 Scalar_FLOAT32_IEEE 0 VBU0706_CM_single_cnt -3.4028234663852886E+38 3.4028234663852886E+38 /end CHARACTERISTIC
/begin CHARACTERISTIC CcSOF_CyclePowerLimitLevel1SOCMax_pct "" VALUE 0x700006e8 Scalar_FLOAT32_IEEE 0 VBU0706_CM_single_cnt -3.4028234663852886E+38 3.4028234663852886E+38 /end CHARACTERISTIC
/begin CHARACTERISTIC CcSOF_CyclePowerLimitLevel1SOCMin_pct "" VALUE 0x700006ec Scalar_FLOAT32_IEEE 0 VBU0706_CM_single_cnt -3.4028234663852886E+38 3.4028234663852886E+38 /end CHARACTERISTIC
/begin CHARACTERISTIC CcSOF_CyclePowerLimitLevel2Discharge_Kw "" VALUE 0x700006f0 Scalar_FLOAT32_IEEE 0 VBU0706_CM_single_cnt -3.4028234663852886E+38 3.4028234663852886E+38 /end CHARACTERISTIC
/begin CHARACTERISTIC CcSOF_CyclePowerLimitLevel2SOCMax_pct "" VALUE 0x700006f4 Scalar_FLOAT32_IEEE 0 VBU0706_CM_single_cnt -3.4028234663852886E+38 3.4028234663852886E+38 /end CHARACTERISTIC
/begin CHARACTERISTIC CcSOF_CyclePowerLimitLevel2SOCMin_pct "" VALUE 0x700006f8 Scalar_FLOAT32_IEEE 0 VBU0706_CM_single_cnt -3.4028234663852886E+38 3.4028234663852886E+38 /end CHARACTERISTIC
/begin CHARACTERISTIC CcSOF_CyclePowerLimitLevel3Discharge1_Kw "" VALUE 0x700006fc Scalar_FLOAT32_IEEE 0 VBU0706_CM_single_cnt -3.4028234663852886E+38 3.4028234663852886E+38 /end CHARACTERISTIC
/begin CHARACTERISTIC CcSOF_CyclePowerLimitLevel3Discharge2_Kw "" VALUE 0x70000700 Scalar_FLOAT32_IEEE 0 VBU0706_CM_single_cnt -3.4028234663852886E+38 3.4028234663852886E+38 /end CHARACTERISTIC
/begin CHARACTERISTIC CcSOF_CyclePowerLimitLevel3SOCMax_pct "" VALUE 0x70000704 Scalar_FLOAT32_IEEE 0 VBU0706_CM_single_cnt -3.4028234663852886E+38 3.4028234663852886E+38 /end CHARACTERISTIC
/begin CHARACTERISTIC CcSOF_CyclePowerLimitLevel3SOCMin_pct "" VALUE 0x70000708 Scalar_FLOAT32_IEEE 0 VBU0706_CM_single_cnt -3.4028234663852886E+38 3.4028234663852886E+38 /end CHARACTERISTIC
/begin CHARACTERISTIC CcSOF_CyclePowerLimitMax_Kw "" VALUE 0x7000070c Scalar_FLOAT32_IEEE 0 VBU0706_CM_single_cnt -3.4028234663852886E+38 3.4028234663852886E+38 /end CHARACTERISTIC
/begin CHARACTERISTIC CcSOF_DynamicChargeCurrentLimp_A "" VALUE 0x7000074c Scalar_FLOAT32_IEEE 0 VBU0706_CM_single_cnt -3.4028234663852886E+38 3.4028234663852886E+38 /end CHARACTERISTIC
/begin CHARACTERISTIC CcSOF_DynamicDischargeCurrentLimp_A "" VALUE 0x70000750 Scalar_FLOAT32_IEEE 0 VBU0706_CM_single_cnt -3.4028234663852886E+38 3.4028234663852886E+38 /end CHARACTERISTIC
/begin CHARACTERISTIC CcSOF_FastChargeCellVoltageSOCLimit_pct "" VALUE 0x70000758 Scalar_FLOAT32_IEEE 0 VBU0706_CM_single_cnt -3.4028234663852886E+38 3.4028234663852886E+38 /end CHARACTERISTIC
/begin CHARACTERISTIC CcSOF_FastChargeSOCLimit_pct "" VALUE 0x7000077c Scalar_FLOAT32_IEEE 0 VBU0706_CM_single_cnt -3.4028234663852886E+38 3.4028234663852886E+38 /end CHARACTERISTIC
/begin CHARACTERISTIC CcSOF_FastChrgClvLowCurr_A "" VALUE 0x70000784 Scalar_FLOAT32_IEEE 0 VBU0706_CM_single_A -3.4028234663852886E+38 3.4028234663852886E+38 /end CHARACTERISTIC
/begin CHARACTERISTIC CcSOF_FastChrgClvTooLowCurr_A "" VALUE 0x70000788 Scalar_FLOAT32_IEEE 0 VBU0706_CM_single_A -3.4028234663852886E+38 3.4028234663852886E+38 /end CHARACTERISTIC
/begin CHARACTERISTIC CcSOF_FastChrgLowVolt_mV "" VALUE 0x7000078c Scalar_FLOAT32_IEEE 0 VBU0706_CM_single_mV -3.4028234663852886E+38 3.4028234663852886E+38 /end CHARACTERISTIC
/begin CHARACTERISTIC CcSOF_FastChrgTooLowVolt_mV "" VALUE 0x70000790 Scalar_FLOAT32_IEEE 0 VBU0706_CM_single_mV -3.4028234663852886E+38 3.4028234663852886E+38 /end CHARACTERISTIC
/begin CHARACTERISTIC CcSOF_FccOneThirdRateCurtSlope_A "" VALUE 0x70000794 Scalar_FLOAT32_IEEE 0 VBU0706_CM_single_cnt -3.4028234663852886E+38 3.4028234663852886E+38 /end CHARACTERISTIC
/begin CHARACTERISTIC CcSOF_LowVoltageResetSOC_pct "" VALUE 0x700007ac Scalar_FLOAT32_IEEE 0 VBU0706_CM_single_cnt -3.4028234663852886E+38 3.4028234663852886E+38 /end CHARACTERISTIC
/begin CHARACTERISTIC CcSOF_LowVoltageSetCurrent_A "" VALUE 0x700007b0 Scalar_FLOAT32_IEEE 0 VBU0706_CM_single_cnt -3.4028234663852886E+38 3.4028234663852886E+38 /end CHARACTERISTIC
/begin CHARACTERISTIC CcSOF_LowVoltageSetSOC_pct "" VALUE 0x700007b4 Scalar_FLOAT32_IEEE 0 VBU0706_CM_single_cnt -3.4028234663852886E+38 3.4028234663852886E+38 /end CHARACTERISTIC
/begin CHARACTERISTIC CcSOF_LowVoltageSetVolt2Delta_mV "" VALUE 0x700007bc Scalar_FLOAT32_IEEE 0 VBU0706_CM_single_cnt -3.4028234663852886E+38 3.4028234663852886E+38 /end CHARACTERISTIC
/begin CHARACTERISTIC CcSOF_LowVoltageSetVolt2_mV "" VALUE 0x700007c0 Scalar_FLOAT32_IEEE 0 VBU0706_CM_single_cnt -3.4028234663852886E+38 3.4028234663852886E+38 /end CHARACTERISTIC
/begin CHARACTERISTIC CcSOF_LowVoltageSetVolt_mV "" VALUE 0x700007c4 Scalar_FLOAT32_IEEE 0 VBU0706_CM_single_cnt -3.4028234663852886E+38 3.4028234663852886E+38 /end CHARACTERISTIC
/begin CHARACTERISTIC CcSOF_ShortPulseChargeCurrentLimp_A "" VALUE 0x700007d0 Scalar_FLOAT32_IEEE 0 VBU0706_CM_single_cnt -3.4028234663852886E+38 3.4028234663852886E+38 /end CHARACTERISTIC
/begin CHARACTERISTIC CcSOF_ShortPulseDischargeCurrentLimp_A "" VALUE 0x700007d4 Scalar_FLOAT32_IEEE 0 VBU0706_CM_single_cnt -3.4028234663852886E+38 3.4028234663852886E+38 /end CHARACTERISTIC
/begin CHARACTERISTIC CcSOF_SocpDischargeSocDebounce_pct "" VALUE 0x700007e0 Scalar_FLOAT32_IEEE 0 VBU0706_CM_single_cnt -3.4028234663852886E+38 3.4028234663852886E+38 /end CHARACTERISTIC
/begin CHARACTERISTIC CcSOF_StopChargeBattVolt_V "" VALUE 0x700007e4 Scalar_FLOAT32_IEEE 0 VBU0706_CM_single_cnt -3.4028234663852886E+38 3.4028234663852886E+38 /end CHARACTERISTIC
/begin CHARACTERISTIC CcSOF_StopChargeDeltaBattVolt_V "" VALUE 0x700007e8 Scalar_FLOAT32_IEEE 0 VBU0706_CM_single_cnt -3.4028234663852886E+38 3.4028234663852886E+38 /end CHARACTERISTIC
/begin CHARACTERISTIC CcSOF_StopChargeDeltaSOC_pct "" VALUE 0x700007ec Scalar_FLOAT32_IEEE 0 VBU0706_CM_single_cnt -3.4028234663852886E+38 3.4028234663852886E+38 /end CHARACTERISTIC
/begin CHARACTERISTIC CcSOF_StopChargeSOC_pct "" VALUE 0x700007f0 Scalar_FLOAT32_IEEE 0 VBU0706_CM_single_cnt -3.4028234663852886E+38 3.4028234663852886E+38 /end CHARACTERISTIC
/begin CHARACTERISTIC CcSOH_FastChargeWeighting_pct "" VALUE 0x7000086c Scalar_FLOAT32_IEEE 0 VBU0706_CM_single_cnt -3.4028234663852886E+38 3.4028234663852886E+38 /end CHARACTERISTIC
/begin CHARACTERISTIC CcSOH_MaxBalancedCapacity_As "" VALUE 0x70000874 Scalar_FLOAT32_IEEE 0 VBU0706_CM_single_cnt -3.4028234663852886E+38 3.4028234663852886E+38 /end CHARACTERISTIC
/begin CHARACTERISTIC CcSOH_MaxCurrentIntegral_As "" VALUE 0x70000878 Scalar_FLOAT32_IEEE 0 VBU0706_CM_single_cnt -3.4028234663852886E+38 3.4028234663852886E+38 /end CHARACTERISTIC
/begin CHARACTERISTIC CcSOH_MinBalancedCapacity_As "" VALUE 0x7000087c Scalar_FLOAT32_IEEE 0 VBU0706_CM_single_cnt -3.4028234663852886E+38 3.4028234663852886E+38 /end CHARACTERISTIC
/begin CHARACTERISTIC CcSOH_MinCurrentIntegral_As "" VALUE 0x70000880 Scalar_FLOAT32_IEEE 0 VBU0706_CM_single_cnt -3.4028234663852886E+38 3.4028234663852886E+38 /end CHARACTERISTIC
/begin CHARACTERISTIC CcSOH_PulseCurrentThreshold_pct "" VALUE 0x70000888 Scalar_FLOAT32_IEEE 0 VBU0706_CM_single_cnt -3.4028234663852886E+38 3.4028234663852886E+38 /end CHARACTERISTIC
/begin CHARACTERISTIC DSPL_facDecRateVldHi_C "" VALUE 0x70000b6c Scalar_FLOAT32_IEEE 0 VBU0706_CM_single_fac -200.0 200.0 /end CHARACTERISTIC
/begin CHARACTERISTIC DSPL_facDecRateVldLo_C "" VALUE 0x70000b70 Scalar_FLOAT32_IEEE 0 VBU0706_CM_single_fac -200.0 200.0 /end CHARACTERISTIC
/begin CHARACTERISTIC DSPL_facInitRateSOCFactor_C "" VALUE 0x70000b80 Scalar_FLOAT32_IEEE 0 VBU0706_CM_single_fac -200.0 200.0 /end CHARACTERISTIC
/begin CHARACTERISTIC DSPL_kmChrgDownStepMin_C "" VALUE 0x70000b8c Scalar_FLOAT32_IEEE 0 VBU0706_CM_single_km -1.0E+7 1.0E+10 /end CHARACTERISTIC
/begin CHARACTERISTIC DSPL_kmChrgUpStepMax_C "" VALUE 0x70000b90 Scalar_FLOAT32_IEEE 0 VBU0706_CM_single_km -1.0E+7 1.0E+10 /end CHARACTERISTIC
/begin CHARACTERISTIC DSPL_kmDrvRngMax_C "" VALUE 0x70000b98 Scalar_FLOAT32_IEEE 0 VBU0706_CM_single_km 0.0 1.0E+11 /end CHARACTERISTIC
/begin CHARACTERISTIC DSPL_kmDrvRngStepMax_C "" VALUE 0x70000b9c Scalar_FLOAT32_IEEE 0 VBU0706_CM_single_km -1.0E+7 1.0E+10 /end CHARACTERISTIC
/begin CHARACTERISTIC DSPL_kmFullSocRateRng_C "" VALUE 0x70000ba0 Scalar_FLOAT32_IEEE 0 VBU0706_CM_single_km 0.0 10000.0 /end CHARACTERISTIC
/begin CHARACTERISTIC DSPL_kmRemainingRangeDisplayStep_C "" VALUE 0x70000ba4 Scalar_FLOAT32_IEEE 0 VBU0706_CM_single_km 0.0 1.0E+23 /end CHARACTERISTIC
/begin CHARACTERISTIC DSPL_numSOCJump_C "" VALUE 0x70000bb0 Scalar_FLOAT32_IEEE 0 VBU0706_CM_single_cnt 0.0 1.0E+15 /end CHARACTERISTIC
/begin CHARACTERISTIC DSPL_pctBMSSOCMinStep_C "" VALUE 0x70000bb4 Scalar_FLOAT32_IEEE 0 VBU0706_CM_single_pct 0.0 100.0 /end CHARACTERISTIC
/begin CHARACTERISTIC DSPL_pctSOCFullChrg_C "" VALUE 0x70000bc0 Scalar_FLOAT32_IEEE 0 VBU0706_CM_single_pct 0.0 100.0 /end CHARACTERISTIC
/begin CHARACTERISTIC DSPL_pctSOCJumpHi_C "" VALUE 0x70000bc4 Scalar_FLOAT32_IEEE 0 VBU0706_CM_single_pct -200.0 200.0 /end CHARACTERISTIC
/begin CHARACTERISTIC DSPL_pctSOCJumpLo_C "" VALUE 0x70000bc8 Scalar_FLOAT32_IEEE 0 VBU0706_CM_single_pct -200.0 200.0 /end CHARACTERISTIC
/begin CHARACTERISTIC DSPL_pctSocFull_C "" VALUE 0x70000bcc Scalar_FLOAT32_IEEE 0 VBU0706_CM_single_pct 0.0 100.0 /end CHARACTERISTIC
/begin CHARACTERISTIC DSPL_tAmbTempChrg_CUR_x "" VAL_BLK 0x70001a8e Scalar_FLOAT32_IEEE 0 VBU0706_CM_single_C -40.0 120.0 NUMBER 6 /end CHARACTERISTIC
/begin CHARACTERISTIC DSPL_tiBmsSocFullDelay_C "" VALUE 0x70000be0 Scalar_FLOAT32_IEEE 0 VBU0706_CM_single_s 0.0 1.0E+23 /end CHARACTERISTIC
/begin CHARACTERISTIC DSPL_tiBmsSocZeroDelay_C "" VALUE 0x70000be4 Scalar_FLOAT32_IEEE 0 VBU0706_CM_single_s 0.0 1.0E+23 /end CHARACTERISTIC
/begin CHARACTERISTIC DSPL_tiDelayTimeChrgFallingEdge_C "" VALUE 0x70000bec Scalar_FLOAT32_IEEE 0 VBU0706_CM_single_s 0.0 1.0E+23 /end CHARACTERISTIC
/begin CHARACTERISTIC DSPL_tiSOCJumpDelay_C "" VALUE 0x70000c0c Scalar_FLOAT32_IEEE 0 VBU0706_CM_single_s 0.0 1.0E+23 /end CHARACTERISTIC
/begin CHARACTERISTIC EDIS_facVehSpd2MotSpd_C "" VALUE 0x70000c30 Scalar_FLOAT32_IEEE 0 VBU0706_CM_single_cnt -3.4028234663852886E+38 3.4028234663852886E+38 /end CHARACTERISTIC
/begin CHARACTERISTIC EDIS_numChOverLim_C "" VALUE 0x70000c38 Scalar_FLOAT32_IEEE 0 VBU0706_CM_single_cnt -3.4028234663852886E+38 3.4028234663852886E+38 /end CHARACTERISTIC
/begin CHARACTERISTIC EDIS_numChPwrOverCntEEPROMInit_SY "" VALUE 0x70000c3c Scalar_FLOAT32_IEEE 0 VBU0706_CM_single_cnt -3.4028234663852886E+38 3.4028234663852886E+38 /end CHARACTERISTIC
/begin CHARACTERISTIC EDIS_pwrChRed40vLim_C "" VALUE 0x70000c88 Scalar_FLOAT32_IEEE 0 VBU0706_CM_single_cnt -3.4028234663852886E+38 3.4028234663852886E+38 /end CHARACTERISTIC
/begin CHARACTERISTIC EDIS_pwrOfflineDisChDyn_C "" VALUE 0x70000cd0 Scalar_FLOAT32_IEEE 0 VBU0706_CM_single_kW 0.0 1000.0 /end CHARACTERISTIC
/begin CHARACTERISTIC EDIS_pwrOfflineDownStep_C "" VALUE 0x70000cd4 Scalar_FLOAT32_IEEE 0 VBU0706_CM_single_kW -1000.0 1000.0 /end CHARACTERISTIC
/begin CHARACTERISTIC EDIS_pwrOfflineUpStep_C "" VALUE 0x70000cd8 Scalar_FLOAT32_IEEE 0 VBU0706_CM_single_kW -1000.0 1000.0 /end CHARACTERISTIC
/begin CHARACTERISTIC EDIS_pwrOnlineDownStep_C "" VALUE 0x70000cdc Scalar_FLOAT32_IEEE 0 VBU0706_CM_single_kW -1000.0 1000.0 /end CHARACTERISTIC
/begin CHARACTERISTIC EDIS_pwrOnlineUpStep_C "" VALUE 0x70000ce0 Scalar_FLOAT32_IEEE 0 VBU0706_CM_single_kW -1000.0 1000.0 /end CHARACTERISTIC
/begin CHARACTERISTIC EDIS_tiBattOverChrg_C "" VALUE 0x70000cfc Scalar_FLOAT32_IEEE 0 VBU0706_CM_single_cnt -3.4028234663852886E+38 3.4028234663852886E+38 /end CHARACTERISTIC
/begin CHARACTERISTIC EDIS_wChOverEnrgLim_C "" VALUE 0x70000d1c Scalar_FLOAT32_IEEE 0 VBU0706_CM_single_cnt -3.4028234663852886E+38 3.4028234663852886E+38 /end CHARACTERISTIC
/begin CHARACTERISTIC Gear_pctBrkPosPressed_C "" VALUE 0x70000d58 Scalar_FLOAT32_IEEE 0 VBU0706_CM_single_cnt -3.4028234663852886E+38 3.4028234663852886E+38 /end CHARACTERISTIC
/begin CHARACTERISTIC Gear_tiGearDebounceCnt_C "" VALUE 0x70000d68 Scalar_FLOAT32_IEEE 0 VBU0706_CM_single_cnt -3.4028234663852886E+38 3.4028234663852886E+38 /end CHARACTERISTIC
/begin CHARACTERISTIC Gear_tiGearPSwitchDebounceCnt_C "" VALUE 0x70000d7c Scalar_FLOAT32_IEEE 0 VBU0706_CM_single_cnt -3.4028234663852886E+38 3.4028234663852886E+38 /end CHARACTERISTIC
/begin CHARACTERISTIC Gear_tiSampleTime_C "" VALUE 0x70000d98 Scalar_FLOAT32_IEEE 0 VBU0706_CM_single_cnt -3.4028234663852886E+38 3.4028234663852886E+38 /end CHARACTERISTIC
/begin CHARACTERISTIC Gear_tiShiftEnableCnt_C "" VALUE 0x70000d9c Scalar_FLOAT32_IEEE 0 VBU0706_CM_single_cnt -3.4028234663852886E+38 3.4028234663852886E+38 /end CHARACTERISTIC
/begin CHARACTERISTIC Gear_trqShiftDriveEnableLe_C "" VALUE 0x70000da0 Scalar_FLOAT32_IEEE 0 VBU0706_CM_single_cnt -3.4028234663852886E+38 3.4028234663852886E+38 /end CHARACTERISTIC
/begin CHARACTERISTIC Gear_trqShiftDriveEnableRi_C "" VALUE 0x70000da4 Scalar_FLOAT32_IEEE 0 VBU0706_CM_single_cnt -3.4028234663852886E+38 3.4028234663852886E+38 /end CHARACTERISTIC
/begin CHARACTERISTIC Gear_vForce2NThreshold_C "" VALUE 0x70000da8 Scalar_FLOAT32_IEEE 0 VBU0706_CM_single_cnt -3.4028234663852886E+38 3.4028234663852886E+38 /end CHARACTERISTIC
/begin CHARACTERISTIC Gear_vGearDLowThreshold_C "" VALUE 0x70000dac Scalar_FLOAT32_IEEE 0 VBU0706_CM_single_cnt -3.4028234663852886E+38 3.4028234663852886E+38 /end CHARACTERISTIC
/begin CHARACTERISTIC Gear_vGearDMiThreshold_C "" VALUE 0x70000db0 Scalar_FLOAT32_IEEE 0 VBU0706_CM_single_cnt -3.4028234663852886E+38 3.4028234663852886E+38 /end CHARACTERISTIC
/begin CHARACTERISTIC Gear_vGearPThreshold_C "" VALUE 0x70000db4 Scalar_FLOAT32_IEEE 0 VBU0706_CM_single_cnt -3.4028234663852886E+38 3.4028234663852886E+38 /end CHARACTERISTIC
/begin CHARACTERISTIC LVC_uDCDCReq_C "" VALUE 0x70000e60 Scalar_FLOAT32_IEEE 0 VBU0706_CM_single_cnt -3.4028234663852886E+38 3.4028234663852886E+38 /end CHARACTERISTIC
/begin CHARACTERISTIC LVC_uDcdcHvMax_C "" VALUE 0x70000e64 Scalar_FLOAT32_IEEE 0 VBU0706_CM_single_cnt -3.4028234663852886E+38 3.4028234663852886E+38 /end CHARACTERISTIC
/begin CHARACTERISTIC LVC_uDcdcHvMin_C "" VALUE 0x70000e68 Scalar_FLOAT32_IEEE 0 VBU0706_CM_single_cnt -3.4028234663852886E+38 3.4028234663852886E+38 /end CHARACTERISTIC
/begin CHARACTERISTIC MTQL_trqDecLim_C "" VALUE 0x70000e78 Scalar_FLOAT32_IEEE 0 VBU0706_CM_single_cnt -10000.0 10000.0 /end CHARACTERISTIC
/begin CHARACTERISTIC MTQL_trqIncLim_C "" VALUE 0x70000e7c Scalar_FLOAT32_IEEE 0 VBU0706_CM_single_cnt -10000.0 10000.0 /end CHARACTERISTIC
/begin CHARACTERISTIC MTQL_trqMtrDrvLimOvrdVal_C "" VALUE 0x70000e80 Scalar_FLOAT32_IEEE 0 VBU0706_CM_single_cnt -3.4028234663852886E+38 3.4028234663852886E+38 /end CHARACTERISTIC
/begin CHARACTERISTIC MTQL_trqMtrRgnLimOvrdVal_C "" VALUE 0x70000e84 Scalar_FLOAT32_IEEE 0 VBU0706_CM_single_cnt -3.4028234663852886E+38 3.4028234663852886E+38 /end CHARACTERISTIC
/begin CHARACTERISTIC MTQL_trqPEURDrvLowLim_C "" VALUE 0x70000e88 Scalar_FLOAT32_IEEE 0 VBU0706_CM_single_cnt -10000.0 10000.0 /end CHARACTERISTIC
/begin CHARACTERISTIC MTQL_trqPEURDrvUpLim_C "" VALUE 0x70000e8c Scalar_FLOAT32_IEEE 0 VBU0706_CM_single_cnt -10000.0 10000.0 /end CHARACTERISTIC
/begin CHARACTERISTIC MTQL_trqPEURRgnLowLim_C "" VALUE 0x70000e90 Scalar_FLOAT32_IEEE 0 VBU0706_CM_single_cnt -10000.0 10000.0 /end CHARACTERISTIC
/begin CHARACTERISTIC MTQL_trqPEURRgnUpLim_C "" VALUE 0x70000e94 Scalar_FLOAT32_IEEE 0 VBU0706_CM_single_cnt -10000.0 10000.0 /end CHARACTERISTIC
/begin CHARACTERISTIC PMM_tiDlySelfDiag_C "" VALUE 0x70000f5c Scalar_FLOAT32_IEEE 0 VBU0706_CM_single_cnt -3.4028234663852886E+38 3.4028234663852886E+38 /end CHARACTERISTIC
/begin CHARACTERISTIC SPD_aBenchReset_C "" VALUE 0x70000f9c Scalar_FLOAT32_IEEE 0 VBU0706_CM_single_cnt -3.4028234663852886E+38 3.4028234663852886E+38 /end CHARACTERISTIC
/begin CHARACTERISTIC SPD_aBenchSetHi_C "" VALUE 0x70000fa0 Scalar_FLOAT32_IEEE 0 VBU0706_CM_single_cnt -3.4028234663852886E+38 3.4028234663852886E+38 /end CHARACTERISTIC
/begin CHARACTERISTIC SPD_aBenchSetLow_C "" VALUE 0x70000fa4 Scalar_FLOAT32_IEEE 0 VBU0706_CM_single_cnt -3.4028234663852886E+38 3.4028234663852886E+38 /end CHARACTERISTIC
/begin CHARACTERISTIC SPD_cntBenchThd_C "" VALUE 0x70000fa8 Scalar_FLOAT32_IEEE 0 VBU0706_CM_single_cnt -3.4028234663852886E+38 3.4028234663852886E+38 /end CHARACTERISTIC
/begin CHARACTERISTIC SPD_facAXFilter_C "" VALUE 0x70000fac Scalar_FLOAT32_IEEE 0 VBU0706_CM_single_cnt -3.4028234663852886E+38 3.4028234663852886E+38 /end CHARACTERISTIC
/begin CHARACTERISTIC SPD_facSpdFlt_C "" VALUE 0x70000fb0 Scalar_FLOAT32_IEEE 0 VBU0706_CM_single_cnt -3.4028234663852886E+38 3.4028234663852886E+38 /end CHARACTERISTIC
/begin CHARACTERISTIC SPD_nMotrDrvRvsThd_C "" VALUE 0x70000fb4 Scalar_FLOAT32_IEEE 0 VBU0706_CM_single_cnt -3.4028234663852886E+38 3.4028234663852886E+38 /end CHARACTERISTIC
/begin CHARACTERISTIC SPD_tiSample10ms_SY "" VALUE 0x70000fc8 Scalar_FLOAT32_IEEE 0 VBU0706_CM_single_cnt -3.4028234663852886E+38 3.4028234663852886E+38 /end CHARACTERISTIC
/begin CHARACTERISTIC SPD_tiSlopeFilter_C "" VALUE 0x70000fcc Scalar_FLOAT32_IEEE 0 VBU0706_CM_single_cnt -3.4028234663852886E+38 3.4028234663852886E+38 /end CHARACTERISTIC
/begin CHARACTERISTIC SPD_tiSpdFil_C "" VALUE 0x70000fd0 Scalar_FLOAT32_IEEE 0 VBU0706_CM_single_cnt -3.4028234663852886E+38 3.4028234663852886E+38 /end CHARACTERISTIC
/begin CHARACTERISTIC SPD_trqRvsRst_C "" VALUE 0x70000fd4 Scalar_FLOAT32_IEEE 0 VBU0706_CM_single_cnt -3.4028234663852886E+38 3.4028234663852886E+38 /end CHARACTERISTIC
/begin CHARACTERISTIC SPD_vGoThd_C "" VALUE 0x70000fd8 Scalar_FLOAT32_IEEE 0 VBU0706_CM_single_cnt -3.4028234663852886E+38 3.4028234663852886E+38 /end CHARACTERISTIC
/begin CHARACTERISTIC SPD_vVehOvrdFlg_C "" VALUE 0x70000fdc Scalar_FLOAT32_IEEE 0 VBU0706_CM_single_cnt -3.4028234663852886E+38 3.4028234663852886E+38 /end CHARACTERISTIC
/begin CHARACTERISTIC SPD_vVehOvrdVal_C "" VALUE 0x70000fe0 Scalar_FLOAT32_IEEE 0 VBU0706_CM_single_cnt -3.4028234663852886E+38 3.4028234663852886E+38 /end CHARACTERISTIC
/begin CHARACTERISTIC SPD_vVehRvsRst_C "" VALUE 0x70000fe4 Scalar_FLOAT32_IEEE 0 VBU0706_CM_single_cnt -3.4028234663852886E+38 3.4028234663852886E+38 /end CHARACTERISTIC
/begin CHARACTERISTIC SPD_vVehRvsThd_C "" VALUE 0x70000fe8 Scalar_FLOAT32_IEEE 0 VBU0706_CM_single_cnt -3.4028234663852886E+38 3.4028234663852886E+38 /end CHARACTERISTIC
/begin CHARACTERISTIC SYS_facGearRatioR_SY "" VALUE 0x70000ff0 Scalar_FLOAT32_IEEE 0 VBU0706_CM_single_cnt -3.4028234663852886E+38 3.4028234663852886E+38 /end CHARACTERISTIC
/begin CHARACTERISTIC THM_tActvCoolDsblDeltaTemp_C "" VALUE 0x70001088 Scalar_FLOAT32_IEEE 0 VBU0706_CM_single_cnt -3.4028234663852886E+38 3.4028234663852886E+38 /end CHARACTERISTIC
/begin CHARACTERISTIC THM_tActvCoolEnaDeltaTemp_C "" VALUE 0x7000108c Scalar_FLOAT32_IEEE 0 VBU0706_CM_single_cnt -3.4028234663852886E+38 3.4028234663852886E+38 /end CHARACTERISTIC
/begin CHARACTERISTIC THM_tActvHeatDsblDeltaTemp_C "" VALUE 0x70001090 Scalar_FLOAT32_IEEE 0 VBU0706_CM_single_cnt -3.4028234663852886E+38 3.4028234663852886E+38 /end CHARACTERISTIC
/begin CHARACTERISTIC THM_tActvHeatEnaDeltaTemp_C "" VALUE 0x70001094 Scalar_FLOAT32_IEEE 0 VBU0706_CM_single_cnt -3.4028234663852886E+38 3.4028234663852886E+38 /end CHARACTERISTIC
/begin CHARACTERISTIC THM_tPsvCoolDsblDeltaTemp_C "" VALUE 0x700010bc Scalar_FLOAT32_IEEE 0 VBU0706_CM_single_cnt -3.4028234663852886E+38 3.4028234663852886E+38 /end CHARACTERISTIC
/begin CHARACTERISTIC THM_tPsvCoolEnaDeltaTemp_C "" VALUE 0x700010c0 Scalar_FLOAT32_IEEE 0 VBU0706_CM_single_cnt -3.4028234663852886E+38 3.4028234663852886E+38 /end CHARACTERISTIC
/begin CHARACTERISTIC THM_tPsvCoolLckDeltaTemp_C "" VALUE 0x700010c4 Scalar_FLOAT32_IEEE 0 VBU0706_CM_single_cnt -3.4028234663852886E+38 3.4028234663852886E+38 /end CHARACTERISTIC
/begin CHARACTERISTIC THM_tPsvCoolPermitDeltaTemp_C "" VALUE 0x700010c8 Scalar_FLOAT32_IEEE 0 VBU0706_CM_single_cnt -3.4028234663852886E+38 3.4028234663852886E+38 /end CHARACTERISTIC
/begin CHARACTERISTIC THM_tPsvHeatDsblDeltaTemp_C "" VALUE 0x700010cc Scalar_FLOAT32_IEEE 0 VBU0706_CM_single_cnt -3.4028234663852886E+38 3.4028234663852886E+38 /end CHARACTERISTIC
/begin CHARACTERISTIC THM_tPsvHeatEnaDeltaTemp_C "" VALUE 0x700010d0 Scalar_FLOAT32_IEEE 0 VBU0706_CM_single_cnt -3.4028234663852886E+38 3.4028234663852886E+38 /end CHARACTERISTIC
/begin CHARACTERISTIC THM_tPsvHeatLckDeltaTemp_C "" VALUE 0x700010d4 Scalar_FLOAT32_IEEE 0 VBU0706_CM_single_cnt -3.4028234663852886E+38 3.4028234663852886E+38 /end CHARACTERISTIC
/begin CHARACTERISTIC THM_tPsvHeatPermitDeltaTemp_C "" VALUE 0x700010d8 Scalar_FLOAT32_IEEE 0 VBU0706_CM_single_cnt -3.4028234663852886E+38 3.4028234663852886E+38 /end CHARACTERISTIC
/begin CHARACTERISTIC TQC_aAcc2TrqPrpHigh_SY "" VALUE 0x70001108 Scalar_FLOAT32_IEEE 0 VBU0706_CM_single_cnt -3.4028234663852886E+38 3.4028234663852886E+38 /end CHARACTERISTIC
/begin CHARACTERISTIC TQC_aDragLearnMax_C "" VALUE 0x7000110c Scalar_FLOAT32_IEEE 0 VBU0706_CM_single_cnt -3.4028234663852886E+38 3.4028234663852886E+38 /end CHARACTERISTIC
/begin CHARACTERISTIC TQC_aDragLearnMin_C "" VALUE 0x70001110 Scalar_FLOAT32_IEEE 0 VBU0706_CM_single_cnt -3.4028234663852886E+38 3.4028234663852886E+38 /end CHARACTERISTIC
/begin CHARACTERISTIC TQC_aSlopeLimitInit_C "" VALUE 0x70001114 Scalar_FLOAT32_IEEE 0 VBU0706_CM_single_cnt -3.4028234663852886E+38 3.4028234663852886E+38 /end CHARACTERISTIC
/begin CHARACTERISTIC TQC_aThresLe_C "" VALUE 0x70001118 Scalar_FLOAT32_IEEE 0 VBU0706_CM_single_cnt -3.4028234663852886E+38 3.4028234663852886E+38 /end CHARACTERISTIC
/begin CHARACTERISTIC TQC_aThresRi_C "" VALUE 0x7000111c Scalar_FLOAT32_IEEE 0 VBU0706_CM_single_cnt -3.4028234663852886E+38 3.4028234663852886E+38 /end CHARACTERISTIC
/begin CHARACTERISTIC TQC_aXFltGradDec_C "" VALUE 0x70001120 Scalar_FLOAT32_IEEE 0 VBU0706_CM_single_cnt -3.4028234663852886E+38 3.4028234663852886E+38 /end CHARACTERISTIC
/begin CHARACTERISTIC TQC_aXFltGradInc_C "" VALUE 0x70001124 Scalar_FLOAT32_IEEE 0 VBU0706_CM_single_cnt -3.4028234663852886E+38 3.4028234663852886E+38 /end CHARACTERISTIC
/begin CHARACTERISTIC TQC_facDecDrag_C "" VALUE 0x70001128 Scalar_FLOAT32_IEEE 0 VBU0706_CM_single_cnt -3.4028234663852886E+38 3.4028234663852886E+38 /end CHARACTERISTIC
/begin CHARACTERISTIC TQC_facDelayShiftFilter_C "" VALUE 0x7000112c Scalar_FLOAT32_IEEE 0 VBU0706_CM_single_cnt -3.4028234663852886E+38 3.4028234663852886E+38 /end CHARACTERISTIC
/begin CHARACTERISTIC TQC_facDragCalGradDec_C "" VALUE 0x70001130 Scalar_FLOAT32_IEEE 0 VBU0706_CM_single_cnt -3.4028234663852886E+38 3.4028234663852886E+38 /end CHARACTERISTIC
/begin CHARACTERISTIC TQC_facDragCalGradInc_C "" VALUE 0x70001134 Scalar_FLOAT32_IEEE 0 VBU0706_CM_single_cnt -3.4028234663852886E+38 3.4028234663852886E+38 /end CHARACTERISTIC
/begin CHARACTERISTIC TQC_facDragCalGradMax_C "" VALUE 0x70001138 Scalar_FLOAT32_IEEE 0 VBU0706_CM_single_cnt -3.4028234663852886E+38 3.4028234663852886E+38 /end CHARACTERISTIC
/begin CHARACTERISTIC TQC_facDragCalGradMin_C "" VALUE 0x7000113c Scalar_FLOAT32_IEEE 0 VBU0706_CM_single_cnt -3.4028234663852886E+38 3.4028234663852886E+38 /end CHARACTERISTIC
/begin CHARACTERISTIC TQC_facDragFastFilter_C "" VALUE 0x70001140 Scalar_FLOAT32_IEEE 0 VBU0706_CM_single_cnt -3.4028234663852886E+38 3.4028234663852886E+38 /end CHARACTERISTIC
/begin CHARACTERISTIC TQC_facDragNormalFilter_C "" VALUE 0x70001144 Scalar_FLOAT32_IEEE 0 VBU0706_CM_single_cnt -3.4028234663852886E+38 3.4028234663852886E+38 /end CHARACTERISTIC
/begin CHARACTERISTIC TQC_facDragShiftFilter_C "" VALUE 0x70001148 Scalar_FLOAT32_IEEE 0 VBU0706_CM_single_cnt -3.4028234663852886E+38 3.4028234663852886E+38 /end CHARACTERISTIC
/begin CHARACTERISTIC TQC_facDragWheelFilter_C "" VALUE 0x7000114c Scalar_FLOAT32_IEEE 0 VBU0706_CM_single_cnt -3.4028234663852886E+38 3.4028234663852886E+38 /end CHARACTERISTIC
/begin CHARACTERISTIC TQC_facMinDrag_C "" VALUE 0x70001150 Scalar_FLOAT32_IEEE 0 VBU0706_CM_single_cnt 0.0 1.0 /end CHARACTERISTIC
/begin CHARACTERISTIC TQC_facNormalDrag_C "" VALUE 0x70001154 Scalar_FLOAT32_IEEE 0 VBU0706_CM_single_cnt -3.4028234663852886E+38 3.4028234663852886E+38 /end CHARACTERISTIC
/begin CHARACTERISTIC TQC_facSlopeLimitIntegral_C "" VALUE 0x70001158 Scalar_FLOAT32_IEEE 0 VBU0706_CM_single_cnt -3.4028234663852886E+38 3.4028234663852886E+38 /end CHARACTERISTIC
/begin CHARACTERISTIC TQC_facSlopeLimitProportion_C "" VALUE 0x7000115c Scalar_FLOAT32_IEEE 0 VBU0706_CM_single_cnt -3.4028234663852886E+38 3.4028234663852886E+38 /end CHARACTERISTIC
/begin CHARACTERISTIC TQC_facTrqWheelFilter_C "" VALUE 0x70001160 Scalar_FLOAT32_IEEE 0 VBU0706_CM_single_cnt 0.0 1.0 /end CHARACTERISTIC
/begin CHARACTERISTIC TQC_facVehSpdFilter_C "" VALUE 0x70001164 Scalar_FLOAT32_IEEE 0 VBU0706_CM_single_cnt -3.4028234663852886E+38 3.4028234663852886E+38 /end CHARACTERISTIC
/begin CHARACTERISTIC TQC_mInrt_C "" VALUE 0x70001168 Scalar_FLOAT32_IEEE 0 VBU0706_CM_single_cnt -3.4028234663852886E+38 3.4028234663852886E+38 /end CHARACTERISTIC
/begin CHARACTERISTIC TQC_mVeh_C "" VALUE 0x7000116c Scalar_FLOAT32_IEEE 0 VBU0706_CM_single_kg 0.0 10000.0 /end CHARACTERISTIC
/begin CHARACTERISTIC TQC_numDragCalAverageAccStepDown_C "" VALUE 0x70001170 Scalar_FLOAT32_IEEE 0 VBU0706_CM_single_cnt -10000.0 10000.0 /end CHARACTERISTIC
/begin CHARACTERISTIC TQC_numDragCalAverageAccStepUp_C "" VALUE 0x70001174 Scalar_FLOAT32_IEEE 0 VBU0706_CM_single_cnt -10000.0 10000.0 /end CHARACTERISTIC
/begin CHARACTERISTIC TQC_numDragCalAverageAcc_C "" VALUE 0x70001178 Scalar_FLOAT32_IEEE 0 VBU0706_CM_single_cnt 0.0 255.0 /end CHARACTERISTIC
/begin CHARACTERISTIC TQC_numDragCalAverageBrk_C "" VALUE 0x7000117c Scalar_FLOAT32_IEEE 0 VBU0706_CM_single_cnt -3.4028234663852886E+38 3.4028234663852886E+38 /end CHARACTERISTIC
/begin CHARACTERISTIC TQC_numDragFastLearn_C "" VALUE 0x70001180 Scalar_FLOAT32_IEEE 0 VBU0706_CM_single_cnt -10000.0 10000.0 /end CHARACTERISTIC
/begin CHARACTERISTIC TQC_numDragLearnMin_C "" VALUE 0x70001184 Scalar_FLOAT32_IEEE 0 VBU0706_CM_single_cnt -3.4028234663852886E+38 3.4028234663852886E+38 /end CHARACTERISTIC
/begin CHARACTERISTIC TQC_numDragLearnStepDown_C "" VALUE 0x70001188 Scalar_FLOAT32_IEEE 0 VBU0706_CM_single_cnt -10000.0 10000.0 /end CHARACTERISTIC
/begin CHARACTERISTIC TQC_numDragLearnStepMax_C "" VALUE 0x7000118c Scalar_FLOAT32_IEEE 0 VBU0706_CM_single_cnt -10000.0 10000.0 /end CHARACTERISTIC
/begin CHARACTERISTIC TQC_numDragLearnStepUp_C "" VALUE 0x70001190 Scalar_FLOAT32_IEEE 0 VBU0706_CM_single_cnt -10000.0 10000.0 /end CHARACTERISTIC
/begin CHARACTERISTIC TQC_numDragLearnStep_C "" VALUE 0x70001194 Scalar_FLOAT32_IEEE 0 VBU0706_CM_single_cnt -10000.0 10000.0 /end CHARACTERISTIC
/begin CHARACTERISTIC TQC_numFltAccAverage_C "" VALUE 0x70001198 Scalar_FLOAT32_IEEE 0 VBU0706_CM_single_cnt 0.0 255.0 /end CHARACTERISTIC
/begin CHARACTERISTIC TQC_numSlopeSample_C "" VALUE 0x7000119c Scalar_FLOAT32_IEEE 0 VBU0706_CM_single_cnt -3.4028234663852886E+38 3.4028234663852886E+38 /end CHARACTERISTIC
/begin CHARACTERISTIC TQC_pctDragCalPedLe_C "" VALUE 0x700011a0 Scalar_FLOAT32_IEEE 0 VBU0706_CM_single_cnt 0.0 100.0 /end CHARACTERISTIC
/begin CHARACTERISTIC TQC_pctDragCalPedRi_C "" VALUE 0x700011a4 Scalar_FLOAT32_IEEE 0 VBU0706_CM_single_cnt 0.0 100.0 /end CHARACTERISTIC
/begin CHARACTERISTIC TQC_rRatioReducer_C "" VALUE 0x700011a8 Scalar_FLOAT32_IEEE 0 VBU0706_CM_single_cnt 0.0 100.0 /end CHARACTERISTIC
/begin CHARACTERISTIC TQC_tiDelayDragTime_C "" VALUE 0x700011ac Scalar_FLOAT32_IEEE 0 VBU0706_CM_single_cnt -3.4028234663852886E+38 3.4028234663852886E+38 /end CHARACTERISTIC
/begin CHARACTERISTIC TQC_tiDragDelayTime_C "" VALUE 0x700011b0 Scalar_FLOAT32_IEEE 0 VBU0706_CM_single_cnt -3.4028234663852886E+38 3.4028234663852886E+38 /end CHARACTERISTIC
/begin CHARACTERISTIC TQC_tiSampleTime_C "" VALUE 0x700011b4 Scalar_FLOAT32_IEEE 0 VBU0706_CM_single_cnt -3.4028234663852886E+38 3.4028234663852886E+38 /end CHARACTERISTIC
/begin CHARACTERISTIC TQC_trqDefaultLimit_C "" VALUE 0x700011b8 Scalar_FLOAT32_IEEE 0 VBU0706_CM_single_cnt -10000.0 10000.0 /end CHARACTERISTIC
/begin CHARACTERISTIC TQC_trqDefaultSlope_C "" VALUE 0x700011bc Scalar_FLOAT32_IEEE 0 VBU0706_CM_single_cnt -10000.0 10000.0 /end CHARACTERISTIC
/begin CHARACTERISTIC TQC_trqDragCalGradDec_C "" VALUE 0x700011c0 Scalar_FLOAT32_IEEE 0 VBU0706_CM_single_cnt -10000.0 10000.0 /end CHARACTERISTIC
/begin CHARACTERISTIC TQC_trqDragCalGradInc_C "" VALUE 0x700011c4 Scalar_FLOAT32_IEEE 0 VBU0706_CM_single_cnt -10000.0 10000.0 /end CHARACTERISTIC
/begin CHARACTERISTIC TQC_trqDragMax_C "" VALUE 0x700011c8 Scalar_FLOAT32_IEEE 0 VBU0706_CM_single_cnt -10000.0 10000.0 /end CHARACTERISTIC
/begin CHARACTERISTIC TQC_trqSlopeLimitInit_C "" VALUE 0x700011cc Scalar_FLOAT32_IEEE 0 VBU0706_CM_single_cnt -10000.0 10000.0 /end CHARACTERISTIC
/begin CHARACTERISTIC TQC_trqSlopeLimitMax_C "" VALUE 0x700011d0 Scalar_FLOAT32_IEEE 0 VBU0706_CM_single_cnt -10000.0 10000.0 /end CHARACTERISTIC
/begin CHARACTERISTIC TQC_trqSlopeLimitMin_C "" VALUE 0x700011d4 Scalar_FLOAT32_IEEE 0 VBU0706_CM_single_cnt -10000.0 10000.0 /end CHARACTERISTIC
/begin CHARACTERISTIC TQC_trqVehMax_C "" VALUE 0x700011d8 Scalar_FLOAT32_IEEE 0 VBU0706_CM_single_cnt -10000.0 10000.0 /end CHARACTERISTIC
/begin CHARACTERISTIC TQC_trqVehMin_C "" VALUE 0x700011dc Scalar_FLOAT32_IEEE 0 VBU0706_CM_single_cnt -10000.0 10000.0 /end CHARACTERISTIC
/begin CHARACTERISTIC TQC_vDragSpeedLe_C "" VALUE 0x700011e0 Scalar_FLOAT32_IEEE 0 VBU0706_CM_single_cnt -3.4028234663852886E+38 3.4028234663852886E+38 /end CHARACTERISTIC
/begin CHARACTERISTIC TQC_vDragSpeedLearnLe_C "" VALUE 0x700011e4 Scalar_FLOAT32_IEEE 0 VBU0706_CM_single_cnt -3.4028234663852886E+38 3.4028234663852886E+38 /end CHARACTERISTIC
/begin CHARACTERISTIC TQC_vDragSpeedLearnRi_C "" VALUE 0x700011e8 Scalar_FLOAT32_IEEE 0 VBU0706_CM_single_cnt -3.4028234663852886E+38 3.4028234663852886E+38 /end CHARACTERISTIC
/begin CHARACTERISTIC TQC_vDragSpeedRi_C "" VALUE 0x700011ec Scalar_FLOAT32_IEEE 0 VBU0706_CM_single_cnt -3.4028234663852886E+38 3.4028234663852886E+38 /end CHARACTERISTIC
/begin CHARACTERISTIC TQDMP_vVehEnaMax_C "" VALUE 0x7000129c Scalar_FLOAT32_IEEE 0 VBU0706_CM_single_cnt -3.4028234663852886E+38 3.4028234663852886E+38 /end CHARACTERISTIC
/begin CHARACTERISTIC TQDMP_vVehEnaMin_C "" VALUE 0x700012a0 Scalar_FLOAT32_IEEE 0 VBU0706_CM_single_cnt -3.4028234663852886E+38 3.4028234663852886E+38 /end CHARACTERISTIC
/begin CHARACTERISTIC TQD_trqModeChngDecGrad_C "" VALUE 0x700012b8 Scalar_FLOAT32_IEEE 0 VBU0706_CM_single_cnt -3.4028234663852886E+38 3.4028234663852886E+38 /end CHARACTERISTIC
/begin CHARACTERISTIC TQD_trqModeChngIncGrad_C "" VALUE 0x700012bc Scalar_FLOAT32_IEEE 0 VBU0706_CM_single_cnt -3.4028234663852886E+38 3.4028234663852886E+38 /end CHARACTERISTIC
/begin CHARACTERISTIC TQD_trqNrmDecGrad_C "" VALUE 0x700012c0 Scalar_FLOAT32_IEEE 0 VBU0706_CM_single_cnt -3.4028234663852886E+38 3.4028234663852886E+38 /end CHARACTERISTIC
/begin CHARACTERISTIC TQD_trqNrmIncGrad_C "" VALUE 0x700012c4 Scalar_FLOAT32_IEEE 0 VBU0706_CM_single_cnt -3.4028234663852886E+38 3.4028234663852886E+38 /end CHARACTERISTIC
/begin CHARACTERISTIC TQD_trqRateLimThres_C "" VALUE 0x700012c8 Scalar_FLOAT32_IEEE 0 VBU0706_CM_single_cnt -3.4028234663852886E+38 3.4028234663852886E+38 /end CHARACTERISTIC
/begin CHARACTERISTIC TQO_pctSlopeShft_C "" VALUE 0x700012d4 Scalar_FLOAT32_IEEE 0 VBU0706_CM_single_cnt -3.4028234663852886E+38 3.4028234663852886E+38 /end CHARACTERISTIC
/begin CHARACTERISTIC TQO_tiShftDR_C "" VALUE 0x700012dc Scalar_FLOAT32_IEEE 0 VBU0706_CM_single_cnt -3.4028234663852886E+38 3.4028234663852886E+38 /end CHARACTERISTIC
/begin CHARACTERISTIC TQO_tiShftOut_C "" VALUE 0x700012e0 Scalar_FLOAT32_IEEE 0 VBU0706_CM_single_cnt -3.4028234663852886E+38 3.4028234663852886E+38 /end CHARACTERISTIC
/begin CHARACTERISTIC VM_aVehLimDifNeg_C "" VALUE 0x700012fc Scalar_FLOAT32_IEEE 0 VBU0706_CM_single_cnt -3.4028234663852886E+38 3.4028234663852886E+38 /end CHARACTERISTIC
/begin CHARACTERISTIC VM_aVehLimDifPos_C "" VALUE 0x70001300 Scalar_FLOAT32_IEEE 0 VBU0706_CM_single_cnt -3.4028234663852886E+38 3.4028234663852886E+38 /end CHARACTERISTIC
/begin CHARACTERISTIC VM_aVehLimMax_C "" VALUE 0x70001304 Scalar_FLOAT32_IEEE 0 VBU0706_CM_single_cnt -3.4028234663852886E+38 3.4028234663852886E+38 /end CHARACTERISTIC
/begin CHARACTERISTIC VM_vVehLimFix_C "" VALUE 0x70001308 Scalar_FLOAT32_IEEE 0 VBU0706_CM_single_cnt -3.4028234663852886E+38 3.4028234663852886E+38 /end CHARACTERISTIC
/begin CHARACTERISTIC VM_vVehLimMaxRThresHi_C "" VALUE 0x7000130c Scalar_FLOAT32_IEEE 0 VBU0706_CM_single_cnt -3.4028234663852886E+38 3.4028234663852886E+38 /end CHARACTERISTIC
/begin CHARACTERISTIC VM_vVehLimMaxRThresLo_C "" VALUE 0x70001310 Scalar_FLOAT32_IEEE 0 VBU0706_CM_single_cnt -3.4028234663852886E+38 3.4028234663852886E+38 /end CHARACTERISTIC
/begin CHARACTERISTIC VM_vVehLimMaxR_C "" VALUE 0x70001314 Scalar_FLOAT32_IEEE 0 VBU0706_CM_single_cnt -3.4028234663852886E+38 3.4028234663852886E+38 /end CHARACTERISTIC
/begin CHARACTERISTIC VM_vVehLimMaxThresHi_C "" VALUE 0x70001318 Scalar_FLOAT32_IEEE 0 VBU0706_CM_single_cnt -3.4028234663852886E+38 3.4028234663852886E+38 /end CHARACTERISTIC
/begin CHARACTERISTIC VM_vVehLimMaxThresLo_C "" VALUE 0x7000131c Scalar_FLOAT32_IEEE 0 VBU0706_CM_single_cnt -3.4028234663852886E+38 3.4028234663852886E+38 /end CHARACTERISTIC
/begin CHARACTERISTIC VM_vVehLimMax_C "" VALUE 0x70001320 Scalar_FLOAT32_IEEE 0 VBU0706_CM_single_cnt -3.4028234663852886E+38 3.4028234663852886E+38 /end CHARACTERISTIC
/begin CHARACTERISTIC VM_vVehLimThresD_C "" VALUE 0x70001324 Scalar_FLOAT32_IEEE 0 VBU0706_CM_single_cnt -3.4028234663852886E+38 3.4028234663852886E+38 /end CHARACTERISTIC
/begin CHARACTERISTIC VM_vVehLimThresR_C "" VALUE 0x70001328 Scalar_FLOAT32_IEEE 0 VBU0706_CM_single_cnt -3.4028234663852886E+38 3.4028234663852886E+38 /end CHARACTERISTIC
/begin CHARACTERISTIC VM_vVehLimpHomeThresD_C "" VALUE 0x7000132c Scalar_FLOAT32_IEEE 0 VBU0706_CM_single_cnt -3.4028234663852886E+38 3.4028234663852886E+38 /end CHARACTERISTIC
/begin CHARACTERISTIC VM_vVehLimpHomeThresR_C "" VALUE 0x70001330 Scalar_FLOAT32_IEEE 0 VBU0706_CM_single_cnt -3.4028234663852886E+38 3.4028234663852886E+38 /end CHARACTERISTIC
/begin CHARACTERISTIC Veh_tiModeDebTime_C "" VALUE 0x70001398 Scalar_FLOAT32_IEEE 0 VBU0706_CM_single_cnt -3.4028234663852886E+38 3.4028234663852886E+38 /end CHARACTERISTIC
/begin CHARACTERISTIC Veh_tiModeSampleTime_C "" VALUE 0x7000139c Scalar_FLOAT32_IEEE 0 VBU0706_CM_single_cnt -3.4028234663852886E+38 3.4028234663852886E+38 /end CHARACTERISTIC
/begin CHARACTERISTIC CaSOF_ContinuousDischargeEolSocTempMapDimension_n "" VAL_BLK 0x70001416 Scalar_ULONG 0 VBU0706_CM_uint32_cnt 0.0 4.294967295E+9 NUMBER 2 /end CHARACTERISTIC
/begin CHARACTERISTIC CaSOF_ContinuousDischargeLockedSocTempMapDimension_n "" VAL_BLK 0x7000141e Scalar_ULONG 0 VBU0706_CM_uint32_cnt 0.0 4.294967295E+9 NUMBER 2 /end CHARACTERISTIC
/begin CHARACTERISTIC CaSOF_ContinuousDischargeSocTempMapDimension_n "" VAL_BLK 0x70001426 Scalar_ULONG 0 VBU0706_CM_uint32_cnt 0.0 4.294967295E+9 NUMBER 2 /end CHARACTERISTIC
/begin CHARACTERISTIC CaSOF_FastChargeCurrentDropBOLCellVoltageDimension_n "" VAL_BLK 0x7000144e Scalar_ULONG 0 VBU0706_CM_uint32_cnt 0.0 4.294967295E+9 NUMBER 2 /end CHARACTERISTIC
/begin CHARACTERISTIC CaSOF_FastChargeCurrentDropEOLCellVoltageDimension_n "" VAL_BLK 0x70001456 Scalar_ULONG 0 VBU0706_CM_uint32_cnt 0.0 4.294967295E+9 NUMBER 2 /end CHARACTERISTIC
/begin CHARACTERISTIC CaSOF_FastChargeSocTempMapDimension_n "" VAL_BLK 0x7000145e Scalar_ULONG 0 VBU0706_CM_uint32_cnt 0.0 4.294967295E+9 NUMBER 2 /end CHARACTERISTIC
/begin CHARACTERISTIC CaSOF_ShortPulseChargeEolSocTempMapDimension_n "" VAL_BLK 0x70001476 Scalar_ULONG 0 VBU0706_CM_uint32_cnt 0.0 4.294967295E+9 NUMBER 2 /end CHARACTERISTIC
/begin CHARACTERISTIC CaSOF_ShortPulseChargeLockedSocTempMapDimension_n "" VAL_BLK 0x7000147e Scalar_ULONG 0 VBU0706_CM_uint32_cnt 0.0 4.294967295E+9 NUMBER 2 /end CHARACTERISTIC
/begin CHARACTERISTIC CaSOF_ShortPulseChargeSocTempMapDimension_n "" VAL_BLK 0x70001486 Scalar_ULONG 0 VBU0706_CM_uint32_cnt 0.0 4.294967295E+9 NUMBER 2 /end CHARACTERISTIC
/begin CHARACTERISTIC CaSOF_ShortPulseDischargeEolSocTempMapDimension_n "" VAL_BLK 0x7000148e Scalar_ULONG 0 VBU0706_CM_uint32_cnt 0.0 4.294967295E+9 NUMBER 2 /end CHARACTERISTIC
/begin CHARACTERISTIC CaSOF_ShortPulseDischargeLockedSocTempMapDimension_n "" VAL_BLK 0x70001496 Scalar_ULONG 0 VBU0706_CM_uint32_cnt 0.0 4.294967295E+9 NUMBER 2 /end CHARACTERISTIC
/begin CHARACTERISTIC CaSOF_ShortPulseDischargeSocTempMapDimension_n "" VAL_BLK 0x7000149e Scalar_ULONG 0 VBU0706_CM_uint32_cnt 0.0 4.294967295E+9 NUMBER 2 /end CHARACTERISTIC
/begin CHARACTERISTIC CaSOH_DecreaseCapacityMapDimension_n "" VALUE 0x700002b0 Scalar_ULONG 0 VBU0706_CM_uint32_cnt 0.0 4.294967295E+9 /end CHARACTERISTIC
/begin CHARACTERISTIC CcSOF_BatteryCycleHomo_n "" VALUE 0x7000069c Scalar_ULONG 0 VBU0706_CM_uint32_cnt 0.0 4.294967295E+9 /end CHARACTERISTIC
/begin CHARACTERISTIC CcSOF_LowVoltageSetTime_s "" VALUE 0x700007b8 Scalar_ULONG 0 VBU0706_CM_uint32_cnt 0.0 4.294967295E+9 /end CHARACTERISTIC
/begin CHARACTERISTIC CcSOH_AfterEdgeFallTime_ms "" VALUE 0x70000834 Scalar_ULONG 0 VBU0706_CM_uint32_cnt 0.0 4.294967295E+9 /end CHARACTERISTIC
/begin CHARACTERISTIC CcSOH_BeforeEdgeFallTime_ms "" VALUE 0x70000838 Scalar_ULONG 0 VBU0706_CM_uint32_cnt 0.0 4.294967295E+9 /end CHARACTERISTIC
/begin CHARACTERISTIC BPD_numHWBrkSwtDebounce_C "" VALUE 0x70000006 Scalar_UWORD 0 VBU0706_CM_uint16_cnt 0.0 65535.0 /end CHARACTERISTIC
/begin CHARACTERISTIC CcBCV_BatteryCurrentZeroDriftTime_ms "" VALUE 0x70000026 Scalar_UWORD 0 VBU0706_CM_uint16_cnt 0.0 65535.0 /end CHARACTERISTIC
/begin CHARACTERISTIC CcFCC_BatteryCapacityCycleHomo_n "" VALUE 0x70000076 Scalar_UWORD 0 VBU0706_CM_uint16_cnt 0.0 65535.0 /end CHARACTERISTIC
/begin CHARACTERISTIC CcFCC_FullChargeOcvDebounceTime_s "" VALUE 0x70000088 Scalar_UWORD 0 VBU0706_CM_uint16_cnt 0.0 65535.0 /end CHARACTERISTIC
/begin CHARACTERISTIC CcFCC_FullChargeSocDebounceTime_s "" VALUE 0x7000008a Scalar_UWORD 0 VBU0706_CM_uint16_cnt 0.0 65535.0 /end CHARACTERISTIC
/begin CHARACTERISTIC CcSOF_FccOneThirdCurtSloDelay_ms "" VALUE 0x700000cc Scalar_UWORD 0 VBU0706_CM_uint16_cnt 0.0 65535.0 /end CHARACTERISTIC
/begin CHARACTERISTIC CcSOF_LowVoltageAbnormalPowerOnDelay_ms "" VALUE 0x700000d2 Scalar_UWORD 0 VBU0706_CM_uint16_cnt 0.0 65535.0 /end CHARACTERISTIC
/begin CHARACTERISTIC CcSOF_LowVoltageSetCurrentDelay_ms "" VALUE 0x700000d6 Scalar_UWORD 0 VBU0706_CM_uint16_cnt 0.0 65535.0 /end CHARACTERISTIC
/begin CHARACTERISTIC CcSOF_LowVoltageSetVoltageDelay_ms "" VALUE 0x700000d8 Scalar_UWORD 0 VBU0706_CM_uint16_cnt 0.0 65535.0 /end CHARACTERISTIC
/begin CHARACTERISTIC CcSOF_SocpModeDebounceTime_ms "" VALUE 0x700000e2 Scalar_UWORD 0 VBU0706_CM_uint16_cnt 0.0 65535.0 /end CHARACTERISTIC
/begin CHARACTERISTIC CcSOF_StopChargeSOCDebounceTime_s "" VALUE 0x700000e4 Scalar_UWORD 0 VBU0706_CM_uint16_cnt 0.0 65535.0 /end CHARACTERISTIC
/begin CHARACTERISTIC CcSOF_StopChargeVoltDebounceTime_s "" VALUE 0x700000e6 Scalar_UWORD 0 VBU0706_CM_uint16_cnt 0.0 65535.0 /end CHARACTERISTIC
/begin CHARACTERISTIC CcSYS_FullChargeOcv_mV "" VALUE 0x700000ee Scalar_UWORD 0 VBU0706_CM_uint16_cnt 0.0 65535.0 /end CHARACTERISTIC
/begin CHARACTERISTIC CcTHM_CoolantSensorValidDelayTime_s "" VALUE 0x700000f4 Scalar_UWORD 0 VBU0706_CM_uint16_cnt 0.0 65535.0 /end CHARACTERISTIC
/begin CHARACTERISTIC APD_efAccPedPos_C "" VALUE 0x7001071f Scalar_BOOLEAN 0 VBU0706_CM_boolean_cnt 0.0 1.0 /end CHARACTERISTIC
/begin CHARACTERISTIC APD_flgAccPedPosPctVld_C "" VALUE 0x70010720 Scalar_BOOLEAN 0 VBU0706_CM_boolean_cnt 0.0 1.0 /end CHARACTERISTIC
/begin CHARACTERISTIC CGW_flgVehCreepModeCaliOvrd_C "" VALUE 0x700107c2 Scalar_BOOLEAN 0 VBU0706_CM_boolean_cnt 0.0 1.0 /end CHARACTERISTIC
/begin CHARACTERISTIC CGW_flgVehDrvModeCaliOvrd_C "" VALUE 0x700107c3 Scalar_BOOLEAN 0 VBU0706_CM_boolean_cnt 0.0 1.0 /end CHARACTERISTIC
/begin CHARACTERISTIC CGW_flgVehRgnModeCaliOvrd_C "" VALUE 0x700107c5 Scalar_BOOLEAN 0 VBU0706_CM_boolean_cnt 0.0 1.0 /end CHARACTERISTIC
/begin CHARACTERISTIC CbFCC_ChargeVoltageOvR_flg "" VALUE 0x70010864 Scalar_BOOLEAN 0 VBU0706_CM_boolean_cnt 0.0 1.0 /end CHARACTERISTIC
/begin CHARACTERISTIC CcSOF_UseSohLimitEnable_flg "" VALUE 0x7001095c Scalar_BOOLEAN 0 VBU0706_CM_boolean_cnt 0.0 1.0 /end CHARACTERISTIC
/begin CHARACTERISTIC EDIS_flgOverPwrLimNum_C "" VALUE 0x70010a84 Scalar_BOOLEAN 0 VBU0706_CM_boolean_cnt 0.0 1.0 /end CHARACTERISTIC
/begin CHARACTERISTIC EDIS_flgUseEEPROMStroeVal_C "" VALUE 0x70010a88 Scalar_BOOLEAN 0 VBU0706_CM_boolean_cnt 0.0 1.0 /end CHARACTERISTIC
/begin CHARACTERISTIC EDIS_flgUsePowSpPredict_C "" VALUE 0x70010a89 Scalar_BOOLEAN 0 VBU0706_CM_boolean_cnt 0.0 1.0 /end CHARACTERISTIC
/begin CHARACTERISTIC Gear_flgBrkPressConfig_C "" VALUE 0x70010abf Scalar_BOOLEAN 0 VBU0706_CM_boolean 0 1 /end CHARACTERISTIC
/begin CHARACTERISTIC Gear_flgEmotTqSelect_C "" VALUE 0x70010ac1 Scalar_BOOLEAN 0 VBU0706_CM_boolean_cnt 0.0 1.0 /end CHARACTERISTIC
/begin CHARACTERISTIC Gear_flgTorqueProtectEn_C "" VALUE 0x70010ac2 Scalar_BOOLEAN 0 VBU0706_CM_boolean_cnt 0.0 1.0 /end CHARACTERISTIC
/begin CHARACTERISTIC MTQL_trqMtrDrvLimOvrd_C "" VALUE 0x70010b2b Scalar_BOOLEAN 0 VBU0706_CM_boolean_cnt 0.0 1.0 /end CHARACTERISTIC
/begin CHARACTERISTIC MTQL_trqMtrRgnLimOvrd_C "" VALUE 0x70010b2c Scalar_BOOLEAN 0 VBU0706_CM_boolean_cnt 0.0 1.0 /end CHARACTERISTIC
/begin CHARACTERISTIC PMM_flgHVPwrDwnEnaOvrdSwt_C "" VALUE 0x70010b3f Scalar_BOOLEAN 0 VBU0706_CM_boolean_cnt 0.0 1.0 /end CHARACTERISTIC
/begin CHARACTERISTIC PMM_flgHVPwrDwnEnaOvrdVal_C "" VALUE 0x70010b40 Scalar_BOOLEAN 0 VBU0706_CM_boolean_cnt 0.0 1.0 /end CHARACTERISTIC
/begin CHARACTERISTIC PMM_flgHVPwrUpEnaOvrdSwt_C "" VALUE 0x70010b41 Scalar_BOOLEAN 0 VBU0706_CM_boolean_cnt 0.0 1.0 /end CHARACTERISTIC
/begin CHARACTERISTIC PMM_flgHVPwrUpEnaOvrdVal_C "" VALUE 0x70010b42 Scalar_BOOLEAN 0 VBU0706_CM_boolean_cnt 0.0 1.0 /end CHARACTERISTIC
/begin CHARACTERISTIC PMM_flgPEURActvDisChEnaOvrdSwt_C "" VALUE 0x70010b46 Scalar_BOOLEAN 0 VBU0706_CM_boolean_cnt 0.0 1.0 /end CHARACTERISTIC
/begin CHARACTERISTIC PMM_flgPEURActvDisChEnaOvrdVal_C "" VALUE 0x70010b47 Scalar_BOOLEAN 0 VBU0706_CM_boolean_cnt 0.0 1.0 /end CHARACTERISTIC
/begin CHARACTERISTIC PMM_flgSelfDiagEnaOvrdSwt_C "" VALUE 0x70010b4c Scalar_BOOLEAN 0 VBU0706_CM_boolean_cnt 0.0 1.0 /end CHARACTERISTIC
/begin CHARACTERISTIC PMM_flgSelfDiagEnaOvrdVal_C "" VALUE 0x70010b4d Scalar_BOOLEAN 0 VBU0706_CM_boolean_cnt 0.0 1.0 /end CHARACTERISTIC
/begin CHARACTERISTIC SPD_flgUseMotorSpeed_C "" VALUE 0x70010b8a Scalar_BOOLEAN 0 VBU0706_CM_boolean_cnt 0.0 1.0 /end CHARACTERISTIC
/begin CHARACTERISTIC STC_flgRgnTrqCnclRA_C "" VALUE 0x70010b90 Scalar_BOOLEAN 0 VBU0706_CM_boolean_cnt 0.0 1.0 /end CHARACTERISTIC
/begin CHARACTERISTIC TQARB_flgSTCProtect_C "" VALUE 0x70010bb2 Scalar_BOOLEAN 0 VBU0706_CM_boolean_cnt 0.0 1.0 /end CHARACTERISTIC
/begin CHARACTERISTIC TQC_flgDragCalEn_C "" VALUE 0x70010bb4 Scalar_BOOLEAN 0 VBU0706_CM_boolean_cnt 0.0 1.0 /end CHARACTERISTIC
/begin CHARACTERISTIC TQC_flgDragTrqMovingOn_C "" VALUE 0x70010bb5 Scalar_BOOLEAN 0 VBU0706_CM_boolean_cnt 0.0 1.0 /end CHARACTERISTIC
/begin CHARACTERISTIC TQC_flgSlopeLimitEn_C "" VALUE 0x70010bb6 Scalar_BOOLEAN 0 VBU0706_CM_boolean_cnt 0.0 1.0 /end CHARACTERISTIC
/begin CHARACTERISTIC TQC_flgVehAccCalcEnable_C "" VALUE 0x70010bb7 Scalar_BOOLEAN 0 VBU0706_CM_boolean_cnt 0.0 1.0 /end CHARACTERISTIC
/begin CHARACTERISTIC TQDMP_flgROTCDisblORF "" VALUE 0x70010bbe Scalar_BOOLEAN 0 VBU0706_CM_boolean_cnt 0.0 1.0 /end CHARACTERISTIC
/begin CHARACTERISTIC TQDMP_flgROTCDisblORV "" VALUE 0x70010bbf Scalar_BOOLEAN 0 VBU0706_CM_boolean_cnt 0.0 1.0 /end CHARACTERISTIC
/begin CHARACTERISTIC TQD_flgBrkPresUsed_C "" VALUE 0x70010bc4 Scalar_BOOLEAN 0 VBU0706_CM_boolean_cnt 0.0 1.0 /end CHARACTERISTIC
/begin CHARACTERISTIC TQD_flgCreepFnctnEna_C "" VALUE 0x70010bc6 Scalar_BOOLEAN 0 VBU0706_CM_boolean_cnt 0.0 1.0 /end CHARACTERISTIC
/begin CHARACTERISTIC TQD_flgTrqMinEn_C "" VALUE 0x70010bc7 Scalar_BOOLEAN 0 VBU0706_CM_boolean_cnt 0.0 1.0 /end CHARACTERISTIC
/begin CHARACTERISTIC VM_flgVehLimFixEnable_C "" VALUE 0x70010bd7 Scalar_BOOLEAN 0 VBU0706_CM_boolean_cnt 0.0 1.0 /end CHARACTERISTIC
/begin CHARACTERISTIC Veh_flgNetworkPartialEn_C "" VALUE 0x70010be7 Scalar_BOOLEAN 0 VBU0706_CM_boolean_cnt 0.0 1.0 /end CHARACTERISTIC
/begin CHARACTERISTIC APD_stConfirmErr_C "" VALUE 0x70010722 Scalar_UBYTE 0 VBU0706_CM_uint8_cnt 0.0 15.0 /end CHARACTERISTIC
/begin CHARACTERISTIC APD_stNoErr_C "" VALUE 0x70010723 Scalar_UBYTE 0 VBU0706_CM_uint8_cnt 0.0 15.0 /end CHARACTERISTIC
/begin CHARACTERISTIC BPD_stBrkPedPrsActv_C "" VALUE 0x700107a7 Scalar_UBYTE 0 VBU0706_CM_uint8_cnt 0.0 15.0 /end CHARACTERISTIC
/begin CHARACTERISTIC BPD_stBrkPedPrsPsbl_C "" VALUE 0x700107a9 Scalar_UBYTE 0 VBU0706_CM_uint8_cnt 0.0 15.0 /end CHARACTERISTIC
/begin CHARACTERISTIC BPD_stBrkSwtConfig_C "" VALUE 0x700107aa Scalar_UBYTE 0 VBU0706_CM_uint8_cnt 0.0 255.0 /end CHARACTERISTIC
/begin CHARACTERISTIC CDC_stVehAccrNormalMod_C "" VALUE 0x700107b6 Scalar_UBYTE 0 VBU0706_CM_uint8_cnt 0.0 15.0 /end CHARACTERISTIC
/begin CHARACTERISTIC CDC_stVehAccrSportMod_C "" VALUE 0x700107b7 Scalar_UBYTE 0 VBU0706_CM_uint8_cnt 0.0 15.0 /end CHARACTERISTIC
/begin CHARACTERISTIC CDC_stVehAutoMod_C "" VALUE 0x700107b8 Scalar_UBYTE 0 VBU0706_CM_uint8_cnt 0.0 15.0 /end CHARACTERISTIC
/begin CHARACTERISTIC CDC_stVehCreepON_C "" VALUE 0x700107b9 Scalar_UBYTE 0 VBU0706_CM_uint8_cnt 0.0 15.0 /end CHARACTERISTIC
/begin CHARACTERISTIC CDC_stVehCreepOffRgnOff_C "" VALUE 0x700107ba Scalar_UBYTE 0 VBU0706_CM_uint8_cnt 0.0 15.0 /end CHARACTERISTIC
/begin CHARACTERISTIC CDC_stVehCreepOff_C "" VALUE 0x700107bb Scalar_UBYTE 0 VBU0706_CM_uint8_cnt 0.0 15.0 /end CHARACTERISTIC
/begin CHARACTERISTIC CDC_stVehCreepOnRgnLow_C "" VALUE 0x700107bc Scalar_UBYTE 0 VBU0706_CM_uint8_cnt 0.0 15.0 /end CHARACTERISTIC
/begin CHARACTERISTIC CDC_stVehCreepOnRgnNormal_C "" VALUE 0x700107bd Scalar_UBYTE 0 VBU0706_CM_uint8_cnt 0.0 15.0 /end CHARACTERISTIC
/begin CHARACTERISTIC CDC_stVehCreepOnRgnZero_C "" VALUE 0x700107be Scalar_UBYTE 0 VBU0706_CM_uint8_cnt 0.0 15.0 /end CHARACTERISTIC
/begin CHARACTERISTIC CDC_stVehECOMod_C "" VALUE 0x700107bf Scalar_UBYTE 0 VBU0706_CM_uint8_cnt 0.0 15.0 /end CHARACTERISTIC
/begin CHARACTERISTIC CGW_stVehCreepModeCaliOvrdVal_C "" VALUE 0x700107c6 Scalar_UBYTE 0 VBU0706_CM_uint8_cnt 0.0 15.0 /end CHARACTERISTIC
/begin CHARACTERISTIC CGW_stVehCreepOff_C "" VALUE 0x700107c7 Scalar_UBYTE 0 VBU0706_CM_uint8_cnt 0.0 15.0 /end CHARACTERISTIC
/begin CHARACTERISTIC CGW_stVehCreepOn_C "" VALUE 0x700107c8 Scalar_UBYTE 0 VBU0706_CM_uint8_cnt 0.0 15.0 /end CHARACTERISTIC
/begin CHARACTERISTIC CGW_stVehDrvModeCaliOvrdVal_C "" VALUE 0x700107c9 Scalar_UBYTE 0 VBU0706_CM_uint8_cnt 0.0 15.0 /end CHARACTERISTIC
/begin CHARACTERISTIC CGW_stVehECOMod_C "" VALUE 0x700107cb Scalar_UBYTE 0 VBU0706_CM_uint8_cnt 0.0 15.0 /end CHARACTERISTIC
/begin CHARACTERISTIC CGW_stVehNormalMod_C "" VALUE 0x700107cc Scalar_UBYTE 0 VBU0706_CM_uint8_cnt 0.0 15.0 /end CHARACTERISTIC
/begin CHARACTERISTIC CGW_stVehRgnLow_C "" VALUE 0x700107cd Scalar_UBYTE 0 VBU0706_CM_uint8_cnt 0.0 15.0 /end CHARACTERISTIC
/begin CHARACTERISTIC CGW_stVehRgnModeCaliOvrdVal_C "" VALUE 0x700107ce Scalar_UBYTE 0 VBU0706_CM_uint8_cnt 0.0 15.0 /end CHARACTERISTIC
/begin CHARACTERISTIC CGW_stVehRgnNormal_C "" VALUE 0x700107d1 Scalar_UBYTE 0 VBU0706_CM_uint8_cnt 0.0 15.0 /end CHARACTERISTIC
/begin CHARACTERISTIC CGW_stVehRgnOff_C "" VALUE 0x700107d2 Scalar_UBYTE 0 VBU0706_CM_uint8_cnt 0.0 15.0 /end CHARACTERISTIC
/begin CHARACTERISTIC CGW_stVehRgnZero_C "" VALUE 0x700107d3 Scalar_UBYTE 0 VBU0706_CM_uint8_cnt 0.0 15.0 /end CHARACTERISTIC
/begin CHARACTERISTIC CGW_stVehSportMod_C "" VALUE 0x700107d4 Scalar_UBYTE 0 VBU0706_CM_uint8_cnt 0.0 15.0 /end CHARACTERISTIC
/begin CHARACTERISTIC CaFCC_FullChargeVoltageHysteresisMapDimension_n "" VAL_BLK 0x70010c03 Scalar_UBYTE 0 VBU0706_CM_uint8_cnt 0.0 255.0 NUMBER 2 /end CHARACTERISTIC
/begin CHARACTERISTIC CaFCC_FullChargeVoltageSOHAttenuationMapDimension_n "" VAL_BLK 0x70010c05 Scalar_UBYTE 0 VBU0706_CM_uint8_cnt 0.0 255.0 NUMBER 2 /end CHARACTERISTIC
/begin CHARACTERISTIC CaSYS_FullChargeOcvMapDimension_n "" VAL_BLK 0x70010c0d Scalar_UBYTE 0 VBU0706_CM_uint8_cnt 0.0 255.0 NUMBER 2 /end CHARACTERISTIC
/begin CHARACTERISTIC DIAGS_stNRCFail_SY "" VALUE 0x70010a71 Scalar_UBYTE 0 VBU0706_CM_uint8_cnt 0.0 255.0 /end CHARACTERISTIC
/begin CHARACTERISTIC DIAGS_stPsvRespIn_SY "" VALUE 0x70010a73 Scalar_UBYTE 0 VBU0706_CM_uint8_cnt 0.0 255.0 /end CHARACTERISTIC
/begin CHARACTERISTIC DIAGS_stPsvRespNok_SY "" VALUE 0x70010a74 Scalar_UBYTE 0 VBU0706_CM_uint8_cnt 0.0 255.0 /end CHARACTERISTIC
/begin CHARACTERISTIC DIAGS_stPsvRespOk_SY "" VALUE 0x70010a75 Scalar_UBYTE 0 VBU0706_CM_uint8_cnt 0.0 255.0 /end CHARACTERISTIC
/begin CHARACTERISTIC EPB_stClosed "" VALUE 0x70010a92 Scalar_UBYTE 0 VBU0706_CM_uint8_cnt 0.0 255.0 /end CHARACTERISTIC
/begin CHARACTERISTIC Gear_stBCUEPBSwtPressed_C "" VALUE 0x70010ac3 Scalar_UBYTE 0 VBU0706_CM_uint8_cnt 0.0 15.0 /end CHARACTERISTIC
/begin CHARACTERISTIC Gear_stCurrentGearD_C "" VALUE 0x70010ac4 Scalar_UBYTE 0 VBU0706_CM_uint8_cnt 0.0 15.0 /end CHARACTERISTIC
/begin CHARACTERISTIC Gear_stCurrentGearR_C "" VALUE 0x70010ac9 Scalar_UBYTE 0 VBU0706_CM_uint8_cnt 0.0 15.0 /end CHARACTERISTIC
/begin CHARACTERISTIC Gear_stEPBApplied_C "" VALUE 0x70010ace Scalar_UBYTE 0 VBU0706_CM_uint8_cnt 0.0 15.0 /end CHARACTERISTIC
/begin CHARACTERISTIC Gear_stEPBApplyReq_C "" VALUE 0x70010acf Scalar_UBYTE 0 VBU0706_CM_uint8_cnt 0.0 15.0 /end CHARACTERISTIC
/begin CHARACTERISTIC Gear_stEPBNoApplyReq_C "" VALUE 0x70010ad0 Scalar_UBYTE 0 VBU0706_CM_uint8_cnt 0.0 15.0 /end CHARACTERISTIC
/begin CHARACTERISTIC Gear_stEPBReleased_C "" VALUE 0x70010ad1 Scalar_UBYTE 0 VBU0706_CM_uint8_cnt 0.0 15.0 /end CHARACTERISTIC
/begin CHARACTERISTIC Gear_stHVRelayClosed_C "" VALUE 0x70010ad6 Scalar_UBYTE 0 VBU0706_CM_uint8_cnt 0.0 15.0 /end CHARACTERISTIC
/begin CHARACTERISTIC Gear_stIntendGearP_C "" VALUE 0x70010ad9 Scalar_UBYTE 0 VBU0706_CM_uint8_cnt 0.0 15.0 /end CHARACTERISTIC
/begin CHARACTERISTIC Gear_stVehModeDCH_C "" VALUE 0x70010adb Scalar_UBYTE 0 VBU0706_CM_uint8_cnt 0.0 15.0 /end CHARACTERISTIC
/begin CHARACTERISTIC TQC_stCurrentGearD_C "" VALUE 0x70010bb8 Scalar_UBYTE 0 VBU0706_CM_uint8_cnt 0.0 15.0 /end CHARACTERISTIC
/begin CHARACTERISTIC TQC_stDGear_C "" VALUE 0x70010bb9 Scalar_UBYTE 0 VBU0706_CM_uint8_cnt 0.0 15.0 /end CHARACTERISTIC
/begin CHARACTERISTIC VM_stVehLimMaxSpdD_C "" VALUE 0x70010bd8 Scalar_UBYTE 0 VBU0706_CM_uint8_cnt 0.0 15.0 /end CHARACTERISTIC
/begin CHARACTERISTIC VM_stVehLimMaxSpdR_C "" VALUE 0x70010bd9 Scalar_UBYTE 0 VBU0706_CM_uint8_cnt 0.0 15.0 /end CHARACTERISTIC
/begin CHARACTERISTIC VM_stVehLimServerGearD_C "" VALUE 0x70010bda Scalar_UBYTE 0 VBU0706_CM_uint8_cnt 0.0 15.0 /end CHARACTERISTIC
/begin CHARACTERISTIC VM_stVehLimServerGearR_C "" VALUE 0x70010bdb Scalar_UBYTE 0 VBU0706_CM_uint8_cnt 0.0 15.0 /end CHARACTERISTIC
/begin CHARACTERISTIC Veh_stCGWNetworkPartial_C "" VALUE 0x70010be8 Scalar_UBYTE 0 VBU0706_CM_uint8_cnt 0.0 15.0 /end CHARACTERISTIC
/begin MEASUREMENT SOF_facContinuousChargeFactor "" FLOAT32_IEEE VBU0706_CM_single 0 0 -3.4E+38 3.4E+38 ECU_ADDRESS 0x700117fa /end MEASUREMENT
/begin MEASUREMENT SOF_iAContinuousChargeCurrentBaseRaw "" FLOAT32_IEEE VBU0706_CM_single 0 0 -3.4E+38 3.4E+38 ECU_ADDRESS 0x7001180a /end MEASUREMENT
/begin MEASUREMENT SOF_iAContinuousChargeCurrentLimitMapBaseNormal "" FLOAT32_IEEE VBU0706_CM_single 0 0 -3.4E+38 3.4E+38 ECU_ADDRESS 0x7001181a /end MEASUREMENT
/begin MEASUREMENT SOF_iAShortPulseChargeCurrentLimitMapBaseNormal "" FLOAT32_IEEE VBU0706_CM_single 0 0 -3.4E+38 3.4E+38 ECU_ADDRESS 0x7001186a /end MEASUREMENT
/begin MEASUREMENT SOF_iAShortPulseDischargeCurrentLimitBase "" FLOAT32_IEEE VBU0706_CM_single 0 0 -3.4E+38 3.4E+38 ECU_ADDRESS 0x7001187a /end MEASUREMENT
/begin MEASUREMENT SOF_iAShortPulseDischargeCurrentLimitFastChrgChk "" FLOAT32_IEEE VBU0706_CM_single 0 0 -3.4E+38 3.4E+38 ECU_ADDRESS 0x7001187e /end MEASUREMENT
/begin MEASUREMENT SOF_iAContinuousDischargeCurrentLimitFastChrgChk "" FLOAT32_IEEE VBU0706_CM_single 0 0 -3.4E+38 3.4E+38 ECU_ADDRESS 0x70011826 /end MEASUREMENT
/begin MEASUREMENT SOF_iAShortPulseChargeCurrentLimitFastChrgChk "" FLOAT32_IEEE VBU0706_CM_single 0 0 -3.4E+38 3.4E+38 ECU_ADDRESS 0x70011866 /end MEASUREMENT
/begin MEASUREMENT SOF_iAContinuousChargeCurrentLimitFastChrgChkRaw "" FLOAT32_IEEE VBU0706_CM_single 0 0 -3.4E+38 3.4E+38 ECU_ADDRESS 0x70011816 /end MEASUREMENT
/begin MEASUREMENT SOF_iAFastChrgCurrLimit "" FLOAT32_IEEE VBU0706_CM_single_A 0 0 -3.4E+38 3.4E+38 ECU_ADDRESS 0x7001185a /end MEASUREMENT
/begin MEASUREMENT LcSOC_iASocLookUpCurr "" FLOAT32_IEEE VBU0706_CM_single_A 0 0 -3.4E+38 3.4E+38 ECU_ADDRESS 0x7001170a /end MEASUREMENT
/begin MEASUREMENT LcSOC_iAClvLookUp2Curr "" FLOAT32_IEEE VBU0706_CM_single_A 0 0 -3.4E+38 3.4E+38 ECU_ADDRESS 0x70011706 /end MEASUREMENT
/begin MEASUREMENT LcSOC_iAClvLookUp1Curr "" FLOAT32_IEEE VBU0706_CM_single 0 0 -3.4E+38 3.4E+38 ECU_ADDRESS 0x70011702 /end MEASUREMENT
/begin MEASUREMENT BPD_pBrkPress "" FLOAT32_IEEE VBU0706_CM_single 0 0 -3.4E+38 3.4E+38 ECU_ADDRESS 0x7001147a /end MEASUREMENT
/begin MEASUREMENT BPD_pctBrkPress "" FLOAT32_IEEE VBU0706_CM_single 0 0 -3.4E+38 3.4E+38 ECU_ADDRESS 0x70011482 /end MEASUREMENT
/begin MEASUREMENT BPD_pctBrkPressPercent "" FLOAT32_IEEE VBU0706_CM_single 0 0 -3.4E+38 3.4E+38 ECU_ADDRESS 0x70011486 /end MEASUREMENT
/begin MEASUREMENT BPD_pctBrkPos "" FLOAT32_IEEE VBU0706_CM_single 0 0 -3.4E+38 3.4E+38 ECU_ADDRESS 0x7001147e /end MEASUREMENT
/begin MEASUREMENT SPD_vMotrSpd "" FLOAT32_IEEE VBU0706_CM_single 0 0 -3.4E+38 3.4E+38 ECU_ADDRESS 0x70011922 /end MEASUREMENT
/begin MEASUREMENT THM_pctESSPmpCmdRaw "" FLOAT32_IEEE VBU0706_CM_single 0 0 -3.4E+38 3.4E+38 ECU_ADDRESS 0x70011942 /end MEASUREMENT
/begin MEASUREMENT THM_pctRearPmpCmdRaw "" FLOAT32_IEEE VBU0706_CM_single 0 0 -3.4E+38 3.4E+38 ECU_ADDRESS 0x7001195a /end MEASUREMENT
/begin MEASUREMENT APD_pctAccPedPos "" FLOAT32_IEEE VBU0706_CM_single 0 0 -3.4E+38 3.4E+38 ECU_ADDRESS 0x70011422 /end MEASUREMENT
/begin MEASUREMENT SPD_pctSlope "" FLOAT32_IEEE VBU0706_CM_single 0 0 -3.4E+38 3.4E+38 ECU_ADDRESS 0x70011916 /end MEASUREMENT
/begin MEASUREMENT TQC_trqLIM "" FLOAT32_IEEE VBU0706_CM_single 0 0 -10000.0 10000.0 ECU_ADDRESS 0x700119a6 /end MEASUREMENT
/begin MEASUREMENT MTQL_trqRMotrMaxLim "" FLOAT32_IEEE VBU0706_CM_single 0 0 -10000.0 10000.0 ECU_ADDRESS 0x7001173e /end MEASUREMENT
/begin MEASUREMENT MTQL_trqRMotrMinLim "" FLOAT32_IEEE VBU0706_CM_single 0 0 -10000.0 10000.0 ECU_ADDRESS 0x70011742 /end MEASUREMENT
/begin MEASUREMENT MTQL_trqMtrDrvLimRaw "" FLOAT32_IEEE VBU0706_CM_single 0 0 -3.4E+38 3.4E+38 ECU_ADDRESS 0x7001172e /end MEASUREMENT
/begin MEASUREMENT MTQL_trqMtrRgnLimRaw "" FLOAT32_IEEE VBU0706_CM_single 0 0 -3.4E+38 3.4E+38 ECU_ADDRESS 0x70011736 /end MEASUREMENT
/begin MEASUREMENT MTQL_trqMtrDrvLim "" FLOAT32_IEEE VBU0706_CM_single 0 0 -3.4E+38 3.4E+38 ECU_ADDRESS 0x7001172a /end MEASUREMENT
/begin MEASUREMENT MTQL_trqMtrRgnLim "" FLOAT32_IEEE VBU0706_CM_single 0 0 -3.4E+38 3.4E+38 ECU_ADDRESS 0x70011732 /end MEASUREMENT
/begin MEASUREMENT TQDMP_trqCompRA "" FLOAT32_IEEE VBU0706_CM_single 0 0 -10000.0 10000.0 ECU_ADDRESS 0x70011a16 /end MEASUREMENT
/begin MEASUREMENT TQO_facFilter "" FLOAT32_IEEE VBU0706_CM_single 0 0 -3.4E+38 3.4E+38 ECU_ADDRESS 0x70011a82 /end MEASUREMENT
/begin MEASUREMENT TQARB_TrqRgnRA "" FLOAT32_IEEE VBU0706_CM_single 0 0 -10000.0 10000.0 ECU_ADDRESS 0x70011982 /end MEASUREMENT
/begin MEASUREMENT TQARB_trqArbRA2 "" FLOAT32_IEEE VBU0706_CM_single 0 0 -3.4E+38 3.4E+38 ECU_ADDRESS 0x7001198a /end MEASUREMENT
/begin MEASUREMENT TQARB_trqBattRAMax "" FLOAT32_IEEE VBU0706_CM_single 0 0 -10000.0 10000.0 ECU_ADDRESS 0x7001198e /end MEASUREMENT
/begin MEASUREMENT TQARB_trqBattRAMin "" FLOAT32_IEEE VBU0706_CM_single 0 0 -10000.0 10000.0 ECU_ADDRESS 0x70011992 /end MEASUREMENT
/begin MEASUREMENT TQARB_trqArbRA "" FLOAT32_IEEE VBU0706_CM_single 0 0 -10000.0 10000.0 ECU_ADDRESS 0x70011986 /end MEASUREMENT
/begin MEASUREMENT STC_trqRgnLimit "" FLOAT32_IEEE VBU0706_CM_single 0 0 -3.4E+38 3.4E+38 ECU_ADDRESS 0x70011932 /end MEASUREMENT
/begin MEASUREMENT TQDIS_trqRAPropLim "" FLOAT32_IEEE VBU0706_CM_single 0 0 -10000.0 10000.0 ECU_ADDRESS 0x700119fe /end MEASUREMENT
/begin MEASUREMENT TQDIS_trqRARgnLim "" FLOAT32_IEEE VBU0706_CM_single 0 0 -10000.0 10000.0 ECU_ADDRESS 0x70011a02 /end MEASUREMENT
/begin MEASUREMENT TQDIS_trqRALim "" FLOAT32_IEEE VBU0706_CM_single 0 0 -10000.0 10000.0 ECU_ADDRESS 0x700119fa /end MEASUREMENT
/begin MEASUREMENT TQDIS_AxleArbK "" FLOAT32_IEEE VBU0706_CM_single 0 0 -3.4E+38 3.4E+38 ECU_ADDRESS 0x700119aa /end MEASUREMENT
/begin MEASUREMENT TQD_vVehSpd "" FLOAT32_IEEE VBU0706_CM_single 0 0 -3.4E+38 3.4E+38 ECU_ADDRESS 0x70011a7e /end MEASUREMENT
/begin MEASUREMENT TQD_pBrkPressFlt "" FLOAT32_IEEE VBU0706_CM_single 0 0 -3.4E+38 3.4E+38 ECU_ADDRESS 0x70011a3e /end MEASUREMENT
/begin MEASUREMENT TQD_facBrkPresCrpMod "" FLOAT32_IEEE VBU0706_CM_single 0 0 -3.4E+38 3.4E+38 ECU_ADDRESS 0x70011a36 /end MEASUREMENT
/begin MEASUREMENT TQD_facBrkPosCrpMod "" FLOAT32_IEEE VBU0706_CM_single 0 0 0.0 1.0 ECU_ADDRESS 0x70011a32 /end MEASUREMENT
/begin MEASUREMENT TQD_facBrkCrpPct "" FLOAT32_IEEE VBU0706_CM_single 0 0 -3.4E+38 3.4E+38 ECU_ADDRESS 0x70011a2e /end MEASUREMENT
/begin MEASUREMENT TQD_trqCrpCst "" FLOAT32_IEEE VBU0706_CM_single 0 0 -10000.0 10000.0 ECU_ADDRESS 0x70011a52 /end MEASUREMENT
/begin MEASUREMENT TQD_trqCrpMode "" FLOAT32_IEEE VBU0706_CM_single 0 0 -10000.0 10000.0 ECU_ADDRESS 0x70011a56 /end MEASUREMENT
/begin MEASUREMENT TQD_trqCor "" FLOAT32_IEEE VBU0706_CM_single 0 0 -3.4E+38 3.4E+38 ECU_ADDRESS 0x70011a4e /end MEASUREMENT
/begin MEASUREMENT EDIS_pwrDownStep "" FLOAT32_IEEE VBU0706_CM_single 0 0 -1000.0 1000.0 ECU_ADDRESS 0x700115b2 /end MEASUREMENT
/begin MEASUREMENT EDIS_pwrUpStep "" FLOAT32_IEEE VBU0706_CM_single 0 0 -1000.0 1000.0 ECU_ADDRESS 0x700115e2 /end MEASUREMENT
/begin MEASUREMENT EDIS_pwrDownStepCh "" FLOAT32_IEEE VBU0706_CM_single 0 0 -3.4E+38 3.4E+38 ECU_ADDRESS 0x700115b6 /end MEASUREMENT
/begin MEASUREMENT EDIS_pwrUpStepCh "" FLOAT32_IEEE VBU0706_CM_single 0 0 -3.4E+38 3.4E+38 ECU_ADDRESS 0x700115e6 /end MEASUREMENT
/begin MEASUREMENT EDIS_pwrDrvPwrLimFilter "" FLOAT32_IEEE VBU0706_CM_single 0 0 0.0 1000.0 ECU_ADDRESS 0x700115c2 /end MEASUREMENT
/begin MEASUREMENT EDIS_pwrChDynSp "" FLOAT32_IEEE VBU0706_CM_single 0 0 -3.4E+38 3.4E+38 ECU_ADDRESS 0x70011576 /end MEASUREMENT
/begin MEASUREMENT EDIS_pwrChSp "" FLOAT32_IEEE VBU0706_CM_single 0 0 -3.4E+38 3.4E+38 ECU_ADDRESS 0x70011582 /end MEASUREMENT
/begin MEASUREMENT PEUR_uDCRlyOutsideVltg "" FLOAT32_IEEE VBU0706_CM_single 0 0 -3.4E+38 3.4E+38 ECU_ADDRESS 0x7001179a /end MEASUREMENT
/begin MEASUREMENT BCU_vWhlRL "" FLOAT32_IEEE VBU0706_CM_single 0 0 -3.4E+38 3.4E+38 ECU_ADDRESS 0x7001142e /end MEASUREMENT
/begin MEASUREMENT BCU_vWhlRR "" FLOAT32_IEEE VBU0706_CM_single 0 0 -3.4E+38 3.4E+38 ECU_ADDRESS 0x70011432 /end MEASUREMENT
/begin MEASUREMENT PEUR_stActvDisCh "" FLOAT32_IEEE VBU0706_CM_single 0 0 -3.4E+38 3.4E+38 ECU_ADDRESS 0x7001178e /end MEASUREMENT
/begin MEASUREMENT PEUR_nMotr "" FLOAT32_IEEE VBU0706_CM_single 0 0 -3.4E+38 3.4E+38 ECU_ADDRESS 0x7001178a /end MEASUREMENT
/begin MEASUREMENT PEUR_iCalcDC "" FLOAT32_IEEE VBU0706_CM_single 0 0 -1000.0 1000.0 ECU_ADDRESS 0x70011786 /end MEASUREMENT
/begin MEASUREMENT SOF_mvFastChargeCurrentDropCellVoltage "" UWORD VBU0706_CM_uint16 0 0 0 65535 ECU_ADDRESS 0x700113d4 /end MEASUREMENT
/begin MEASUREMENT FCC_mvFullChargeCellVoltage "" UWORD VBU0706_CM_uint16 0 0 0 65535 ECU_ADDRESS 0x7001139e /end MEASUREMENT
/begin MEASUREMENT FCC_mvFullChargeDisbaleCellVoltage "" UWORD VBU0706_CM_uint16 0 0 0 65535 ECU_ADDRESS 0x700113a0 /end MEASUREMENT
/begin MEASUREMENT CTD_stMnPosContactorStuckOpenDiagnosticStatus "" UBYTE VBU0706_CM_uint8 0 0 0 255 ECU_ADDRESS 0x70011d3b /end MEASUREMENT
/begin MEASUREMENT CTD_stMnNegContactorStuckOpenDiagnosticStatus "" UBYTE VBU0706_CM_uint8 0 0 0 255 ECU_ADDRESS 0x70011d39 /end MEASUREMENT
/begin MEASUREMENT SPD_numWhlSpdInvld "" UBYTE VBU0706_CM_uint8 0 0 0 255 ECU_ADDRESS 0x70011ef2 /end MEASUREMENT
/begin MEASUREMENT BPD_stBrkPedSwtRaw "" UBYTE VBU0706_CM_uint8 0 0 0.0 15.0 ECU_ADDRESS 0x70011d0f /end MEASUREMENT
/begin MEASUREMENT BPD_stBrkSwt "" UBYTE VBU0706_CM_uint8 0 0 0.0 15.0 ECU_ADDRESS 0x70011d10 /end MEASUREMENT
/begin MEASUREMENT TQO_stShft "" UBYTE VBU0706_CM_uint8 0 0 0.0 15.0 ECU_ADDRESS 0x70011f19 /end MEASUREMENT
/begin MEASUREMENT PMM_stSelfDiagResp "" UBYTE VBU0706_CM_uint8 0 0 0 255 ECU_ADDRESS 0x70011ebd /end MEASUREMENT
/begin MEASUREMENT CDC_stRgnMode "" UBYTE VBU0706_CM_uint8 0 0 0 255 ECU_ADDRESS 0x70011d26 /end MEASUREMENT
/begin MEASUREMENT CDC_stDrvMode "" UBYTE VBU0706_CM_uint8 0 0 0 255 ECU_ADDRESS 0x70011d25 /end MEASUREMENT
/begin MEASUREMENT SOF_flgFastChrgOneThirdRateCurrentLimit "" UBYTE VBU0706_CM_boolean 0 0 0.0 1.0 ECU_ADDRESS 0x70011ee8 /end MEASUREMENT
/begin MEASUREMENT LbSOC_flgSocLookUp2ClvLookUp "" UBYTE VBU0706_CM_boolean_flg 0 0 0 1 ECU_ADDRESS 0x70011e5d /end MEASUREMENT
/begin MEASUREMENT LbSOC_flgClvLookUp2ToSocLookUp "" UBYTE VBU0706_CM_boolean_flg 0 0 0 1 ECU_ADDRESS 0x70011e5c /end MEASUREMENT
/begin MEASUREMENT LbSOC_flgClvLookUp1ToClvLookUp2 "" UBYTE VBU0706_CM_boolean_flg 0 0 0 1 ECU_ADDRESS 0x70011e5a /end MEASUREMENT
/begin MEASUREMENT LbSOC_flgClvLookUp1ToSocLookUp "" UBYTE VBU0706_CM_boolean_flg 0 0 0 1 ECU_ADDRESS 0x70011e5b /end MEASUREMENT
/begin MEASUREMENT SOF_flgLowVoltageState "" UBYTE VBU0706_CM_boolean 0 0 0 1 ECU_ADDRESS 0x70011ee9 /end MEASUREMENT
/begin MEASUREMENT VoltThld_flg "" UBYTE VBU0706_CM_boolean 0 0 0 1 ECU_ADDRESS 0x70011f53 /end MEASUREMENT
/begin MEASUREMENT VoltThld1_flg "" UBYTE VBU0706_CM_boolean 0 0 0 1 ECU_ADDRESS 0x70011f52 /end MEASUREMENT
/begin MEASUREMENT FCC_flgFullChargeCellVoltageCriteria "" UBYTE VBU0706_CM_boolean 0 0 0.0 1.0 ECU_ADDRESS 0x70011de3 /end MEASUREMENT
/begin MEASUREMENT FCC_flgFullChargePackVoltageCriteria "" UBYTE VBU0706_CM_boolean 0 0 0.0 1.0 ECU_ADDRESS 0x70011de5 /end MEASUREMENT
/begin MEASUREMENT FCC_flgFullChargeSOCCriteria "" UBYTE VBU0706_CM_boolean 0 0 0.0 1.0 ECU_ADDRESS 0x70011de6 /end MEASUREMENT
/begin MEASUREMENT FCC_flgComputeResistanceEnable "" UBYTE VBU0706_CM_boolean 0 0 0.0 1.0 ECU_ADDRESS 0x70011ddf /end MEASUREMENT
/begin MEASUREMENT FCC_flgComputeResistanceStart "" UBYTE VBU0706_CM_boolean 0 0 0 1 ECU_ADDRESS 0x70011de2 /end MEASUREMENT
/begin MEASUREMENT FCC_flgComputeResistancePulseCurrentEnable "" UBYTE VBU0706_CM_boolean 0 0 0.0 1.0 ECU_ADDRESS 0x70011de1 /end MEASUREMENT
/begin MEASUREMENT DCH_flgAPlusWkup "" UBYTE VBU0706_CM_boolean 0 0 0.0 1.0 ECU_ADDRESS 0x70011d6e /end MEASUREMENT
/begin MEASUREMENT DCH_flgBmsChAvl "" UBYTE VBU0706_CM_boolean 0 0 0.0 1.0 ECU_ADDRESS 0x70011d7a /end MEASUREMENT
/begin MEASUREMENT DCH_flgDCChRlyCloseSt "" UBYTE VBU0706_CM_boolean 0 0 0.0 1.0 ECU_ADDRESS 0x70011d82 /end MEASUREMENT
/begin MEASUREMENT BPD_flgMainBrkSwt "" UBYTE VBU0706_CM_boolean 0 0 0.0 1.0 ECU_ADDRESS 0x70011d0e /end MEASUREMENT
/begin MEASUREMENT SPD_flgVehSpdVld "" UBYTE VBU0706_CM_boolean 0 0 0.0 1.0 ECU_ADDRESS 0x70011ef1 /end MEASUREMENT
/begin MEASUREMENT APD_flgDftRatioPlausibility "" UBYTE VBU0706_CM_boolean 0 0 0.0 1.0 ECU_ADDRESS 0x70011cdc /end MEASUREMENT
/begin MEASUREMENT Gear_flgBrkPrssed "" UBYTE VBU0706_CM_boolean 0 0 0.0 1.0 ECU_ADDRESS 0x70011df9 /end MEASUREMENT
/begin MEASUREMENT Gear_flgGearShiftReady "" UBYTE VBU0706_CM_boolean 0 0 0.0 1.0 ECU_ADDRESS 0x70011e00 /end MEASUREMENT
/begin MEASUREMENT TQD_flgVehSlide "" UBYTE VBU0706_CM_boolean 0 0 0.0 1.0 ECU_ADDRESS 0x70011f15 /end MEASUREMENT
/begin MEASUREMENT TQD_flgCrpEna "" UBYTE VBU0706_CM_boolean 0 0 0.0 1.0 ECU_ADDRESS 0x70011f12 /end MEASUREMENT
/begin MEASUREMENT TQD_flgHillHld "" UBYTE VBU0706_CM_boolean 0 0 0.0 1.0 ECU_ADDRESS 0x70011f13 /end MEASUREMENT
/begin MEASUREMENT PMM_flgPEURActvDisChEnaOvrd "" UBYTE VBU0706_CM_boolean 0 0 0 1 ECU_ADDRESS 0x70011eaf /end MEASUREMENT
/begin MEASUREMENT PMM_flgSelfDiagEnaOvrd "" UBYTE VBU0706_CM_boolean 0 0 0 1 ECU_ADDRESS 0x70011eb2 /end MEASUREMENT
/begin MEASUREMENT PMM_flgHVPwrUpEnaOvrd "" UBYTE VBU0706_CM_boolean 0 0 0 1 ECU_ADDRESS 0x70011ea0 /end MEASUREMENT
/begin MEASUREMENT PMM_flgHVPwrUpEna "" UBYTE VBU0706_CM_boolean 0 0 0 1 ECU_ADDRESS 0x70011e9f /end MEASUREMENT
/begin MEASUREMENT PMM_flgHVPwrDwnEnaOvrd "" UBYTE VBU0706_CM_boolean 0 0 0 1 ECU_ADDRESS 0x70011e9e /end MEASUREMENT
/begin MEASUREMENT PMM_flgHVPwrDwnEna "" UBYTE VBU0706_CM_boolean 0 0 0 1 ECU_ADDRESS 0x70011e9d /end MEASUREMENT
/begin MEASUREMENT PEUR_flgtrqActVld "" UBYTE VBU0706_CM_boolean 0 0 0.0 1.0 ECU_ADDRESS 0x70011e91 /end MEASUREMENT
/begin MEASUREMENT PEUR_flgMotrHillHld "" UBYTE VBU0706_CM_boolean 0 0 0.0 1.0 ECU_ADDRESS 0x70011e8f /end MEASUREMENT
/begin MEASUREMENT EcSOF_LowVoltageStartTime_s "" ULONG VBU0706_CM_uint32 0 0 0 4294967295 ECU_ADDRESS 0x70011606 /end MEASUREMENT
/begin COMPU_METHOD VBU0706_CM_single_cnt "Q = V" RAT_FUNC "%8.6" "cnt" COEFFS 0 1 0 0 0 1 /end COMPU_METHOD
/begin COMPU_METHOD VBU0706_CM_uint16_cnt "Q = V" RAT_FUNC "%5.0" "cnt" COEFFS 0 1 0 0 0 1 /end COMPU_METHOD
/begin COMPU_METHOD VBU0706_CM_single_mV "Q = V" RAT_FUNC "%8.6" "mV" COEFFS 0 1 0 0 0 1 /end COMPU_METHOD
/begin COMPU_METHOD VBU0706_CM_single_C "Q = V" RAT_FUNC "%8.6" "C" COEFFS 0 1 0 0 0 1 /end COMPU_METHOD
/begin COMPU_METHOD VBU0706_CM_single_Nm "Q = V" RAT_FUNC "%8.6" "Nm" COEFFS 0 1 0 0 0 1 /end COMPU_METHOD
/begin COMPU_METHOD VBU0706_CM_single_kph "Q = V" RAT_FUNC "%8.6" "kph" COEFFS 0 1 0 0 0 1 /end COMPU_METHOD
/begin COMPU_METHOD VBU0706_CM_single_pct "Q = V" RAT_FUNC "%8.6" "pct" COEFFS 0 1 0 0 0 1 /end COMPU_METHOD
/begin COMPU_METHOD VBU0706_CM_single_t "Q = V" RAT_FUNC "%8.6" "t" COEFFS 0 1 0 0 0 1 /end COMPU_METHOD
/begin COMPU_METHOD VBU0706_CM_single_A "Q = V" RAT_FUNC "%8.6" "A" COEFFS 0 1 0 0 0 1 /end COMPU_METHOD
/begin COMPU_METHOD VBU0706_CM_single_fac "Q = V" RAT_FUNC "%8.6" "fac" COEFFS 0 1 0 0 0 1 /end COMPU_METHOD
/begin COMPU_METHOD VBU0706_CM_single_p "Q = V" RAT_FUNC "%8.6" "p" COEFFS 0 1 0 0 0 1 /end COMPU_METHOD
/begin COMPU_METHOD VBU0706_CM_double_cnt "Q = V" RAT_FUNC "%15.10" "cnt" COEFFS 0 1 0 0 0 1 /end COMPU_METHOD
/begin COMPU_METHOD VBU0706_CM_single_MPa "Q = V" RAT_FUNC "%8.6" "MPa" COEFFS 0 1 0 0 0 1 /end COMPU_METHOD
/begin COMPU_METHOD VBU0706_CM_single_V "Q = V" RAT_FUNC "%8.6" "V" COEFFS 0 1 0 0 0 1 /end COMPU_METHOD
/begin COMPU_METHOD VBU0706_CM_double_A "Q = V" RAT_FUNC "%15.10" "A" COEFFS 0 1 0 0 0 1 /end COMPU_METHOD
/begin COMPU_METHOD VBU0706_CM_single_i "Q = V" RAT_FUNC "%8.6" "i" COEFFS 0 1 0 0 0 1 /end COMPU_METHOD
/begin COMPU_METHOD VBU0706_CM_uint16 "Q = V" RAT_FUNC "%5.0" "" COEFFS 0 1 0 0 0 1 /end COMPU_METHOD
/begin COMPU_METHOD VBU0706_CM_single_km "Q = V" RAT_FUNC "%8.6" "km" COEFFS 0 1 0 0 0 1 /end COMPU_METHOD
/begin COMPU_METHOD VBU0706_CM_uint8 "Q = V" RAT_FUNC "%3.0" "" COEFFS 0 1 0 0 0 1 /end COMPU_METHOD
/begin COMPU_METHOD VBU0706_CM_single "Q = V" RAT_FUNC "%8.6" "" COEFFS 0 1 0 0 0 1 /end COMPU_METHOD
/begin COMPU_METHOD VBU0706_CM_single_s "Q = V" RAT_FUNC "%8.6" "s" COEFFS 0 1 0 0 0 1 /end COMPU_METHOD
/begin COMPU_METHOD VBU0706_CM_single_kW "Q = V" RAT_FUNC "%8.6" "kW" COEFFS 0 1 0 0 0 1 /end COMPU_METHOD
/begin COMPU_METHOD VBU0706_CM_single_kg "Q = V" RAT_FUNC "%8.6" "kg" COEFFS 0 1 0 0 0 1 /end COMPU_METHOD
/begin COMPU_METHOD VBU0706_CM_uint32_cnt "Q = V" RAT_FUNC "%10.0" "cnt" COEFFS 0 1 0 0 0 1 /end COMPU_METHOD
/begin COMPU_METHOD VBU0706_CM_boolean_flg "Q = V" RAT_FUNC "%1.0" "flg" COEFFS 0 1 0 0 0 1 /end COMPU_METHOD
/begin COMPU_METHOD VBU0706_CM_boolean "Q = V" RAT_FUNC "%1.0" "" COEFFS 0 1 0 0 0 1 /end COMPU_METHOD
/begin COMPU_METHOD VBU0706_CM_boolean_cnt "Q = V" RAT_FUNC "%1.0" "cnt" COEFFS 0 1 0 0 0 1 /end COMPU_METHOD
/begin COMPU_METHOD VBU0706_CM_uint8_cnt "Q = V" RAT_FUNC "%3.0" "cnt" COEFFS 0 1 0 0 0 1 /end COMPU_METHOD
/begin COMPU_METHOD VBU0706_CM_uint32 "Q = V" RAT_FUNC "%10.0" "" COEFFS 0 1 0 0 0 1 /end COMPU_METHOD
/begin GROUP S3601_Routine "VBU0706/Task_10ms/Subsystem/VCU /PMM/PMM_Ctrl/PMM/PwrMod_Ctrl/Routine" /begin SUB_GROUP S3658_PwrUpRoutine S3658_Routine_PwrDwn /end SUB_GROUP /end GROUP
/begin GROUP S3601_RoutineOvrd "VBU0706/Task_10ms/Subsystem/VCU /PMM/PMM_Ctrl/PMM/PwrMod_Ctrl/RoutineOvrd"
 /begin REF_CHARACTERISTIC PMM_flgHVPwrDwnEnaOvrdSwt_C PMM_flgHVPwrDwnEnaOvrdVal_C PMM_flgHVPwrUpEnaOvrdSwt_C PMM_flgHVPwrUpEnaOvrdVal_C PMM_flgPEURActvDisChEnaOvrdSwt_C PMM_flgPEURActvDisChEnaOvrdVal_C PMM_flgSelfDiagEnaOvrdSwt_C PMM_flgSelfDiagEnaOvrdVal_C /end REF_CHARACTERISTIC
 /begin REF_MEASUREMENT PMM_flgHVPwrDwnEnaOvrd PMM_flgHVPwrUpEnaOvrd PMM_flgPEURActvDisChEnaOvrd PMM_flgSelfDiagEnaOvrd /end REF_MEASUREMENT
/end GROUP
/begin GROUP S3601_SelfRoutine "VBU0706/Task_10ms/Subsystem/VCU /PMM/PMM_Ctrl/PMM/PwrMod_Ctrl/SelfRoutine"
 /begin REF_CHARACTERISTIC DIAGS_stNRCFail_SY DIAGS_stPsvRespIn_SY DIAGS_stPsvRespNok_SY DIAGS_stPsvRespOk_SY PMM_tiDlySelfDiag_C /end REF_CHARACTERISTIC
 /begin REF_MEASUREMENT PMM_flgHVPwrDwnEna PMM_flgHVPwrUpEna PMM_stSelfDiagResp /end REF_MEASUREMENT
/end GROUP
/begin GROUP S3706_BenchArb "VBU0706/Task_10ms/Subsystem/VCU /SPD/SPD/SignalProcessing_10ms/Bench/BenchArb"
 /begin REF_CHARACTERISTIC SPD_aBenchReset_C SPD_aBenchSetHi_C SPD_aBenchSetLow_C SPD_cntBenchThd_C SPD_facAXFilter_C /end REF_CHARACTERISTIC
/end GROUP
/begin GROUP S3708_SlopeCal "VBU0706/Task_10ms/Subsystem/VCU /SPD/SPD/SignalProcessing_10ms/SlopeCal1/SlopeCal" /begin REF_CHARACTERISTIC SPD_pctSlope_CUR_v /end REF_CHARACTERISTIC /begin REF_MEASUREMENT SPD_pctSlope /end REF_MEASUREMENT /end GROUP
/begin GROUP S3708_VehSt "VBU0706/Task_10ms/Subsystem/VCU /SPD/SPD/SignalProcessing_10ms/SlopeCal1/VehSt" /begin REF_CHARACTERISTIC SPD_tiSlopeFilter_C SPD_vGoThd_C /end REF_CHARACTERISTIC /end GROUP
/begin GROUP S3709_vWhlProcess "VBU0706/Task_10ms/Subsystem/VCU /SPD/SPD/SignalProcessing_10ms/Subsystem1/vWhlProcess" /begin REF_MEASUREMENT SPD_numWhlSpdInvld /end REF_MEASUREMENT /end GROUP
/begin GROUP S3709_v_Axle "VBU0706/Task_10ms/Subsystem/VCU /SPD/SPD/SignalProcessing_10ms/Subsystem1/v_Axle" /begin SUB_GROUP S3727_Front S3727_Rear /end SUB_GROUP /end GROUP
/begin GROUP S3710_RearWhl "VBU0706/Task_10ms/Subsystem/VCU /SPD/SPD/SignalProcessing_10ms/VehDir/RearWhl" /begin SUB_GROUP S3730_SR_Flip_Flop /end SUB_GROUP
 /begin REF_CHARACTERISTIC SPD_nMotrDrvRvsThd_C SPD_trqRvsRst_C SPD_vVehRvsRst_C SPD_vVehRvsThd_C /end REF_CHARACTERISTIC
/end GROUP
/begin GROUP S3711_Normal_VehSpdCal "VBU0706/Task_10ms/Subsystem/VCU /SPD/SPD/SignalProcessing_10ms/VehSpdNorm/Normal_VehSpdCal" /begin SUB_GROUP S3732_First_Order_Low_Pass_Filter /end SUB_GROUP
 /begin REF_CHARACTERISTIC SPD_facSpdFlt_C SPD_flgUseMotorSpeed_C SPD_vVehOvrdFlg_C SPD_vVehOvrdVal_C /end REF_CHARACTERISTIC
 /begin REF_MEASUREMENT SPD_flgVehSpdVld /end REF_MEASUREMENT
/end GROUP
/begin GROUP S3711_nMotr2vVeh "VBU0706/Task_10ms/Subsystem/VCU /SPD/SPD/SignalProcessing_10ms/VehSpdNorm/nMotr2vVeh" /begin REF_CHARACTERISTIC SPD_tiSample10ms_SY SPD_tiSpdFil_C SYS_facGearRatioR_SY /end REF_CHARACTERISTIC /begin REF_MEASUREMENT SPD_vMotrSpd /end REF_MEASUREMENT /end GROUP
/begin GROUP S3753_Cool "VBU0706/Task_10ms/Subsystem/VCU /THM/THM/ESSThermalMode/OperateCycle/Cool"
 /begin REF_CHARACTERISTIC THM_tActvCoolDsblDeltaTemp_C THM_tActvCoolEnaDeltaTemp_C THM_tPsvCoolDsblDeltaTemp_C THM_tPsvCoolEnaDeltaTemp_C THM_tPsvCoolLckDeltaTemp_C THM_tPsvCoolPermitDeltaTemp_C /end REF_CHARACTERISTIC
/end GROUP
/begin GROUP S3753_Heat "VBU0706/Task_10ms/Subsystem/VCU /THM/THM/ESSThermalMode/OperateCycle/Heat"
 /begin REF_CHARACTERISTIC THM_tActvHeatDsblDeltaTemp_C THM_tActvHeatEnaDeltaTemp_C THM_tPsvHeatDsblDeltaTemp_C THM_tPsvHeatEnaDeltaTemp_C THM_tPsvHeatLckDeltaTemp_C THM_tPsvHeatPermitDeltaTemp_C /end REF_CHARACTERISTIC
/end GROUP
/begin GROUP S3782_GradientLimiter "VBU0706/Task_10ms/Subsystem/VCU /THM/THM/PumpRaw/ESSPmpCmdRaw/GradientLimiter" /begin REF_MEASUREMENT THM_pctESSPmpCmdRaw /end REF_MEASUREMENT /end GROUP
/begin GROUP S3784_GradientLimiter "VBU0706/Task_10ms/Subsystem/VCU /THM/THM/PumpRaw/RearPmpCmdRaw/GradientLimiter" /begin REF_MEASUREMENT THM_pctRearPmpCmdRaw /end REF_MEASUREMENT /end GROUP
/begin GROUP S3812_Subsystem "VBU0706/Task_10ms/Subsystem/VCU /TQC/TQC/Subsystem/TQC_VehSpdLimit/Subsystem"
 /begin REF_CHARACTERISTIC TQC_aAcc2TrqPrpHigh_SY TQC_aSlopeLimitInit_C TQC_aThresLe_C TQC_aThresRi_C TQC_facDecDrag_C TQC_facDragFastFilter_C TQC_facDragNormalFilter_C TQC_facMinDrag_C TQC_facNormalDrag_C TQC_facSlopeLimitIntegral_C TQC_facSlopeLimitProportion_C TQC_flgSlopeLimitEn_C TQC_numSlopeSample_C TQC_tiDragDelayTime_C TQC_tiSampleTime_C TQC_trqDefaultLimit_C TQC_trqDefaultSlope_C TQC_trqSlopeLimitInit_C TQC_trqSlopeLimitMax_C TQC_trqSlopeLimitMin_C TQC_trqVehMax_C TQC_trqVehMin_C /end REF_CHARACTERISTIC
 /begin REF_MEASUREMENT TQC_trqLIM /end REF_MEASUREMENT
/end GROUP
/begin GROUP S3812_VLIMCal "VBU0706/Task_10ms/Subsystem/VCU /TQC/TQC/Subsystem/TQC_VehSpdLimit/VLIMCal"
 /begin REF_CHARACTERISTIC VM_aMSLimD_CUR_v VM_aMSLimHomeD_CUR_v VM_aMSLimHomeR_CUR_v VM_aMSLimR_CUR_v VM_aVehLimDifNeg_C VM_aVehLimDifPos_C VM_aVehLimMax_C VM_stVehLimMaxSpdR_C VM_stVehLimServerGearD_C VM_stVehLimServerGearR_C VM_vVehLimThresD_C VM_vVehLimThresR_C VM_vVehLimpHomeThresD_C VM_vVehLimpHomeThresR_C /end REF_CHARACTERISTIC
/end GROUP
/begin GROUP S3812_VMax "VBU0706/Task_10ms/Subsystem/VCU /TQC/TQC/Subsystem/TQC_VehSpdLimit/VMax"
 /begin REF_CHARACTERISTIC TQC_stCurrentGearD_C VM_flgVehLimFixEnable_C VM_stVehLimMaxSpdD_C VM_stVehLimMaxSpdR_C VM_vVehLimFix_C VM_vVehLimMaxRThresHi_C VM_vVehLimMaxRThresLo_C VM_vVehLimMaxR_C VM_vVehLimMaxThresHi_C VM_vVehLimMaxThresLo_C VM_vVehLimMax_C /end REF_CHARACTERISTIC
/end GROUP
/begin GROUP S3812_VMaxServer "VBU0706/Task_10ms/Subsystem/VCU /TQC/TQC/Subsystem/TQC_VehSpdLimit/VMaxServer"
 /begin REF_CHARACTERISTIC TQC_stCurrentGearD_C VM_stVehLimServerGearD_C VM_stVehLimServerGearR_C VM_vVehLimMax_C /end REF_CHARACTERISTIC
/end GROUP
/begin GROUP S3813_TQC_VehInfoAnalysis "VBU0706/Task_10ms/Subsystem/VCU /TQC/TQC/Subsystem/VehInfo1/TQC_VehInfoAnalysis"
 /begin REF_CHARACTERISTIC TQC_aXFltGradDec_C TQC_aXFltGradInc_C TQC_facDelayShiftFilter_C TQC_facDragShiftFilter_C TQC_facVehSpdFilter_C TQC_flgDragCalEn_C TQC_flgVehAccCalcEnable_C TQC_numFltAccAverage_C TQC_stDGear_C TQC_tiDelayDragTime_C TQC_tiSampleTime_C TQC_vDragSpeedLe_C TQC_vDragSpeedRi_C /end REF_CHARACTERISTIC
/end GROUP
/begin GROUP S3813_Veh_Drag "VBU0706/Task_10ms/Subsystem/VCU /TQC/TQC/Subsystem/VehInfo1/Veh_Drag"
 /begin REF_CHARACTERISTIC CrCtl_facDragSpeed_MAP_v TQC_aDragLearnMax_C TQC_aDragLearnMin_C TQC_facDragCalGradDec_C TQC_facDragCalGradInc_C TQC_facDragCalGradMax_C TQC_facDragCalGradMin_C TQC_facDragWheelFilter_C TQC_facTrqWheelFilter_C TQC_flgDragTrqMovingOn_C TQC_numDragCalAverageAccStepDown_C TQC_numDragCalAverageAccStepUp_C TQC_numDragCalAverageAcc_C TQC_numDragCalAverageBrk_C TQC_numDragFastLearn_C TQC_numDragLearnMin_C TQC_numDragLearnStepDown_C TQC_numDragLearnStepMax_C TQC_numDragLearnStepUp_C TQC_numDragLearnStep_C TQC_pctDragCalPedLe_C TQC_pctDragCalPedRi_C TQC_rRatioReducer_C TQC_trqDragCalGradDec_C TQC_trqDragCalGradInc_C TQC_trqDragMax_C TQC_vDragSpeedLearnLe_C TQC_vDragSpeedLearnRi_C /end REF_CHARACTERISTIC
/end GROUP
/begin GROUP S3813_Veh_a2Trq "VBU0706/Task_10ms/Subsystem/VCU /TQC/TQC/Subsystem/VehInfo1/Veh_a2Trq" /begin REF_CHARACTERISTIC TQC_mInrt_C TQC_mVeh_C /end REF_CHARACTERISTIC /end GROUP
/begin GROUP S3862_BrakeCrpModify "VBU0706/Task_10ms/Subsystem/VCU /TQD/TrqDem/TrqDem_DrvTrq_Cal/TrqDem_MinTrq_Cal/BrakeCrpModify"
 /begin REF_CHARACTERISTIC TQD_flgBrkPresUsed_C TQD_pctCrpCtrlBrkPctS_CUR_v TQD_pctCrpCtrlBrkPct_MAP_v TQD_pctCrpCtrlBrkPresS_CUR_v TQD_pctCrpCtrlBrkPres_MAP_v /end REF_CHARACTERISTIC
 /begin REF_MEASUREMENT TQD_facBrkCrpPct TQD_facBrkPosCrpMod TQD_facBrkPresCrpMod /end REF_MEASUREMENT
/end GROUP
/begin GROUP S3862_CrpEnaArb "VBU0706/Task_10ms/Subsystem/VCU /TQD/TrqDem/TrqDem_DrvTrq_Cal/TrqDem_MinTrq_Cal/CrpEnaArb" /begin REF_CHARACTERISTIC EPB_stClosed TQD_flgCreepFnctnEna_C /end REF_CHARACTERISTIC /begin REF_MEASUREMENT TQD_flgCrpEna /end REF_MEASUREMENT /end GROUP
/begin GROUP S3862_CrpRgnTrqArb "VBU0706/Task_10ms/Subsystem/VCU /TQD/TrqDem/TrqDem_DrvTrq_Cal/TrqDem_MinTrq_Cal/CrpRgnTrqArb" /begin REF_CHARACTERISTIC TQD_flgSlpEna_C TQD_trqCrpCtrlSlp_MAP_v /end REF_CHARACTERISTIC /begin REF_MEASUREMENT TQD_flgHillHld TQD_trqCor TQD_trqCrpMode /end REF_MEASUREMENT /end GROUP
/begin GROUP S3862_CrpRgnTrqCal "VBU0706/Task_10ms/Subsystem/VCU /TQD/TrqDem/TrqDem_DrvTrq_Cal/TrqDem_MinTrq_Cal/CrpRgnTrqCal"
 /begin REF_CHARACTERISTIC TQD_trqCrpCstModeA_CUR_v TQD_trqCrpCstModeB_CUR_v TQD_trqCrpCstModeC_CUR_v TQD_trqCrpCstModeD_CUR_v /end REF_CHARACTERISTIC
 /begin REF_MEASUREMENT TQD_trqCrpCst /end REF_MEASUREMENT
/end GROUP
/begin GROUP S3862_CrpRgnTrqLim "VBU0706/Task_10ms/Subsystem/VCU /TQD/TrqDem/TrqDem_DrvTrq_Cal/TrqDem_MinTrq_Cal/CrpRgnTrqLim"
 /begin REF_CHARACTERISTIC TQD_flgTrqMinEn_C TQD_trqModeChngDecGrad_C TQD_trqModeChngIncGrad_C TQD_trqNrmDecGrad_C TQD_trqNrmIncGrad_C TQD_trqRateLimThres_C /end REF_CHARACTERISTIC
/end GROUP
/begin GROUP S3874_First_Order_Low_Pass_Filter "VBU0706/Task_10ms/Subsystem/VCU /TQD/TrqDem/TrqDem_InputTransfer/BrakePressureFilter/First_Order_Low_Pass_Filter" /begin REF_MEASUREMENT TQD_pBrkPressFlt /end REF_MEASUREMENT /end GROUP
/begin GROUP S3877_DejitterFIL "VBU0706/Task_10ms/Subsystem/VCU /TQD/TrqDem/TrqDem_InputTransfer/TrqDem_VehSpeed_Filter/DejitterFIL" /begin REF_MEASUREMENT TQD_vVehSpd /end REF_MEASUREMENT /end GROUP
/begin GROUP S3877_SR_Flip_Flop "VBU0706/Task_10ms/Subsystem/VCU /TQD/TrqDem/TrqDem_InputTransfer/TrqDem_VehSpeed_Filter/SR_Flip_Flop" /begin REF_MEASUREMENT TQD_flgVehSlide /end REF_MEASUREMENT /end GROUP
/begin GROUP S3892_DisableRgnTorque "VBU0706/Task_10ms/Subsystem/VCU /TQO/TQOAll/STC/STC/DisableRgnTorque" /begin REF_CHARACTERISTIC STC_flgRgnTrqCnclRA_C /end REF_CHARACTERISTIC /begin REF_MEASUREMENT STC_trqRgnLimit /end REF_MEASUREMENT /end GROUP
/begin GROUP S3896_Limitation "VBU0706/Task_10ms/Subsystem/VCU /TQO/TQOAll/TQARB/TQARB/Limitation"
 /begin REF_MEASUREMENT TQARB_trqArbRA TQARB_trqArbRA2 TQARB_trqBattRAMax TQARB_trqBattRAMin /end REF_MEASUREMENT
/end GROUP
/begin GROUP S3896_TrqArb "VBU0706/Task_10ms/Subsystem/VCU /TQO/TQOAll/TQARB/TQARB/TrqArb" /begin SUB_GROUP S3898_SignalProcess /end SUB_GROUP /begin REF_CHARACTERISTIC TQARB_flgSTCProtect_C /end REF_CHARACTERISTIC /begin REF_MEASUREMENT TQARB_TrqRgnRA /end REF_MEASUREMENT /end GROUP
/begin GROUP S3902_TrqPulse "VBU0706/Task_10ms/Subsystem/VCU /TQO/TQOAll/TQCMP/TQCMP/TrqPulse" /begin SUB_GROUP S3903_PulseTime S3903_PulseTrig S3903_PulseTrq /end SUB_GROUP /end GROUP
/begin GROUP S3910_AxleArb "VBU0706/Task_10ms/Subsystem/VCU /TQO/TQOAll/TQDIS/TQDIS/AxleArb" /begin REF_MEASUREMENT TQDIS_AxleArbK /end REF_MEASUREMENT /end GROUP
/begin GROUP S3910_Dmp "VBU0706/Task_10ms/Subsystem/VCU /TQO/TQOAll/TQDIS/TQDIS/Dmp" /begin SUB_GROUP S3912_DmpFilter /end SUB_GROUP /end GROUP
/begin GROUP S3910_TrqFilter "VBU0706/Task_10ms/Subsystem/VCU /TQO/TQOAll/TQDIS/TQDIS/TrqFilter" /begin SUB_GROUP S3913_Arb S3913_DrvLim S3913_Subsystem /end SUB_GROUP /end GROUP
/begin GROUP S3910_TrqLim "VBU0706/Task_10ms/Subsystem/VCU /TQO/TQOAll/TQDIS/TQDIS/TrqLim" /begin REF_CHARACTERISTIC SYS_facGearRatioR_SY /end REF_CHARACTERISTIC /begin REF_MEASUREMENT TQDIS_trqRALim TQDIS_trqRAPropLim TQDIS_trqRARgnLim /end REF_MEASUREMENT /end GROUP
/begin GROUP S3946_CMB "VBU0706/Task_10ms/Subsystem/VCU /TQO/TQOAll/TQDMP/TQDMP/CMB" /begin REF_CHARACTERISTIC SYS_facGearRatioR_SY /end REF_CHARACTERISTIC /begin REF_MEASUREMENT TQDMP_trqCompRA /end REF_MEASUREMENT /end GROUP
/begin GROUP S3946_Dibl "VBU0706/Task_10ms/Subsystem/VCU /TQO/TQOAll/TQDMP/TQDMP/Dibl"
 /begin REF_CHARACTERISTIC TQDMP_flgROTCDisblORF TQDMP_flgROTCDisblORV TQDMP_vVehEnaMax_C TQDMP_vVehEnaMin_C /end REF_CHARACTERISTIC
/end GROUP
/begin GROUP S3946_RAROTC "VBU0706/Task_10ms/Subsystem/VCU /TQO/TQOAll/TQDMP/TQDMP/RAROTC"
 /begin SUB_GROUP S3949_CalcSpdHiFre S3949_Foreback S3949_ROTCArbRA S3949_ROTCConidtion S3949_TorqueCal /end SUB_GROUP
/end GROUP
/begin GROUP S3989_MotorTorque "VBU0706/Task_10ms/Subsystem/VCU /TQO/TQOAll/TQO/TQO/MotorTorque" /begin SUB_GROUP S3990_ShftChange S3990_Subsystem /end SUB_GROUP /begin REF_CHARACTERISTIC TQO_pctSlopeShft_C TQO_tiShftDR_C TQO_tiShftOut_C /end REF_CHARACTERISTIC /begin REF_MEASUREMENT TQO_facFilter TQO_stShft /end REF_MEASUREMENT /end GROUP
/begin GROUP S3989_Subsystem "VBU0706/Task_10ms/Subsystem/VCU /TQO/TQOAll/TQO/TQO/Subsystem" /begin SUB_GROUP S3991_VirtualAPD /end SUB_GROUP /end GROUP
/begin GROUP S3989_Trq "VBU0706/Task_10ms/Subsystem/VCU /TQO/TQOAll/TQO/TQO/Trq" /begin SUB_GROUP S3992_TrqProtect /end SUB_GROUP /end GROUP
/begin GROUP S4003_TorqueRamp "VBU0706/Task_10ms/Subsystem/VCU /VTQA/Subsystem/Subsystem/MTrqLim/TorqueRamp" /begin REF_CHARACTERISTIC MTQL_trqDecLim_C MTQL_trqIncLim_C /end REF_CHARACTERISTIC /end GROUP
/begin GROUP S4003_TrqCapacityArb "VBU0706/Task_10ms/Subsystem/VCU /VTQA/Subsystem/Subsystem/MTrqLim/TrqCapacityArb"
 /begin REF_CHARACTERISTIC MTQL_trqMtrDrvLimOvrdVal_C MTQL_trqMtrDrvLimOvrd_C MTQL_trqMtrRgnLimOvrdVal_C MTQL_trqMtrRgnLimOvrd_C MTQL_trqPEURDrvLowLim_C MTQL_trqPEURDrvUpLim_C MTQL_trqPEURRgnLowLim_C MTQL_trqPEURRgnUpLim_C /end REF_CHARACTERISTIC
 /begin REF_MEASUREMENT MTQL_trqMtrDrvLim MTQL_trqMtrDrvLimRaw MTQL_trqMtrRgnLim MTQL_trqMtrRgnLimRaw /end REF_MEASUREMENT
/end GROUP
/begin GROUP S4003_TrqCapacityCal "VBU0706/Task_10ms/Subsystem/VCU /VTQA/Subsystem/Subsystem/MTrqLim/TrqCapacityCal" /begin REF_MEASUREMENT MTQL_trqRMotrMaxLim MTQL_trqRMotrMinLim /end REF_MEASUREMENT /end GROUP
/begin GROUP S4003_TrqCapacityLim "VBU0706/Task_10ms/Subsystem/VCU /VTQA/Subsystem/Subsystem/MTrqLim/TrqCapacityLim"
 /begin SUB_GROUP S4008_FIDTrqLim S4008_Motor_Inhibit S4008_VehicleSpeedLim S4008_dnLim /end SUB_GROUP
/end GROUP
/begin GROUP S4004_BattLim_Transfer "VBU0706/Task_10ms/Subsystem/VCU /VTQA/Subsystem/Subsystem/VehTrqArb/BattLim_Transfer" /begin SUB_GROUP S4017_AxleTrq_Limit_Calc S4017_Motor_PwrLoss_Calc /end SUB_GROUP /end GROUP
/begin GROUP S4004_Trq_Arb "VBU0706/Task_10ms/Subsystem/VCU /VTQA/Subsystem/Subsystem/VehTrqArb/Trq_Arb" /begin SUB_GROUP S4018_AlxeMax S4018_AlxeMin S4018_Arb /end SUB_GROUP /end GROUP
/begin GROUP S4046_APD1_Norm "VBU0706/Task_10ms/Subsystem/VCU /VehINP/VehINP_Logic/APD/APD/APD1_Norm" /begin REF_CHARACTERISTIC APD_uSetPoint1Max_C APD_uSetPoint1Min_C /end REF_CHARACTERISTIC /end GROUP
/begin GROUP S4046_APD2_Norm "VBU0706/Task_10ms/Subsystem/VCU /VehINP/VehINP_Logic/APD/APD/APD2_Norm" /begin REF_CHARACTERISTIC APD_uSetPoint2Max_C APD_uSetPoint2Min_C /end REF_CHARACTERISTIC /end GROUP
/begin GROUP S4046_APD_Dejitter1 "VBU0706/Task_10ms/Subsystem/VCU /VehINP/VehINP_Logic/APD/APD/APD_Dejitter1" /begin REF_CHARACTERISTIC APD_uJitterFil1_C APD_uSetPoint1Min_C /end REF_CHARACTERISTIC /end GROUP
/begin GROUP S4046_APD_Dejitter2 "VBU0706/Task_10ms/Subsystem/VCU /VehINP/VehINP_Logic/APD/APD/APD_Dejitter2" /begin REF_CHARACTERISTIC APD_uJitterFil2_C APD_uSetPoint2Min_C /end REF_CHARACTERISTIC /end GROUP
/begin GROUP S4046_APD_Override "VBU0706/Task_10ms/Subsystem/VCU /VehINP/VehINP_Logic/APD/APD/APD_Override"
 /begin REF_CHARACTERISTIC APD_efAccPedPos_C APD_flgAccPedPosPctVld_C APD_pctAccPedPosLimit_C APD_pctAccPedPosOverrideVal_C APD_pctAccPedPosOverride_C /end REF_CHARACTERISTIC
 /begin REF_MEASUREMENT APD_pctAccPedPos /end REF_MEASUREMENT
/end GROUP
/begin GROUP S4046_Diag_Ratio "VBU0706/Task_10ms/Subsystem/VCU /VehINP/VehINP_Logic/APD/APD/Diag_Ratio"
 /begin REF_CHARACTERISTIC APD_numPlausibilityDec_C APD_numPlausibilityInc_C APD_numPlausibilityLim_C APD_stNoErr_C APD_uThdDiff12_CUR_v /end REF_CHARACTERISTIC
 /begin REF_MEASUREMENT APD_flgDftRatioPlausibility /end REF_MEASUREMENT
/end GROUP
/begin GROUP S4046_Diag_Status "VBU0706/Task_10ms/Subsystem/VCU /VehINP/VehINP_Logic/APD/APD/Diag_Status" /begin REF_CHARACTERISTIC APD_stConfirmErr_C /end REF_CHARACTERISTIC /end GROUP
/begin GROUP S4046_Value_Selection "VBU0706/Task_10ms/Subsystem/VCU /VehINP/VehINP_Logic/APD/APD/Value_Selection" /begin SUB_GROUP S4054_PedalPercentSelection S4054_PedalSelection /end SUB_GROUP /end GROUP
/begin GROUP S4087_Digital_Gear_D_R "VBU0706/Task_10ms/Subsystem/VCU /VehINP/VehINP_Logic/GearShift/Gear1/Digital_Gear_D_R"
 /begin SUB_GROUP S4088_Gear4DriveIntend S4088_Gear_Bit S4088_Gear_DR_Req S4088_Gear_DR_Warning S4088_Gear_RawReq S4088_Gear_Warning /end SUB_GROUP
/end GROUP
/begin GROUP S4087_Gear_BrakeCondition "VBU0706/Task_10ms/Subsystem/VCU /VehINP/VehINP_Logic/GearShift/Gear1/Gear_BrakeCondition" /begin REF_CHARACTERISTIC Gear_flgBrkPressConfig_C Gear_pctBrkPosPressed_C /end REF_CHARACTERISTIC /begin REF_MEASUREMENT Gear_flgBrkPrssed /end REF_MEASUREMENT /end GROUP
/begin GROUP S4087_Gear_DriverShiftPReq "VBU0706/Task_10ms/Subsystem/VCU /VehINP/VehINP_Logic/GearShift/Gear1/Gear_DriverShiftPReq"
 /begin REF_CHARACTERISTIC Gear_stEPBApplyReq_C Gear_stEPBNoApplyReq_C Gear_stIntendGearP_C /end REF_CHARACTERISTIC
/end GROUP
/begin GROUP S4087_Gear_EPBStatus "VBU0706/Task_10ms/Subsystem/VCU /VehINP/VehINP_Logic/GearShift/Gear1/Gear_EPBStatus"
 /begin REF_CHARACTERISTIC Gear_stEPBApplied_C Gear_stEPBReleased_C Veh_flgNetworkPartialEn_C Veh_stCGWNetworkPartial_C /end REF_CHARACTERISTIC
/end GROUP
/begin GROUP S4087_Gear_ExternalReq "VBU0706/Task_10ms/Subsystem/VCU /VehINP/VehINP_Logic/GearShift/Gear1/Gear_ExternalReq" /begin REF_CHARACTERISTIC Gear_tiGearDebounceCnt_C Gear_tiSampleTime_C /end REF_CHARACTERISTIC /end GROUP
/begin GROUP S4087_Gear_P "VBU0706/Task_10ms/Subsystem/VCU /VehINP/VehINP_Logic/GearShift/Gear1/Gear_P"
 /begin REF_CHARACTERISTIC Gear_stBCUEPBSwtPressed_C Gear_tiGearPSwitchDebounceCnt_C Gear_tiSampleTime_C /end REF_CHARACTERISTIC
/end GROUP
/begin GROUP S4087_Gear_ProtectCondition "VBU0706/Task_10ms/Subsystem/VCU /VehINP/VehINP_Logic/GearShift/Gear1/Gear_ProtectCondition"
 /begin REF_CHARACTERISTIC Gear_flgEmotTqSelect_C Gear_flgTorqueProtectEn_C Gear_stCurrentGearD_C Gear_stCurrentGearR_C Gear_tiSampleTime_C Gear_tiShiftEnableCnt_C Gear_trqShiftDriveEnableLe_C Gear_trqShiftDriveEnableRi_C /end REF_CHARACTERISTIC
/end GROUP
/begin GROUP S4087_Gear_Status "VBU0706/Task_10ms/Subsystem/VCU /VehINP/VehINP_Logic/GearShift/Gear1/Gear_Status"
 /begin SUB_GROUP S4096_Gear4Reset S4096_Gear_DGear S4096_Gear_DefaultGear S4096_Gear_DriverShiftDReq S4096_Gear_DriverShiftRReq S4096_Gear_GearReq S4096_Gear_InitGear S4096_Gear_PGear S4096_Gear_PGear1 S4096_Gear_Powertrain S4096_Gear_RGear /end SUB_GROUP
/end GROUP
/begin GROUP S4087_Gear_VehSpeed "VBU0706/Task_10ms/Subsystem/VCU /VehINP/VehINP_Logic/GearShift/Gear1/Gear_VehSpeed"
 /begin REF_CHARACTERISTIC Gear_vForce2NThreshold_C Gear_vGearDLowThreshold_C Gear_vGearDMiThreshold_C Gear_vGearPThreshold_C /end REF_CHARACTERISTIC
/end GROUP
/begin GROUP S4087_Gear_VehicleStatus "VBU0706/Task_10ms/Subsystem/VCU /VehINP/VehINP_Logic/GearShift/Gear1/Gear_VehicleStatus" /begin REF_CHARACTERISTIC Gear_stHVRelayClosed_C Gear_stVehModeDCH_C /end REF_CHARACTERISTIC /begin REF_MEASUREMENT Gear_flgGearShiftReady /end REF_MEASUREMENT /end GROUP
/begin GROUP S4205_Veh_CreepMode "VBU0706/Task_10ms/Subsystem/VCU /VehINP/VehINP_Logic/Mode/VehMode/Veh_CreepMode" /begin SUB_GROUP S4207_override_signal1 /end SUB_GROUP
 /begin REF_CHARACTERISTIC CDC_stVehCreepON_C CDC_stVehCreepOff_C CGW_flgVehCreepModeCaliOvrd_C CGW_stVehCreepModeCaliOvrdVal_C CGW_stVehCreepOff_C CGW_stVehCreepOn_C Veh_tiModeDebTime_C Veh_tiModeSampleTime_C /end REF_CHARACTERISTIC
/end GROUP
/begin GROUP S4205_Veh_DrvMode "VBU0706/Task_10ms/Subsystem/VCU /VehINP/VehINP_Logic/Mode/VehMode/Veh_DrvMode"
 /begin REF_CHARACTERISTIC CDC_stVehAccrNormalMod_C CDC_stVehAccrSportMod_C CDC_stVehAutoMod_C CDC_stVehECOMod_C CGW_flgVehDrvModeCaliOvrd_C CGW_stVehDrvModeCaliOvrdVal_C CGW_stVehECOMod_C CGW_stVehNormalMod_C CGW_stVehSportMod_C Veh_tiModeDebTime_C Veh_tiModeSampleTime_C /end REF_CHARACTERISTIC
/end GROUP
/begin GROUP S4205_Veh_RgnMode "VBU0706/Task_10ms/Subsystem/VCU /VehINP/VehINP_Logic/Mode/VehMode/Veh_RgnMode"
 /begin REF_CHARACTERISTIC CDC_stVehCreepOffRgnOff_C CDC_stVehCreepOnRgnLow_C CDC_stVehCreepOnRgnNormal_C CDC_stVehCreepOnRgnZero_C CGW_flgVehRgnModeCaliOvrd_C CGW_stVehRgnLow_C CGW_stVehRgnModeCaliOvrdVal_C CGW_stVehRgnNormal_C CGW_stVehRgnOff_C CGW_stVehRgnZero_C Veh_tiModeDebTime_C Veh_tiModeSampleTime_C /end REF_CHARACTERISTIC
/end GROUP
/begin GROUP S4248_BPD_BrakePercentStatus "VBU0706/Task_10ms/Subsystem/VCU /VehINP/VehINP_Logic/VehINP_BPD/BPD_BrakePercent/BPD_BrakePercentStatus"
 /begin REF_CHARACTERISTIC BPD_pctBrkPedalDownStep_C BPD_pctBrkPedalPressedZero_C BPD_pctBrkPedalPressed_C /end REF_CHARACTERISTIC
 /begin REF_MEASUREMENT BPD_pctBrkPressPercent /end REF_MEASUREMENT
/end GROUP
/begin GROUP S4248_BPD_PressBrake "VBU0706/Task_10ms/Subsystem/VCU /VehINP/VehINP_Logic/VehINP_BPD/BPD_BrakePercent/BPD_PressBrake" /begin SUB_GROUP S4253_First_Order_Low_Pass_Filter /end SUB_GROUP
 /begin REF_CHARACTERISTIC BCU_pBrkPres BPD_facBrkPresVoltFilt_C BPD_pctBrkPress_CUR_v /end REF_CHARACTERISTIC
 /begin REF_MEASUREMENT BPD_pBrkPress BPD_pctBrkPress /end REF_MEASUREMENT
/end GROUP
/begin GROUP S4249_BPD_BrakeSwitchHW "VBU0706/Task_10ms/Subsystem/VCU /VehINP/VehINP_Logic/VehINP_BPD/BPD_BrakeSwitch/BPD_BrakeSwitchHW" /begin REF_CHARACTERISTIC BPD_numHWBrkSwtDebounce_C /end REF_CHARACTERISTIC /end GROUP
/begin GROUP S4249_BPD_BrakeSwitchSelect "VBU0706/Task_10ms/Subsystem/VCU /VehINP/VehINP_Logic/VehINP_BPD/BPD_BrakeSwitch/BPD_BrakeSwitchSelect"
 /begin REF_CHARACTERISTIC BPD_stBrkPedPrsActv_C BPD_stBrkPedPrsPsbl_C BPD_stBrkSwtConfig_C /end REF_CHARACTERISTIC
 /begin REF_MEASUREMENT BPD_flgMainBrkSwt BPD_stBrkPedSwtRaw /end REF_MEASUREMENT
/end GROUP
/begin GROUP S4251_override_signal1 "VBU0706/Task_10ms/Subsystem/VCU /VehINP/VehINP_Logic/VehINP_BPD/VehINP_BrkPedOverride/override_signal1" /begin REF_MEASUREMENT BPD_pctBrkPos /end REF_MEASUREMENT /end GROUP
/begin GROUP S4251_override_signal4 "VBU0706/Task_10ms/Subsystem/VCU /VehINP/VehINP_Logic/VehINP_BPD/VehINP_BrkPedOverride/override_signal4" /begin REF_MEASUREMENT BPD_stBrkSwt /end REF_MEASUREMENT /end GROUP
/begin GROUP S4268_HVIL "VBU0706/Task_10ms/Subsystem/VCU /VehINP/VehINP_Logic/Veh_Status/VehHVIL/HVIL" /begin SUB_GROUP S4269_Veh_HVILCheck S4269_Veh_VCUHVIL /end SUB_GROUP /end GROUP
/begin GROUP S336_Calculate_Current_ZeroDruft "VBU0706/Function-Call Subsystem/Subsystem1/BCV/BCV/Subsystem/Calculate_BatteryCurrent/Correct_BatteryCurrent/Calculate_BatteryCurrent_ZeroDrift/Calculate_Current_ZeroDruft" /begin SUB_GROUP S338_Enabled_Subsystem /end SUB_GROUP /begin REF_CHARACTERISTIC CcBCV_BatteryCurrentZeroDriftTime_ms /end REF_CHARACTERISTIC /end GROUP
/begin GROUP S336_Calculate_ExtremeData "VBU0706/Function-Call Subsystem/Subsystem1/BCV/BCV/Subsystem/Calculate_BatteryCurrent/Correct_BatteryCurrent/Calculate_BatteryCurrent_ZeroDrift/Calculate_ExtremeData" /begin SUB_GROUP S339_Enabled_Subsystem /end SUB_GROUP /end GROUP
/begin GROUP S472_BigDataMonitor_Handler "VBU0706/Function-Call Subsystem/Subsystem1/BCV/BCV/Subsystem/Monitor_BCV_Performance/Diagnose_BDM_BCV_Communication_Fault/Diagnose_BdmOutOfRange_Fault/BigDataMonitor_Handler" /begin SUB_GROUP S473_DetermineFault S473_DetermineFaultCounter /end SUB_GROUP /end GROUP
/begin GROUP S472_BigDataMonitor_Handler1 "VBU0706/Function-Call Subsystem/Subsystem1/BCV/BCV/Subsystem/Monitor_BCV_Performance/Diagnose_BDM_BCV_Communication_Fault/Diagnose_BdmOutOfRange_Fault/BigDataMonitor_Handler1" /begin SUB_GROUP S474_DetermineFault S474_DetermineFaultCounter /end SUB_GROUP /end GROUP
/begin GROUP S483_BigDataMonitor_Handler1 "VBU0706/Function-Call Subsystem/Subsystem1/BCV/BCV/Subsystem/Monitor_BCV_Performance/Diagnose_BDM_BCV_Data_Fault/Diagnose_BdmBatteryBusVoltageMismatch_Fault/BigDataMonitor_Handler1" /begin SUB_GROUP S485_DetermineFault S485_DetermineFaultCounter /end SUB_GROUP /end GROUP
/begin GROUP S484_BigDataMonitor_Handler "VBU0706/Function-Call Subsystem/Subsystem1/BCV/BCV/Subsystem/Monitor_BCV_Performance/Diagnose_BDM_BCV_Data_Fault/Diagnose_BdmVoltageCurrent_Fault/BigDataMonitor_Handler" /begin SUB_GROUP S491_DetermineFault S491_DetermineFaultCounter /end SUB_GROUP /end GROUP
/begin GROUP S484_BigDataMonitor_Handler1 "VBU0706/Function-Call Subsystem/Subsystem1/BCV/BCV/Subsystem/Monitor_BCV_Performance/Diagnose_BDM_BCV_Data_Fault/Diagnose_BdmVoltageCurrent_Fault/BigDataMonitor_Handler1" /begin SUB_GROUP S492_DetermineFault S492_DetermineFaultCounter /end SUB_GROUP /end GROUP
/begin GROUP S484_BigDataMonitor_Handler2 "VBU0706/Function-Call Subsystem/Subsystem1/BCV/BCV/Subsystem/Monitor_BCV_Performance/Diagnose_BDM_BCV_Data_Fault/Diagnose_BdmVoltageCurrent_Fault/BigDataMonitor_Handler2" /begin SUB_GROUP S493_DetermineFault S493_DetermineFaultCounter /end SUB_GROUP /end GROUP
/begin GROUP S734_Determine_Accumulated_RemainingHeat "VBU0706/Function-Call Subsystem/Subsystem1/CTD/Subsystem/Subsystem4/PrechrgProcessMonitoring/Precharge_Thermal_Management/Determine_Precharge_JouleHeat/Determine_Accumulated_RemainingHeat"
 /begin SUB_GROUP S736_Determine_Accumulated_Cooling S736_Determine_Accumulated_RemainingHeat /end SUB_GROUP
/end GROUP
/begin GROUP S756_Determine_Diagnostic_Status "VBU0706/Function-Call Subsystem/Subsystem1/CTD/Subsystem/Subsystem4/Stuck_Open_Diagnostic/MNC_Stuck_Open/MNC_Stuck_Open_With_VehicleSpeed/Determine_Diagnostic_Status" /begin REF_MEASUREMENT CTD_stMnNegContactorStuckOpenDiagnosticStatus /end REF_MEASUREMENT /end GROUP
/begin GROUP S780_Determine_Diagnostic_Status "VBU0706/Function-Call Subsystem/Subsystem1/CTD/Subsystem/Subsystem4/Stuck_Open_Diagnostic/MPC_Stuck_Open/MPC_Stuck_Open_Without_VehicleSpeed/Determine_Diagnostic_Status" /begin REF_MEASUREMENT CTD_stMnPosContactorStuckOpenDiagnosticStatus /end REF_MEASUREMENT /end GROUP
/begin GROUP S1057_Turn_Off_Delay_Time "VBU0706/Function-Call Subsystem/Subsystem1/FCC /DCH_Overall/DCH_DCChargeCtrlOverall/DCH_DCChargeCtrlStateflow/DCH_InputSignalPreProcess/DCH_BMSChAvlDebounce/Turn_Off_Delay_Time" /begin REF_MEASUREMENT DCH_flgBmsChAvl /end REF_MEASUREMENT /end GROUP
/begin GROUP S1058_Turn_Off_Delay_Time2 "VBU0706/Function-Call Subsystem/Subsystem1/FCC /DCH_Overall/DCH_DCChargeCtrlOverall/DCH_DCChargeCtrlStateflow/DCH_InputSignalPreProcess/DCH_DCRelayCloseDiagnose/Turn_Off_Delay_Time2" /begin REF_MEASUREMENT DCH_flgDCChRlyCloseSt /end REF_MEASUREMENT /end GROUP
/begin GROUP S1059_Turn_Off_Delay_Time2 "VBU0706/Function-Call Subsystem/Subsystem1/FCC /DCH_Overall/DCH_DCChargeCtrlOverall/DCH_DCChargeCtrlStateflow/DCH_InputSignalPreProcess/DCH_VehStateAnalyze/Turn_Off_Delay_Time2" /begin REF_MEASUREMENT DCH_flgAPlusWkup /end REF_MEASUREMENT /end GROUP
/begin GROUP S1220_Override_Block3 "VBU0706/Function-Call Subsystem/Subsystem1/FCC /FCC/Subsystem/Determine_Fastcharge_Request/Charge_Request_Protection/Override_Voltage_Request/Override_Block3" /begin REF_CHARACTERISTIC CbFCC_ChargeVoltageOvR_flg CcFCC_ChargeVoltageOvRValue_V /end REF_CHARACTERISTIC /end GROUP
/begin GROUP S1228_Delay_FallingEdge "VBU0706/Function-Call Subsystem/Subsystem1/FCC /FCC/Subsystem/Determine_Fastcharge_Request/DetermineComputeResistancePulseCurrent/Determine_ComputeResistanceCondition/Delay_FallingEdge" /begin REF_MEASUREMENT FCC_flgComputeResistancePulseCurrentEnable /end REF_MEASUREMENT /end GROUP
/begin GROUP S1228_RS_Flip_Flop "VBU0706/Function-Call Subsystem/Subsystem1/FCC /FCC/Subsystem/Determine_Fastcharge_Request/DetermineComputeResistancePulseCurrent/Determine_ComputeResistanceCondition/RS Flip-Flop" /begin REF_MEASUREMENT FCC_flgComputeResistanceEnable /end REF_MEASUREMENT /end GROUP
/begin GROUP S1228_S_H "VBU0706/Function-Call Subsystem/Subsystem1/FCC /FCC/Subsystem/Determine_Fastcharge_Request/DetermineComputeResistancePulseCurrent/Determine_ComputeResistanceCondition/S&H" /begin REF_MEASUREMENT FCC_flgComputeResistanceStart /end REF_MEASUREMENT /end GROUP
/begin GROUP S1257_FullCharge_criteria1 "VBU0706/Function-Call Subsystem/Subsystem1/FCC /FCC/Subsystem/Fastcharge_Conditions_Check/Condition_Categorize/Full_Charge_Determination/FullCharge_criteria1"
 /begin REF_CHARACTERISTIC CaFCC_FullChargeVoltageHysteresisMapDimension_n CaFCC_FullChargeVoltageHysteresisMapZ_mV CaFCC_FullChargeVoltageSOHAttenuationMapDimension_n CaFCC_FullChargeVoltageSOHAttenuationMapZ_mV CaSYS_FullChargeOcvMapDimension_n CaSYS_FullChargeOcvMapZ_mV CcFCC_FullChargeOcvDebounceTime_s CcSYS_FullChargeOcv_mV /end REF_CHARACTERISTIC
 /begin REF_MEASUREMENT FCC_flgFullChargeCellVoltageCriteria FCC_mvFullChargeCellVoltage FCC_mvFullChargeDisbaleCellVoltage /end REF_MEASUREMENT
/end GROUP
/begin GROUP S1257_FullCharge_criteria2 "VBU0706/Function-Call Subsystem/Subsystem1/FCC /FCC/Subsystem/Fastcharge_Conditions_Check/Condition_Categorize/Full_Charge_Determination/FullCharge_criteria2"
 /begin REF_CHARACTERISTIC CcFCC_FullChargeOcvDebounceTime_s CcFCC_FullChargePackVoltageDelta_V CcSYS_FullChargeOcv_mV /end REF_CHARACTERISTIC
 /begin REF_MEASUREMENT FCC_flgFullChargePackVoltageCriteria /end REF_MEASUREMENT
/end GROUP
/begin GROUP S1257_FullCharge_criteria4 "VBU0706/Function-Call Subsystem/Subsystem1/FCC /FCC/Subsystem/Fastcharge_Conditions_Check/Condition_Categorize/Full_Charge_Determination/FullCharge_criteria4"
 /begin REF_CHARACTERISTIC CcFCC_BatteryCapacityCycleHomo_n CcFCC_FullChargeSocDebounceTime_s CcFCC_FullChargeSocDelta_pct CcFCC_HomoFullChargeSoc_pct /end REF_CHARACTERISTIC
 /begin REF_MEASUREMENT FCC_flgFullChargeSOCCriteria /end REF_MEASUREMENT
/end GROUP
/begin GROUP S1588_Determine_CurrentStable_Condition "VBU0706/Function-Call Subsystem/Subsystem1/SOC/Subsystem5/Subsystem/Determine_FastChargeCorrection_Soc/FastCharge_DynamicCorrection/FastCharge_DynamicCorrection_Enable/Determine_CurrentStable_Condition" /begin SUB_GROUP S1590_Delay_RisingEdge /end SUB_GROUP
 /begin REF_CHARACTERISTIC CcSOC_CurrentStableThresholdRate_pct CcSOC_CurrentStableTime_ms /end REF_CHARACTERISTIC
/end GROUP
/begin GROUP S1588_VoltThldEdge "VBU0706/Function-Call Subsystem/Subsystem1/SOC/Subsystem5/Subsystem/Determine_FastChargeCorrection_Soc/FastCharge_DynamicCorrection/FastCharge_DynamicCorrection_Enable/VoltThldEdge" /begin REF_MEASUREMENT VoltThld_flg /end REF_MEASUREMENT /end GROUP
/begin GROUP S1588_VoltThldEdge1 "VBU0706/Function-Call Subsystem/Subsystem1/SOC/Subsystem5/Subsystem/Determine_FastChargeCorrection_Soc/FastCharge_DynamicCorrection/FastCharge_DynamicCorrection_Enable/VoltThldEdge1" /begin REF_MEASUREMENT VoltThld1_flg /end REF_MEASUREMENT /end GROUP
/begin GROUP S1600_FastCharge_PreCorrectionSOC "VBU0706/Function-Call Subsystem/Subsystem1/SOC/Subsystem5/Subsystem/Determine_FastChargeCorrection_Soc/FastCharge_PreCorrection/FastCharge_PreCorrectionMain/FastCharge_PreCorrectionSOC" /begin REF_CHARACTERISTIC CcSOC_FastChargePreCorrectionSOC_pct /end REF_CHARACTERISTIC /end GROUP
/begin GROUP S1600_FastCharge_PreCorrectionVoltage "VBU0706/Function-Call Subsystem/Subsystem1/SOC/Subsystem5/Subsystem/Determine_FastChargeCorrection_Soc/FastCharge_PreCorrection/FastCharge_PreCorrectionMain/FastCharge_PreCorrectionVoltage" /begin SUB_GROUP S1604_FastCharge_TOCAdjustAllSOC /end SUB_GROUP /begin REF_CHARACTERISTIC CcSOC_FastChargePreCorrectionSOC_pct /end REF_CHARACTERISTIC /end GROUP
/begin GROUP S1738_Power_Limit_Level1_ChargePowerLimit "VBU0706/Function-Call Subsystem/Subsystem1/SOF/Subsystem6/Subsystem/Calculate_PowerLimit/Determine_Capacity_Cycle_PowerLimit/Power_Limit_Cycle_Level1/Power_Limit_Level1_ChargePowerLimit"
 /begin REF_CHARACTERISTIC CcSOF_CyclePowerLimitCharge_Kw CcSOF_CyclePowerLimitLevel1SOCMax_pct CcSOF_CyclePowerLimitMax_Kw /end REF_CHARACTERISTIC
/end GROUP
/begin GROUP S1738_Power_Limit_Level1_DischargePowerLimit "VBU0706/Function-Call Subsystem/Subsystem1/SOF/Subsystem6/Subsystem/Calculate_PowerLimit/Determine_Capacity_Cycle_PowerLimit/Power_Limit_Cycle_Level1/Power_Limit_Level1_DischargePowerLimit"
 /begin REF_CHARACTERISTIC CcSOF_CyclePowerLimitLevel1Discharge_Kw CcSOF_CyclePowerLimitLevel1SOCMin_pct CcSOF_CyclePowerLimitMax_Kw /end REF_CHARACTERISTIC
/end GROUP
/begin GROUP S1739_Power_Limit_Cycle_Level2_ChargePowerLimit "VBU0706/Function-Call Subsystem/Subsystem1/SOF/Subsystem6/Subsystem/Calculate_PowerLimit/Determine_Capacity_Cycle_PowerLimit/Power_Limit_Cycle_Level2/Power_Limit_Cycle_Level2_ChargePowerLimit"
 /begin REF_CHARACTERISTIC CcSOF_CyclePowerLimitCharge_Kw CcSOF_CyclePowerLimitLevel2SOCMax_pct CcSOF_CyclePowerLimitMax_Kw /end REF_CHARACTERISTIC
/end GROUP
/begin GROUP S1739_Power_Limit_Cycle_Level2_DischargePowerLimit "VBU0706/Function-Call Subsystem/Subsystem1/SOF/Subsystem6/Subsystem/Calculate_PowerLimit/Determine_Capacity_Cycle_PowerLimit/Power_Limit_Cycle_Level2/Power_Limit_Cycle_Level2_DischargePowerLimit"
 /begin REF_CHARACTERISTIC CcSOF_CyclePowerLimitLevel2Discharge_Kw CcSOF_CyclePowerLimitLevel2SOCMin_pct CcSOF_CyclePowerLimitMax_Kw /end REF_CHARACTERISTIC
/end GROUP
/begin GROUP S1740_Power_Limit_Cycle_Level3_ChargePowerLimit "VBU0706/Function-Call Subsystem/Subsystem1/SOF/Subsystem6/Subsystem/Calculate_PowerLimit/Determine_Capacity_Cycle_PowerLimit/Power_Limit_Cycle_Level3/Power_Limit_Cycle_Level3_ChargePowerLimit"
 /begin REF_CHARACTERISTIC CcSOF_CyclePowerLimitCharge_Kw CcSOF_CyclePowerLimitLevel3SOCMax_pct CcSOF_CyclePowerLimitMax_Kw /end REF_CHARACTERISTIC
/end GROUP
/begin GROUP S1740_Power_Limit_Cycle_Level3_DischargePowerLimit "VBU0706/Function-Call Subsystem/Subsystem1/SOF/Subsystem6/Subsystem/Calculate_PowerLimit/Determine_Capacity_Cycle_PowerLimit/Power_Limit_Cycle_Level3/Power_Limit_Cycle_Level3_DischargePowerLimit"
 /begin REF_CHARACTERISTIC CcSOF_CyclePowerLimitLevel2SOCMin_pct CcSOF_CyclePowerLimitLevel3Discharge1_Kw CcSOF_CyclePowerLimitLevel3Discharge2_Kw CcSOF_CyclePowerLimitLevel3SOCMin_pct CcSOF_CyclePowerLimitMax_Kw /end REF_CHARACTERISTIC
/end GROUP
/begin GROUP S1748_Determine_SOCP_Condition "VBU0706/Function-Call Subsystem/Subsystem1/SOF/Subsystem6/Subsystem/Calculate_PowerLimit/Determine_SOCP_PowerLimit/Determine_ContinuousDischargePowerLimitTarget/Determine_SOCP_Condition"
 /begin REF_CHARACTERISTIC CcSOF_SocpDischargeSocDebounce_pct CcSOF_SocpModeDebounceTime_ms /end REF_CHARACTERISTIC
/end GROUP
/begin GROUP S1749_Determine_SOCP_Condition "VBU0706/Function-Call Subsystem/Subsystem1/SOF/Subsystem6/Subsystem/Calculate_PowerLimit/Determine_SOCP_PowerLimit/Determine_DischargePowerLimitTarget/Determine_SOCP_Condition"
 /begin REF_CHARACTERISTIC CcSOF_SocpDischargeSocDebounce_pct CcSOF_SocpModeDebounceTime_ms /end REF_CHARACTERISTIC
/end GROUP
/begin GROUP S1763_Calculate_ContinuousChargeCurrent "VBU0706/Function-Call Subsystem/Subsystem1/SOF/Subsystem6/Subsystem/Determine_Currentlimit_Target/Calculate_CurrentLimit_Target/Calculate_CurrentLimit_Base/Calculate_ContinuousChargeCurrent"
 /begin SUB_GROUP S1769_Calculate_Locked_SOC S1769_Calculate_Locked_SOC1 S1769_Calculate_Locked_SOC2 S1769_Calculate_SOH_Current_Limit /end SUB_GROUP
 /begin REF_CHARACTERISTIC CaSOF_ContinuousChargeEolMap_v CaSOF_ContinuousChargeFactorMap_v CaSOF_ContinuousChargeHomoMap_v CaSOF_ContinuousChargeLockedHomoMap_v CaSOF_ContinuousChargeLockedSocTempMapZ_A CaSOF_ContinuousChargeSocTempMapZ_A CcSOF_BaseCurrentLimitFactor_pct CcSOF_BatteryCycleHomo_n CcSOF_UseSohLimitEnable_flg /end REF_CHARACTERISTIC
 /begin REF_MEASUREMENT SOF_facContinuousChargeFactor SOF_iAContinuousChargeCurrentBaseRaw SOF_iAContinuousChargeCurrentLimitMapBaseNormal /end REF_MEASUREMENT
/end GROUP
/begin GROUP S1763_Calculate_ContinuousDischargeCurrent "VBU0706/Function-Call Subsystem/Subsystem1/SOF/Subsystem6/Subsystem/Determine_Currentlimit_Target/Calculate_CurrentLimit_Target/Calculate_CurrentLimit_Base/Calculate_ContinuousDischargeCurrent"
 /begin SUB_GROUP S1770_Calculate_Locked_SOC S1770_Calculate_Locked_SOC1 S1770_Calculate_SOH_Current_Limit /end SUB_GROUP
 /begin REF_CHARACTERISTIC CaSOF_ContinuousDischargeEolSocTempMapDimension_n CaSOF_ContinuousDischargeEolSocTempMapZ_A CaSOF_ContinuousDischargeLockedSocTempMapDimension_n CaSOF_ContinuousDischargeLockedSocTempMapZ_A CaSOF_ContinuousDischargeSocTempMapDimension_n CaSOF_ContinuousDischargeSocTempMapZ_A CcSOF_BaseCurrentLimitFactor_pct CcSOF_UseSohLimitEnable_flg /end REF_CHARACTERISTIC
/end GROUP
/begin GROUP S1763_Calculate_ShortPulseChargeCurrent "VBU0706/Function-Call Subsystem/Subsystem1/SOF/Subsystem6/Subsystem/Determine_Currentlimit_Target/Calculate_CurrentLimit_Target/Calculate_CurrentLimit_Base/Calculate_ShortPulseChargeCurrent"
 /begin SUB_GROUP S1771_Calculate_Locked_SOC S1771_Calculate_Locked_SOC1 S1771_Calculate_SOH_Current_Limit /end SUB_GROUP
 /begin REF_CHARACTERISTIC CaSOF_ShortPulseChargeEolSocTempMapDimension_n CaSOF_ShortPulseChargeEolSocTempMapZ_A CaSOF_ShortPulseChargeLockedSocTempMapDimension_n CaSOF_ShortPulseChargeLockedSocTempMapZ_A CaSOF_ShortPulseChargeSocTempMapDimension_n CaSOF_ShortPulseChargeSocTempMapZ_A CcSOF_BaseCurrentLimitFactor_pct CcSOF_UseSohLimitEnable_flg /end REF_CHARACTERISTIC
 /begin REF_MEASUREMENT SOF_iAShortPulseChargeCurrentLimitMapBaseNormal /end REF_MEASUREMENT
/end GROUP
/begin GROUP S1763_Calculate_ShortPulseDischargeCurrent "VBU0706/Function-Call Subsystem/Subsystem1/SOF/Subsystem6/Subsystem/Determine_Currentlimit_Target/Calculate_CurrentLimit_Target/Calculate_CurrentLimit_Base/Calculate_ShortPulseDischargeCurrent"
 /begin SUB_GROUP S1772_Calculate_Locked_SOC S1772_Calculate_Locked_SOC1 S1772_Calculate_SOH_Current_Limit /end SUB_GROUP
 /begin REF_CHARACTERISTIC CaSOF_ShortPulseDischargeEolSocTempMapDimension_n CaSOF_ShortPulseDischargeEolSocTempMapZ_A CaSOF_ShortPulseDischargeLockedSocTempMapDimension_n CaSOF_ShortPulseDischargeLockedSocTempMapZ_A CaSOF_ShortPulseDischargeSocTempMapDimension_n CaSOF_ShortPulseDischargeSocTempMapZ_A CcSOF_BaseCurrentLimitFactor_pct CcSOF_UseSohLimitEnable_flg /end REF_CHARACTERISTIC
 /begin REF_MEASUREMENT SOF_iAShortPulseDischargeCurrentLimitBase /end REF_MEASUREMENT
/end GROUP
/begin GROUP S1763_Determine_LowVoltageLimitChargeCurrent "VBU0706/Function-Call Subsystem/Subsystem1/SOF/Subsystem6/Subsystem/Determine_Currentlimit_Target/Calculate_CurrentLimit_Target/Calculate_CurrentLimit_Base/Determine_LowVoltageLimitChargeCurrent" /begin SUB_GROUP S1775_RS_FlipFlop_EEPROM /end SUB_GROUP
 /begin REF_CHARACTERISTIC CcSOF_LowVoltageAbnormalPowerOnDelay_ms CcSOF_LowVoltageResetSOC_pct CcSOF_LowVoltageSetCurrentDelay_ms CcSOF_LowVoltageSetCurrent_A CcSOF_LowVoltageSetSOC_pct CcSOF_LowVoltageSetTime_s CcSOF_LowVoltageSetVolt2Delta_mV CcSOF_LowVoltageSetVolt2_mV CcSOF_LowVoltageSetVolt_mV CcSOF_LowVoltageSetVoltageDelay_ms /end REF_CHARACTERISTIC
 /begin REF_MEASUREMENT EcSOF_LowVoltageStartTime_s SOF_flgLowVoltageState /end REF_MEASUREMENT
/end GROUP
/begin GROUP S1764_Calculate_Dynamic_ChargeCurrentLimit "VBU0706/Function-Call Subsystem/Subsystem1/SOF/Subsystem6/Subsystem/Determine_Currentlimit_Target/Calculate_CurrentLimit_Target/Calculate_Dynamic_CurrentLimit/Calculate_Dynamic_ChargeCurrentLimit"
 /begin SUB_GROUP S1814_Calculate_ChargeCurrentLimit_Buff S1814_Calculate_Dynamic_ChargeCurrentLimit /end SUB_GROUP
/end GROUP
/begin GROUP S1764_Calculate_Dynamic_DischargeCurrentLimit "VBU0706/Function-Call Subsystem/Subsystem1/SOF/Subsystem6/Subsystem/Determine_Currentlimit_Target/Calculate_CurrentLimit_Target/Calculate_Dynamic_CurrentLimit/Calculate_Dynamic_DischargeCurrentLimit"
 /begin SUB_GROUP S1815_Calculate_DischargeCurrentLimit_Buff S1815_Calculate_Dynamic_DischargeCurrentLimit /end SUB_GROUP
/end GROUP
/begin GROUP S1765_FastChrgOneThirdRateCurrentLimitCheck "VBU0706/Function-Call Subsystem/Subsystem1/SOF/Subsystem6/Subsystem/Determine_Currentlimit_Target/Calculate_CurrentLimit_Target/CurrentLimit_FastCharge_Check/FastChrgOneThirdRateCurrentLimitCheck" /begin SUB_GROUP S1835_FCC_CHARGE_MODE1 S1835_Rate_Limiter_Reset /end SUB_GROUP
 /begin REF_CHARACTERISTIC CaSOF_ContinuousChargeSocTempMapZ_A CaSOF_FastChargeCurrentDropBOLCellVoltageDimension_n CaSOF_FastChargeCurrentDropBOLCellVoltageMapZ_mV CaSOF_FastChargeCurrentDropEOLCellVoltageDimension_n CaSOF_FastChargeCurrentDropEOLCellVoltageMapZ_mV CcSOF_FastChargeCellVoltageSOCLimit_pct CcSOF_FastChargeSOCLimit_pct CcSOF_FccOneThirdCurtSloDelay_ms CcSOF_FccOneThirdRateCurtSlope_A /end REF_CHARACTERISTIC
 /begin REF_MEASUREMENT SOF_flgFastChrgOneThirdRateCurrentLimit SOF_mvFastChargeCurrentDropCellVoltage /end REF_MEASUREMENT
/end GROUP
/begin GROUP S1765_SegmentChargeCheck "VBU0706/Function-Call Subsystem/Subsystem1/SOF/Subsystem6/Subsystem/Determine_Currentlimit_Target/Calculate_CurrentLimit_Target/CurrentLimit_FastCharge_Check/SegmentChargeCheck" /begin SUB_GROUP S1836_FCC_CHARGE_MODE1 S1836_FastCharge /end SUB_GROUP
 /begin REF_MEASUREMENT SOF_iAContinuousChargeCurrentLimitFastChrgChkRaw SOF_iAContinuousDischargeCurrentLimitFastChrgChk SOF_iAShortPulseChargeCurrentLimitFastChrgChk SOF_iAShortPulseDischargeCurrentLimitFastChrgChk /end REF_MEASUREMENT
/end GROUP
/begin GROUP S1766_CAT4 "VBU0706/Function-Call Subsystem/Subsystem1/SOF/Subsystem6/Subsystem/Determine_Currentlimit_Target/Calculate_CurrentLimit_Target/CurrentLimit_Fault_Correct/CAT4"
 /begin REF_CHARACTERISTIC CcSOF_ContinuousChargeCurrentLimp_A CcSOF_ContinuousDischargeCurrentLimp_A CcSOF_DynamicChargeCurrentLimp_A CcSOF_DynamicDischargeCurrentLimp_A CcSOF_ShortPulseChargeCurrentLimp_A CcSOF_ShortPulseDischargeCurrentLimp_A /end REF_CHARACTERISTIC
/end GROUP
/begin GROUP S1766_Determine_StopCharge_Condition "VBU0706/Function-Call Subsystem/Subsystem1/SOF/Subsystem6/Subsystem/Determine_Currentlimit_Target/Calculate_CurrentLimit_Target/CurrentLimit_Fault_Correct/Determine_StopCharge_Condition"
 /begin REF_CHARACTERISTIC CcSOF_StopChargeBattVolt_V CcSOF_StopChargeDeltaBattVolt_V CcSOF_StopChargeDeltaSOC_pct CcSOF_StopChargeSOCDebounceTime_s CcSOF_StopChargeSOC_pct CcSOF_StopChargeVoltDebounceTime_s /end REF_CHARACTERISTIC
/end GROUP
/begin GROUP S1767_Correct_CurrentLimit "VBU0706/Function-Call Subsystem/Subsystem1/SOF/Subsystem6/Subsystem/Determine_Currentlimit_Target/Calculate_CurrentLimit_Target/CurrentLimit_Voltage_Correct/Correct_CurrentLimit"
 /begin SUB_GROUP S1871_Calculate_CurrentLimit S1871_Determine_VoltageCorrect_level /end SUB_GROUP
/end GROUP
/begin GROUP S1768_ClvLookUp1 "VBU0706/Function-Call Subsystem/Subsystem1/SOF/Subsystem6/Subsystem/Determine_Currentlimit_Target/Calculate_CurrentLimit_Target/FastChrgCurr1/ClvLookUp1" /begin REF_CHARACTERISTIC CaSOF_FastChargeClv1LookUpCurrY_A CcSOF_ClvLookUp2Volt_mV /end REF_CHARACTERISTIC
 /begin REF_MEASUREMENT LbSOC_flgClvLookUp1ToClvLookUp2 LbSOC_flgClvLookUp1ToSocLookUp LcSOC_iAClvLookUp1Curr /end REF_MEASUREMENT
/end GROUP
/begin GROUP S1768_ClvLookUp2 "VBU0706/Function-Call Subsystem/Subsystem1/SOF/Subsystem6/Subsystem/Determine_Currentlimit_Target/Calculate_CurrentLimit_Target/FastChrgCurr1/ClvLookUp2" /begin REF_CHARACTERISTIC CaSOF_FastChargeClv2LookUpCurrY_A /end REF_CHARACTERISTIC /begin REF_MEASUREMENT LbSOC_flgClvLookUp2ToSocLookUp LcSOC_iAClvLookUp2Curr /end REF_MEASUREMENT /end GROUP
/begin GROUP S1768_SOCLookUp "VBU0706/Function-Call Subsystem/Subsystem1/SOF/Subsystem6/Subsystem/Determine_Currentlimit_Target/Calculate_CurrentLimit_Target/FastChrgCurr1/SOCLookUp"
 /begin REF_CHARACTERISTIC CaSOF_FastChargeSocTempMapDimension_n CaSOF_FastChargeSocTempMapZ_A CcSOF_ClvLookUp1CellSoc_pct CcSOF_ClvLookUp1Volt_mV CcSOF_ClvLookUp2Volt_mV /end REF_CHARACTERISTIC
 /begin REF_MEASUREMENT LbSOC_flgSocLookUp2ClvLookUp LcSOC_iASocLookUpCurr /end REF_MEASUREMENT
/end GROUP
/begin GROUP S1768_Subsystem "VBU0706/Function-Call Subsystem/Subsystem1/SOF/Subsystem6/Subsystem/Determine_Currentlimit_Target/Calculate_CurrentLimit_Target/FastChrgCurr1/Subsystem"
 /begin REF_CHARACTERISTIC CcSOF_FastChrgClvLowCurr_A CcSOF_FastChrgClvTooLowCurr_A CcSOF_FastChrgLowVolt_mV CcSOF_FastChrgTooLowVolt_mV /end REF_CHARACTERISTIC
 /begin REF_MEASUREMENT SOF_iAFastChrgCurrLimit /end REF_MEASUREMENT
/end GROUP
/begin GROUP S1966_Caculate_WeightingLifeTimeCharge "VBU0706/Function-Call Subsystem/Subsystem1/SOH/Subsystem4/Subsystem1/Calculate_Capacity/Calculate_CellCapacity/Caculate_CellCapacity_LifeTimeQ/Caculate_WeightingLifeTimeCharge" /begin REF_CHARACTERISTIC CcSOH_FastChargeWeighting_pct /end REF_CHARACTERISTIC /end GROUP
/begin GROUP S1967_LimittedByNVMvalue "VBU0706/Function-Call Subsystem/Subsystem1/SOH/Subsystem4/Subsystem1/Calculate_Capacity/Calculate_CellCapacity/CellCapacity_Limit/LimittedByNVMvalue"
 /begin REF_CHARACTERISTIC CaSOH_DecreaseCapacityMapDimension_n CaSOH_DecreaseCapacityMapY_pct /end REF_CHARACTERISTIC
/end GROUP
/begin GROUP S1968_MMASVC1 "VBU0706/Function-Call Subsystem/Subsystem1/SOH/Subsystem4/Subsystem1/Calculate_Capacity/Calculate_CellCapacity/Determine_CellCapacity/MMASVC1" /begin SUB_GROUP S1982_Update_Max_Min /end SUB_GROUP /end GROUP
/begin GROUP S2000_Determine_AhIntegral_Q "VBU0706/Function-Call Subsystem/Subsystem1/SOH/Subsystem4/Subsystem1/Calculate_Capacity/Calculate_CellCapacity_SlowCharge/Determine_AhIntegral_DeltaQ/Determine_AhIntegral_Q" /begin SUB_GROUP S2006_Determine_Cell_Balanced_Capacity /end SUB_GROUP
 /begin REF_CHARACTERISTIC CcSOH_MaxBalancedCapacity_As CcSOH_MaxCurrentIntegral_As CcSOH_MinBalancedCapacity_As CcSOH_MinCurrentIntegral_As /end REF_CHARACTERISTIC
/end GROUP
/begin GROUP S2000_Determine_Module_Current "VBU0706/Function-Call Subsystem/Subsystem1/SOH/Subsystem4/Subsystem1/Calculate_Capacity/Calculate_CellCapacity_SlowCharge/Determine_AhIntegral_DeltaQ/Determine_Module_Current" /begin SUB_GROUP S2007_CONTACTOR_STATUS_OPENED1 /end SUB_GROUP /end GROUP
/begin GROUP S2002_Determine_Module_Current "VBU0706/Function-Call Subsystem/Subsystem1/SOH/Subsystem4/Subsystem1/Calculate_Capacity/Calculate_CellCapacity_SlowCharge/Determine_Soc/Determine_Module_Current" /begin SUB_GROUP S2011_CONTACTOR_STATUS_OPENED1 /end SUB_GROUP /end GROUP
/begin GROUP S2002_Lookup_Table_Cal_Soc "VBU0706/Function-Call Subsystem/Subsystem1/SOH/Subsystem4/Subsystem1/Calculate_Capacity/Calculate_CellCapacity_SlowCharge/Determine_Soc/Lookup_Table_Cal_Soc" /begin SUB_GROUP S2012_Cal_Resistance S2012_Cal_Soc /end SUB_GROUP /end GROUP
/begin GROUP S2039_DuringStep_AfterStep_Check "VBU0706/Function-Call Subsystem/Subsystem1/SOH/Subsystem4/Subsystem1/Calculate_Resistance/BasicCellResistance_Calculation_Check/BeforStep_DuringStep_AfterStep_Check/DuringStep_AfterStep_Check" /begin REF_CHARACTERISTIC CcSOH_AfterEdgeFallTime_ms CcSOH_BeforeEdgeFallTime_ms /end REF_CHARACTERISTIC /end GROUP
/begin GROUP S2055_Determine_FCCPulseCurrent_Condition "VBU0706/Function-Call Subsystem/Subsystem1/SOH/Subsystem4/Subsystem1/Calculate_Resistance/Determine_Condition_Calculate_Pulse_Average_CurrentVoltage/Determine_Condition/Determine_FCCPulseCurrent_Condition" /begin REF_CHARACTERISTIC CcSOH_PulseCurrentThreshold_pct /end REF_CHARACTERISTIC /end GROUP
/begin GROUP S2097_Determinate_InletTempValidationDelay "VBU0706/Function-Call Subsystem/Subsystem1/THM/Subsystem/Subsystem/Calculate_PipeTemperature/Determine_CoolantSensorTemp_Validation/Determine_InletTemp_Validation/Determinate_InletTempValidationDelay" /begin REF_CHARACTERISTIC CcTHM_CoolantSensorValidDelayTime_s /end REF_CHARACTERISTIC /end GROUP
/begin GROUP S2098_Determinate_OutletTempValidationDelay "VBU0706/Function-Call Subsystem/Subsystem1/THM/Subsystem/Subsystem/Calculate_PipeTemperature/Determine_CoolantSensorTemp_Validation/Determine_OutletTemp_Validation/Determinate_OutletTempValidationDelay" /begin REF_CHARACTERISTIC CcTHM_CoolantSensorValidDelayTime_s /end REF_CHARACTERISTIC /end GROUP
/begin GROUP S2598_override_signal "VBU0706/Task_10ms/Subsystem/HALIn/PTCAN/Subsystem/20ms/ABS_0x79/Input_CAN_Signal_No_Range_Check/override_signal" /begin REF_MEASUREMENT BCU_vWhlRL /end REF_MEASUREMENT /end GROUP
/begin GROUP S2600_override_signal "VBU0706/Task_10ms/Subsystem/HALIn/PTCAN/Subsystem/20ms/ABS_0x79/Input_CAN_Signal_No_Range_Check2/override_signal" /begin REF_MEASUREMENT BCU_vWhlRR /end REF_MEASUREMENT /end GROUP
/begin GROUP S2682_override_signal "VBU0706/Task_10ms/Subsystem/HALIn/PTCAN/Subsystem/20ms/MCU_205/Input_CAN_Signal_No_Range_Check1/override_signal" /begin REF_MEASUREMENT PEUR_flgtrqActVld /end REF_MEASUREMENT /end GROUP
/begin GROUP S2684_override_signal "VBU0706/Task_10ms/Subsystem/HALIn/PTCAN/Subsystem/20ms/MCU_205/Input_CAN_Signal_No_Range_Check3/override_signal" /begin REF_MEASUREMENT PEUR_flgMotrHillHld /end REF_MEASUREMENT /end GROUP
/begin GROUP S2685_override_signal "VBU0706/Task_10ms/Subsystem/HALIn/PTCAN/Subsystem/20ms/MCU_205/Input_CAN_Signal_No_Range_Check4/override_signal" /begin REF_MEASUREMENT PEUR_stActvDisCh /end REF_MEASUREMENT /end GROUP
/begin GROUP S2686_override_signal "VBU0706/Task_10ms/Subsystem/HALIn/PTCAN/Subsystem/20ms/MCU_205/Input_CAN_Signal_No_Range_Check5/override_signal" /begin REF_MEASUREMENT PEUR_nMotr /end REF_MEASUREMENT /end GROUP
/begin GROUP S2688_override_signal "VBU0706/Task_10ms/Subsystem/HALIn/PTCAN/Subsystem/20ms/MCU_205/Input_CAN_Signal_No_Range_Check7/override_signal" /begin REF_MEASUREMENT PEUR_iCalcDC /end REF_MEASUREMENT /end GROUP
/begin GROUP S2776_override_signal "VBU0706/Task_10ms/Subsystem/HALIn/PTCAN/Subsystem/50ms/MCU_305/Input_CAN_Signal_No_Range_Check/override_signal" /begin REF_MEASUREMENT PEUR_uDCRlyOutsideVltg /end REF_MEASUREMENT /end GROUP
/begin GROUP S3126_override_signal "VBU0706/Task_10ms/Subsystem/HALIn/PTCAN/Subsystem/Subsystem4/CDC_220/Input_CAN_Signal_No_Range_Check3/override_signal" /begin REF_MEASUREMENT CDC_stRgnMode /end REF_MEASUREMENT /end GROUP
/begin GROUP S3127_override_signal "VBU0706/Task_10ms/Subsystem/HALIn/PTCAN/Subsystem/Subsystem4/CDC_220/Input_CAN_Signal_No_Range_Check4/override_signal" /begin REF_MEASUREMENT CDC_stDrvMode /end REF_MEASUREMENT /end GROUP
/begin GROUP S3349_DSPL_EnergyComsumptionCal "VBU0706/Task_10ms/Subsystem/VCU /DSPL/DSPL/DriveRange/DSPL_Consumption/DSPL_EnergySelfLearn/DSPL_EnergyComsumptionCal" /begin REF_CHARACTERISTIC DSPL_pctBMSSOCMinStep_C /end REF_CHARACTERISTIC /end GROUP
/begin GROUP S3349_DSPL_EnergyFactorCal "VBU0706/Task_10ms/Subsystem/VCU /DSPL/DSPL/DriveRange/DSPL_Consumption/DSPL_EnergySelfLearn/DSPL_EnergyFactorCal" /begin SUB_GROUP S3353_DSPL_EnergyFactorInit S3353_DSPL_EnergyFactorUpdate /end SUB_GROUP /end GROUP
/begin GROUP S3398_FullRangeCalculation "VBU0706/Task_10ms/Subsystem/VCU /DSPL/DSPL/DriveRange/RemainingRange/FullRangeAndSocDeclineFactor/FullRangeCalculation"
 /begin REF_CHARACTERISTIC DSPL_kmFullSocRateRng_C DSPL_kmRngNEDCMAP_CUR_y_Md_Default DSPL_pctSocFull_C /end REF_CHARACTERISTIC
/end GROUP
/begin GROUP S3398_SOCDecRate "VBU0706/Task_10ms/Subsystem/VCU /DSPL/DSPL/DriveRange/RemainingRange/FullRangeAndSocDeclineFactor/SOCDecRate" /begin REF_CHARACTERISTIC DSPL_kmDrvRngStepMax_C /end REF_CHARACTERISTIC /end GROUP
/begin GROUP S3398_SOCDeclineFactorCalculation "VBU0706/Task_10ms/Subsystem/VCU /DSPL/DSPL/DriveRange/RemainingRange/FullRangeAndSocDeclineFactor/SOCDeclineFactorCalculation"
 /begin REF_CHARACTERISTIC DSPL_facDecRateVldHi_C DSPL_facDecRateVldLo_C DSPL_facInitRateSOCFactor_C DSPL_tAmbTempChrg_CUR_x DSPL_tiDelayTimeChrgFallingEdge_C /end REF_CHARACTERISTIC
/end GROUP
/begin GROUP S3400_Charge "VBU0706/Task_10ms/Subsystem/VCU /DSPL/DSPL/DriveRange/RemainingRange/SelectDisplayRange/Charge"
 /begin REF_CHARACTERISTIC DSPL_kmChrgDownStepMin_C DSPL_kmChrgUpStepMax_C DSPL_pctSOCFullChrg_C DSPL_pctSocFull_C DSPL_tiBmsSocFullDelay_C /end REF_CHARACTERISTIC
/end GROUP
/begin GROUP S3400_Drive "VBU0706/Task_10ms/Subsystem/VCU /DSPL/DSPL/DriveRange/RemainingRange/SelectDisplayRange/Drive"
 /begin REF_CHARACTERISTIC DSPL_numSOCJump_C DSPL_pctSOCJumpHi_C DSPL_pctSOCJumpLo_C DSPL_tiBmsSocZeroDelay_C DSPL_tiSOCJumpDelay_C /end REF_CHARACTERISTIC
/end GROUP
/begin GROUP S3400_storeRange "VBU0706/Task_10ms/Subsystem/VCU /DSPL/DSPL/DriveRange/RemainingRange/SelectDisplayRange/storeRange"
 /begin REF_CHARACTERISTIC DSPL_kmDrvRngMax_C DSPL_kmRemainingRangeDisplayStep_C DSPL_kmRngNEDCMAP_CUR_y_Md_Default DSPL_tiBmsSocZeroDelay_C /end REF_CHARACTERISTIC
/end GROUP
/begin GROUP S3478_LowpassT "VBU0706/Task_10ms/Subsystem/VCU /EDIS/EDIS_Ctrl/BatDis_Power_Lim_Calc/Power_Arbitration/drive_power_limit_calculate/LowpassT" /begin REF_MEASUREMENT EDIS_pwrDrvPwrLimFilter /end REF_MEASUREMENT /end GROUP
/begin GROUP S3497_fid_action "VBU0706/Task_10ms/Subsystem/VCU /EDIS/EDIS_Ctrl/battery_power_calculate/charge_power_calculate/ChPowSetPoint/fid_action" /begin SUB_GROUP S3499_GradientLimiter S3499_GradientLimiter1 /end SUB_GROUP
 /begin REF_CHARACTERISTIC EDIS_pwrOfflineDisChDyn_C EDIS_pwrOfflineDownStep_C EDIS_pwrOfflineUpStep_C EDIS_pwrOnlineDownStep_C EDIS_pwrOnlineUpStep_C /end REF_CHARACTERISTIC
 /begin REF_MEASUREMENT EDIS_pwrDownStepCh EDIS_pwrUpStepCh /end REF_MEASUREMENT
/end GROUP
/begin GROUP S3497_setpiont "VBU0706/Task_10ms/Subsystem/VCU /EDIS/EDIS_Ctrl/battery_power_calculate/charge_power_calculate/ChPowSetPoint/setpiont"
 /begin REF_CHARACTERISTIC EDIS_facBMSSOCCh_CUR_v EDIS_facChPwrDeltaBaseDiff_CUR_v EDIS_facMaxBMSCh_CUR_v EDIS_facMinBMSCh_CUR_v EDIS_facRgnReqCapDelta_CUR_v EDIS_facVehSpd2MotSpd_C EDIS_flgOverPwrLimNum_C EDIS_flgUseEEPROMStroeVal_C EDIS_flgUsePowSpPredict_C EDIS_numChOverLim_C EDIS_numChPwrOverCntEEPROMInit_SY EDIS_pwrChRed40vLim_C EDIS_pwrSpBaseChDyn_CUR_v EDIS_tiBattOverChrg_C EDIS_wChOverEnrgLim_C SYS_facGearRatioR_SY /end REF_CHARACTERISTIC
 /begin REF_MEASUREMENT EDIS_pwrChDynSp EDIS_pwrChSp /end REF_MEASUREMENT
/end GROUP
/begin GROUP S3512_fid_action "VBU0706/Task_10ms/Subsystem/VCU /EDIS/EDIS_Ctrl/battery_power_calculate/discharge_power_calculate/DchPowSetpiont/fid_action"
 /begin SUB_GROUP S3514_GradientLimiter S3514_GradientLimiter1 S3514_GradientLimiter2 /end SUB_GROUP
 /begin REF_CHARACTERISTIC EDIS_pwrOfflineDisChDyn_C EDIS_pwrOfflineDownStep_C EDIS_pwrOfflineUpStep_C EDIS_pwrOnlineDownStep_C EDIS_pwrOnlineUpStep_C /end REF_CHARACTERISTIC
 /begin REF_MEASUREMENT EDIS_pwrDownStep EDIS_pwrUpStep /end REF_MEASUREMENT
/end GROUP
/begin GROUP S3512_setpoint "VBU0706/Task_10ms/Subsystem/VCU /EDIS/EDIS_Ctrl/battery_power_calculate/discharge_power_calculate/DchPowSetpiont/setpoint" /begin SUB_GROUP S3515_batt_stpower_overrite S3515_discharge_setpoint /end SUB_GROUP /end GROUP
/begin GROUP S3512_temperature_correction "VBU0706/Task_10ms/Subsystem/VCU /EDIS/EDIS_Ctrl/battery_power_calculate/discharge_power_calculate/DchPowSetpiont/temperature_correction" /begin SUB_GROUP S3516_BattDisChaCold S3516_BattDisChaHot S3516_MinSel /end SUB_GROUP /end GROUP
/begin GROUP S3579_DCDC_Enable "VBU0706/Task_10ms/Subsystem/VCU /PMM/PMM_Ctrl/LVC/LowVoltageBalanceControl/LVC_DcdcStCtl/DCDC_Enable" /begin REF_CHARACTERISTIC LVC_uDCDCReq_C LVC_uDcdcHvMax_C LVC_uDcdcHvMin_C /end REF_CHARACTERISTIC /end GROUP
/begin GROUP S3579_RoutineControl "VBU0706/Task_10ms/Subsystem/VCU /PMM/PMM_Ctrl/LVC/LowVoltageBalanceControl/LVC_DcdcStCtl/RoutineControl" /begin SUB_GROUP S3587_Disenable S3587_Enable /end SUB_GROUP /end GROUP
/begin GROUP S3607_LVWSrc "VBU0706/Task_10ms/Subsystem/VCU /PMM/PMM_Ctrl/PMM/LvWakeUp_Ctrl/LvWakeUp_State_Calc/LVWSrc" /begin SUB_GROUP S3610_VCUActSrc S3610_VCUWakeUp /end SUB_GROUP /end GROUP
/begin GROUP S3658_PwrUpRoutine "VBU0706/Task_10ms/Subsystem/VCU /PMM/PMM_Ctrl/PMM/PwrMod_Ctrl/Routine/PwrUpRoutine"
 /begin REF_CHARACTERISTIC DIAGS_stNRCFail_SY DIAGS_stPsvRespIn_SY DIAGS_stPsvRespNok_SY DIAGS_stPsvRespOk_SY /end REF_CHARACTERISTIC
/end GROUP
/begin GROUP S3658_Routine_PwrDwn "VBU0706/Task_10ms/Subsystem/VCU /PMM/PMM_Ctrl/PMM/PwrMod_Ctrl/Routine/Routine_PwrDwn"
 /begin REF_CHARACTERISTIC DIAGS_stNRCFail_SY DIAGS_stPsvRespIn_SY DIAGS_stPsvRespNok_SY DIAGS_stPsvRespOk_SY /end REF_CHARACTERISTIC
/end GROUP
/begin GROUP S3990_Subsystem "VBU0706/Task_10ms/Subsystem/VCU /TQO/TQOAll/TQO/TQO/MotorTorque/Subsystem" /begin REF_CHARACTERISTIC SYS_facGearRatioR_SY /end REF_CHARACTERISTIC /end GROUP
/begin GROUP S4008_FIDTrqLim "VBU0706/Task_10ms/Subsystem/VCU /VTQA/Subsystem/Subsystem/MTrqLim/TrqCapacityLim/FIDTrqLim" /begin REF_CHARACTERISTIC MTQL_trqPEURDrvUpLim_C /end REF_CHARACTERISTIC /end GROUP
/begin GROUP S4018_AlxeMax "VBU0706/Task_10ms/Subsystem/VCU /VTQA/Subsystem/Subsystem/VehTrqArb/Trq_Arb/AlxeMax" /begin REF_CHARACTERISTIC SYS_facGearRatioR_SY /end REF_CHARACTERISTIC /end GROUP
/begin GROUP S4018_AlxeMin "VBU0706/Task_10ms/Subsystem/VCU /VTQA/Subsystem/Subsystem/VehTrqArb/Trq_Arb/AlxeMin" /begin REF_CHARACTERISTIC SYS_facGearRatioR_SY /end REF_CHARACTERISTIC /end GROUP
/begin GROUP S4088_Gear_DR_Req "VBU0706/Task_10ms/Subsystem/VCU /VehINP/VehINP_Logic/GearShift/Gear1/Digital_Gear_D_R/Gear_DR_Req" /begin REF_CHARACTERISTIC Gear_tiSampleTime_C /end REF_CHARACTERISTIC /end GROUP
/begin GROUP S4088_Gear_DR_Warning "VBU0706/Task_10ms/Subsystem/VCU /VehINP/VehINP_Logic/GearShift/Gear1/Digital_Gear_D_R/Gear_DR_Warning" /begin REF_CHARACTERISTIC Gear_tiSampleTime_C /end REF_CHARACTERISTIC /end GROUP
/begin GROUP S4096_Gear4Reset "VBU0706/Task_10ms/Subsystem/VCU /VehINP/VehINP_Logic/GearShift/Gear1/Gear_Status/Gear4Reset"
 /begin REF_CHARACTERISTIC Gear_stCurrentGearD_C Gear_stCurrentGearR_C Gear_tiSampleTime_C /end REF_CHARACTERISTIC
/end GROUP
/begin GROUP S4096_Gear_DGear "VBU0706/Task_10ms/Subsystem/VCU /VehINP/VehINP_Logic/GearShift/Gear1/Gear_Status/Gear_DGear" /begin REF_CHARACTERISTIC Gear_stCurrentGearD_C /end REF_CHARACTERISTIC /end GROUP
/begin GROUP S4096_Gear_DefaultGear "VBU0706/Task_10ms/Subsystem/VCU /VehINP/VehINP_Logic/GearShift/Gear1/Gear_Status/Gear_DefaultGear" /begin REF_CHARACTERISTIC Gear_tiSampleTime_C /end REF_CHARACTERISTIC /end GROUP
/begin GROUP S4096_Gear_DriverShiftDReq "VBU0706/Task_10ms/Subsystem/VCU /VehINP/VehINP_Logic/GearShift/Gear1/Gear_Status/Gear_DriverShiftDReq" /begin REF_CHARACTERISTIC Gear_stCurrentGearD_C Gear_stCurrentGearR_C /end REF_CHARACTERISTIC /end GROUP
/begin GROUP S4096_Gear_DriverShiftRReq "VBU0706/Task_10ms/Subsystem/VCU /VehINP/VehINP_Logic/GearShift/Gear1/Gear_Status/Gear_DriverShiftRReq" /begin REF_CHARACTERISTIC Gear_stCurrentGearD_C Gear_stCurrentGearR_C /end REF_CHARACTERISTIC /end GROUP
/begin GROUP S4096_Gear_GearReq "VBU0706/Task_10ms/Subsystem/VCU /VehINP/VehINP_Logic/GearShift/Gear1/Gear_Status/Gear_GearReq" /begin REF_CHARACTERISTIC Gear_tiSampleTime_C /end REF_CHARACTERISTIC /end GROUP
/begin GROUP S4096_Gear_InitGear "VBU0706/Task_10ms/Subsystem/VCU /VehINP/VehINP_Logic/GearShift/Gear1/Gear_Status/Gear_InitGear" /begin REF_CHARACTERISTIC Gear_tiSampleTime_C /end REF_CHARACTERISTIC /end GROUP
/begin GROUP S4096_Gear_PGear "VBU0706/Task_10ms/Subsystem/VCU /VehINP/VehINP_Logic/GearShift/Gear1/Gear_Status/Gear_PGear" /begin REF_CHARACTERISTIC Gear_stIntendGearP_C Gear_tiSampleTime_C /end REF_CHARACTERISTIC /end GROUP
/begin GROUP S4096_Gear_RGear "VBU0706/Task_10ms/Subsystem/VCU /VehINP/VehINP_Logic/GearShift/Gear1/Gear_Status/Gear_RGear" /begin REF_CHARACTERISTIC Gear_stCurrentGearR_C /end REF_CHARACTERISTIC /end GROUP
/begin GROUP S338_Enabled_Subsystem "VBU0706/Function-Call Subsystem/Subsystem1/BCV/BCV/Subsystem/Calculate_BatteryCurrent/Correct_BatteryCurrent/Calculate_BatteryCurrent_ZeroDrift/Calculate_Current_ZeroDruft/Enabled_Subsystem" /begin REF_CHARACTERISTIC CcBCV_BatteryCurrentZeroDriftTime_ms /end REF_CHARACTERISTIC /end GROUP
/begin GROUP S1604_FastCharge_TOCAdjustAllSOC "VBU0706/Function-Call Subsystem/Subsystem1/SOC/Subsystem5/Subsystem/Determine_FastChargeCorrection_Soc/FastCharge_PreCorrection/FastCharge_PreCorrectionMain/FastCharge_PreCorrectionVoltage/FastCharge_TOCAdjustAllSOC" /begin REF_CHARACTERISTIC CcSOC_FastChargePreCorrectionSOC_pct /end REF_CHARACTERISTIC /end GROUP
/begin GROUP S3515_discharge_setpoint "VBU0706/Task_10ms/Subsystem/VCU /EDIS/EDIS_Ctrl/battery_power_calculate/discharge_power_calculate/DchPowSetpiont/setpoint/discharge_setpoint" /begin REF_CHARACTERISTIC EDIS_flgOverPwrLimNum_C EDIS_flgUseEEPROMStroeVal_C /end REF_CHARACTERISTIC /end GROUP
/begin GROUP S3587_Disenable "VBU0706/Task_10ms/Subsystem/VCU /PMM/PMM_Ctrl/LVC/LowVoltageBalanceControl/LVC_DcdcStCtl/RoutineControl/Disenable"
 /begin REF_CHARACTERISTIC DIAGS_stNRCFail_SY DIAGS_stPsvRespIn_SY DIAGS_stPsvRespNok_SY DIAGS_stPsvRespOk_SY /end REF_CHARACTERISTIC
/end GROUP
/begin GROUP S3587_Enable "VBU0706/Task_10ms/Subsystem/VCU /PMM/PMM_Ctrl/LVC/LowVoltageBalanceControl/LVC_DcdcStCtl/RoutineControl/Enable"
 /begin REF_CHARACTERISTIC DIAGS_stNRCFail_SY DIAGS_stPsvRespIn_SY DIAGS_stPsvRespNok_SY DIAGS_stPsvRespOk_SY /end REF_CHARACTERISTIC
/end GROUP
/begin GROUP S344_Calculate_Current_Sum "VBU0706/Function-Call Subsystem/Subsystem1/BCV/BCV/Subsystem/Calculate_BatteryCurrent/Correct_BatteryCurrent/Calculate_BatteryCurrent_ZeroDrift/Calculate_ExtremeData/Enabled_Subsystem/Calculate_Current_Sum" /begin REF_CHARACTERISTIC CcBCV_BatteryCurrentZeroDriftTime_ms /end REF_CHARACTERISTIC /end GROUP
/end MODULE
/end PROJECT
