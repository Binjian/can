ASAP2_VERSION 1 31
/begin PROJECT ProjectName "Project Comment Goes Here"
/begin HEADER "Header Comments go here" /end HEADER
/begin MODULE ModuleName "Module Comment Goes Here"
/begin MOD_COMMON "Mod Common Comment Here" ALIGNMENT_WORD 1 ALIGNMENT_LONG 1 ALIGNMENT_FLOAT32_IEEE 1 ALIGNMENT_FLOAT64_IEEE 1 BYTE_ORDER MSB_LAST /end MOD_COMMON
/begin RECORD_LAYOUT Scalar_BOOLEAN FNC_VALUES 1 UBYTE COLUMN_DIR DIRECT /end RECORD_LAYOUT
/begin RECORD_LAYOUT Scalar_UBYTE FNC_VALUES 1 UBYTE COLUMN_DIR DIRECT /end RECORD_LAYOUT
/begin RECORD_LAYOUT Scalar_BYTE FNC_VALUES 1 SBYTE COLUMN_DIR DIRECT /end RECORD_LAYOUT
/begin RECORD_LAYOUT Scalar_UWORD FNC_VALUES 1 UWORD COLUMN_DIR DIRECT /end RECORD_LAYOUT
/begin RECORD_LAYOUT Scalar_ULONG FNC_VALUES 1 ULONG COLUMN_DIR DIRECT /end RECORD_LAYOUT
/begin RECORD_LAYOUT Scalar_FLOAT32_IEEE FNC_VALUES 1 FLOAT32_IEEE COLUMN_DIR DIRECT /end RECORD_LAYOUT
/begin RECORD_LAYOUT Lookup1D_ULONG FNC_VALUES 1 ULONG COLUMN_DIR DIRECT /end RECORD_LAYOUT
/begin RECORD_LAYOUT Lookup1D_X_ULONG AXIS_PTS_X 1 ULONG INDEX_INCR DIRECT /end RECORD_LAYOUT
/begin RECORD_LAYOUT Lookup1D_SLONG FNC_VALUES 1 SLONG COLUMN_DIR DIRECT /end RECORD_LAYOUT
/begin RECORD_LAYOUT Lookup1D_FLOAT32_IEEE FNC_VALUES 1 FLOAT32_IEEE COLUMN_DIR DIRECT /end RECORD_LAYOUT
/begin RECORD_LAYOUT Lookup1D_X_FLOAT32_IEEE AXIS_PTS_X 1 FLOAT32_IEEE INDEX_INCR DIRECT /end RECORD_LAYOUT
/begin RECORD_LAYOUT Lookup2D_X_UWORD AXIS_PTS_X 1 UWORD INDEX_INCR DIRECT /end RECORD_LAYOUT
/begin RECORD_LAYOUT Lookup2D_FLOAT32_IEEE FNC_VALUES 1 FLOAT32_IEEE COLUMN_DIR DIRECT /end RECORD_LAYOUT
/begin RECORD_LAYOUT Lookup2D_X_FLOAT32_IEEE AXIS_PTS_X 1 FLOAT32_IEEE INDEX_INCR DIRECT /end RECORD_LAYOUT
/begin CHARACTERISTIC THM_nComprssrActvCool_v "" CURVE 0x70001e52 Lookup1D_FLOAT32_IEEE 0 VBU0706_CM_single_cnt -3.4028234663852886E+38 3.4028234663852886E+38
 /begin AXIS_DESCR COM_AXIS NO_INPUT_QUANTITY VBU0706_CM_single_cnt 7 -3.4028234663852886E+38 3.4028234663852886E+38 AXIS_PTS_REF THM_tActvCoolTarDeltaTemp_x /end AXIS_DESCR
/end CHARACTERISTIC
/begin AXIS_PTS THM_tActvCoolTarDeltaTemp_x "" 0x70001e8a NO_INPUT_QUANTITY Lookup1D_X_FLOAT32_IEEE 0 VBU0706_CM_single_cnt 7 -3.4028234663852886E+38 3.4028234663852886E+38 /end AXIS_PTS
/begin CHARACTERISTIC THM_pctEXVDeltaTemp_v "" CURVE 0x70001e6e Lookup1D_FLOAT32_IEEE 0 VBU0706_CM_single_cnt -3.4028234663852886E+38 3.4028234663852886E+38
 /begin AXIS_DESCR COM_AXIS NO_INPUT_QUANTITY VBU0706_CM_single_cnt 7 -3.4028234663852886E+38 3.4028234663852886E+38 AXIS_PTS_REF THM_tCoolEXVDeltaTemp_x /end AXIS_DESCR
/end CHARACTERISTIC
/begin AXIS_PTS THM_tCoolEXVDeltaTemp_x "" 0x70001ea6 NO_INPUT_QUANTITY Lookup1D_X_FLOAT32_IEEE 0 VBU0706_CM_single_cnt 7 -3.4028234663852886E+38 3.4028234663852886E+38 /end AXIS_PTS
/begin CHARACTERISTIC THM_pctFANRearPump_v "" CURVE 0x70001b66 Lookup1D_FLOAT32_IEEE 0 VBU0706_CM_single_cnt -3.4028234663852886E+38 3.4028234663852886E+38
 /begin AXIS_DESCR COM_AXIS THM_pctRearPmpCmdRaw VBU0706_CM_single_cnt 6 -3.4028234663852886E+38 3.4028234663852886E+38 AXIS_PTS_REF THM_pctFANRearPump_x /end AXIS_DESCR
/end CHARACTERISTIC
/begin AXIS_PTS THM_pctFANRearPump_x "" 0x70001b7e THM_pctRearPmpCmdRaw Lookup1D_X_FLOAT32_IEEE 0 VBU0706_CM_single_cnt 6 -3.4028234663852886E+38 3.4028234663852886E+38 /end AXIS_PTS
/begin CHARACTERISTIC THM_pctFANEDSInletTemp_v "" CURVE 0x70001ffa Lookup1D_FLOAT32_IEEE 0 VBU0706_CM_single_cnt -3.4028234663852886E+38 3.4028234663852886E+38
 /begin AXIS_DESCR COM_AXIS NO_INPUT_QUANTITY VBU0706_CM_single_cnt 8 -3.4028234663852886E+38 3.4028234663852886E+38 AXIS_PTS_REF THM_tFANEDSInletTemp_x /end AXIS_DESCR
/end CHARACTERISTIC
/begin AXIS_PTS THM_tFANEDSInletTemp_x "" 0x7000201a NO_INPUT_QUANTITY Lookup1D_X_FLOAT32_IEEE 0 VBU0706_CM_single_cnt 8 -3.4028234663852886E+38 3.4028234663852886E+38 /end AXIS_PTS
/begin CHARACTERISTIC THM_pctFANACSpdSet_v "" CURVE 0x70001fda Lookup1D_FLOAT32_IEEE 0 VBU0706_CM_single_cnt -3.4028234663852886E+38 3.4028234663852886E+38
 /begin AXIS_DESCR COM_AXIS THM_nACSpdSet VBU0706_CM_single_cnt 8 -3.4028234663852886E+38 3.4028234663852886E+38 AXIS_PTS_REF THM_nFANACSpdSet_x /end AXIS_DESCR
/end CHARACTERISTIC
/begin AXIS_PTS THM_nFANACSpdSet_x "" 0x70001fba THM_nACSpdSet Lookup1D_X_FLOAT32_IEEE 0 VBU0706_CM_single_cnt 8 -3.4028234663852886E+38 3.4028234663852886E+38 /end AXIS_PTS
/begin CHARACTERISTIC THM_facVheSpdFAN_v "" CURVE 0x70001e36 Lookup1D_FLOAT32_IEEE 0 VBU0706_CM_single_cnt -3.4028234663852886E+38 3.4028234663852886E+38
 /begin AXIS_DESCR COM_AXIS NO_INPUT_QUANTITY VBU0706_CM_single_cnt 7 -3.4028234663852886E+38 3.4028234663852886E+38 AXIS_PTS_REF THM_vVheSpdFAN_x /end AXIS_DESCR
/end CHARACTERISTIC
/begin AXIS_PTS THM_vVheSpdFAN_x "" 0x70001ec2 NO_INPUT_QUANTITY Lookup1D_X_FLOAT32_IEEE 0 VBU0706_CM_single_cnt 7 -3.4028234663852886E+38 3.4028234663852886E+38 /end AXIS_PTS
/begin CHARACTERISTIC TQD_trqDrvBrkRgn_MAP_V "" MAP 0x7000600c Lookup2D_FLOAT32_IEEE 0 VBU0706_CM_single_Nm -3000.0 2000.0
 /begin AXIS_DESCR COM_AXIS TQD_pBrkPressFlt VBU0706_CM_single_bar 10 0.0 100.0 AXIS_PTS_REF TQD_pBrkDrvPressFlt /end AXIS_DESCR
 /begin AXIS_DESCR COM_AXIS TQD_vVehSpd VBU0706_CM_single_kph 13 0.0 140.0 AXIS_PTS_REF TQD_vBrkPressVehSpd /end AXIS_DESCR
/end CHARACTERISTIC
/begin AXIS_PTS TQD_vBrkPressVehSpd "" 0x7000303c TQD_vVehSpd Lookup2D_X_FLOAT32_IEEE 0 VBU0706_CM_single_kph 13 0.0 140.0 /end AXIS_PTS
/begin AXIS_PTS TQD_pBrkDrvPressFlt "" 0x7000253e TQD_pBrkPressFlt Lookup2D_X_FLOAT32_IEEE 0 VBU0706_CM_single_bar 10 0.0 100.0 /end AXIS_PTS
/begin CHARACTERISTIC TQD_trqRvsBrkRgn_MAP_V "" MAP 0x70006214 Lookup2D_FLOAT32_IEEE 0 VBU0706_CM_single_Nm -3000.0 2000.0
 /begin AXIS_DESCR COM_AXIS TQD_vVehSpd VBU0706_CM_single_cnt 10 0.0 100.0 AXIS_PTS_REF TQD_pBrkRvsPressFlt /end AXIS_DESCR
 /begin AXIS_DESCR COM_AXIS TQD_pBrkPressFlt VBU0706_CM_single_kph 13 0.0 140.0 AXIS_PTS_REF TQD_vBrkPressVehSpd /end AXIS_DESCR
/end CHARACTERISTIC
/begin AXIS_PTS TQD_pBrkRvsPressFlt "" 0x70002566 TQD_vVehSpd Lookup2D_X_FLOAT32_IEEE 0 VBU0706_CM_single_cnt 10 0.0 100.0 /end AXIS_PTS
/begin CHARACTERISTIC CaFCC_IdealRemainChargeTimeSocTempMapZ_min "" MAP 0x70006888 Lookup2D_FLOAT32_IEEE 0 VBU0706_CM_single_cnt -3.4028234663852886E+38 3.4028234663852886E+38
 /begin AXIS_DESCR COM_AXIS NO_INPUT_QUANTITY VBU0706_CM_single_cnt 13 -3.4028234663852886E+38 3.4028234663852886E+38 AXIS_PTS_REF CaFCC_IdealRemainChargeTimeSocTempMapY_pct /end AXIS_DESCR
 /begin AXIS_DESCR COM_AXIS NO_INPUT_QUANTITY VBU0706_CM_single_cnt 11 -3.4028234663852886E+38 3.4028234663852886E+38 AXIS_PTS_REF CaFCC_IdealRemainChargeTimeSocTempMapX_C /end AXIS_DESCR
/end CHARACTERISTIC
/begin AXIS_PTS CaFCC_IdealRemainChargeTimeSocTempMapX_C "" 0x700025ba NO_INPUT_QUANTITY Lookup2D_X_FLOAT32_IEEE 0 VBU0706_CM_single_cnt 11 -3.4028234663852886E+38 3.4028234663852886E+38 /end AXIS_PTS
/begin AXIS_PTS CaFCC_IdealRemainChargeTimeSocTempMapY_pct "" 0x70002bf8 NO_INPUT_QUANTITY Lookup2D_X_FLOAT32_IEEE 0 VBU0706_CM_single_cnt 13 -3.4028234663852886E+38 3.4028234663852886E+38 /end AXIS_PTS
/begin CHARACTERISTIC CaFCC_CurrentLimitRemainChargeTimeSocTempMapZ_min "" MAP 0x7000664c Lookup2D_FLOAT32_IEEE 0 VBU0706_CM_single_cnt -3.4028234663852886E+38 3.4028234663852886E+38
 /begin AXIS_DESCR COM_AXIS NO_INPUT_QUANTITY VBU0706_CM_single_cnt 13 -3.4028234663852886E+38 3.4028234663852886E+38 AXIS_PTS_REF CaFCC_CurrentLimitRemainChargeTimeSocTempMapY_pct /end AXIS_DESCR
 /begin AXIS_DESCR COM_AXIS NO_INPUT_QUANTITY VBU0706_CM_single_cnt 11 -3.4028234663852886E+38 3.4028234663852886E+38 AXIS_PTS_REF CaFCC_CurrentLimitRemainChargeTimeSocTempMapX_C /end AXIS_DESCR
/end CHARACTERISTIC
/begin AXIS_PTS CaFCC_CurrentLimitRemainChargeTimeSocTempMapX_C "" 0x7000258e NO_INPUT_QUANTITY Lookup2D_X_FLOAT32_IEEE 0 VBU0706_CM_single_cnt 11 -3.4028234663852886E+38 3.4028234663852886E+38 /end AXIS_PTS
/begin AXIS_PTS CaFCC_CurrentLimitRemainChargeTimeSocTempMapY_pct "" 0x70002bc4 NO_INPUT_QUANTITY Lookup2D_X_FLOAT32_IEEE 0 VBU0706_CM_single_cnt 13 -3.4028234663852886E+38 3.4028234663852886E+38 /end AXIS_PTS
/begin CHARACTERISTIC CaFCC_EstimateChargingTimeDeltaMapY_min "" CURVE 0x700015e6 Lookup1D_FLOAT32_IEEE 0 VBU0706_CM_single_cnt -3.4028234663852886E+38 3.4028234663852886E+38
 /begin AXIS_DESCR COM_AXIS LcFCC_timinEstimatePercTime VBU0706_CM_single_cnt 4 -3.4028234663852886E+38 3.4028234663852886E+38 AXIS_PTS_REF CaFCC_EstimateChargingTimeDeltaMapX_min /end AXIS_DESCR
/end CHARACTERISTIC
/begin AXIS_PTS CaFCC_EstimateChargingTimeDeltaMapX_min "" 0x700015d6 LcFCC_timinEstimatePercTime Lookup1D_X_FLOAT32_IEEE 0 VBU0706_CM_single_cnt 4 -3.4028234663852886E+38 3.4028234663852886E+38 /end AXIS_PTS
/begin CHARACTERISTIC CaOCV_QuasiOCVCurrentZ_A "" MAP 0x700049bc Lookup2D_FLOAT32_IEEE 0 VBU0706_CM_single_cnt -3.4028234663852886E+38 3.4028234663852886E+38
 /begin AXIS_DESCR COM_AXIS CVT_mvCellVoltageMin VBU0706_CM_uint16_cnt 7 0.0 65535.0 AXIS_PTS_REF CaOCV_QuasiOCVCurrentY_mV /end AXIS_DESCR
 /begin AXIS_DESCR COM_AXIS CTM_tCellTempMin VBU0706_CM_single_cnt 6 -3.4028234663852886E+38 3.4028234663852886E+38 AXIS_PTS_REF CaOCV_QuasiOCVCurrentX_C /end AXIS_DESCR
/end CHARACTERISTIC
/begin AXIS_PTS CaOCV_QuasiOCVCurrentX_C "" 0x700019ce CTM_tCellTempMin Lookup2D_X_FLOAT32_IEEE 0 VBU0706_CM_single_cnt 6 -3.4028234663852886E+38 3.4028234663852886E+38 /end AXIS_PTS
/begin AXIS_PTS CaOCV_QuasiOCVCurrentY_mV "" 0x700015a8 CVT_mvCellVoltageMin Lookup2D_X_UWORD 0 VBU0706_CM_uint16_cnt 7 0.0 65535.0 /end AXIS_PTS
/begin CHARACTERISTIC APO_ACOvrdVal_C "" VALUE 0x70000160 Scalar_FLOAT32_IEEE 0 VBU0706_CM_single_cnt -3.4028234663852886E+38 3.4028234663852886E+38 /end CHARACTERISTIC
/begin CHARACTERISTIC APO_ACPowerOvrdVal_C "" VALUE 0x70000164 Scalar_FLOAT32_IEEE 0 VBU0706_CM_single_cnt -3.4028234663852886E+38 3.4028234663852886E+38 /end CHARACTERISTIC
/begin CHARACTERISTIC APO_ACSpeedOvrdVal_C "" VALUE 0x70000168 Scalar_FLOAT32_IEEE 0 VBU0706_CM_single_cnt -3.4028234663852886E+38 3.4028234663852886E+38 /end CHARACTERISTIC
/begin CHARACTERISTIC APO_BrakWarningOvrdVal_C "" VALUE 0x70000178 Scalar_FLOAT32_IEEE 0 VBU0706_CM_single_cnt -3.4028234663852886E+38 3.4028234663852886E+38 /end CHARACTERISTIC
/begin CHARACTERISTIC APO_BrkingWhileDrivingOvrdVal_C "" VALUE 0x7000017c Scalar_FLOAT32_IEEE 0 VBU0706_CM_single_cnt -3.4028234663852886E+38 3.4028234663852886E+38 /end CHARACTERISTIC
/begin CHARACTERISTIC APO_CruiseStatusOvrdVal_C "" VALUE 0x70000180 Scalar_FLOAT32_IEEE 0 VBU0706_CM_single_cnt -3.4028234663852886E+38 3.4028234663852886E+38 /end CHARACTERISTIC
/begin CHARACTERISTIC APO_EPBCtrlModeOvrdVal_C "" VALUE 0x70000184 Scalar_FLOAT32_IEEE 0 VBU0706_CM_single_cnt -3.4028234663852886E+38 3.4028234663852886E+38 /end CHARACTERISTIC
/begin CHARACTERISTIC APO_EPBFaultOvrdVal_C "" VALUE 0x70000188 Scalar_FLOAT32_IEEE 0 VBU0706_CM_single_cnt -3.4028234663852886E+38 3.4028234663852886E+38 /end CHARACTERISTIC
/begin CHARACTERISTIC APO_EPFaultLevelWarningOvrdVal_C "" VALUE 0x7000018c Scalar_FLOAT32_IEEE 0 VBU0706_CM_single_cnt -3.4028234663852886E+38 3.4028234663852886E+38 /end CHARACTERISTIC
/begin CHARACTERISTIC APO_EPSFaultOvrdVal_C "" VALUE 0x70000190 Scalar_FLOAT32_IEEE 0 VBU0706_CM_single_cnt -3.4028234663852886E+38 3.4028234663852886E+38 /end CHARACTERISTIC
/begin CHARACTERISTIC APO_LimpHomeOvrdVal_C "" VALUE 0x70000198 Scalar_FLOAT32_IEEE 0 VBU0706_CM_single_cnt -3.4028234663852886E+38 3.4028234663852886E+38 /end CHARACTERISTIC
/begin CHARACTERISTIC APO_OverSpeedOvrdVal_C "" VALUE 0x7000019c Scalar_FLOAT32_IEEE 0 VBU0706_CM_single_cnt -3.4028234663852886E+38 3.4028234663852886E+38 /end CHARACTERISTIC
/begin CHARACTERISTIC APO_PlsUSE750VDCOvrdVal_C "" VALUE 0x700001a0 Scalar_FLOAT32_IEEE 0 VBU0706_CM_single_cnt -3.4028234663852886E+38 3.4028234663852886E+38 /end CHARACTERISTIC
/begin CHARACTERISTIC APO_PowerModeOvrdVal_C "" VALUE 0x700001a4 Scalar_FLOAT32_IEEE 0 VBU0706_CM_single_cnt -3.4028234663852886E+38 3.4028234663852886E+38 /end CHARACTERISTIC
/begin CHARACTERISTIC APO_VehicleModeOvrdVal_C "" VALUE 0x700001c0 Scalar_FLOAT32_IEEE 0 VBU0706_CM_single_cnt -3.4028234663852886E+38 3.4028234663852886E+38 /end CHARACTERISTIC
/begin CHARACTERISTIC APO_fACPumpOvrdVal_C "" VALUE 0x700001c8 Scalar_FLOAT32_IEEE 0 VBU0706_CM_single_cnt -3.4028234663852886E+38 3.4028234663852886E+38 /end CHARACTERISTIC
/begin CHARACTERISTIC APO_fFanOvrdVal_C "" VALUE 0x700001cc Scalar_FLOAT32_IEEE 0 VBU0706_CM_single_cnt -3.4028234663852886E+38 3.4028234663852886E+38 /end CHARACTERISTIC
/begin CHARACTERISTIC APO_fHVIL1OvrdVal_C "" VALUE 0x700001d0 Scalar_FLOAT32_IEEE 0 VBU0706_CM_single_cnt -3.4028234663852886E+38 3.4028234663852886E+38 /end CHARACTERISTIC
/begin CHARACTERISTIC APO_fVacuumPumpOvrdVal_C "" VALUE 0x700001d4 Scalar_FLOAT32_IEEE 0 VBU0706_CM_single_cnt -3.4028234663852886E+38 3.4028234663852886E+38 /end CHARACTERISTIC
/begin CHARACTERISTIC APO_fWaterPump1OvrdVal_C "" VALUE 0x700001d8 Scalar_FLOAT32_IEEE 0 VBU0706_CM_single_cnt -3.4028234663852886E+38 3.4028234663852886E+38 /end CHARACTERISTIC
/begin CHARACTERISTIC APO_fWaterPump2OvrdVal_C "" VALUE 0x700001dc Scalar_FLOAT32_IEEE 0 VBU0706_CM_single_cnt -3.4028234663852886E+38 3.4028234663852886E+38 /end CHARACTERISTIC
/begin CHARACTERISTIC APO_pctACPumpOvrdVal_C "" VALUE 0x700001f0 Scalar_FLOAT32_IEEE 0 VBU0706_CM_single_cnt -3.4028234663852886E+38 3.4028234663852886E+38 /end CHARACTERISTIC
/begin CHARACTERISTIC APO_pctFanOvrdVal_C "" VALUE 0x70000204 Scalar_FLOAT32_IEEE 0 VBU0706_CM_single_cnt -3.4028234663852886E+38 3.4028234663852886E+38 /end CHARACTERISTIC
/begin CHARACTERISTIC APO_pctHVIL1OvrdVal_C "" VALUE 0x70000208 Scalar_FLOAT32_IEEE 0 VBU0706_CM_single_cnt -3.4028234663852886E+38 3.4028234663852886E+38 /end CHARACTERISTIC
/begin CHARACTERISTIC APO_pctWaterPump1OvrdVal_C "" VALUE 0x7000020c Scalar_FLOAT32_IEEE 0 VBU0706_CM_single_cnt -3.4028234663852886E+38 3.4028234663852886E+38 /end CHARACTERISTIC
/begin CHARACTERISTIC APO_pctWaterPump2OvrdVal_C "" VALUE 0x70000210 Scalar_FLOAT32_IEEE 0 VBU0706_CM_single_cnt -3.4028234663852886E+38 3.4028234663852886E+38 /end CHARACTERISTIC
/begin CHARACTERISTIC CcBCV_ABatteryCurrentOoR_C "" VALUE 0x700002b4 Scalar_FLOAT32_IEEE 0 VBU0706_CM_single_A -3.4028234663852886E+38 3.4028234663852886E+38 /end CHARACTERISTIC
/begin CHARACTERISTIC CcBCV_BatteryBusVoltageMismatchFaultDelta_V "" VALUE 0x700002b8 Scalar_FLOAT32_IEEE 0 VBU0706_CM_single_cnt -3.4028234663852886E+38 3.4028234663852886E+38 /end CHARACTERISTIC
/begin CHARACTERISTIC CcBCV_BatteryBusVoltageMismatchFault_V "" VALUE 0x700002bc Scalar_FLOAT32_IEEE 0 VBU0706_CM_single_cnt -3.4028234663852886E+38 3.4028234663852886E+38 /end CHARACTERISTIC
/begin CHARACTERISTIC CcBCV_BatteryCurrentOoR_A "" VALUE 0x700002c0 Scalar_FLOAT32_IEEE 0 VBU0706_CM_single_cnt -3.4028234663852886E+38 3.4028234663852886E+38 /end CHARACTERISTIC
/begin CHARACTERISTIC CcBCV_BatteryOverCurrentWarning_A "" VALUE 0x700002c8 Scalar_FLOAT32_IEEE 0 VBU0706_CM_single_cnt -3.4028234663852886E+38 3.4028234663852886E+38 /end CHARACTERISTIC
/begin CHARACTERISTIC CcBCV_BatteryOverCurrent_A "" VALUE 0x700002cc Scalar_FLOAT32_IEEE 0 VBU0706_CM_single_cnt -3.4028234663852886E+38 3.4028234663852886E+38 /end CHARACTERISTIC
/begin CHARACTERISTIC CcBCV_BatteryOverVoltageEVM_V "" VALUE 0x700002d0 Scalar_FLOAT32_IEEE 0 VBU0706_CM_single_cnt -3.4028234663852886E+38 3.4028234663852886E+38 /end CHARACTERISTIC
/begin CHARACTERISTIC CcBCV_BatteryOverVoltageWarning_V "" VALUE 0x700002d8 Scalar_FLOAT32_IEEE 0 VBU0706_CM_single_cnt -3.4028234663852886E+38 3.4028234663852886E+38 /end CHARACTERISTIC
/begin CHARACTERISTIC CcBCV_BatteryOverVoltage_V "" VALUE 0x700002dc Scalar_FLOAT32_IEEE 0 VBU0706_CM_single_cnt -3.4028234663852886E+38 3.4028234663852886E+38 /end CHARACTERISTIC
/begin CHARACTERISTIC CcBCV_BatteryUnderVoltage1_V "" VALUE 0x700002e0 Scalar_FLOAT32_IEEE 0 VBU0706_CM_single_cnt -3.4028234663852886E+38 3.4028234663852886E+38 /end CHARACTERISTIC
/begin CHARACTERISTIC CcBCV_BatteryUnderVoltage2_V "" VALUE 0x700002e4 Scalar_FLOAT32_IEEE 0 VBU0706_CM_single_cnt -3.4028234663852886E+38 3.4028234663852886E+38 /end CHARACTERISTIC
/begin CHARACTERISTIC CcBCV_BatteryUnderVoltageEVM1_V "" VALUE 0x700002e8 Scalar_FLOAT32_IEEE 0 VBU0706_CM_single_cnt -3.4028234663852886E+38 3.4028234663852886E+38 /end CHARACTERISTIC
/begin CHARACTERISTIC CcBCV_BatteryUnderVoltageEVM2_V "" VALUE 0x700002ec Scalar_FLOAT32_IEEE 0 VBU0706_CM_single_cnt -3.4028234663852886E+38 3.4028234663852886E+38 /end CHARACTERISTIC
/begin CHARACTERISTIC CcBCV_BatteryUnderVoltageTemp_C "" VALUE 0x700002f0 Scalar_FLOAT32_IEEE 0 VBU0706_CM_single_cnt -3.4028234663852886E+38 3.4028234663852886E+38 /end CHARACTERISTIC
/begin CHARACTERISTIC CcBCV_BatteryVoltageOoRHigh_V "" VALUE 0x700002f4 Scalar_FLOAT32_IEEE 0 VBU0706_CM_single_cnt -3.4028234663852886E+38 3.4028234663852886E+38 /end CHARACTERISTIC
/begin CHARACTERISTIC CcBCV_BatteryVoltageOoRLow_V "" VALUE 0x700002f8 Scalar_FLOAT32_IEEE 0 VBU0706_CM_single_cnt -3.4028234663852886E+38 3.4028234663852886E+38 /end CHARACTERISTIC
/begin CHARACTERISTIC CcBCV_DCContactorOverCurrent_A "" VALUE 0x70000324 Scalar_FLOAT32_IEEE 0 VBU0706_CM_single_cnt -3.4028234663852886E+38 3.4028234663852886E+38 /end CHARACTERISTIC
/begin CHARACTERISTIC CcBCV_FuseCurrentFactor1_n "" VALUE 0x70000328 Scalar_FLOAT32_IEEE 0 VBU0706_CM_single_cnt -3.4028234663852886E+38 3.4028234663852886E+38 /end CHARACTERISTIC
/begin CHARACTERISTIC CcBCV_FuseCurrentFactor2_n "" VALUE 0x7000032c Scalar_FLOAT32_IEEE 0 VBU0706_CM_single_cnt -3.4028234663852886E+38 3.4028234663852886E+38 /end CHARACTERISTIC
/begin CHARACTERISTIC CcBCV_FuseCurrentFactor3_n "" VALUE 0x70000330 Scalar_FLOAT32_IEEE 0 VBU0706_CM_single_cnt -3.4028234663852886E+38 3.4028234663852886E+38 /end CHARACTERISTIC
/begin CHARACTERISTIC CcBCV_FuseCurrentHigh1_A "" VALUE 0x70000334 Scalar_FLOAT32_IEEE 0 VBU0706_CM_single_cnt -3.4028234663852886E+38 3.4028234663852886E+38 /end CHARACTERISTIC
/begin CHARACTERISTIC CcBCV_FuseCurrentHigh2_A "" VALUE 0x70000338 Scalar_FLOAT32_IEEE 0 VBU0706_CM_single_cnt -3.4028234663852886E+38 3.4028234663852886E+38 /end CHARACTERISTIC
/begin CHARACTERISTIC CcBCV_FuseCurrentHigh3_A "" VALUE 0x7000033c Scalar_FLOAT32_IEEE 0 VBU0706_CM_single_cnt -3.4028234663852886E+38 3.4028234663852886E+38 /end CHARACTERISTIC
/begin CHARACTERISTIC CcBCV_FuseCurrentHigh4_A "" VALUE 0x70000340 Scalar_FLOAT32_IEEE 0 VBU0706_CM_single_cnt -3.4028234663852886E+38 3.4028234663852886E+38 /end CHARACTERISTIC
/begin CHARACTERISTIC CcBCV_FuseCurrentLow1_A "" VALUE 0x70000344 Scalar_FLOAT32_IEEE 0 VBU0706_CM_single_cnt -3.4028234663852886E+38 3.4028234663852886E+38 /end CHARACTERISTIC
/begin CHARACTERISTIC CcBCV_FuseCurrentLow2_A "" VALUE 0x70000348 Scalar_FLOAT32_IEEE 0 VBU0706_CM_single_cnt -3.4028234663852886E+38 3.4028234663852886E+38 /end CHARACTERISTIC
/begin CHARACTERISTIC CcBCV_FuseCurrentLow3_A "" VALUE 0x7000034c Scalar_FLOAT32_IEEE 0 VBU0706_CM_single_cnt -3.4028234663852886E+38 3.4028234663852886E+38 /end CHARACTERISTIC
/begin CHARACTERISTIC CcBCV_FuseCurrentLow4_A "" VALUE 0x70000350 Scalar_FLOAT32_IEEE 0 VBU0706_CM_single_cnt -3.4028234663852886E+38 3.4028234663852886E+38 /end CHARACTERISTIC
/begin CHARACTERISTIC CcBCV_FuseHealthThreshold_n "" VALUE 0x70000354 Scalar_FLOAT32_IEEE 0 VBU0706_CM_single_cnt -3.4028234663852886E+38 3.4028234663852886E+38 /end CHARACTERISTIC
/begin CHARACTERISTIC CcCBL_BalanceStartCellSoc_pct "" VALUE 0x70000380 Scalar_FLOAT32_IEEE 0 VBU0706_CM_single_cnt -3.4028234663852886E+38 3.4028234663852886E+38 /end CHARACTERISTIC
/begin CHARACTERISTIC CcCBL_BalanceStartCellTempMaxHysteresis_C "" VALUE 0x70000384 Scalar_FLOAT32_IEEE 0 VBU0706_CM_single_cnt -3.4028234663852886E+38 3.4028234663852886E+38 /end CHARACTERISTIC
/begin CHARACTERISTIC CcCBL_BalanceStartCellTempMax_C "" VALUE 0x70000388 Scalar_FLOAT32_IEEE 0 VBU0706_CM_single_cnt -3.4028234663852886E+38 3.4028234663852886E+38 /end CHARACTERISTIC
/begin CHARACTERISTIC CcCBL_BalanceStartDeltaSoc_pct "" VALUE 0x7000038c Scalar_FLOAT32_IEEE 0 VBU0706_CM_single_cnt -3.4028234663852886E+38 3.4028234663852886E+38 /end CHARACTERISTIC
/begin CHARACTERISTIC CcCBL_BalanceStartIsoResistance_Kohm "" VALUE 0x70000390 Scalar_FLOAT32_IEEE 0 VBU0706_CM_single_cnt -3.4028234663852886E+38 3.4028234663852886E+38 /end CHARACTERISTIC
/begin CHARACTERISTIC CcCBL_CellBalanceChargeCurrentHysteresis_A "" VALUE 0x700003a0 Scalar_FLOAT32_IEEE 0 VBU0706_CM_single_cnt -3.4028234663852886E+38 3.4028234663852886E+38 /end CHARACTERISTIC
/begin CHARACTERISTIC CcCBL_CellBalanceChargeCurrent_A "" VALUE 0x700003a4 Scalar_FLOAT32_IEEE 0 VBU0706_CM_single_cnt -3.4028234663852886E+38 3.4028234663852886E+38 /end CHARACTERISTIC
/begin CHARACTERISTIC CcCBL_CellBalanceDischargeCurrentHysteresis_A "" VALUE 0x700003a8 Scalar_FLOAT32_IEEE 0 VBU0706_CM_single_cnt -3.4028234663852886E+38 3.4028234663852886E+38 /end CHARACTERISTIC
/begin CHARACTERISTIC CcCBL_CellBalanceDischargeCurrent_A "" VALUE 0x700003ac Scalar_FLOAT32_IEEE 0 VBU0706_CM_single_cnt -3.4028234663852886E+38 3.4028234663852886E+38 /end CHARACTERISTIC
/begin CHARACTERISTIC CcCBL_SocBalanceChargeCurrentHysteresis_A "" VALUE 0x700003b0 Scalar_FLOAT32_IEEE 0 VBU0706_CM_single_cnt -3.4028234663852886E+38 3.4028234663852886E+38 /end CHARACTERISTIC
/begin CHARACTERISTIC CcCBL_SocBalanceChargeCurrent_A "" VALUE 0x700003b4 Scalar_FLOAT32_IEEE 0 VBU0706_CM_single_cnt -3.4028234663852886E+38 3.4028234663852886E+38 /end CHARACTERISTIC
/begin CHARACTERISTIC CcCBL_SocBalanceDischargeCurrentHysteresis_A "" VALUE 0x700003b8 Scalar_FLOAT32_IEEE 0 VBU0706_CM_single_cnt -3.4028234663852886E+38 3.4028234663852886E+38 /end CHARACTERISTIC
/begin CHARACTERISTIC CcCBL_SocBalanceDischargeCurrent_A "" VALUE 0x700003bc Scalar_FLOAT32_IEEE 0 VBU0706_CM_single_cnt -3.4028234663852886E+38 3.4028234663852886E+38 /end CHARACTERISTIC
/begin CHARACTERISTIC CcCBL_SystemVoltageMaxHysteresis_V "" VALUE 0x700003c0 Scalar_FLOAT32_IEEE 0 VBU0706_CM_single_cnt -3.4028234663852886E+38 3.4028234663852886E+38 /end CHARACTERISTIC
/begin CHARACTERISTIC CcCBL_SystemVoltageMax_V "" VALUE 0x700003c4 Scalar_FLOAT32_IEEE 0 VBU0706_CM_single_cnt -3.4028234663852886E+38 3.4028234663852886E+38 /end CHARACTERISTIC
/begin CHARACTERISTIC CcCBL_SystemVoltageMinHysteresis_V "" VALUE 0x700003c8 Scalar_FLOAT32_IEEE 0 VBU0706_CM_single_cnt -3.4028234663852886E+38 3.4028234663852886E+38 /end CHARACTERISTIC
/begin CHARACTERISTIC CcCBL_SystemVoltageMin_V "" VALUE 0x700003cc Scalar_FLOAT32_IEEE 0 VBU0706_CM_single_cnt -3.4028234663852886E+38 3.4028234663852886E+38 /end CHARACTERISTIC
/begin CHARACTERISTIC CcCTD_MessageDataValidDelay_ms "" VALUE 0x700003e8 Scalar_FLOAT32_IEEE 0 VBU0706_CM_single_cnt -3.4028234663852886E+38 3.4028234663852886E+38 /end CHARACTERISTIC
/begin CHARACTERISTIC CcCTD_MnNegContactorCloseDeltaVoltage_V "" VALUE 0x700003f0 Scalar_FLOAT32_IEEE 0 VBU0706_CM_single_cnt -3.4028234663852886E+38 3.4028234663852886E+38 /end CHARACTERISTIC
/begin CHARACTERISTIC CcCTD_MnPosContactorCloseDeltaVoltage_V "" VALUE 0x700003f8 Scalar_FLOAT32_IEEE 0 VBU0706_CM_single_cnt -3.4028234663852886E+38 3.4028234663852886E+38 /end CHARACTERISTIC
/begin CHARACTERISTIC CcCTD_PEURDCVoltageThreshold_V "" VALUE 0x70000404 Scalar_FLOAT32_IEEE 0 VBU0706_CM_single_cnt -3.4028234663852886E+38 3.4028234663852886E+38 /end CHARACTERISTIC
/begin CHARACTERISTIC CcCTD_PEURVtoBatVThresholdLower_pct "" VALUE 0x70000408 Scalar_FLOAT32_IEEE 0 VBU0706_CM_single_cnt -3.4028234663852886E+38 3.4028234663852886E+38 /end CHARACTERISTIC
/begin CHARACTERISTIC CcCTD_PEURVtoBatVThresholdUpper_pct "" VALUE 0x7000040c Scalar_FLOAT32_IEEE 0 VBU0706_CM_single_cnt -3.4028234663852886E+38 3.4028234663852886E+38 /end CHARACTERISTIC
/begin CHARACTERISTIC CcCTD_PrechargeOverEnergyLockoutInterval_s "" VALUE 0x70000410 Scalar_FLOAT32_IEEE 0 VBU0706_CM_single_cnt 0.0 65535.0 /end CHARACTERISTIC
/begin CHARACTERISTIC CcCTD_PrechargeRelayStuckOpenDeltaVoltage_V "" VALUE 0x70000418 Scalar_FLOAT32_IEEE 0 VBU0706_CM_single_cnt -3.4028234663852886E+38 3.4028234663852886E+38 /end CHARACTERISTIC
/begin CHARACTERISTIC CcCTD_PrechargeSuccessMax_pct "" VALUE 0x70000424 Scalar_FLOAT32_IEEE 0 VBU0706_CM_single_cnt -3.4028234663852886E+38 3.4028234663852886E+38 /end CHARACTERISTIC
/begin CHARACTERISTIC CcCTD_PrechargeSuccessMin_pct "" VALUE 0x70000428 Scalar_FLOAT32_IEEE 0 VBU0706_CM_single_cnt -3.4028234663852886E+38 3.4028234663852886E+38 /end CHARACTERISTIC
/begin CHARACTERISTIC CcCTD_VehSpdPrechargeDiag_kmh "" VALUE 0x70000438 Scalar_FLOAT32_IEEE 0 VBU0706_CM_single_cnt -3.4028234663852886E+38 3.4028234663852886E+38 /end CHARACTERISTIC
/begin CHARACTERISTIC CcCTM_ThermalRunawayTriggerTime_ms "" VALUE 0x70000470 Scalar_FLOAT32_IEEE 0 VBU0706_CM_single_cnt -3.4028234663852886E+38 3.4028234663852886E+38 /end CHARACTERISTIC
/begin CHARACTERISTIC CcCTM_ThermalRunawayValidDelayTime_ms "" VALUE 0x70000474 Scalar_FLOAT32_IEEE 0 VBU0706_CM_single_cnt -3.4028234663852886E+38 3.4028234663852886E+38 /end CHARACTERISTIC
/begin CHARACTERISTIC CcCTS_BatteryVoltageMinLimit_V "" VALUE 0x70000478 Scalar_FLOAT32_IEEE 0 VBU0706_CM_single_cnt -3.4028234663852886E+38 3.4028234663852886E+38 /end CHARACTERISTIC
/begin CHARACTERISTIC CcCTS_CellVoltageMinLimitDelta_mV "" VALUE 0x7000047c Scalar_FLOAT32_IEEE 0 VBU0706_CM_single_cnt -3.4028234663852886E+38 3.4028234663852886E+38 /end CHARACTERISTIC
/begin CHARACTERISTIC CcCTS_CellVoltageMinLimit_mV "" VALUE 0x70000480 Scalar_FLOAT32_IEEE 0 VBU0706_CM_single_cnt -3.4028234663852886E+38 3.4028234663852886E+38 /end CHARACTERISTIC
/begin CHARACTERISTIC CcCTS_SocInitialDelayTime_s "" VALUE 0x70000494 Scalar_FLOAT32_IEEE 0 VBU0706_CM_single_cnt -3.4028234663852886E+38 3.4028234663852886E+38 /end CHARACTERISTIC
/begin CHARACTERISTIC CcFCC_BatteryChargeCurrentFactor_n "" VALUE 0x700004b4 Scalar_FLOAT32_IEEE 0 VBU0706_CM_single_cnt -3.4028234663852886E+38 3.4028234663852886E+38 /end CHARACTERISTIC
/begin CHARACTERISTIC CcFCC_CellVoltageMaxCorrectEndDelta_mV "" VALUE 0x700004b8 Scalar_FLOAT32_IEEE 0 VBU0706_CM_single_cnt -3.4028234663852886E+38 3.4028234663852886E+38 /end CHARACTERISTIC
/begin CHARACTERISTIC CcFCC_CellVoltageMaxCorrectMiddleDelta_mV "" VALUE 0x700004bc Scalar_FLOAT32_IEEE 0 VBU0706_CM_single_cnt -3.4028234663852886E+38 3.4028234663852886E+38 /end CHARACTERISTIC
/begin CHARACTERISTIC CcFCC_CellVoltageMaxCorrectSlopMax_nbr "" VALUE 0x700004c0 Scalar_FLOAT32_IEEE 0 VBU0706_CM_single_cnt -3.4028234663852886E+38 3.4028234663852886E+38 /end CHARACTERISTIC
/begin CHARACTERISTIC CcFCC_CellVoltageMaxCorrectSlopMin_nbr "" VALUE 0x700004c4 Scalar_FLOAT32_IEEE 0 VBU0706_CM_single_cnt -3.4028234663852886E+38 3.4028234663852886E+38 /end CHARACTERISTIC
/begin CHARACTERISTIC CcFCC_CellVoltageMaxCorrectStartDelta_mV "" VALUE 0x700004c8 Scalar_FLOAT32_IEEE 0 VBU0706_CM_single_cnt -3.4028234663852886E+38 3.4028234663852886E+38 /end CHARACTERISTIC
/begin CHARACTERISTIC CcFCC_CellVoltageMaxFactorEnd_nbr "" VALUE 0x700004cc Scalar_FLOAT32_IEEE 0 VBU0706_CM_single_cnt -3.4028234663852886E+38 3.4028234663852886E+38 /end CHARACTERISTIC
/begin CHARACTERISTIC CcFCC_CellVoltageMaxFactorMiddle_nbr "" VALUE 0x700004d0 Scalar_FLOAT32_IEEE 0 VBU0706_CM_single_cnt -3.4028234663852886E+38 3.4028234663852886E+38 /end CHARACTERISTIC
/begin CHARACTERISTIC CcFCC_CellVoltageMaxFactorStart_nbr "" VALUE 0x700004d4 Scalar_FLOAT32_IEEE 0 VBU0706_CM_single_cnt -3.4028234663852886E+38 3.4028234663852886E+38 /end CHARACTERISTIC
/begin CHARACTERISTIC CcFCC_ChargePowerDecRate_Kw "" VALUE 0x70000500 Scalar_FLOAT32_IEEE 0 VBU0706_CM_single_cnt -3.4028234663852886E+38 3.4028234663852886E+38 /end CHARACTERISTIC
/begin CHARACTERISTIC CcFCC_ChargePowerIncRate_Kw "" VALUE 0x70000504 Scalar_FLOAT32_IEEE 0 VBU0706_CM_single_cnt -3.4028234663852886E+38 3.4028234663852886E+38 /end CHARACTERISTIC
/begin CHARACTERISTIC CcFCC_ComputeResistanceCurrentDecRate_A "" VALUE 0x70000514 Scalar_FLOAT32_IEEE 0 VBU0706_CM_single_cnt -3.4028234663852886E+38 3.4028234663852886E+38 /end CHARACTERISTIC
/begin CHARACTERISTIC CcFCC_ComputeResistanceCurrentIncRate_A "" VALUE 0x70000518 Scalar_FLOAT32_IEEE 0 VBU0706_CM_single_cnt -3.4028234663852886E+38 3.4028234663852886E+38 /end CHARACTERISTIC
/begin CHARACTERISTIC CcFCC_CustomSetSOCEnable_pct "" VALUE 0x70000528 Scalar_FLOAT32_IEEE 0 VBU0706_CM_single_cnt -3.4028234663852886E+38 3.4028234663852886E+38 /end CHARACTERISTIC
/begin CHARACTERISTIC CcFCC_EstimateChargeTimeCurrent_A "" VALUE 0x70000534 Scalar_FLOAT32_IEEE 0 VBU0706_CM_single_cnt -3.4028234663852886E+38 3.4028234663852886E+38 /end CHARACTERISTIC
/begin CHARACTERISTIC CcFCC_FullChargeSoc1_pct "" VALUE 0x7000053c Scalar_FLOAT32_IEEE 0 VBU0706_CM_single_cnt -3.4028234663852886E+38 3.4028234663852886E+38 /end CHARACTERISTIC
/begin CHARACTERISTIC CcFCC_FullChargeSoc2_pct "" VALUE 0x70000540 Scalar_FLOAT32_IEEE 0 VBU0706_CM_single_cnt -3.4028234663852886E+38 3.4028234663852886E+38 /end CHARACTERISTIC
/begin CHARACTERISTIC CcFCC_FullChargeSoc3_pct "" VALUE 0x70000544 Scalar_FLOAT32_IEEE 0 VBU0706_CM_single_cnt -3.4028234663852886E+38 3.4028234663852886E+38 /end CHARACTERISTIC
/begin CHARACTERISTIC CcFCC_NoChargeHighTemp_C "" VALUE 0x70000550 Scalar_FLOAT32_IEEE 0 VBU0706_CM_single_C -40.0 200.0 /end CHARACTERISTIC
/begin CHARACTERISTIC CcFCC_NoChargeLowTemp_C "" VALUE 0x70000554 Scalar_FLOAT32_IEEE 0 VBU0706_CM_single_C -40.0 200.0 /end CHARACTERISTIC
/begin CHARACTERISTIC CcFCC_StandardPowerLimit_Kw "" VALUE 0x70000558 Scalar_FLOAT32_IEEE 0 VBU0706_CM_single_cnt -3.4028234663852886E+38 3.4028234663852886E+38 /end CHARACTERISTIC
/begin CHARACTERISTIC CcFCC_TrickleChargeCurrent_A "" VALUE 0x7000055c Scalar_FLOAT32_IEEE 0 VBU0706_CM_single_cnt -3.4028234663852886E+38 3.4028234663852886E+38 /end CHARACTERISTIC
/begin CHARACTERISTIC CcSOC_CellCapacityOvrdVal_Ah "" VALUE 0x700005fc Scalar_FLOAT32_IEEE 0 VBU0706_CM_single_cnt -3.4028234663852886E+38 3.4028234663852886E+38 /end CHARACTERISTIC
/begin CHARACTERISTIC CcSOC_MaxBalancedCapacity_As "" VALUE 0x70000644 Scalar_FLOAT32_IEEE 0 VBU0706_CM_single_cnt -3.4028234663852886E+38 3.4028234663852886E+38 /end CHARACTERISTIC
/begin CHARACTERISTIC CcSOC_MaxCurrentIntegral_As "" VALUE 0x70000648 Scalar_FLOAT32_IEEE 0 VBU0706_CM_single_cnt -3.4028234663852886E+38 3.4028234663852886E+38 /end CHARACTERISTIC
/begin CHARACTERISTIC CcSOC_MinBalancedCapacity_As "" VALUE 0x7000064c Scalar_FLOAT32_IEEE 0 VBU0706_CM_single_cnt -3.4028234663852886E+38 3.4028234663852886E+38 /end CHARACTERISTIC
/begin CHARACTERISTIC CcSOC_MinCurrentIntegral_As "" VALUE 0x70000650 Scalar_FLOAT32_IEEE 0 VBU0706_CM_single_cnt -3.4028234663852886E+38 3.4028234663852886E+38 /end CHARACTERISTIC
/begin CHARACTERISTIC CcSYS_MappedCellCapacity_Ah "" VALUE 0x700008ac Scalar_FLOAT32_IEEE 0 VBU0706_CM_single_cnt -3.4028234663852886E+38 3.4028234663852886E+38 /end CHARACTERISTIC
/begin CHARACTERISTIC DCH_iDiaDCChOvrCrntDiff_C "" VALUE 0x70000a14 Scalar_FLOAT32_IEEE 0 VBU0706_CM_single_cnt -3.4028234663852886E+38 3.4028234663852886E+38 /end CHARACTERISTIC
/begin CHARACTERISTIC DCH_tDCChPortTempLowLim_C "" VALUE 0x70000a68 Scalar_FLOAT32_IEEE 0 VBU0706_CM_single_cnt -3.4028234663852886E+38 3.4028234663852886E+38 /end CHARACTERISTIC
/begin CHARACTERISTIC DCH_tReStartDCChPortTemp_C "" VALUE 0x70000a84 Scalar_FLOAT32_IEEE 0 VBU0706_CM_single_cnt -3.4028234663852886E+38 3.4028234663852886E+38 /end CHARACTERISTIC
/begin CHARACTERISTIC DCH_tStopForDCChPortTemp_C "" VALUE 0x70000a88 Scalar_FLOAT32_IEEE 0 VBU0706_CM_single_cnt -3.4028234663852886E+38 3.4028234663852886E+38 /end CHARACTERISTIC
/begin CHARACTERISTIC DCH_tiDCChRlyOpClsdDly_C "" VALUE 0x70000ae0 Scalar_FLOAT32_IEEE 0 VBU0706_CM_single_cnt -3.4028234663852886E+38 3.4028234663852886E+38 /end CHARACTERISTIC
/begin CHARACTERISTIC DCH_tiDiagRlyCmd_C "" VALUE 0x70000af0 Scalar_FLOAT32_IEEE 0 VBU0706_CM_single_cnt -3.4028234663852886E+38 3.4028234663852886E+38 /end CHARACTERISTIC
/begin CHARACTERISTIC DCH_uDiaDCChOvrVltgDiff_C "" VALUE 0x70000b40 Scalar_FLOAT32_IEEE 0 VBU0706_CM_single_cnt -3.4028234663852886E+38 3.4028234663852886E+38 /end CHARACTERISTIC
/begin CHARACTERISTIC DSPL_facMtrDrvLT_C "" VALUE 0x70000b84 Scalar_FLOAT32_IEEE 0 VBU0706_CM_single_fac 0.0 1.0 /end CHARACTERISTIC
/begin CHARACTERISTIC DSPL_nMotSpdOvrSpdLower_C "" VALUE 0x70000ba8 Scalar_FLOAT32_IEEE 0 VBU0706_CM_single_cnt 0.0 1.0E+23 /end CHARACTERISTIC
/begin CHARACTERISTIC DSPL_nMotSpdOvrSpdUpper_C "" VALUE 0x70000bac Scalar_FLOAT32_IEEE 0 VBU0706_CM_single_cnt 0.0 65535.0 /end CHARACTERISTIC
/begin CHARACTERISTIC DSPL_pctSocLowWarnLower_C "" VALUE 0x70000bd0 Scalar_FLOAT32_IEEE 0 VBU0706_CM_single_pct 0.0 100.0 /end CHARACTERISTIC
/begin CHARACTERISTIC DSPL_pctSocLowWarnUpper_C "" VALUE 0x70000bd4 Scalar_FLOAT32_IEEE 0 VBU0706_CM_single_pct 0.0 100.0 /end CHARACTERISTIC
/begin CHARACTERISTIC DSPL_tiDCDCStsFail_C "" VALUE 0x70000be8 Scalar_FLOAT32_IEEE 0 VBU0706_CM_single_s 0.0 1.0E+23 /end CHARACTERISTIC
/begin CHARACTERISTIC DSPL_tiDisableDCDC_C "" VALUE 0x70000bf0 Scalar_FLOAT32_IEEE 0 VBU0706_CM_single_s 0.0 1.0E+23 /end CHARACTERISTIC
/begin CHARACTERISTIC DSPL_tiMotOvrSpd_C "" VALUE 0x70000c00 Scalar_FLOAT32_IEEE 0 VBU0706_CM_single_s 0.0 1.0E+23 /end CHARACTERISTIC
/begin CHARACTERISTIC DSPL_tiMtrDrvLT_C "" VALUE 0x70000c04 Scalar_FLOAT32_IEEE 0 VBU0706_CM_single_s 0.0 1.0E+23 /end CHARACTERISTIC
/begin CHARACTERISTIC DSPL_tiSample_SY "" VALUE 0x70000c10 Scalar_FLOAT32_IEEE 0 VBU0706_CM_single_s 0.0 1.0E+23 /end CHARACTERISTIC
/begin CHARACTERISTIC DSPL_trqMtrDrvLTHi_C "" VALUE 0x70000c14 Scalar_FLOAT32_IEEE 0 VBU0706_CM_single_cnt 0.0 1.0E+23 /end CHARACTERISTIC
/begin CHARACTERISTIC DSPL_trqMtrDrvLTLo_C "" VALUE 0x70000c18 Scalar_FLOAT32_IEEE 0 VBU0706_CM_single_cnt 0.0 1.0E+23 /end CHARACTERISTIC
/begin CHARACTERISTIC EDIS_pwrCurrPwrOvrdVal_C "" VALUE 0x70000c8c Scalar_FLOAT32_IEEE 0 VBU0706_CM_single_cnt -3.4028234663852886E+38 3.4028234663852886E+38 /end CHARACTERISTIC
/begin CHARACTERISTIC EPFaultLevelWarning "" VALUE 0x70000d38 Scalar_FLOAT32_IEEE 0 VBU0706_CM_single_cnt 0.0 1.0E+23 /end CHARACTERISTIC
/begin CHARACTERISTIC HVBattCutOffOvrdVal_C "" VALUE 0x70000db8 Scalar_FLOAT32_IEEE 0 VBU0706_CM_single_cnt -3.4028234663852886E+38 3.4028234663852886E+38 /end CHARACTERISTIC
/begin CHARACTERISTIC LVC_uDCDCReqOvrdVal_C "" VALUE 0x70000e5c Scalar_FLOAT32_IEEE 0 VBU0706_CM_single_cnt -3.4028234663852886E+38 3.4028234663852886E+38 /end CHARACTERISTIC
/begin CHARACTERISTIC LowBatteryWarningOvrdVal_C "" VALUE 0x70000e70 Scalar_FLOAT32_IEEE 0 VBU0706_CM_single_cnt -3.4028234663852886E+38 3.4028234663852886E+38 /end CHARACTERISTIC
/begin CHARACTERISTIC SPD_vVehSpdOvrdVal_C "" VALUE 0x70000fec Scalar_FLOAT32_IEEE 0 VBU0706_CM_single_cnt -3.4028234663852886E+38 3.4028234663852886E+38 /end CHARACTERISTIC
/begin CHARACTERISTIC THM_fFANFrecuencyOvrdVal_C "" VALUE 0x70001018 Scalar_FLOAT32_IEEE 0 VBU0706_CM_single_cnt -3.4028234663852886E+38 3.4028234663852886E+38 /end CHARACTERISTIC
/begin CHARACTERISTIC THM_fPmp1FrecuencyOvrdVal_C "" VALUE 0x7000101c Scalar_FLOAT32_IEEE 0 VBU0706_CM_single_cnt -3.4028234663852886E+38 3.4028234663852886E+38 /end CHARACTERISTIC
/begin CHARACTERISTIC THM_fPmp2FrecuencyOvrdVal_C "" VALUE 0x70001020 Scalar_FLOAT32_IEEE 0 VBU0706_CM_single_cnt -3.4028234663852886E+38 3.4028234663852886E+38 /end CHARACTERISTIC
/begin CHARACTERISTIC THM_nACCmpCmdOvrdVal_C "" VALUE 0x70001024 Scalar_FLOAT32_IEEE 0 VBU0706_CM_single_cnt -3.4028234663852886E+38 3.4028234663852886E+38 /end CHARACTERISTIC
/begin CHARACTERISTIC THM_nComprssrDecGrad_C "" VALUE 0x70001028 Scalar_FLOAT32_IEEE 0 VBU0706_CM_single_cnt -3.4028234663852886E+38 3.4028234663852886E+38 /end CHARACTERISTIC
/begin CHARACTERISTIC THM_nComprssrDrvrACOn_C "" VALUE 0x7000102c Scalar_FLOAT32_IEEE 0 VBU0706_CM_single_cnt -3.4028234663852886E+38 3.4028234663852886E+38 /end CHARACTERISTIC
/begin CHARACTERISTIC THM_nComprssrIncGrad_C "" VALUE 0x70001030 Scalar_FLOAT32_IEEE 0 VBU0706_CM_single_cnt -3.4028234663852886E+38 3.4028234663852886E+38 /end CHARACTERISTIC
/begin CHARACTERISTIC THM_nMinComprssrStrt_C "" VALUE 0x70001034 Scalar_FLOAT32_IEEE 0 VBU0706_CM_single_cnt -3.4028234663852886E+38 3.4028234663852886E+38 /end CHARACTERISTIC
/begin CHARACTERISTIC THM_pctESSPmpCmdOvrdVal_C "" VALUE 0x70001038 Scalar_FLOAT32_IEEE 0 VBU0706_CM_single_cnt -3.4028234663852886E+38 3.4028234663852886E+38 /end CHARACTERISTIC
/begin CHARACTERISTIC THM_pctEXVDecGrad_C "" VALUE 0x70001048 Scalar_FLOAT32_IEEE 0 VBU0706_CM_single_cnt -3.4028234663852886E+38 3.4028234663852886E+38 /end CHARACTERISTIC
/begin CHARACTERISTIC THM_pctEXVIncGrad_C "" VALUE 0x7000104c Scalar_FLOAT32_IEEE 0 VBU0706_CM_single_cnt -3.4028234663852886E+38 3.4028234663852886E+38 /end CHARACTERISTIC
/begin CHARACTERISTIC THM_pctEXVMax_C "" VALUE 0x70001050 Scalar_FLOAT32_IEEE 0 VBU0706_CM_single_cnt -3.4028234663852886E+38 3.4028234663852886E+38 /end CHARACTERISTIC
/begin CHARACTERISTIC THM_pctEXVMin_C "" VALUE 0x70001054 Scalar_FLOAT32_IEEE 0 VBU0706_CM_single_cnt -3.4028234663852886E+38 3.4028234663852886E+38 /end CHARACTERISTIC
/begin CHARACTERISTIC THM_pctFANACMidPresSwtActv_C "" VALUE 0x70001058 Scalar_FLOAT32_IEEE 0 VBU0706_CM_single_cnt -3.4028234663852886E+38 3.4028234663852886E+38 /end CHARACTERISTIC
/begin CHARACTERISTIC THM_pctFANAfterRunMin_C "" VALUE 0x7000105c Scalar_FLOAT32_IEEE 0 VBU0706_CM_single_cnt -3.4028234663852886E+38 3.4028234663852886E+38 /end CHARACTERISTIC
/begin CHARACTERISTIC THM_pctFANDecGrad_C "" VALUE 0x70001060 Scalar_FLOAT32_IEEE 0 VBU0706_CM_single_cnt -3.4028234663852886E+38 3.4028234663852886E+38 /end CHARACTERISTIC
/begin CHARACTERISTIC THM_pctFANIncGrad_C "" VALUE 0x70001064 Scalar_FLOAT32_IEEE 0 VBU0706_CM_single_cnt -3.4028234663852886E+38 3.4028234663852886E+38 /end CHARACTERISTIC
/begin CHARACTERISTIC THM_pctFANReqOvrdVal_C "" VALUE 0x70001068 Scalar_FLOAT32_IEEE 0 VBU0706_CM_single_cnt -3.4028234663852886E+38 3.4028234663852886E+38 /end CHARACTERISTIC
/begin CHARACTERISTIC THM_pctRearPmpCmdOvrdVal_C "" VALUE 0x7000106c Scalar_FLOAT32_IEEE 0 VBU0706_CM_single_cnt -3.4028234663852886E+38 3.4028234663852886E+38 /end CHARACTERISTIC
/begin CHARACTERISTIC THM_phiEXVPosReqOvrdVal_C "" VALUE 0x70001078 Scalar_FLOAT32_IEEE 0 VBU0706_CM_single_cnt -3.4028234663852886E+38 3.4028234663852886E+38 /end CHARACTERISTIC
/begin CHARACTERISTIC THM_pwrACMaxLimit "" VALUE 0x70001080 Scalar_FLOAT32_IEEE 0 VBU0706_CM_single_cnt -3.4028234663852886E+38 3.4028234663852886E+38 /end CHARACTERISTIC
/begin CHARACTERISTIC THM_pwrACPwrLimitOvrdVal_C "" VALUE 0x70001084 Scalar_FLOAT32_IEEE 0 VBU0706_CM_single_cnt -3.4028234663852886E+38 3.4028234663852886E+38 /end CHARACTERISTIC
/begin CHARACTERISTIC THM_tTempDecDeltaGrad_C "" VALUE 0x700010dc Scalar_FLOAT32_IEEE 0 VBU0706_CM_single_cnt -3.4028234663852886E+38 3.4028234663852886E+38 /end CHARACTERISTIC
/begin CHARACTERISTIC THM_tTempIncDeltaGrad_C "" VALUE 0x700010e0 Scalar_FLOAT32_IEEE 0 VBU0706_CM_single_cnt -3.4028234663852886E+38 3.4028234663852886E+38 /end CHARACTERISTIC
/begin CHARACTERISTIC THM_tiDlyEXVDisbl_C "" VALUE 0x700010e4 Scalar_FLOAT32_IEEE 0 VBU0706_CM_single_cnt -3.4028234663852886E+38 3.4028234663852886E+38 /end CHARACTERISTIC
/begin CHARACTERISTIC THM_tiDlyFANAfterRun_C "" VALUE 0x700010e8 Scalar_FLOAT32_IEEE 0 VBU0706_CM_single_cnt -3.4028234663852886E+38 3.4028234663852886E+38 /end CHARACTERISTIC
/begin CHARACTERISTIC THM_tiDlyInitReq_C "" VALUE 0x700010ec Scalar_FLOAT32_IEEE 0 VBU0706_CM_single_cnt -3.4028234663852886E+38 3.4028234663852886E+38 /end CHARACTERISTIC
/begin CHARACTERISTIC THM_tiDlyTHMAfterRun_C "" VALUE 0x700010f0 Scalar_FLOAT32_IEEE 0 VBU0706_CM_single_cnt -3.4028234663852886E+38 3.4028234663852886E+38 /end CHARACTERISTIC
/begin CHARACTERISTIC THM_tiSmplTime_SY "" VALUE 0x700010f4 Scalar_FLOAT32_IEEE 0 VBU0706_CM_single_s 0.0 1.0E+23 /end CHARACTERISTIC
/begin CHARACTERISTIC THM_vVehSpdHysBand_C "" VALUE 0x700010f8 Scalar_FLOAT32_IEEE 0 VBU0706_CM_single_cnt -3.4028234663852886E+38 3.4028234663852886E+38 /end CHARACTERISTIC
/begin CHARACTERISTIC TQO_trqRMotrOvrdVal_C "" VALUE 0x700012ec Scalar_FLOAT32_IEEE 0 VBU0706_CM_single_cnt -3.4028234663852886E+38 3.4028234663852886E+38 /end CHARACTERISTIC
/begin CHARACTERISTIC VCUImdStopDrivingOvrdVal_C "" VALUE 0x700012f4 Scalar_FLOAT32_IEEE 0 VBU0706_CM_single_cnt -3.4028234663852886E+38 3.4028234663852886E+38 /end CHARACTERISTIC
/begin CHARACTERISTIC VCURmvAcChgerOvrdVal_C "" VALUE 0x700012f8 Scalar_FLOAT32_IEEE 0 VBU0706_CM_single_cnt -3.4028234663852886E+38 3.4028234663852886E+38 /end CHARACTERISTIC
/begin CHARACTERISTIC VehPwrLimdLampReqOvrdVal_C "" VALUE 0x70001374 Scalar_FLOAT32_IEEE 0 VBU0706_CM_single_cnt -3.4028234663852886E+38 3.4028234663852886E+38 /end CHARACTERISTIC
/begin CHARACTERISTIC Veh_flgHVILOvrdVal_C "" VALUE 0x70001380 Scalar_FLOAT32_IEEE 0 VBU0706_CM_single_cnt -3.4028234663852886E+38 3.4028234663852886E+38 /end CHARACTERISTIC
/begin CHARACTERISTIC Veh_pVacPumpRun_C "" VALUE 0x70001384 Scalar_FLOAT32_IEEE 0 VBU0706_CM_single_cnt 0.0 1.0E+23 /end CHARACTERISTIC
/begin CHARACTERISTIC Veh_pVacPumpStop_C "" VALUE 0x70001388 Scalar_FLOAT32_IEEE 0 VBU0706_CM_single_cnt 0.0 1.0E+23 /end CHARACTERISTIC
/begin CHARACTERISTIC Veh_pVacPumpWarning_C "" VALUE 0x7000138c Scalar_FLOAT32_IEEE 0 VBU0706_CM_single_cnt 0.0 1.0E+23 /end CHARACTERISTIC
/begin CHARACTERISTIC CcBCV_BatteryOverCurrentWarningFaultDelay_ms "" VALUE 0x700002c4 Scalar_ULONG 0 VBU0706_CM_uint32_cnt 0.0 4.294967295E+9 /end CHARACTERISTIC
/begin CHARACTERISTIC CcBCV_BatteryOverVoltageWarningFaultDelay_ms "" VALUE 0x700002d4 Scalar_ULONG 0 VBU0706_CM_uint32_cnt 0.0 4.294967295E+9 /end CHARACTERISTIC
/begin CHARACTERISTIC CcFCC_BatteryCapacityCycle1_n "" VALUE 0x700004ac Scalar_ULONG 0 VBU0706_CM_uint32_cnt 0.0 4.294967295E+9 /end CHARACTERISTIC
/begin CHARACTERISTIC CcFCC_BatteryCapacityCycle2_n "" VALUE 0x700004b0 Scalar_ULONG 0 VBU0706_CM_uint32_cnt 0.0 4.294967295E+9 /end CHARACTERISTIC
/begin CHARACTERISTIC CcSOC_BatteryDisplaySocUpdateInterval_s "" VALUE 0x700005ac Scalar_ULONG 0 VBU0706_CM_uint32_cnt 0.0 4.294967295E+9 /end CHARACTERISTIC
/begin CHARACTERISTIC CcSOC_InvalidLastShutdownTime_s "" VALUE 0x7000063c Scalar_ULONG 0 VBU0706_CM_uint32_cnt 0.0 4.294967295E+9 /end CHARACTERISTIC
/begin CHARACTERISTIC EcBCV_nbrFuseProtectCounter3W "" VALUE 0x70000d44 Scalar_ULONG 0 VBU0706_CM_uint32_cnt 0.0 4.294967295E+9 /end CHARACTERISTIC
/begin CHARACTERISTIC CTM_CELL_THERMAL_RUNAWAY_FAULT "" VALUE 0x7000001a Scalar_UWORD 0 VBU0706_CM_uint16_cnt 0.0 65535.0 /end CHARACTERISTIC
/begin CHARACTERISTIC CcBCV_BatteryCurrentDelay_ms "" VALUE 0x70000024 Scalar_UWORD 0 VBU0706_CM_uint16_cnt 0.0 65535.0 /end CHARACTERISTIC
/begin CHARACTERISTIC CcBCV_FuseProtectDelay1_ms "" VALUE 0x70000028 Scalar_UWORD 0 VBU0706_CM_uint16_cnt 0.0 65535.0 /end CHARACTERISTIC
/begin CHARACTERISTIC CcBCV_FuseProtectDelay2_ms "" VALUE 0x7000002a Scalar_UWORD 0 VBU0706_CM_uint16_cnt 0.0 65535.0 /end CHARACTERISTIC
/begin CHARACTERISTIC CcBCV_FuseProtectDelay3_ms "" VALUE 0x7000002c Scalar_UWORD 0 VBU0706_CM_uint16_cnt 0.0 65535.0 /end CHARACTERISTIC
/begin CHARACTERISTIC CcBCV_FuseProtectDelay4_ms "" VALUE 0x7000002e Scalar_UWORD 0 VBU0706_CM_uint16_cnt 0.0 65535.0 /end CHARACTERISTIC
/begin CHARACTERISTIC CcBCV_HighVoltageDelay_ms "" VALUE 0x70000030 Scalar_UWORD 0 VBU0706_CM_uint16_cnt 0.0 65535.0 /end CHARACTERISTIC
/begin CHARACTERISTIC CcCBL_BalanceStartCellVoltageMinHysteresis_mV "" VALUE 0x70000040 Scalar_UWORD 0 VBU0706_CM_uint16_cnt 0.0 65535.0 /end CHARACTERISTIC
/begin CHARACTERISTIC CcCBL_BalanceStartCellVoltageMin_mV "" VALUE 0x70000042 Scalar_UWORD 0 VBU0706_CM_uint16_cnt 0.0 65535.0 /end CHARACTERISTIC
/begin CHARACTERISTIC CcCBL_BalanceStartDeltaVoltage_mV "" VALUE 0x70000044 Scalar_UWORD 0 VBU0706_CM_uint16_cnt 0.0 65535.0 /end CHARACTERISTIC
/begin CHARACTERISTIC CcCBL_CellBalanceCurrentCheckTime_s "" VALUE 0x70000046 Scalar_UWORD 0 VBU0706_CM_uint16_cnt 0.0 65535.0 /end CHARACTERISTIC
/begin CHARACTERISTIC CcCBL_SocBalanceCurrentCheckTime_s "" VALUE 0x70000048 Scalar_UWORD 0 VBU0706_CM_uint16_cnt 0.0 65535.0 /end CHARACTERISTIC
/begin CHARACTERISTIC CcCTD_PrechargeFailLockoutInterval_s "" VALUE 0x7000004a Scalar_UWORD 0 VBU0706_CM_uint16_cnt 0.0 65535.0 /end CHARACTERISTIC
/begin CHARACTERISTIC CcCTD_PrechargeTimeMax_ms "" VALUE 0x7000004c Scalar_UWORD 0 VBU0706_CM_uint16_cnt 0.0 65535.0 /end CHARACTERISTIC
/begin CHARACTERISTIC CcCTS_ContactorRequestCloseDelay_ms "" VALUE 0x70000050 Scalar_UWORD 0 VBU0706_CM_uint16_cnt 0.0 65535.0 /end CHARACTERISTIC
/begin CHARACTERISTIC CcFCC_CurrentValueCrossZeroFlagDelay_ms "" VALUE 0x70000084 Scalar_UWORD 0 VBU0706_CM_uint16_cnt 0.0 65535.0 /end CHARACTERISTIC
/begin CHARACTERISTIC CcFCC_EstimateChargeTimeRefresh_s "" VALUE 0x70000086 Scalar_UWORD 0 VBU0706_CM_uint16_cnt 0.0 65535.0 /end CHARACTERISTIC
/begin CHARACTERISTIC CcFCC_MaxValidChargeTime_min "" VALUE 0x7000008e Scalar_UWORD 0 VBU0706_CM_uint16_cnt 0.0 65535.0 /end CHARACTERISTIC
/begin CHARACTERISTIC CcSOC_ChargeStateDelay_ms "" VALUE 0x7000009a Scalar_UWORD 0 VBU0706_CM_uint16_cnt 0.0 65535.0 /end CHARACTERISTIC
/begin CHARACTERISTIC INP_numEXVPosition1Lower_C "" VALUE 0x70000100 Scalar_UWORD 0 VBU0706_CM_uint16_cnt 0.0 480.0 /end CHARACTERISTIC
/begin CHARACTERISTIC INP_numEXVPosition1Upper_C "" VALUE 0x70000102 Scalar_UWORD 0 VBU0706_CM_uint16_cnt 0.0 480.0 /end CHARACTERISTIC
/begin CHARACTERISTIC INP_numEXVPosition2Upper_C "" VALUE 0x70000104 Scalar_UWORD 0 VBU0706_CM_uint16_cnt 0.0 480.0 /end CHARACTERISTIC
/begin CHARACTERISTIC MINUTES_PER_HOUR "" VALUE 0x7000010c Scalar_UWORD 0 VBU0706_CM_uint16_cnt 0.0 65535.0 /end CHARACTERISTIC
/begin CHARACTERISTIC SECONDS_PER_HOUR "" VALUE 0x70000118 Scalar_UWORD 0 VBU0706_CM_uint16_cnt 0.0 65535.0 /end CHARACTERISTIC
/begin CHARACTERISTIC APO_ACOvrd_C "" VALUE 0x70010729 Scalar_BOOLEAN 0 VBU0706_CM_boolean_cnt 0.0 1.0 /end CHARACTERISTIC
/begin CHARACTERISTIC APO_ACPowerOvrd_C "" VALUE 0x7001072a Scalar_BOOLEAN 0 VBU0706_CM_boolean_cnt 0.0 1.0 /end CHARACTERISTIC
/begin CHARACTERISTIC APO_ACSpeedOvrd_C "" VALUE 0x7001072b Scalar_BOOLEAN 0 VBU0706_CM_boolean_cnt 0.0 1.0 /end CHARACTERISTIC
/begin CHARACTERISTIC APO_BrakWarningOvrd_C "" VALUE 0x7001072e Scalar_BOOLEAN 0 VBU0706_CM_boolean_cnt 0.0 1.0 /end CHARACTERISTIC
/begin CHARACTERISTIC APO_BrkingWhileDrivingOvrd_C "" VALUE 0x7001072f Scalar_BOOLEAN 0 VBU0706_CM_boolean_cnt 0.0 1.0 /end CHARACTERISTIC
/begin CHARACTERISTIC APO_CruiseStatusOvrd_C "" VALUE 0x70010730 Scalar_BOOLEAN 0 VBU0706_CM_boolean_cnt 0.0 1.0 /end CHARACTERISTIC
/begin CHARACTERISTIC APO_EPBCtrlModeOvrd_C "" VALUE 0x70010731 Scalar_BOOLEAN 0 VBU0706_CM_boolean_cnt 0.0 1.0 /end CHARACTERISTIC
/begin CHARACTERISTIC APO_EPFaultLevelWarningOvrd_C "" VALUE 0x70010732 Scalar_BOOLEAN 0 VBU0706_CM_boolean_cnt 0.0 1.0 /end CHARACTERISTIC
/begin CHARACTERISTIC APO_LimpHomeOvrd_C "" VALUE 0x70010734 Scalar_BOOLEAN 0 VBU0706_CM_boolean_cnt 0.0 1.0 /end CHARACTERISTIC
/begin CHARACTERISTIC APO_OverSpeedOvrd_C "" VALUE 0x70010735 Scalar_BOOLEAN 0 VBU0706_CM_boolean_cnt 0.0 1.0 /end CHARACTERISTIC
/begin CHARACTERISTIC APO_PlsUSE750VDCOvrd_C "" VALUE 0x70010736 Scalar_BOOLEAN 0 VBU0706_CM_boolean_cnt 0.0 1.0 /end CHARACTERISTIC
/begin CHARACTERISTIC APO_PowerModeOvrd_C "" VALUE 0x70010737 Scalar_BOOLEAN 0 VBU0706_CM_boolean_cnt 0.0 1.0 /end CHARACTERISTIC
/begin CHARACTERISTIC APO_VehicleModeOvrd_C "" VALUE 0x7001073e Scalar_BOOLEAN 0 VBU0706_CM_boolean_cnt 0.0 1.0 /end CHARACTERISTIC
/begin CHARACTERISTIC APO_fACPumpOvrd_C "" VALUE 0x70010740 Scalar_BOOLEAN 0 VBU0706_CM_boolean_cnt 0.0 1.0 /end CHARACTERISTIC
/begin CHARACTERISTIC APO_fFanOvrd_C "" VALUE 0x70010741 Scalar_BOOLEAN 0 VBU0706_CM_boolean_cnt 0.0 1.0 /end CHARACTERISTIC
/begin CHARACTERISTIC APO_fHVIL1Ovrd_C "" VALUE 0x70010742 Scalar_BOOLEAN 0 VBU0706_CM_boolean_cnt 0.0 1.0 /end CHARACTERISTIC
/begin CHARACTERISTIC APO_fVacuumPumpOvrd_C "" VALUE 0x70010743 Scalar_BOOLEAN 0 VBU0706_CM_boolean_cnt 0.0 1.0 /end CHARACTERISTIC
/begin CHARACTERISTIC APO_fWaterPump1Ovrd_C "" VALUE 0x70010744 Scalar_BOOLEAN 0 VBU0706_CM_boolean_cnt 0.0 1.0 /end CHARACTERISTIC
/begin CHARACTERISTIC APO_fWaterPump2Ovrd_C "" VALUE 0x70010745 Scalar_BOOLEAN 0 VBU0706_CM_boolean_cnt 0.0 1.0 /end CHARACTERISTIC
/begin CHARACTERISTIC APO_flgBMSChargeStateOvrd_C "" VALUE 0x70010754 Scalar_BOOLEAN 0 VBU0706_CM_boolean_flg 0.0 1.0 /end CHARACTERISTIC
/begin CHARACTERISTIC APO_flgBattPackTempWarningOvrd_C "" VALUE 0x70010768 Scalar_BOOLEAN 0 VBU0706_CM_boolean_cnt 0.0 1.0 /end CHARACTERISTIC
/begin CHARACTERISTIC APO_flgDCChgRlyOvrdVal_C "" VALUE 0x7001076d Scalar_BOOLEAN 0 VBU0706_CM_boolean_cnt 0.0 1.0 /end CHARACTERISTIC
/begin CHARACTERISTIC APO_flgDCChgRlyOvrd_C "" VALUE 0x7001076e Scalar_BOOLEAN 0 VBU0706_CM_boolean_cnt 0.0 1.0 /end CHARACTERISTIC
/begin CHARACTERISTIC APO_flgEPBFaultOvrd_C "" VALUE 0x7001076f Scalar_BOOLEAN 0 VBU0706_CM_boolean_cnt 0.0 1.0 /end CHARACTERISTIC
/begin CHARACTERISTIC APO_flgEPSFaultOvrd_C "" VALUE 0x70010770 Scalar_BOOLEAN 0 VBU0706_CM_boolean_cnt 0.0 1.0 /end CHARACTERISTIC
/begin CHARACTERISTIC APO_flgFanORF "" VALUE 0x70010772 Scalar_BOOLEAN 0 VBU0706_CM_boolean_cnt 0.0 1.0 /end CHARACTERISTIC
/begin CHARACTERISTIC APO_flgHVBattWarningOvrd_C "" VALUE 0x70010773 Scalar_BOOLEAN 0 VBU0706_CM_boolean_cnt 0.0 1.0 /end CHARACTERISTIC
/begin CHARACTERISTIC APO_flgHVOnOvrd_C "" VALUE 0x70010774 Scalar_BOOLEAN 0 VBU0706_CM_boolean_flg 0.0 1.0 /end CHARACTERISTIC
/begin CHARACTERISTIC APO_flgHWSleepEnableORF "" VALUE 0x70010775 Scalar_BOOLEAN 0 VBU0706_CM_boolean_cnt 0.0 1.0 /end CHARACTERISTIC
/begin CHARACTERISTIC APO_flgIsolutionWarningOvrd_C "" VALUE 0x70010776 Scalar_BOOLEAN 0 VBU0706_CM_boolean_cnt 0.0 1.0 /end CHARACTERISTIC
/begin CHARACTERISTIC APO_flgMainRlyOvrdVal_C "" VALUE 0x70010778 Scalar_BOOLEAN 0 VBU0706_CM_boolean_cnt 0.0 1.0 /end CHARACTERISTIC
/begin CHARACTERISTIC APO_flgMainRlyOvrd_C "" VALUE 0x70010779 Scalar_BOOLEAN 0 VBU0706_CM_boolean_cnt 0.0 1.0 /end CHARACTERISTIC
/begin CHARACTERISTIC APO_flgSleepEnableORV "" VALUE 0x7001077a Scalar_BOOLEAN 0 VBU0706_CM_boolean_cnt 0.0 1.0 /end CHARACTERISTIC
/begin CHARACTERISTIC APO_flgWakeUp1OvrdVal_C "" VALUE 0x7001077b Scalar_BOOLEAN 0 VBU0706_CM_boolean_cnt 0.0 1.0 /end CHARACTERISTIC
/begin CHARACTERISTIC APO_flgWakeUp1Ovrd_C "" VALUE 0x7001077c Scalar_BOOLEAN 0 VBU0706_CM_boolean_cnt 0.0 1.0 /end CHARACTERISTIC
/begin CHARACTERISTIC APO_pctACPumpOvrd_C "" VALUE 0x7001077d Scalar_BOOLEAN 0 VBU0706_CM_boolean_cnt 0.0 1.0 /end CHARACTERISTIC
/begin CHARACTERISTIC APO_pctHVIL1Ovrd_C "" VALUE 0x7001077e Scalar_BOOLEAN 0 VBU0706_CM_boolean_cnt 0.0 1.0 /end CHARACTERISTIC
/begin CHARACTERISTIC APO_pctWaterPump1Ovrd_C "" VALUE 0x7001077f Scalar_BOOLEAN 0 VBU0706_CM_boolean_cnt 0.0 1.0 /end CHARACTERISTIC
/begin CHARACTERISTIC APO_pctWaterPump2Ovrd_C "" VALUE 0x70010780 Scalar_BOOLEAN 0 VBU0706_CM_boolean_cnt 0.0 1.0 /end CHARACTERISTIC
/begin CHARACTERISTIC CGW_flgVehDrvModeOvrd_C "" VALUE 0x700107c4 Scalar_BOOLEAN 0 VBU0706_CM_boolean_cnt 0.0 1.0 /end CHARACTERISTIC
/begin CHARACTERISTIC CGW_stVehRgnModeOvrd_C "" VALUE 0x700107d0 Scalar_BOOLEAN 0 VBU0706_CM_boolean_cnt 0.0 1.0 /end CHARACTERISTIC
/begin CHARACTERISTIC CaDSM_CscValueUncertainFault_flg "" VAL_BLK 0x70010c1b Scalar_BOOLEAN 0 VBU0706_CM_boolean_cnt 0.0 1.0 NUMBER 330 /end CHARACTERISTIC
/begin CHARACTERISTIC CaDSM_CycleUploadAbnormalEvent_flg "" VAL_BLK 0x70010d65 Scalar_BOOLEAN 0 VBU0706_CM_boolean_cnt 0.0 1.0 NUMBER 330 /end CHARACTERISTIC
/begin CHARACTERISTIC CaDSM_NoChargeFault_flg "" VAL_BLK 0x70010ff9 Scalar_BOOLEAN 0 VBU0706_CM_boolean_cnt 0.0 1.0 NUMBER 330 /end CHARACTERISTIC
/begin CHARACTERISTIC CbBCV_BatteryBusVoltageMismatch_flg "" VALUE 0x7001080c Scalar_BOOLEAN 0 VBU0706_CM_boolean_cnt 0.0 1.0 /end CHARACTERISTIC
/begin CHARACTERISTIC CbBCV_BatteryCurrentOoR_flg "" VALUE 0x7001080d Scalar_BOOLEAN 0 VBU0706_CM_boolean_cnt 0.0 1.0 /end CHARACTERISTIC
/begin CHARACTERISTIC CbBCV_BatteryCurrentZeroDriftEnable_flg "" VALUE 0x7001080e Scalar_BOOLEAN 0 VBU0706_CM_boolean_cnt 0.0 1.0 /end CHARACTERISTIC
/begin CHARACTERISTIC CbBCV_BatteryOverCurrentWarning_flg "" VALUE 0x7001080f Scalar_BOOLEAN 0 VBU0706_CM_boolean_cnt 0.0 1.0 /end CHARACTERISTIC
/begin CHARACTERISTIC CbBCV_BatteryOverCurrent_flg "" VALUE 0x70010810 Scalar_BOOLEAN 0 VBU0706_CM_boolean_cnt 0.0 1.0 /end CHARACTERISTIC
/begin CHARACTERISTIC CbBCV_BatteryOverVoltageEVMFaultEnable_flg "" VALUE 0x70010811 Scalar_BOOLEAN 0 VBU0706_CM_boolean_cnt 0.0 1.0 /end CHARACTERISTIC
/begin CHARACTERISTIC CbBCV_BatteryOverVoltageWarning_flg "" VALUE 0x70010812 Scalar_BOOLEAN 0 VBU0706_CM_boolean_cnt 0.0 1.0 /end CHARACTERISTIC
/begin CHARACTERISTIC CbBCV_BatteryOverVoltage_flg "" VALUE 0x70010813 Scalar_BOOLEAN 0 VBU0706_CM_boolean_cnt 0.0 1.0 /end CHARACTERISTIC
/begin CHARACTERISTIC CbBCV_BatteryUnderVoltageEVMFaultEnable_flg "" VALUE 0x70010814 Scalar_BOOLEAN 0 VBU0706_CM_boolean_cnt 0.0 1.0 /end CHARACTERISTIC
/begin CHARACTERISTIC CbBCV_BatteryUnderVoltage_flg "" VALUE 0x70010815 Scalar_BOOLEAN 0 VBU0706_CM_boolean_cnt 0.0 1.0 /end CHARACTERISTIC
/begin CHARACTERISTIC CbBCV_BatteryVoltageOoR_flg "" VALUE 0x70010816 Scalar_BOOLEAN 0 VBU0706_CM_boolean_cnt 0.0 1.0 /end CHARACTERISTIC
/begin CHARACTERISTIC CbCBL_CellBalanceEnable_flg "" VALUE 0x70010835 Scalar_BOOLEAN 0 VBU0706_CM_boolean_cnt 0.0 1.0 /end CHARACTERISTIC
/begin CHARACTERISTIC CbCBL_CellBalanceOCVCheckEnable_flg "" VALUE 0x70010836 Scalar_BOOLEAN 0 VBU0706_CM_boolean_cnt 0.0 1.0 /end CHARACTERISTIC
/begin CHARACTERISTIC CbCBL_CellTempCheckEnable_flg "" VALUE 0x70010837 Scalar_BOOLEAN 0 VBU0706_CM_boolean_cnt 0.0 1.0 /end CHARACTERISTIC
/begin CHARACTERISTIC CbCBL_IsolationResistanceEnable_flg "" VALUE 0x70010838 Scalar_BOOLEAN 0 VBU0706_CM_boolean_cnt 0.0 1.0 /end CHARACTERISTIC
/begin CHARACTERISTIC CbCTD_MnNegContactorWeldFaultEnable_flg "" VALUE 0x7001083b Scalar_BOOLEAN 0 VBU0706_CM_boolean_cnt 0.0 1.0 /end CHARACTERISTIC
/begin CHARACTERISTIC CbCTD_MnPosContactorWeldFaultEnable_flg "" VALUE 0x7001083d Scalar_BOOLEAN 0 VBU0706_CM_boolean_cnt 0.0 1.0 /end CHARACTERISTIC
/begin CHARACTERISTIC CbCTD_PrechargeOverEnergyLockoutEnable_flg "" VALUE 0x70010840 Scalar_BOOLEAN 0 VBU0706_CM_boolean_cnt 0.0 1.0 /end CHARACTERISTIC
/begin CHARACTERISTIC CbCTD_PrechargeRelayStuckOpenFaultEnable_flg "" VALUE 0x70010841 Scalar_BOOLEAN 0 VBU0706_CM_boolean_cnt 0.0 1.0 /end CHARACTERISTIC
/begin CHARACTERISTIC CbCTD_PrechargeTimeoutFaultEnable_flg "" VALUE 0x70010843 Scalar_BOOLEAN 0 VBU0706_CM_boolean_cnt 0.0 1.0 /end CHARACTERISTIC
/begin CHARACTERISTIC CbSOC_CellCapacityOvrdFlg_flg "" VALUE 0x70010870 Scalar_BOOLEAN 0 VBU0706_CM_boolean_cnt 0.0 1.0 /end CHARACTERISTIC
/begin CHARACTERISTIC DCH_flgDCChDiagCmdOvrdVal_C "" VALUE 0x700109ed Scalar_BOOLEAN 0 VBU0706_CM_boolean_cnt 0.0 1.0 /end CHARACTERISTIC
/begin CHARACTERISTIC DCH_flgDCChDiagCmdOvrd_C "" VALUE 0x700109ee Scalar_BOOLEAN 0 VBU0706_CM_boolean_cnt 0.0 1.0 /end CHARACTERISTIC
/begin CHARACTERISTIC DCH_flgDSPLChStsOvrd_C "" VALUE 0x700109f1 Scalar_BOOLEAN 0 VBU0706_CM_boolean_cnt 0.0 1.0 /end CHARACTERISTIC
/begin CHARACTERISTIC DCH_flgPosDCRlyReqOvrdVal_C "" VALUE 0x70010a04 Scalar_BOOLEAN 0 VBU0706_CM_boolean_cnt 0.0 1.0 /end CHARACTERISTIC
/begin CHARACTERISTIC DCH_flgPosDCRlyReqOvrd_C "" VALUE 0x70010a05 Scalar_BOOLEAN 0 VBU0706_CM_boolean_cnt 0.0 1.0 /end CHARACTERISTIC
/begin CHARACTERISTIC EDIS_flgCurrPwrOvrd_C "" VALUE 0x70010a7e Scalar_BOOLEAN 0 VBU0706_CM_boolean_cnt 0.0 1.0 /end CHARACTERISTIC
/begin CHARACTERISTIC Gear_flgEPBReqOvrd_C "" VALUE 0x70010ac0 Scalar_BOOLEAN 0 VBU0706_CM_boolean_cnt 0.0 1.0 /end CHARACTERISTIC
/begin CHARACTERISTIC Gear_stCurrentGearDisplayOvrd_C "" VALUE 0x70010ac6 Scalar_BOOLEAN 0 VBU0706_CM_boolean_cnt 0.0 1.0 /end CHARACTERISTIC
/begin CHARACTERISTIC HALIn_MotOverTempOvrdVal_C "" VALUE 0x70010adc Scalar_BOOLEAN 0 VBU0706_CM_boolean_cnt 0.0 1.0 /end CHARACTERISTIC
/begin CHARACTERISTIC HALIn_flgMotOverTempOvrd_C "" VALUE 0x70010add Scalar_BOOLEAN 0 VBU0706_CM_boolean_cnt 0.0 1.0 /end CHARACTERISTIC
/begin CHARACTERISTIC HVBattCutOffOvrd_C "" VALUE 0x70010adf Scalar_BOOLEAN 0 VBU0706_CM_boolean_cnt 0.0 1.0 /end CHARACTERISTIC
/begin CHARACTERISTIC LVC_flgDCDCReqOvrd_C "" VALUE 0x70010b0d Scalar_BOOLEAN 0 VBU0706_CM_boolean_cnt 0.0 1.0 /end CHARACTERISTIC
/begin CHARACTERISTIC LVC_flgDcdcCtrlReqOvrdVal_C "" VALUE 0x70010b0e Scalar_BOOLEAN 0 VBU0706_CM_boolean_cnt 0.0 1.0 /end CHARACTERISTIC
/begin CHARACTERISTIC LVC_flgDcdcCtrlReqOvrd_C "" VALUE 0x70010b0f Scalar_BOOLEAN 0 VBU0706_CM_boolean_cnt 0.0 1.0 /end CHARACTERISTIC
/begin CHARACTERISTIC LowBatteryWarningOvrd_C "" VALUE 0x70010b14 Scalar_BOOLEAN 0 VBU0706_CM_boolean_cnt 0.0 1.0 /end CHARACTERISTIC
/begin CHARACTERISTIC MotorFaultLevelOvrdVal_C "" VALUE 0x70010b2d Scalar_BOOLEAN 0 VBU0706_CM_boolean_cnt 0.0 1.0 /end CHARACTERISTIC
/begin CHARACTERISTIC MotorFaultLevelOvrd_C "" VALUE 0x70010b2e Scalar_BOOLEAN 0 VBU0706_CM_boolean_cnt 0.0 1.0 /end CHARACTERISTIC
/begin CHARACTERISTIC OUTP_flgDCRelayStatusORF "" VALUE 0x70010b35 Scalar_BOOLEAN 0 VBU0706_CM_boolean_cnt 0.0 1.0 /end CHARACTERISTIC
/begin CHARACTERISTIC OUTP_flgDCRelayStatusORFV "" VALUE 0x70010b36 Scalar_BOOLEAN 0 VBU0706_CM_boolean_cnt 0.0 1.0 /end CHARACTERISTIC
/begin CHARACTERISTIC PMM_flgRMCUActvDisChReqOvrdVal_C "" VALUE 0x70010b48 Scalar_BOOLEAN 0 VBU0706_CM_boolean_cnt 0.0 1.0 /end CHARACTERISTIC
/begin CHARACTERISTIC PMM_flgRMCUActvDisChReqOvrd_C "" VALUE 0x70010b49 Scalar_BOOLEAN 0 VBU0706_CM_boolean_cnt 0.0 1.0 /end CHARACTERISTIC
/begin CHARACTERISTIC PMM_flgVehRdyOvrdVal_C "" VALUE 0x70010b51 Scalar_BOOLEAN 0 VBU0706_CM_boolean_cnt 0.0 1.0 /end CHARACTERISTIC
/begin CHARACTERISTIC PMM_flgVehRdyOvrd_C "" VALUE 0x70010b52 Scalar_BOOLEAN 0 VBU0706_CM_boolean_cnt 0.0 1.0 /end CHARACTERISTIC
/begin CHARACTERISTIC SPD_vVehSpdOvrd_C "" VALUE 0x70010b8f Scalar_BOOLEAN 0 VBU0706_CM_boolean_cnt 0.0 1.0 /end CHARACTERISTIC
/begin CHARACTERISTIC THM_flgACCmpCmdOvrdSwt_C "" VALUE 0x70010b98 Scalar_BOOLEAN 0 VBU0706_CM_boolean_cnt 0.0 1.0 /end CHARACTERISTIC
/begin CHARACTERISTIC THM_flgACCmpEnaOvrdSwt_C "" VALUE 0x70010b99 Scalar_BOOLEAN 0 VBU0706_CM_boolean_cnt 0.0 1.0 /end CHARACTERISTIC
/begin CHARACTERISTIC THM_flgACCmpEnaOvrdVal_C "" VALUE 0x70010b9a Scalar_BOOLEAN 0 VBU0706_CM_boolean_cnt 0.0 1.0 /end CHARACTERISTIC
/begin CHARACTERISTIC THM_flgACPwrLimitSwt_C "" VALUE 0x70010b9b Scalar_BOOLEAN 0 VBU0706_CM_boolean_cnt 0.0 1.0 /end CHARACTERISTIC
/begin CHARACTERISTIC THM_flgBattPTCCmdOvrdSwt_C "" VALUE 0x70010b9c Scalar_BOOLEAN 0 VBU0706_CM_boolean_cnt 0.0 1.0 /end CHARACTERISTIC
/begin CHARACTERISTIC THM_flgBattPTCCmdOvrdVal_C "" VALUE 0x70010b9d Scalar_BOOLEAN 0 VBU0706_CM_boolean_cnt 0.0 1.0 /end CHARACTERISTIC
/begin CHARACTERISTIC THM_flgESSPmpCmdOvrdSwt_C "" VALUE 0x70010b9e Scalar_BOOLEAN 0 VBU0706_CM_boolean_cnt 0.0 1.0 /end CHARACTERISTIC
/begin CHARACTERISTIC THM_flgEXVEnaOvrdSwt_C "" VALUE 0x70010b9f Scalar_BOOLEAN 0 VBU0706_CM_boolean_cnt 0.0 1.0 /end CHARACTERISTIC
/begin CHARACTERISTIC THM_flgEXVEnaOvrdVal_C "" VALUE 0x70010ba0 Scalar_BOOLEAN 0 VBU0706_CM_boolean_cnt 0.0 1.0 /end CHARACTERISTIC
/begin CHARACTERISTIC THM_flgEXVEnaStsUsed_C "" VALUE 0x70010ba1 Scalar_BOOLEAN 0 VBU0706_CM_boolean_cnt 0.0 1.0 /end CHARACTERISTIC
/begin CHARACTERISTIC THM_flgEXVInitOvrdSwt_C "" VALUE 0x70010ba2 Scalar_BOOLEAN 0 VBU0706_CM_boolean_cnt 0.0 1.0 /end CHARACTERISTIC
/begin CHARACTERISTIC THM_flgEXVPosReqOvrdSwt_C "" VALUE 0x70010ba3 Scalar_BOOLEAN 0 VBU0706_CM_boolean_cnt 0.0 1.0 /end CHARACTERISTIC
/begin CHARACTERISTIC THM_flgFANFrecuencyOvrdSwt_C "" VALUE 0x70010ba4 Scalar_BOOLEAN 0 VBU0706_CM_boolean_cnt 0.0 1.0 /end CHARACTERISTIC
/begin CHARACTERISTIC THM_flgFANReqOvrdSwt_C "" VALUE 0x70010ba5 Scalar_BOOLEAN 0 VBU0706_CM_boolean_cnt 0.0 1.0 /end CHARACTERISTIC
/begin CHARACTERISTIC THM_flgFPVPosReqOvrdSwt_C "" VALUE 0x70010ba6 Scalar_BOOLEAN 0 VBU0706_CM_boolean_cnt 0.0 1.0 /end CHARACTERISTIC
/begin CHARACTERISTIC THM_flgPump1frecuencyOvrdSwt_C "" VALUE 0x70010ba7 Scalar_BOOLEAN 0 VBU0706_CM_boolean_cnt 0.0 1.0 /end CHARACTERISTIC
/begin CHARACTERISTIC THM_flgPump2frecuencyOvrdSwt_C "" VALUE 0x70010ba8 Scalar_BOOLEAN 0 VBU0706_CM_boolean_cnt 0.0 1.0 /end CHARACTERISTIC
/begin CHARACTERISTIC THM_flgRearPmpCmdOvrdSwt_C "" VALUE 0x70010ba9 Scalar_BOOLEAN 0 VBU0706_CM_boolean_cnt 0.0 1.0 /end CHARACTERISTIC
/begin CHARACTERISTIC THM_flgTHMAftRunOvrdSwt_C "" VALUE 0x70010baa Scalar_BOOLEAN 0 VBU0706_CM_boolean_cnt 0.0 1.0 /end CHARACTERISTIC
/begin CHARACTERISTIC THM_flgTHMAftRunOvrdVal_C "" VALUE 0x70010bab Scalar_BOOLEAN 0 VBU0706_CM_boolean_cnt 0.0 1.0 /end CHARACTERISTIC
/begin CHARACTERISTIC TQD_flgBrkRgnConfig_C "" VALUE 0x70010bc5 Scalar_BOOLEAN 0 VBU0706_CM_boolean_cnt 0.0 1.0 /end CHARACTERISTIC
/begin CHARACTERISTIC TQO_flgCtrlRMotrOvrd_C "" VALUE 0x70010bca Scalar_BOOLEAN 0 VBU0706_CM_boolean_cnt 0.0 1.0 /end CHARACTERISTIC
/begin CHARACTERISTIC TQO_trqRMotrOvrd_C "" VALUE 0x70010bcc Scalar_BOOLEAN 0 VBU0706_CM_boolean_cnt 0.0 1.0 /end CHARACTERISTIC
/begin CHARACTERISTIC VCUImdStopDrivingOvrd_C "" VALUE 0x70010bd3 Scalar_BOOLEAN 0 VBU0706_CM_boolean_cnt 0.0 1.0 /end CHARACTERISTIC
/begin CHARACTERISTIC VCURmvAcChgerOvrd_C "" VALUE 0x70010bd4 Scalar_BOOLEAN 0 VBU0706_CM_boolean_cnt 0.0 1.0 /end CHARACTERISTIC
/begin CHARACTERISTIC VM_flgVehLimActvOvrdVal_C "" VALUE 0x70010bd5 Scalar_BOOLEAN 0 VBU0706_CM_boolean_cnt 0.0 1.0 /end CHARACTERISTIC
/begin CHARACTERISTIC VM_flgVehLimActvOvrd_C "" VALUE 0x70010bd6 Scalar_BOOLEAN 0 VBU0706_CM_boolean_cnt 0.0 1.0 /end CHARACTERISTIC
/begin CHARACTERISTIC VehPwrLimdLampReqOvrd_C "" VALUE 0x70010be2 Scalar_BOOLEAN 0 VBU0706_CM_boolean_cnt 0.0 1.0 /end CHARACTERISTIC
/begin CHARACTERISTIC Veh_flgHVILOvrd_C "" VALUE 0x70010be5 Scalar_BOOLEAN 0 VBU0706_CM_boolean_cnt 0.0 1.0 /end CHARACTERISTIC
/begin CHARACTERISTIC CcBCV_BatteryBusVoltageMismatchFaultFIC_n "" VALUE 0x700108e9 Scalar_BYTE 0 VBU0706_CM_int8_cnt -128.0 127.0 /end CHARACTERISTIC
/begin CHARACTERISTIC CcBCV_BatteryBusVoltageMismatchFaultPIC_n "" VALUE 0x700108ea Scalar_BYTE 0 VBU0706_CM_int8_cnt -128.0 127.0 /end CHARACTERISTIC
/begin CHARACTERISTIC CcBCV_BatteryCurrentOoRFaultFIC_n "" VALUE 0x700108eb Scalar_BYTE 0 VBU0706_CM_int8_cnt -128.0 127.0 /end CHARACTERISTIC
/begin CHARACTERISTIC CcBCV_BatteryCurrentOoRFaultPIC_n "" VALUE 0x700108ec Scalar_BYTE 0 VBU0706_CM_int8_cnt -128.0 127.0 /end CHARACTERISTIC
/begin CHARACTERISTIC CcBCV_BatteryOverCurrentFaultFIC_n "" VALUE 0x700108ed Scalar_BYTE 0 VBU0706_CM_int8_cnt -128.0 127.0 /end CHARACTERISTIC
/begin CHARACTERISTIC CcBCV_BatteryOverCurrentFaultPIC_n "" VALUE 0x700108ee Scalar_BYTE 0 VBU0706_CM_int8_cnt -128.0 127.0 /end CHARACTERISTIC
/begin CHARACTERISTIC CcBCV_BatteryOverCurrentWarningFaultFIC_n "" VALUE 0x700108ef Scalar_BYTE 0 VBU0706_CM_int8_cnt -128.0 127.0 /end CHARACTERISTIC
/begin CHARACTERISTIC CcBCV_BatteryOverCurrentWarningFaultPIC_n "" VALUE 0x700108f0 Scalar_BYTE 0 VBU0706_CM_int8_cnt -128.0 127.0 /end CHARACTERISTIC
/begin CHARACTERISTIC CcBCV_BatteryOverVoltageEVMFaultFIC_n "" VALUE 0x700108f1 Scalar_BYTE 0 VBU0706_CM_int8_cnt -128.0 127.0 /end CHARACTERISTIC
/begin CHARACTERISTIC CcBCV_BatteryOverVoltageEVMFaultPIC_n "" VALUE 0x700108f2 Scalar_BYTE 0 VBU0706_CM_int8_cnt -128.0 127.0 /end CHARACTERISTIC
/begin CHARACTERISTIC CcBCV_BatteryOverVoltageFaultFIC_n "" VALUE 0x700108f3 Scalar_BYTE 0 VBU0706_CM_int8_cnt -128.0 127.0 /end CHARACTERISTIC
/begin CHARACTERISTIC CcBCV_BatteryOverVoltageFaultPIC_n "" VALUE 0x700108f4 Scalar_BYTE 0 VBU0706_CM_int8_cnt -128.0 127.0 /end CHARACTERISTIC
/begin CHARACTERISTIC CcBCV_BatteryOverVoltageWarningFaultFIC_n "" VALUE 0x700108f5 Scalar_BYTE 0 VBU0706_CM_int8_cnt -128.0 127.0 /end CHARACTERISTIC
/begin CHARACTERISTIC CcBCV_BatteryOverVoltageWarningFaultPIC_n "" VALUE 0x700108f6 Scalar_BYTE 0 VBU0706_CM_int8_cnt -128.0 127.0 /end CHARACTERISTIC
/begin CHARACTERISTIC CcBCV_BatteryUnderVoltageEVMFaultFIC_n "" VALUE 0x700108f7 Scalar_BYTE 0 VBU0706_CM_int8_cnt -128.0 127.0 /end CHARACTERISTIC
/begin CHARACTERISTIC CcBCV_BatteryUnderVoltageEVMFaultPIC_n "" VALUE 0x700108f8 Scalar_BYTE 0 VBU0706_CM_int8_cnt -128.0 127.0 /end CHARACTERISTIC
/begin CHARACTERISTIC CcBCV_BatteryUnderVoltageFaultFIC_n "" VALUE 0x700108f9 Scalar_BYTE 0 VBU0706_CM_int8_cnt -128.0 127.0 /end CHARACTERISTIC
/begin CHARACTERISTIC CcBCV_BatteryUnderVoltageFaultPIC_n "" VALUE 0x700108fa Scalar_BYTE 0 VBU0706_CM_int8_cnt -128.0 127.0 /end CHARACTERISTIC
/begin CHARACTERISTIC CcBCV_BatteryVoltageOoRFaultFIC_n "" VALUE 0x700108fb Scalar_BYTE 0 VBU0706_CM_int8_cnt -128.0 127.0 /end CHARACTERISTIC
/begin CHARACTERISTIC CcBCV_BatteryVoltageOoRFaultPIC_n "" VALUE 0x700108fc Scalar_BYTE 0 VBU0706_CM_int8_cnt -128.0 127.0 /end CHARACTERISTIC
/begin CHARACTERISTIC CcCTD_MNCWeldTestEnablePEURVoltageRatio_pct "" VALUE 0x7001090a Scalar_BYTE 0 VBU0706_CM_int8_cnt -128.0 127.0 /end CHARACTERISTIC
/begin CHARACTERISTIC CcCTD_MnNegContactorWeldFaultFIC_n "" VALUE 0x70010910 Scalar_BYTE 0 VBU0706_CM_int8_cnt -128.0 127.0 /end CHARACTERISTIC
/begin CHARACTERISTIC CcCTD_MnNegContactorWeldFaultPIC_n "" VALUE 0x70010911 Scalar_BYTE 0 VBU0706_CM_int8_cnt -128.0 127.0 /end CHARACTERISTIC
/begin CHARACTERISTIC CcCTD_MnPosContactorWeldFaultFIC_n "" VALUE 0x70010914 Scalar_BYTE 0 VBU0706_CM_int8_cnt -128.0 127.0 /end CHARACTERISTIC
/begin CHARACTERISTIC CcCTD_MnPosContactorWeldFaultPIC_n "" VALUE 0x70010915 Scalar_BYTE 0 VBU0706_CM_int8_cnt -128.0 127.0 /end CHARACTERISTIC
/begin CHARACTERISTIC CcCTD_PrechargeRelayStuckOpenFaultFIC_n "" VALUE 0x70010918 Scalar_BYTE 0 VBU0706_CM_int8_cnt -128.0 127.0 /end CHARACTERISTIC
/begin CHARACTERISTIC CcCTD_PrechargeRelayStuckOpenFaultPIC_n "" VALUE 0x70010919 Scalar_BYTE 0 VBU0706_CM_int8_cnt -128.0 127.0 /end CHARACTERISTIC
/begin CHARACTERISTIC CcCTD_PrechargeTimeoutFaultFIC_n "" VALUE 0x7001091c Scalar_BYTE 0 VBU0706_CM_int8_cnt -128.0 127.0 /end CHARACTERISTIC
/begin CHARACTERISTIC CcCTD_PrechargeTimeoutFaultPIC_n "" VALUE 0x7001091d Scalar_BYTE 0 VBU0706_CM_int8_cnt -128.0 127.0 /end CHARACTERISTIC
/begin CHARACTERISTIC CcCTM_CellThermalRunawayFaultFIC_n "" VALUE 0x70010929 Scalar_BYTE 0 VBU0706_CM_int8_cnt -128.0 127.0 /end CHARACTERISTIC
/begin CHARACTERISTIC CcCTM_CellThermalRunawayFaultPIC_n "" VALUE 0x7001092a Scalar_BYTE 0 VBU0706_CM_int8_cnt -128.0 127.0 /end CHARACTERISTIC
/begin CHARACTERISTIC CcCTM_ThermalRunawayFaultFIC_n "" VALUE 0x7001092d Scalar_BYTE 0 VBU0706_CM_int8_cnt -128.0 127.0 /end CHARACTERISTIC
/begin CHARACTERISTIC CcCTM_ThermalRunawayFaultPIC_n "" VALUE 0x7001092e Scalar_BYTE 0 VBU0706_CM_int8_cnt -128.0 127.0 /end CHARACTERISTIC
/begin CHARACTERISTIC CcFDC_MaxCount_n "" VALUE 0x70010948 Scalar_BYTE 0 VBU0706_CM_int8_cnt -128.0 127.0 /end CHARACTERISTIC
/begin CHARACTERISTIC CcFDC_MinCount_n "" VALUE 0x70010949 Scalar_BYTE 0 VBU0706_CM_int8_cnt -128.0 127.0 /end CHARACTERISTIC
/begin CHARACTERISTIC APO_stBMSChargeStateOvrdVal_C "" VALUE 0x70010781 Scalar_UBYTE 0 VBU0706_CM_uint8_cnt 0.0 255.0 /end CHARACTERISTIC
/begin CHARACTERISTIC APO_stBattPackTempWarningOvrdVal_C "" VALUE 0x70010784 Scalar_UBYTE 0 VBU0706_CM_uint8_cnt 0.0 255.0 /end CHARACTERISTIC
/begin CHARACTERISTIC APO_stHVBattWarningOvrdVal_C "" VALUE 0x70010785 Scalar_UBYTE 0 VBU0706_CM_uint8_cnt 0.0 255.0 /end CHARACTERISTIC
/begin CHARACTERISTIC APO_stHVOnOvrdVal_C "" VALUE 0x70010786 Scalar_UBYTE 0 VBU0706_CM_uint8_cnt 0.0 255.0 /end CHARACTERISTIC
/begin CHARACTERISTIC APO_stIsolutionWarningOvrdVal_C "" VALUE 0x70010787 Scalar_UBYTE 0 VBU0706_CM_uint8_cnt 0.0 255.0 /end CHARACTERISTIC
/begin CHARACTERISTIC BCV_BATTERY_BUS_VOLTAGE_MISMATCH_FAULT "" VALUE 0x7001078e Scalar_UBYTE 0 VBU0706_CM_uint8_cnt 0.0 255.0 /end CHARACTERISTIC
/begin CHARACTERISTIC BCV_BATTERY_OVER_CURRENT_WARNING_FAULT "" VALUE 0x7001078f Scalar_UBYTE 0 VBU0706_CM_uint8_cnt 0.0 255.0 /end CHARACTERISTIC
/begin CHARACTERISTIC BCV_BATTERY_UNDER_VOLTAGEEVM_FAULT "" VALUE 0x70010790 Scalar_UBYTE 0 VBU0706_CM_uint8_cnt 0.0 255.0 /end CHARACTERISTIC
/begin CHARACTERISTIC BCV_BATTERY_UNDER_VOLTAGE_FAULT "" VALUE 0x70010791 Scalar_UBYTE 0 VBU0706_CM_uint8_cnt 0.0 255.0 /end CHARACTERISTIC
/begin CHARACTERISTIC BCV_BATTERY_VOLTAGE_SENSE_OOR_FAULT "" VALUE 0x70010792 Scalar_UBYTE 0 VBU0706_CM_uint8_cnt 0.0 255.0 /end CHARACTERISTIC
/begin CHARACTERISTIC BCV_LEM_CURRENT_SENSE_OOR_FAULT "" VALUE 0x70010793 Scalar_UBYTE 0 VBU0706_CM_uint8_cnt 0.0 255.0 /end CHARACTERISTIC
/begin CHARACTERISTIC BMM_STATE_POWER_SWAP "" VALUE 0x7001079d Scalar_UBYTE 0 VBU0706_CM_uint8_cnt 0.0 255.0 /end CHARACTERISTIC
/begin CHARACTERISTIC CGW_stVehDrvModeOvrdVal_C "" VALUE 0x700107ca Scalar_UBYTE 0 VBU0706_CM_uint8_cnt 0.0 255.0 /end CHARACTERISTIC
/begin CHARACTERISTIC CGW_stVehRgnModeOvrdVal_C "" VALUE 0x700107cf Scalar_UBYTE 0 VBU0706_CM_uint8_cnt 0.0 255.0 /end CHARACTERISTIC
/begin CHARACTERISTIC CTD_PRECHARGE_STATUS_CHARGING "" VALUE 0x700107ee Scalar_UBYTE 0 VBU0706_CM_uint8_cnt 0.0 255.0 /end CHARACTERISTIC
/begin CHARACTERISTIC CaFCC_CurrentLimitRemainChargeTimeSocTempMapDimension_n "" VAL_BLK 0x70010c01 Scalar_UBYTE 0 VBU0706_CM_uint8_cnt 0.0 255.0 NUMBER 2 /end CHARACTERISTIC
/begin CHARACTERISTIC CaFCC_IdealRemainChargeTimeSocTempMapDimension_n "" VAL_BLK 0x70010c07 Scalar_UBYTE 0 VBU0706_CM_uint8_cnt 0.0 255.0 NUMBER 2 /end CHARACTERISTIC
/begin CHARACTERISTIC CaOCV_QuasiOCVCurrentDimension_n "" VAL_BLK 0x70010c0b Scalar_UBYTE 0 VBU0706_CM_uint8_cnt 0.0 255.0 NUMBER 2 /end CHARACTERISTIC
/begin CHARACTERISTIC CbCTM_CellThermalRunawayEnable_flg "" VALUE 0x70010849 Scalar_UBYTE 0 VBU0706_CM_uint8_cnt 0.0 255.0 /end CHARACTERISTIC
/begin CHARACTERISTIC CbCTM_ThermalRunawayTestFailORF_flg "" VALUE 0x7001084b Scalar_UBYTE 0 VBU0706_CM_uint8_cnt 0.0 255.0 /end CHARACTERISTIC
/begin CHARACTERISTIC CbCTM_ThermalRunawayTestFailORV_flg "" VALUE 0x7001084c Scalar_UBYTE 0 VBU0706_CM_uint8_cnt 0.0 255.0 /end CHARACTERISTIC
/begin CHARACTERISTIC CbCTS_CellDataInvalidSerialCheckEnable_flg "" VALUE 0x7001084d Scalar_UBYTE 0 VBU0706_CM_uint8_cnt 0.0 255.0 /end CHARACTERISTIC
/begin CHARACTERISTIC CbCTS_ContactorComandBypassBMUModeEnable_flg "" VALUE 0x7001084e Scalar_UBYTE 0 VBU0706_CM_uint8_cnt 0.0 255.0 /end CHARACTERISTIC
/begin CHARACTERISTIC CbCTS_EnergyProtectEnable_flg "" VALUE 0x7001084f Scalar_UBYTE 0 VBU0706_CM_uint8_cnt 0.0 255.0 /end CHARACTERISTIC
/begin CHARACTERISTIC CbCTS_SocInitialInhibitEnable_flg "" VALUE 0x70010850 Scalar_UBYTE 0 VBU0706_CM_uint8_cnt 0.0 255.0 /end CHARACTERISTIC
/begin CHARACTERISTIC CcCTD_MnCntcStuckOpenVhclSpdThreshold_kmh "" VALUE 0x7001090d Scalar_UBYTE 0 VBU0706_CM_uint8_cnt 0.0 255.0 /end CHARACTERISTIC
/begin CHARACTERISTIC CcCTS_BatteryDisplaySocLimit_pct "" VALUE 0x7001092f Scalar_UBYTE 0 VBU0706_CM_uint8_cnt 0.0 255.0 /end CHARACTERISTIC
/begin CHARACTERISTIC CcCTS_SocMinLimit_pct "" VALUE 0x70010936 Scalar_UBYTE 0 VBU0706_CM_uint8_cnt 0.0 255.0 /end CHARACTERISTIC
/begin CHARACTERISTIC CcSYS_NoOfInvalidCellVoltages_n "" VALUE 0x70010961 Scalar_UBYTE 0 VBU0706_CM_uint8_cnt 0.0 255.0 /end CHARACTERISTIC
/begin CHARACTERISTIC CmDSM_MILFaultCat_enum "" VALUE 0x70010992 Scalar_UBYTE 0 VBU0706_CM_uint8_cnt 0.0 255.0 /end CHARACTERISTIC
/begin CHARACTERISTIC CmFCC_NoChargeCellTempHigh_enum "" VALUE 0x70010993 Scalar_UBYTE 0 VBU0706_CM_uint8_cnt 0.0 255.0 /end CHARACTERISTIC
/begin CHARACTERISTIC CmFCC_NoChargeCellTempLow_enum "" VALUE 0x70010994 Scalar_UBYTE 0 VBU0706_CM_uint8_cnt 0.0 255.0 /end CHARACTERISTIC
/begin CHARACTERISTIC CmFCC_NoChargeFaultCat_enum "" VALUE 0x70010995 Scalar_UBYTE 0 VBU0706_CM_uint8_cnt 0.0 255.0 /end CHARACTERISTIC
/begin CHARACTERISTIC CmFCC_NoChargeFault_enum "" VALUE 0x70010996 Scalar_UBYTE 0 VBU0706_CM_uint8_cnt 0.0 255.0 /end CHARACTERISTIC
/begin CHARACTERISTIC CmFCC_NoChargeVoltageHigh_enum "" VALUE 0x70010997 Scalar_UBYTE 0 VBU0706_CM_uint8_cnt 0.0 255.0 /end CHARACTERISTIC
/begin CHARACTERISTIC DCH_stBMSChrging_SY "" VALUE 0x70010a21 Scalar_UBYTE 0 VBU0706_CM_uint8_cnt 0.0 255.0 /end CHARACTERISTIC
/begin CHARACTERISTIC DCH_stDSPLChStsOvrdVal_C "" VALUE 0x70010a35 Scalar_UBYTE 0 VBU0706_CM_uint8_cnt 0.0 255.0 /end CHARACTERISTIC
/begin CHARACTERISTIC DCH_stHVCntctClosed_SY "" VALUE 0x70010a38 Scalar_UBYTE 0 VBU0706_CM_uint8_cnt 0.0 255.0 /end CHARACTERISTIC
/begin CHARACTERISTIC DIAGNOSTIC_ON_GOING "" VALUE 0x70010a70 Scalar_UBYTE 0 VBU0706_CM_uint8_cnt 0.0 255.0 /end CHARACTERISTIC
/begin CHARACTERISTIC DSPL_stDCDCStsFail_SY "" VALUE 0x70010a77 Scalar_UBYTE 0 VBU0706_CM_uint8_cnt 0.0 255.0 /end CHARACTERISTIC
/begin CHARACTERISTIC DSPL_stHVCntctStClosed_SY "" VALUE 0x70010a79 Scalar_UBYTE 0 VBU0706_CM_uint8_cnt 0.0 255.0 /end CHARACTERISTIC
/begin CHARACTERISTIC DSPL_stLvBattChrgFail_C "" VALUE 0x70010a7a Scalar_UBYTE 0 VBU0706_CM_uint8_cnt 0.0 255.0 /end CHARACTERISTIC
/begin CHARACTERISTIC DSPL_stLvBattChrging_C "" VALUE 0x70010a7b Scalar_UBYTE 0 VBU0706_CM_uint8_cnt 0.0 255.0 /end CHARACTERISTIC
/begin CHARACTERISTIC DSPL_stLvBattNoChrg_C "" VALUE 0x70010a7c Scalar_UBYTE 0 VBU0706_CM_uint8_cnt 0.0 255.0 /end CHARACTERISTIC
/begin CHARACTERISTIC FAULT_CAT_NONE "" VALUE 0x70010a95 Scalar_UBYTE 0 VBU0706_CM_uint8_cnt 0.0 255.0 /end CHARACTERISTIC
/begin CHARACTERISTIC FPV_st4WayVlvPosFdbkPosition1_SY "" VALUE 0x70010aa0 Scalar_UBYTE 0 VBU0706_CM_uint8_cnt 0.0 8.0 /end CHARACTERISTIC
/begin CHARACTERISTIC FPV_st4WayVlvPosFdbkPosition2_SY "" VALUE 0x70010aa1 Scalar_UBYTE 0 VBU0706_CM_uint8_cnt 0.0 8.0 /end CHARACTERISTIC
/begin CHARACTERISTIC FPV_st4WayVlvPosFdbkUnknow_SY "" VALUE 0x70010aa2 Scalar_UBYTE 0 VBU0706_CM_uint8_cnt 0.0 8.0 /end CHARACTERISTIC
/begin CHARACTERISTIC Gear_stCurrentGearDisplayOvrdVal_C "" VALUE 0x70010ac5 Scalar_UBYTE 0 VBU0706_CM_uint8_cnt 0.0 255.0 /end CHARACTERISTIC
/begin CHARACTERISTIC Gear_stEPBReqOvrdVal_C "" VALUE 0x70010ad2 Scalar_UBYTE 0 VBU0706_CM_uint8_cnt 0.0 255.0 /end CHARACTERISTIC
/begin CHARACTERISTIC PMM_stInitMode_SY "" VALUE 0x70010b69 Scalar_UBYTE 0 VBU0706_CM_uint8_cnt 0.0 255.0 /end CHARACTERISTIC
/begin CHARACTERISTIC PMM_stShutDown_SY "" VALUE 0x70010b72 Scalar_UBYTE 0 VBU0706_CM_uint8_cnt 0.0 255.0 /end CHARACTERISTIC
/begin CHARACTERISTIC THM_stEXVInitOvrdVal_C "" VALUE 0x70010bac Scalar_UBYTE 0 VBU0706_CM_uint8_cnt 0.0 255.0 /end CHARACTERISTIC
/begin CHARACTERISTIC THM_stEXVInitialized_SY "" VALUE 0x70010bad Scalar_UBYTE 0 VBU0706_CM_uint8_cnt 0.0 255.0 /end CHARACTERISTIC
/begin CHARACTERISTIC THM_stEXVNotInitialized_SY "" VALUE 0x70010bae Scalar_UBYTE 0 VBU0706_CM_uint8_cnt 0.0 255.0 /end CHARACTERISTIC
/begin CHARACTERISTIC THM_stFPVBigCycle_SY "" VALUE 0x70010baf Scalar_UBYTE 0 VBU0706_CM_uint8_cnt 0.0 255.0 /end CHARACTERISTIC
/begin CHARACTERISTIC THM_stFPVPosOvrdVal_C "" VALUE 0x70010bb0 Scalar_UBYTE 0 VBU0706_CM_uint8_cnt 0.0 255.0 /end CHARACTERISTIC
/begin CHARACTERISTIC THM_stFPVSmallCycle_SY "" VALUE 0x70010bb1 Scalar_UBYTE 0 VBU0706_CM_uint8_cnt 0.0 255.0 /end CHARACTERISTIC
/begin CHARACTERISTIC TQO_stCtrlRMotrOvrdVal_C "" VALUE 0x70010bcb Scalar_UBYTE 0 VBU0706_CM_uint8_cnt 0.0 255.0 /end CHARACTERISTIC
/begin CHARACTERISTIC Veh_stIMInverterON_C "" VALUE 0x70010bea Scalar_UBYTE 0 VBU0706_CM_uint8_cnt 0.0 15.0 /end CHARACTERISTIC
/begin CHARACTERISTIC Veh_stInverterOFF_C "" VALUE 0x70010beb Scalar_UBYTE 0 VBU0706_CM_uint8_cnt 0.0 15.0 /end CHARACTERISTIC
/begin CHARACTERISTIC Veh_stInverterON_C "" VALUE 0x70010bec Scalar_UBYTE 0 VBU0706_CM_uint8_cnt 0.0 15.0 /end CHARACTERISTIC
/begin MEASUREMENT CTD_tisPrechargeLockoutTime "" ULONG VBU0706_CM_uint32 0 0 0 4294967295 ECU_ADDRESS 0x700114ce /end MEASUREMENT
/begin MEASUREMENT CTD_tiLastPrechargeStartTime "" ULONG VBU0706_CM_uint32 0 0 0 4294967295 ECU_ADDRESS 0x700114ca /end MEASUREMENT
/begin MEASUREMENT EcBCV_nbrFuseProtectCounter3r "" ULONG VBU0706_CM_uint32 0 0 0 4294967295 ECU_ADDRESS 0x700115fe /end MEASUREMENT
/begin MEASUREMENT Src "" ULONG VBU0706_CM_uint32 0 0 0 4294967295 ECU_ADDRESS 0x70011936 /end MEASUREMENT
/begin MEASUREMENT CBL_tCTMBoardTempMaxORV "" FLOAT32_IEEE VBU0706_CM_single 0 0 -3.4E+38 3.4E+38 ECU_ADDRESS 0x700114ae /end MEASUREMENT
/begin MEASUREMENT LcSOH_AhMinSocCellCapacity "" FLOAT32_IEEE VBU0706_CM_single 0 0 -3.4E+38 3.4E+38 ECU_ADDRESS 0x70011712 /end MEASUREMENT
/begin MEASUREMENT CBL_pctBalanceTargeSoc "" FLOAT32_IEEE VBU0706_CM_single 0 0 -3.4E+38 3.4E+38 ECU_ADDRESS 0x700114aa /end MEASUREMENT
/begin MEASUREMENT SOC_iAModuleCurrent "" FLOAT32_IEEE VBU0706_CM_single 0 0 -3.4E+38 3.4E+38 ECU_ADDRESS 0x700117a2 /end MEASUREMENT
/begin MEASUREMENT FCC_iABaseChargeCurrentRequest "" FLOAT32_IEEE VBU0706_CM_single 0 0 -3.4E+38 3.4E+38 ECU_ADDRESS 0x7001160a /end MEASUREMENT
/begin MEASUREMENT FCC_uBaseChargeVoltageRequest "" FLOAT32_IEEE VBU0706_CM_single 0 0 -3.4E+38 3.4E+38 ECU_ADDRESS 0x7001165a /end MEASUREMENT
/begin MEASUREMENT FCC_kwBaseChargePowerRequest "" FLOAT32_IEEE VBU0706_CM_single 0 0 0.0 10000.0 ECU_ADDRESS 0x70011626 /end MEASUREMENT
/begin MEASUREMENT FCC_iAChargeRequestCurrentLimit "" FLOAT32_IEEE VBU0706_CM_single 0 0 -3.4E+38 3.4E+38 ECU_ADDRESS 0x7001161a /end MEASUREMENT
/begin MEASUREMENT FCC_iAChargeCurrentRequestFnl "" FLOAT32_IEEE VBU0706_CM_single 0 0 -3.4E+38 3.4E+38 ECU_ADDRESS 0x70011612 /end MEASUREMENT
/begin MEASUREMENT FCC_timinFastChargeBaseRemainTime "" FLOAT32_IEEE VBU0706_CM_single 0 0 -3.4E+38 3.4E+38 ECU_ADDRESS 0x70011646 /end MEASUREMENT
/begin MEASUREMENT LcFCC_timinEstimatePercTime "" FLOAT32_IEEE VBU0706_CM_single 0 0 -3.4E+38 3.4E+38 ECU_ADDRESS 0x700116f6 /end MEASUREMENT
/begin MEASUREMENT CTD_pctBusOfBatteryVoltage "" FLOAT32_IEEE VBU0706_CM_single 0 0 -3.4E+38 3.4E+38 ECU_ADDRESS 0x700114b6 /end MEASUREMENT
/begin MEASUREMENT LcSOC_AhLifeTimeCoulomb "" FLOAT32_IEEE VBU0706_CM_single 0 0 -3.4E+38 3.4E+38 ECU_ADDRESS 0x700116fa /end MEASUREMENT
/begin MEASUREMENT BCV_AhLifeTimeCharge "" FLOAT32_IEEE VBU0706_CM_single 0 0 -3.4E+38 3.4E+38 ECU_ADDRESS 0x70011436 /end MEASUREMENT
/begin MEASUREMENT BCV_AhLifeTimeDischarge "" FLOAT32_IEEE VBU0706_CM_single 0 0 -3.4E+38 3.4E+38 ECU_ADDRESS 0x7001143a /end MEASUREMENT
/begin MEASUREMENT BCV_AhLifeTimeFastcharge "" FLOAT32_IEEE VBU0706_CM_single 0 0 -3.4E+38 3.4E+38 ECU_ADDRESS 0x7001143e /end MEASUREMENT
/begin MEASUREMENT BCV_uVx2Voltage "" FLOAT32_IEEE VBU0706_CM_single 0 0 -3.4E+38 3.4E+38 ECU_ADDRESS 0x70011476 /end MEASUREMENT
/begin MEASUREMENT BCV_uPrechargeVoltage "" FLOAT32_IEEE VBU0706_CM_single 0 0 -3.4E+38 3.4E+38 ECU_ADDRESS 0x70011472 /end MEASUREMENT
/begin MEASUREMENT BCV_uFuseVoltage "" FLOAT32_IEEE VBU0706_CM_single 0 0 -3.4E+38 3.4E+38 ECU_ADDRESS 0x7001145e /end MEASUREMENT
/begin MEASUREMENT BCV_uBusVoltage "" FLOAT32_IEEE VBU0706_CM_single 0 0 -3.4E+38 3.4E+38 ECU_ADDRESS 0x7001145a /end MEASUREMENT
/begin MEASUREMENT BCV_uBusNegativeVoltage "" FLOAT32_IEEE VBU0706_CM_single 0 0 -3.4E+38 3.4E+38 ECU_ADDRESS 0x70011456 /end MEASUREMENT
/begin MEASUREMENT BCV_uBatteryVoltage "" FLOAT32_IEEE VBU0706_CM_single 0 0 -3.4E+38 3.4E+38 ECU_ADDRESS 0x70011452 /end MEASUREMENT
/begin MEASUREMENT BCV_iAUpdateBatteryCurrent "" FLOAT32_IEEE VBU0706_CM_single 0 0 -3.4E+38 3.4E+38 ECU_ADDRESS 0x7001144e /end MEASUREMENT
/begin MEASUREMENT BCV_iABatteryCurrent "" FLOAT32_IEEE VBU0706_CM_single 0 0 -3.4E+38 3.4E+38 ECU_ADDRESS 0x70011446 /end MEASUREMENT
/begin MEASUREMENT THM_pctESSPmpCmd "" FLOAT32_IEEE VBU0706_CM_single 0 0 -3.4E+38 3.4E+38 ECU_ADDRESS 0x7001193e /end MEASUREMENT
/begin MEASUREMENT THM_pctRearPmpCmd "" FLOAT32_IEEE VBU0706_CM_single 0 0 -3.4E+38 3.4E+38 ECU_ADDRESS 0x70011956 /end MEASUREMENT
/begin MEASUREMENT THM_pctFAN "" FLOAT32_IEEE VBU0706_CM_single 0 0 -3.4E+38 3.4E+38 ECU_ADDRESS 0x7001194e /end MEASUREMENT
/begin MEASUREMENT THM_phiEXVPosReq "" FLOAT32_IEEE VBU0706_CM_single 0 0 -3.4E+38 3.4E+38 ECU_ADDRESS 0x70011962 /end MEASUREMENT
/begin MEASUREMENT THM_rpmACCompCmd "" FLOAT32_IEEE VBU0706_CM_single 0 0 -3.4E+38 3.4E+38 ECU_ADDRESS 0x70011966 /end MEASUREMENT
/begin MEASUREMENT TQC_TrqDes "" FLOAT32_IEEE VBU0706_CM_single 0 0 -9000.0 9000.0 ECU_ADDRESS 0x700119a2 /end MEASUREMENT
/begin MEASUREMENT TQD_trqNrmBrkDes "" FLOAT32_IEEE VBU0706_CM_single 0 0 -10000.0 10000.0 ECU_ADDRESS 0x70011a6e /end MEASUREMENT
/begin MEASUREMENT TQD_trqAPDDes "" FLOAT32_IEEE VBU0706_CM_single 0 0 -3.4E+38 3.4E+38 ECU_ADDRESS 0x70011a46 /end MEASUREMENT
/begin MEASUREMENT TQD_trqBrkRgn "" FLOAT32_IEEE VBU0706_CM_single 0 0 -3.4E+38 3.4E+38 ECU_ADDRESS 0x70011a4a /end MEASUREMENT
/begin MEASUREMENT TQD_trqDes "" FLOAT32_IEEE VBU0706_CM_single 0 0 -3.4E+38 3.4E+38 ECU_ADDRESS 0x70011a5e /end MEASUREMENT
/begin MEASUREMENT CBL_mvBalanceTargetVoltage "" UWORD VBU0706_CM_uint16 0 0 0 65535 ECU_ADDRESS 0x700111ea /end MEASUREMENT
/begin MEASUREMENT CTD_stPrechargeRelayStuckOpenFault "" UWORD VBU0706_CM_uint16 0 0 0 65535 ECU_ADDRESS 0x700111f8 /end MEASUREMENT
/begin MEASUREMENT CTD_stPrechargeTimeoutFault "" UWORD VBU0706_CM_uint16 0 0 0 65535 ECU_ADDRESS 0x700111fa /end MEASUREMENT
/begin MEASUREMENT CTD_timsPrechargeTimer "" UWORD VBU0706_CM_uint16 0 0 0 65535 ECU_ADDRESS 0x70011200 /end MEASUREMENT
/begin MEASUREMENT CTD_stMnPosContactorWeldFault "" UWORD VBU0706_CM_uint16 0 0 0 65535 ECU_ADDRESS 0x700111f2 /end MEASUREMENT
/begin MEASUREMENT BCV_stBatteryOverVoltageFault "" UWORD VBU0706_CM_uint16 0 0 0 65535 ECU_ADDRESS 0x700111de /end MEASUREMENT
/begin MEASUREMENT BCV_stBatteryUnderVoltageFault "" UWORD VBU0706_CM_uint16 0 0 0 65535 ECU_ADDRESS 0x700111e4 /end MEASUREMENT
/begin MEASUREMENT BCV_stBatteryOverCurrentFault "" UWORD VBU0706_CM_uint16 0 0 0 65535 ECU_ADDRESS 0x700111d8 /end MEASUREMENT
/begin MEASUREMENT BCV_stBatteryOverVoltageEVMFault "" UWORD VBU0706_CM_uint16 0 0 0 65535 ECU_ADDRESS 0x700111dc /end MEASUREMENT
/begin MEASUREMENT BCV_stBatteryUnderVoltageEVMFault "" UWORD VBU0706_CM_uint16 0 0 0 65535 ECU_ADDRESS 0x700111e2 /end MEASUREMENT
/begin MEASUREMENT BCV_stBatteryOverVoltageWarningFault "" UWORD VBU0706_CM_uint16 0 0 0 65535 ECU_ADDRESS 0x700111e0 /end MEASUREMENT
/begin MEASUREMENT BCV_stBatteryOverCurrentWarningFault "" UWORD VBU0706_CM_uint16 0 0 0 65535 ECU_ADDRESS 0x700111da /end MEASUREMENT
/begin MEASUREMENT BCV_stBatteryBusVoltageMismatchFault "" UWORD VBU0706_CM_uint16 0 0 0 65535 ECU_ADDRESS 0x700111d4 /end MEASUREMENT
/begin MEASUREMENT BCV_stBatteryCurrentOoRFault "" UWORD VBU0706_CM_uint16 0 0 0 65535 ECU_ADDRESS 0x700111d6 /end MEASUREMENT
/begin MEASUREMENT BCV_stBatteryVoltageOoRFault "" UWORD VBU0706_CM_uint16 0 0 0 65535 ECU_ADDRESS 0x700111e6 /end MEASUREMENT
/begin MEASUREMENT TotalBytes "" UWORD VBU0706_CM_uint16 0 0 0 65535 ECU_ADDRESS 0x700113f0 /end MEASUREMENT
/begin MEASUREMENT CBL_numCellBalanceNumber "" UBYTE VBU0706_CM_uint8 0 0 0 255 ECU_ADDRESS 0x70011d1d /end MEASUREMENT
/begin MEASUREMENT FCC_stNoChargeCause "" UBYTE VBU0706_CM_uint8 0 0 0 255 ECU_ADDRESS 0x70011dec /end MEASUREMENT
/begin MEASUREMENT DSM_stFaultCat "" UBYTE VBU0706_CM_uint8 0 0 0 255 ECU_ADDRESS 0x70011dad /end MEASUREMENT
/begin MEASUREMENT CTD_stPrechargeStatus "" UBYTE VBU0706_CM_uint8 0 0 0 255 ECU_ADDRESS 0x70011d3f /end MEASUREMENT
/begin MEASUREMENT CTD_stPrechargeRelayBlownDiagnosticStatus "" UBYTE VBU0706_CM_uint8 0 0 0 255 ECU_ADDRESS 0x70011d3d /end MEASUREMENT
/begin MEASUREMENT CTD_stMainFuseBlownDiagnosticStatus "" UBYTE VBU0706_CM_uint8 0 0 0 255 ECU_ADDRESS 0x70011d37 /end MEASUREMENT
/begin MEASUREMENT CtrlByte "" UBYTE VBU0706_CM_uint8 0 0 0 255 ECU_ADDRESS 0x70011d5e /end MEASUREMENT
/begin MEASUREMENT Packs "" UBYTE VBU0706_CM_uint8 0 0 0 255 ECU_ADDRESS 0x70011ebf /end MEASUREMENT
/begin MEASUREMENT Rsv "" UBYTE VBU0706_CM_uint8 0 0 0 255 ECU_ADDRESS 0x70011ed1 /end MEASUREMENT
/begin MEASUREMENT THM_stEXVInitReq "" UBYTE VBU0706_CM_uint8 0 0 0 255 ECU_ADDRESS 0x70011f05 /end MEASUREMENT
/begin MEASUREMENT THM_stEXVInitial "" UBYTE VBU0706_CM_uint8 0 0 0 255 ECU_ADDRESS 0x70011f06 /end MEASUREMENT
/begin MEASUREMENT THM_stFPVPosition_Req "" UBYTE VBU0706_CM_uint8 0 0 0 255 ECU_ADDRESS 0x70011f07 /end MEASUREMENT
/begin MEASUREMENT OCV_flgOcvCriteriaMet "" UBYTE VBU0706_CM_boolean 0 0 0.0 1.0 ECU_ADDRESS 0x70011e85 /end MEASUREMENT
/begin MEASUREMENT OCV_flgQuasiOcvCriteria "" UBYTE VBU0706_CM_boolean 0 0 0.0 1.0 ECU_ADDRESS 0x70011e88 /end MEASUREMENT
/begin MEASUREMENT LbCBL_flgBalanceEnableCondition "" UBYTE VBU0706_CM_boolean 0 0 0 1 ECU_ADDRESS 0x70011e4f /end MEASUREMENT
/begin MEASUREMENT CBL_flgVoltageBalanceEnable "" UBYTE VBU0706_CM_boolean 0 0 0 1 ECU_ADDRESS 0x70011d1c /end MEASUREMENT
/begin MEASUREMENT CBL_flgSocBalanceEnable "" UBYTE VBU0706_CM_boolean 0 0 0 1 ECU_ADDRESS 0x70011d1b /end MEASUREMENT
/begin MEASUREMENT CBL_flgCTMBoardTempValidORV "" UBYTE VBU0706_CM_boolean 0 0 0 1 ECU_ADDRESS 0x70011d1a /end MEASUREMENT
/begin MEASUREMENT CBL_flgBalanceStatus "" UBYTE VBU0706_CM_boolean 0 0 0 1 ECU_ADDRESS 0x70011d19 /end MEASUREMENT
/begin MEASUREMENT DCH_flgStationCrrntLimd "" UBYTE VBU0706_CM_boolean 0 0 0.0 1.0 ECU_ADDRESS 0x70011d9a /end MEASUREMENT
/begin MEASUREMENT DCH_flgChargingPortTempHigh "" UBYTE VBU0706_CM_boolean 0 0 0.0 1.0 ECU_ADDRESS 0x70011d7e /end MEASUREMENT
/begin MEASUREMENT SOC_flgRelaxationST "" UBYTE VBU0706_CM_boolean 0 0 0.0 1.0 ECU_ADDRESS 0x70011edd /end MEASUREMENT
/begin MEASUREMENT FCC_flgChargeProtection "" UBYTE VBU0706_CM_boolean 0 0 0.0 1.0 ECU_ADDRESS 0x70011ddd /end MEASUREMENT
/begin MEASUREMENT FCC_flgChargeNoFault "" UBYTE VBU0706_CM_boolean 0 0 0.0 1.0 ECU_ADDRESS 0x70011ddc /end MEASUREMENT
/begin MEASUREMENT FCC_flgChargeAvailable "" UBYTE VBU0706_CM_boolean 0 0 0.0 1.0 ECU_ADDRESS 0x70011dda /end MEASUREMENT
/begin MEASUREMENT FCC_flgInvalidEstimatedChargeTime "" UBYTE VBU0706_CM_boolean 0 0 0.0 1.0 ECU_ADDRESS 0x70011de7 /end MEASUREMENT
/begin MEASUREMENT LbFCC_flgInvalidEstimatedChargeTimeCFT "" UBYTE VBU0706_CM_boolean 0 0 0 1 ECU_ADDRESS 0x70011e57 /end MEASUREMENT
/begin MEASUREMENT FCC_flgPackCurrentUpdatePercTime "" UBYTE VBU0706_CM_boolean 0 0 0 1 ECU_ADDRESS 0x70011de8 /end MEASUREMENT
/begin MEASUREMENT DCH_flgDCChDiagCmd "" UBYTE VBU0706_CM_boolean 0 0 0.0 1.0 ECU_ADDRESS 0x70011d80 /end MEASUREMENT
/begin MEASUREMENT DCH_flgMonDCChOvrCrnt "" UBYTE VBU0706_CM_boolean 0 0 0.0 1.0 ECU_ADDRESS 0x70011d8c /end MEASUREMENT
/begin MEASUREMENT DCH_flgDftDCChOvrCrnt "" UBYTE VBU0706_CM_boolean 0 0 0.0 1.0 ECU_ADDRESS 0x70011d86 /end MEASUREMENT
/begin MEASUREMENT DCH_flgDftDCChOvrVltg "" UBYTE VBU0706_CM_boolean 0 0 0.0 1.0 ECU_ADDRESS 0x70011d87 /end MEASUREMENT
/begin MEASUREMENT DCH_flgDftDCPortOvrTemp "" UBYTE VBU0706_CM_boolean 0 0 0.0 1.0 ECU_ADDRESS 0x70011d89 /end MEASUREMENT
/begin MEASUREMENT DCH_flgMonDCPortOvrTemp "" UBYTE VBU0706_CM_boolean 0 0 0.0 1.0 ECU_ADDRESS 0x70011d8d /end MEASUREMENT
/begin MEASUREMENT DCH_flgDCChPortTempLimEna "" UBYTE VBU0706_CM_boolean 0 0 0.0 1.0 ECU_ADDRESS 0x70011d81 /end MEASUREMENT
/begin MEASUREMENT DSM_flgMILRequest "" UBYTE VBU0706_CM_boolean 0 0 0.0 1.0 ECU_ADDRESS 0x70011daa /end MEASUREMENT
/begin MEASUREMENT CTS_CellDataInvalidInhibitPrecharge_flg "" UBYTE VBU0706_CM_boolean 0 0 0 1 ECU_ADDRESS 0x70011d45 /end MEASUREMENT
/begin MEASUREMENT CTS_flgEnergyProtectInhibitPrecharge "" UBYTE VBU0706_CM_boolean 0 0 0 1 ECU_ADDRESS 0x70011d4b /end MEASUREMENT
/begin MEASUREMENT LbCTS_FaultInhibitPrecharge_flg "" UBYTE VBU0706_CM_boolean 0 0 0 1 ECU_ADDRESS 0x70011e55 /end MEASUREMENT
/begin MEASUREMENT LbCTS_FaultAbortPrecharge_flg "" UBYTE VBU0706_CM_boolean 0 0 0 1 ECU_ADDRESS 0x70011e54 /end MEASUREMENT
/begin MEASUREMENT CTS_flgHVDataInvalidInhibitPrecharge "" UBYTE VBU0706_CM_boolean 0 0 0 1 ECU_ADDRESS 0x70011d4c /end MEASUREMENT
/begin MEASUREMENT LbCTS_HVSafetyStatusInhibitPrecharge_flg "" UBYTE VBU0706_CM_boolean 0 0 0 1 ECU_ADDRESS 0x70011e56 /end MEASUREMENT
/begin MEASUREMENT CTS_SocInitialInhibitPrecharge_flg "" UBYTE VBU0706_CM_boolean 0 0 0 1 ECU_ADDRESS 0x70011d46 /end MEASUREMENT
/begin MEASUREMENT CTD_flgDisablePrechargeDiagInAbnormalPowerOff "" UBYTE VBU0706_CM_boolean 0 0 0 1 ECU_ADDRESS 0x70011d2f /end MEASUREMENT
/begin MEASUREMENT CTD_MnPosContactorWeldTestEnable_flg "" UBYTE VBU0706_CM_boolean 0 0 0 1 ECU_ADDRESS 0x70011d2e /end MEASUREMENT
/begin MEASUREMENT LbCTD_MnNegContactorWeldTestFail_flg "" UBYTE VBU0706_CM_boolean 0 0 0 1 ECU_ADDRESS 0x70011e50 /end MEASUREMENT
/begin MEASUREMENT BCV_flgFuseHealthWarning "" UBYTE VBU0706_CM_boolean 0 0 0 1 ECU_ADDRESS 0x70011cfb /end MEASUREMENT
/begin MEASUREMENT THM_flgAftOpReq "" UBYTE VBU0706_CM_boolean 0 0 0.0 1.0 ECU_ADDRESS 0x70011efa /end MEASUREMENT
/begin MEASUREMENT OD_LsDCChgRly "" UBYTE VBU0706_CM_boolean 0 0 0 1 ECU_ADDRESS 0x70011e8b /end MEASUREMENT
/begin MEASUREMENT OP_flgLSDVacuumPump "" UBYTE VBU0706_CM_boolean 0 0 0 1 ECU_ADDRESS 0x70011e8e /end MEASUREMENT
/begin MEASUREMENT THM_flgActvCool "" UBYTE VBU0706_CM_boolean 0 0 0.0 1.0 ECU_ADDRESS 0x70011ef8 /end MEASUREMENT
/begin MEASUREMENT THM_flgEXVPosReqEnable "" UBYTE VBU0706_CM_boolean 0 0 0.0 1.0 ECU_ADDRESS 0x70011efe /end MEASUREMENT
/begin MEASUREMENT THM_flgFPVReqRaw "" UBYTE VBU0706_CM_boolean 0 0 0.0 1.0 ECU_ADDRESS 0x70011f00 /end MEASUREMENT
/begin MEASUREMENT THM_flgFPVEnable "" UBYTE VBU0706_CM_boolean 0 0 0.0 1.0 ECU_ADDRESS 0x70011eff /end MEASUREMENT
/begin MEASUREMENT Veh_flgVacPressWarning "" UBYTE VBU0706_CM_boolean 0 0 0 1 ECU_ADDRESS 0x70011f50 /end MEASUREMENT
/begin MEASUREMENT THM_flgACEnable "" UBYTE VBU0706_CM_boolean 0 0 0.0 1.0 ECU_ADDRESS 0x70011ef7 /end MEASUREMENT
/begin MEASUREMENT THM_flgACCompCmd "" UBYTE VBU0706_CM_boolean 0 0 0.0 1.0 ECU_ADDRESS 0x70011ef6 /end MEASUREMENT
/begin MEASUREMENT THM_flgActvHeat "" UBYTE VBU0706_CM_boolean 0 0 0.0 1.0 ECU_ADDRESS 0x70011ef9 /end MEASUREMENT
/begin MEASUREMENT THM_flgBattPTCCmdRaw "" UBYTE VBU0706_CM_boolean 0 0 0.0 1.0 ECU_ADDRESS 0x70011efc /end MEASUREMENT
/begin MEASUREMENT THM_flgBattPTCCmd "" UBYTE VBU0706_CM_boolean 0 0 0.0 1.0 ECU_ADDRESS 0x70011efb /end MEASUREMENT
/begin COMPU_METHOD VBU0706_CM_single_cnt "Q = V" RAT_FUNC "%8.6" "cnt" COEFFS 0 1 0 0 0 1 /end COMPU_METHOD
/begin COMPU_METHOD VBU0706_CM_uint16_cnt "Q = V" RAT_FUNC "%5.0" "cnt" COEFFS 0 1 0 0 0 1 /end COMPU_METHOD
/begin COMPU_METHOD VBU0706_CM_single_C "Q = V" RAT_FUNC "%8.6" "C" COEFFS 0 1 0 0 0 1 /end COMPU_METHOD
/begin COMPU_METHOD VBU0706_CM_single_Nm "Q = V" RAT_FUNC "%8.6" "Nm" COEFFS 0 1 0 0 0 1 /end COMPU_METHOD
/begin COMPU_METHOD VBU0706_CM_single_bar "Q = V" RAT_FUNC "%8.6" "bar" COEFFS 0 1 0 0 0 1 /end COMPU_METHOD
/begin COMPU_METHOD VBU0706_CM_single_kph "Q = V" RAT_FUNC "%8.6" "kph" COEFFS 0 1 0 0 0 1 /end COMPU_METHOD
/begin COMPU_METHOD VBU0706_CM_single_pct "Q = V" RAT_FUNC "%8.6" "pct" COEFFS 0 1 0 0 0 1 /end COMPU_METHOD
/begin COMPU_METHOD VBU0706_CM_single_A "Q = V" RAT_FUNC "%8.6" "A" COEFFS 0 1 0 0 0 1 /end COMPU_METHOD
/begin COMPU_METHOD VBU0706_CM_single_fac "Q = V" RAT_FUNC "%8.6" "fac" COEFFS 0 1 0 0 0 1 /end COMPU_METHOD
/begin COMPU_METHOD VBU0706_CM_uint16 "Q = V" RAT_FUNC "%5.0" "" COEFFS 0 1 0 0 0 1 /end COMPU_METHOD
/begin COMPU_METHOD VBU0706_CM_uint8 "Q = V" RAT_FUNC "%3.0" "" COEFFS 0 1 0 0 0 1 /end COMPU_METHOD
/begin COMPU_METHOD VBU0706_CM_single "Q = V" RAT_FUNC "%8.6" "" COEFFS 0 1 0 0 0 1 /end COMPU_METHOD
/begin COMPU_METHOD VBU0706_CM_single_s "Q = V" RAT_FUNC "%8.6" "s" COEFFS 0 1 0 0 0 1 /end COMPU_METHOD
/begin COMPU_METHOD VBU0706_CM_uint32_cnt "Q = V" RAT_FUNC "%10.0" "cnt" COEFFS 0 1 0 0 0 1 /end COMPU_METHOD
/begin COMPU_METHOD VBU0706_CM_boolean_flg "Q = V" RAT_FUNC "%1.0" "flg" COEFFS 0 1 0 0 0 1 /end COMPU_METHOD
/begin COMPU_METHOD VBU0706_CM_boolean "Q = V" RAT_FUNC "%1.0" "" COEFFS 0 1 0 0 0 1 /end COMPU_METHOD
/begin COMPU_METHOD VBU0706_CM_boolean_cnt "Q = V" RAT_FUNC "%1.0" "cnt" COEFFS 0 1 0 0 0 1 /end COMPU_METHOD
/begin COMPU_METHOD VBU0706_CM_int8_cnt "Q = V" RAT_FUNC "%3.0" "cnt" COEFFS 0 1 0 0 0 1 /end COMPU_METHOD
/begin COMPU_METHOD VBU0706_CM_uint8_cnt "Q = V" RAT_FUNC "%3.0" "cnt" COEFFS 0 1 0 0 0 1 /end COMPU_METHOD
/begin COMPU_METHOD VBU0706_CM_uint32 "Q = V" RAT_FUNC "%10.0" "" COEFFS 0 1 0 0 0 1 /end COMPU_METHOD
/begin GROUP S3240_VCU_AC_238 "VBU0706/Task_10ms/Subsystem/VCU /APO2HAL/PTCAN1Transmit/VCU_AC_238"
 /begin REF_CHARACTERISTIC APO_ACOvrdVal_C APO_ACOvrd_C APO_ACPowerOvrdVal_C APO_ACPowerOvrd_C APO_ACSpeedOvrdVal_C APO_ACSpeedOvrd_C /end REF_CHARACTERISTIC
/end GROUP
/begin GROUP S3240_VCU_DCDC_250 "VBU0706/Task_10ms/Subsystem/VCU /APO2HAL/PTCAN1Transmit/VCU_DCDC_250"
 /begin REF_CHARACTERISTIC LVC_flgDCDCReqOvrd_C LVC_flgDcdcCtrlReqOvrdVal_C LVC_flgDcdcCtrlReqOvrd_C LVC_uDCDCReqOvrdVal_C /end REF_CHARACTERISTIC
/end GROUP
/begin GROUP S3240_VCU_EPB_155 "VBU0706/Task_10ms/Subsystem/VCU /APO2HAL/PTCAN1Transmit/VCU_EPB_155"
 /begin REF_CHARACTERISTIC APO_BrkingWhileDrivingOvrdVal_C APO_BrkingWhileDrivingOvrd_C APO_EPBCtrlModeOvrdVal_C APO_EPBCtrlModeOvrd_C Gear_flgEPBReqOvrd_C Gear_stEPBReqOvrdVal_C SPD_vVehSpdOvrdVal_C SPD_vVehSpdOvrd_C /end REF_CHARACTERISTIC
/end GROUP
/begin GROUP S3240_VCU_IC_210 "VBU0706/Task_10ms/Subsystem/VCU /APO2HAL/PTCAN1Transmit/VCU_IC_210"
 /begin REF_CHARACTERISTIC APO_BrakWarningOvrdVal_C APO_BrakWarningOvrd_C APO_CruiseStatusOvrdVal_C APO_CruiseStatusOvrd_C APO_EPBFaultOvrdVal_C APO_EPFaultLevelWarningOvrdVal_C APO_EPFaultLevelWarningOvrd_C APO_EPSFaultOvrdVal_C APO_LimpHomeOvrdVal_C APO_LimpHomeOvrd_C APO_OverSpeedOvrdVal_C APO_OverSpeedOvrd_C APO_PlsUSE750VDCOvrdVal_C APO_PlsUSE750VDCOvrd_C APO_PowerModeOvrdVal_C APO_PowerModeOvrd_C APO_VehicleModeOvrdVal_C APO_VehicleModeOvrd_C APO_flgBMSChargeStateOvrd_C APO_flgBattPackTempWarningOvrd_C APO_flgEPBFaultOvrd_C APO_flgEPSFaultOvrd_C APO_flgHVBattWarningOvrd_C APO_flgHVOnOvrd_C APO_flgIsolutionWarningOvrd_C APO_stBMSChargeStateOvrdVal_C APO_stBattPackTempWarningOvrdVal_C APO_stHVBattWarningOvrdVal_C APO_stHVOnOvrdVal_C APO_stIsolutionWarningOvrdVal_C CGW_flgVehDrvModeOvrd_C CGW_stVehDrvModeOvrdVal_C CGW_stVehRgnModeOvrdVal_C CGW_stVehRgnModeOvrd_C DCH_flgDSPLChStsOvrd_C DCH_stDSPLChStsOvrdVal_C EDIS_flgCurrPwrOvrd_C EDIS_pwrCurrPwrOvrdVal_C EPFaultLevelWarning Gear_stCurrentGearDisplayOvrdVal_C Gear_stCurrentGearDisplayOvrd_C HALIn_MotOverTempOvrdVal_C HALIn_flgMotOverTempOvrd_C HVBattCutOffOvrdVal_C HVBattCutOffOvrd_C LowBatteryWarningOvrdVal_C LowBatteryWarningOvrd_C MotorFaultLevelOvrdVal_C MotorFaultLevelOvrd_C PMM_flgVehRdyOvrdVal_C PMM_flgVehRdyOvrd_C VCUImdStopDrivingOvrdVal_C VCUImdStopDrivingOvrd_C VCURmvAcChgerOvrdVal_C VCURmvAcChgerOvrd_C VM_flgVehLimActvOvrdVal_C VM_flgVehLimActvOvrd_C VehPwrLimdLampReqOvrdVal_C VehPwrLimdLampReqOvrd_C Veh_flgHVILOvrdVal_C Veh_flgHVILOvrd_C /end REF_CHARACTERISTIC
/end GROUP
/begin GROUP S3240_VCU_MCU_105 "VBU0706/Task_10ms/Subsystem/VCU /APO2HAL/PTCAN1Transmit/VCU_MCU_105"
 /begin REF_CHARACTERISTIC OUTP_flgDCRelayStatusORF OUTP_flgDCRelayStatusORFV PMM_flgRMCUActvDisChReqOvrdVal_C PMM_flgRMCUActvDisChReqOvrd_C TQO_flgCtrlRMotrOvrd_C TQO_stCtrlRMotrOvrdVal_C TQO_trqRMotrOvrdVal_C TQO_trqRMotrOvrd_C /end REF_CHARACTERISTIC
/end GROUP
/begin GROUP S3241_Subsystem "VBU0706/Task_10ms/Subsystem/VCU /APO2HAL/Subsystem2/Subsystem"
 /begin SUB_GROUP S3326_PropertyConfirm S3326_PropertyConfirm1 S3326_PropertyConfirm10 S3326_PropertyConfirm11 S3326_PropertyConfirm12 S3326_PropertyConfirm13 S3326_PropertyConfirm14 S3326_PropertyConfirm15 S3326_PropertyConfirm4 S3326_PropertyConfirm5 S3326_PropertyConfirm6 S3326_PropertyConfirm8 S3326_PropertyConfirm9 /end SUB_GROUP
 /begin REF_CHARACTERISTIC APO_fACPumpOvrdVal_C APO_fACPumpOvrd_C APO_fFanOvrdVal_C APO_fFanOvrd_C APO_fHVIL1OvrdVal_C APO_fHVIL1Ovrd_C APO_fVacuumPumpOvrdVal_C APO_fVacuumPumpOvrd_C APO_fWaterPump1OvrdVal_C APO_fWaterPump1Ovrd_C APO_fWaterPump2OvrdVal_C APO_fWaterPump2Ovrd_C APO_flgDCChgRlyOvrdVal_C APO_flgDCChgRlyOvrd_C APO_flgFanORF APO_flgHWSleepEnableORF APO_flgMainRlyOvrdVal_C APO_flgMainRlyOvrd_C APO_flgSleepEnableORV APO_flgWakeUp1OvrdVal_C APO_flgWakeUp1Ovrd_C APO_pctACPumpOvrdVal_C APO_pctACPumpOvrd_C APO_pctFanOvrdVal_C APO_pctHVIL1OvrdVal_C APO_pctHVIL1Ovrd_C APO_pctWaterPump1OvrdVal_C APO_pctWaterPump1Ovrd_C APO_pctWaterPump2OvrdVal_C APO_pctWaterPump2Ovrd_C /end REF_CHARACTERISTIC
 /begin REF_MEASUREMENT OD_LsDCChgRly OP_flgLSDVacuumPump /end REF_MEASUREMENT
/end GROUP
/begin GROUP S3343_DriveRange "VBU0706/Task_10ms/Subsystem/VCU /DSPL/DSPL/DriveRange" /begin SUB_GROUP S3344_DSPL_Consumption S3344_RemainingRange /end SUB_GROUP /end GROUP
/begin GROUP S3343_Other "VBU0706/Task_10ms/Subsystem/VCU /DSPL/DSPL/Other"
 /begin REF_CHARACTERISTIC DSPL_facMtrDrvLT_C DSPL_nMotSpdOvrSpdLower_C DSPL_nMotSpdOvrSpdUpper_C DSPL_pctSocLowWarnLower_C DSPL_pctSocLowWarnUpper_C DSPL_stDCDCStsFail_SY DSPL_stHVCntctStClosed_SY DSPL_stLvBattChrgFail_C DSPL_stLvBattChrging_C DSPL_stLvBattNoChrg_C DSPL_tiDCDCStsFail_C DSPL_tiDisableDCDC_C DSPL_tiMotOvrSpd_C DSPL_tiMtrDrvLT_C DSPL_tiSample_SY DSPL_trqMtrDrvLTHi_C DSPL_trqMtrDrvLTLo_C /end REF_CHARACTERISTIC
/end GROUP
/begin GROUP S3470_BatDis_Power_Lim_Calc "VBU0706/Task_10ms/Subsystem/VCU /EDIS/EDIS_Ctrl/BatDis_Power_Lim_Calc"
 /begin SUB_GROUP S3471_Drive_Mode_Power_Calculate S3471_Power_Arbitration S3471_Regen_Mode_Power_Calculate /end SUB_GROUP
/end GROUP
/begin GROUP S3470_battery_power_calculate "VBU0706/Task_10ms/Subsystem/VCU /EDIS/EDIS_Ctrl/battery_power_calculate"
 /begin SUB_GROUP S3472_charge_power_calculate S3472_discharge_power_calculate /end SUB_GROUP
/end GROUP
/begin GROUP S3470_drive_power_calculate "VBU0706/Task_10ms/Subsystem/VCU /EDIS/EDIS_Ctrl/drive_power_calculate" /begin SUB_GROUP S3473_accessory_load_power /end SUB_GROUP /end GROUP
/begin GROUP S3553_LVC "VBU0706/Task_10ms/Subsystem/VCU /PMM/PMM_Ctrl/LVC" /begin SUB_GROUP S3554_LowVoltageBalanceControl /end SUB_GROUP /end GROUP
/begin GROUP S3553_PMM "VBU0706/Task_10ms/Subsystem/VCU /PMM/PMM_Ctrl/PMM" /begin SUB_GROUP S3555_DrvMod_Ctrl S3555_LvWakeUp_Ctrl S3555_PwrMod_Ctrl /end SUB_GROUP /end GROUP
/begin GROUP S3702_SignalProcessing_10ms "VBU0706/Task_10ms/Subsystem/VCU /SPD/SPD/SignalProcessing_10ms"
 /begin SUB_GROUP S3704_AxleSpeedDiff S3704_Bench S3704_MovingDirectionJudge S3704_SlopeCal1 S3704_Subsystem1 S3704_VehDir S3704_VehSpdNorm /end SUB_GROUP
/end GROUP
/begin GROUP S3738_Active "VBU0706/Task_10ms/Subsystem/VCU /THM/THM/Active" /begin REF_MEASUREMENT THM_flgActvCool THM_flgActvHeat /end REF_MEASUREMENT /end GROUP
/begin GROUP S3738_AfterRun "VBU0706/Task_10ms/Subsystem/VCU /THM/THM/AfterRun" /begin REF_CHARACTERISTIC THM_tiDlyTHMAfterRun_C THM_tiSmplTime_SY /end REF_CHARACTERISTIC /end GROUP
/begin GROUP S3738_Compr "VBU0706/Task_10ms/Subsystem/VCU /THM/THM/Compr" /begin SUB_GROUP S3743_GradientLimiter /end SUB_GROUP
 /begin REF_CHARACTERISTIC THM_nComprssrActvCool_v THM_nComprssrDecGrad_C THM_nComprssrDrvrACOn_C THM_nComprssrIncGrad_C THM_nMinComprssrStrt_C THM_pwrACMaxLimit /end REF_CHARACTERISTIC
 /begin REF_MEASUREMENT THM_flgACEnable /end REF_MEASUREMENT
/end GROUP
/begin GROUP S3738_ESSThermalMode "VBU0706/Task_10ms/Subsystem/VCU /THM/THM/ESSThermalMode" /begin SUB_GROUP S3744_OperateCycle S3744_OperateMode S3744_TempTar /end SUB_GROUP /end GROUP
/begin GROUP S3738_EXVRaw "VBU0706/Task_10ms/Subsystem/VCU /THM/THM/EXVRaw" /begin SUB_GROUP S3745_GradientLimiter S3745_Turn_Off_Delay_Time /end SUB_GROUP
 /begin REF_CHARACTERISTIC THM_flgEXVEnaStsUsed_C THM_pctEXVDecGrad_C THM_pctEXVDeltaTemp_v THM_pctEXVIncGrad_C THM_pctEXVMax_C THM_pctEXVMin_C THM_stEXVInitialized_SY THM_stEXVNotInitialized_SY THM_tiDlyEXVDisbl_C THM_tiDlyInitReq_C THM_tiSmplTime_SY /end REF_CHARACTERISTIC
 /begin REF_MEASUREMENT THM_stEXVInitReq /end REF_MEASUREMENT
/end GROUP
/begin GROUP S3738_FANRaw "VBU0706/Task_10ms/Subsystem/VCU /THM/THM/FANRaw" /begin SUB_GROUP S3746_GradientLimiter /end SUB_GROUP
 /begin REF_CHARACTERISTIC PMM_stInitMode_SY PMM_stShutDown_SY THM_facVheSpdFAN_v THM_pctFANACMidPresSwtActv_C THM_pctFANACSpdSet_v THM_pctFANAfterRunMin_C THM_pctFANDecGrad_C THM_pctFANEDSInletTemp_v THM_pctFANIncGrad_C THM_pctFANRearPump_v THM_tiDlyFANAfterRun_C THM_tiSmplTime_SY /end REF_CHARACTERISTIC
/end GROUP
/begin GROUP S3738_FPVRaw "VBU0706/Task_10ms/Subsystem/VCU /THM/THM/FPVRaw" /begin REF_MEASUREMENT THM_flgFPVReqRaw /end REF_MEASUREMENT /end GROUP
/begin GROUP S3738_PTC "VBU0706/Task_10ms/Subsystem/VCU /THM/THM/PTC" /begin REF_MEASUREMENT THM_flgBattPTCCmdRaw /end REF_MEASUREMENT /end GROUP
/begin GROUP S3738_PumpRaw "VBU0706/Task_10ms/Subsystem/VCU /THM/THM/PumpRaw" /begin SUB_GROUP S3749_ESSPmpCmdRaw S3749_PumpCmd S3749_RearPmpCmdRaw /end SUB_GROUP /end GROUP
/begin GROUP S3739_Fliter "VBU0706/Task_10ms/Subsystem/VCU /THM/THMINP/Fliter"
 /begin REF_CHARACTERISTIC THM_tTempDecDeltaGrad_C THM_tTempIncDeltaGrad_C THM_vVehSpdHysBand_C /end REF_CHARACTERISTIC
/end GROUP
/begin GROUP S3740_AC "VBU0706/Task_10ms/Subsystem/VCU /THM/THMOUT/AC"
 /begin REF_CHARACTERISTIC THM_flgACCmpCmdOvrdSwt_C THM_flgACCmpEnaOvrdSwt_C THM_flgACCmpEnaOvrdVal_C THM_flgACPwrLimitSwt_C THM_nACCmpCmdOvrdVal_C THM_pwrACPwrLimitOvrdVal_C /end REF_CHARACTERISTIC
 /begin REF_MEASUREMENT THM_flgACCompCmd THM_rpmACCompCmd /end REF_MEASUREMENT
/end GROUP
/begin GROUP S3740_AfterRun "VBU0706/Task_10ms/Subsystem/VCU /THM/THMOUT/AfterRun" /begin REF_CHARACTERISTIC THM_flgTHMAftRunOvrdSwt_C THM_flgTHMAftRunOvrdVal_C /end REF_CHARACTERISTIC /begin REF_MEASUREMENT THM_flgAftOpReq /end REF_MEASUREMENT /end GROUP
/begin GROUP S3740_EXV "VBU0706/Task_10ms/Subsystem/VCU /THM/THMOUT/EXV"
 /begin REF_CHARACTERISTIC THM_flgEXVEnaOvrdSwt_C THM_flgEXVEnaOvrdVal_C THM_flgEXVInitOvrdSwt_C THM_flgEXVPosReqOvrdSwt_C THM_phiEXVPosReqOvrdVal_C THM_stEXVInitOvrdVal_C /end REF_CHARACTERISTIC
 /begin REF_MEASUREMENT THM_flgEXVPosReqEnable THM_phiEXVPosReq THM_stEXVInitial /end REF_MEASUREMENT
/end GROUP
/begin GROUP S3740_FAN "VBU0706/Task_10ms/Subsystem/VCU /THM/THMOUT/FAN"
 /begin REF_CHARACTERISTIC THM_fFANFrecuencyOvrdVal_C THM_flgFANFrecuencyOvrdSwt_C THM_flgFANReqOvrdSwt_C THM_pctFANReqOvrdVal_C /end REF_CHARACTERISTIC
 /begin REF_MEASUREMENT THM_pctFAN /end REF_MEASUREMENT
/end GROUP
/begin GROUP S3740_FPV "VBU0706/Task_10ms/Subsystem/VCU /THM/THMOUT/FPV"
 /begin REF_CHARACTERISTIC THM_flgFPVPosReqOvrdSwt_C THM_stFPVBigCycle_SY THM_stFPVPosOvrdVal_C THM_stFPVSmallCycle_SY /end REF_CHARACTERISTIC
 /begin REF_MEASUREMENT THM_flgFPVEnable THM_stFPVPosition_Req /end REF_MEASUREMENT
/end GROUP
/begin GROUP S3740_PTC "VBU0706/Task_10ms/Subsystem/VCU /THM/THMOUT/PTC" /begin REF_CHARACTERISTIC THM_flgBattPTCCmdOvrdSwt_C THM_flgBattPTCCmdOvrdVal_C /end REF_CHARACTERISTIC /begin REF_MEASUREMENT THM_flgBattPTCCmd /end REF_MEASUREMENT /end GROUP
/begin GROUP S3740_Pump "VBU0706/Task_10ms/Subsystem/VCU /THM/THMOUT/Pump"
 /begin REF_CHARACTERISTIC THM_fPmp1FrecuencyOvrdVal_C THM_fPmp2FrecuencyOvrdVal_C THM_flgESSPmpCmdOvrdSwt_C THM_flgPump1frecuencyOvrdSwt_C THM_flgPump2frecuencyOvrdSwt_C THM_flgRearPmpCmdOvrdSwt_C THM_pctESSPmpCmdOvrdVal_C THM_pctRearPmpCmdOvrdVal_C /end REF_CHARACTERISTIC
 /begin REF_MEASUREMENT THM_pctESSPmpCmd THM_pctRearPmpCmd /end REF_MEASUREMENT
/end GROUP
/begin GROUP S3810_Subsystem "VBU0706/Task_10ms/Subsystem/VCU /TQC/TQC/Subsystem" /begin SUB_GROUP S3811_TQC_VehSpdLimit S3811_VehInfo1 /end SUB_GROUP /begin REF_MEASUREMENT TQC_TrqDes /end REF_MEASUREMENT /end GROUP
/begin GROUP S3856_BrkRgn_Cal "VBU0706/Task_10ms/Subsystem/VCU /TQD/TrqDem/BrkRgn_Cal" /begin REF_CHARACTERISTIC TQD_trqDrvBrkRgn_MAP_V TQD_trqRvsBrkRgn_MAP_V /end REF_CHARACTERISTIC /begin REF_MEASUREMENT TQD_trqNrmBrkDes /end REF_MEASUREMENT /end GROUP
/begin GROUP S3856_TrqDem_Arb "VBU0706/Task_10ms/Subsystem/VCU /TQD/TrqDem/TrqDem_Arb" /begin REF_CHARACTERISTIC TQD_flgBrkRgnConfig_C /end REF_CHARACTERISTIC /begin REF_MEASUREMENT TQD_trqAPDDes TQD_trqBrkRgn TQD_trqDes /end REF_MEASUREMENT /end GROUP
/begin GROUP S3856_TrqDem_DrvTrq_Cal "VBU0706/Task_10ms/Subsystem/VCU /TQD/TrqDem/TrqDem_DrvTrq_Cal"
 /begin SUB_GROUP S3859_TrqDem_DrvTrq_Cal S3859_TrqDem_MinTrq_Cal S3859_TrqDem_TrqDes_Cal /end SUB_GROUP
/end GROUP
/begin GROUP S3856_TrqDem_InputTransfer "VBU0706/Task_10ms/Subsystem/VCU /TQD/TrqDem/TrqDem_InputTransfer"
 /begin SUB_GROUP S3860_BrakePressureFilter S3860_TrqDem_AccPdl_Filter S3860_TrqDem_GearDet S3860_TrqDem_VehSpeed_Filter /end SUB_GROUP
/end GROUP
/begin GROUP S3882_STC "VBU0706/Task_10ms/Subsystem/VCU /TQO/TQOAll/STC" /begin SUB_GROUP S3884_STC /end SUB_GROUP /end GROUP
/begin GROUP S3882_TQARB "VBU0706/Task_10ms/Subsystem/VCU /TQO/TQOAll/TQARB" /begin SUB_GROUP S3886_TQARB /end SUB_GROUP /end GROUP
/begin GROUP S3882_TQCMP "VBU0706/Task_10ms/Subsystem/VCU /TQO/TQOAll/TQCMP" /begin SUB_GROUP S3887_TQCMP /end SUB_GROUP /end GROUP
/begin GROUP S3882_TQDIS "VBU0706/Task_10ms/Subsystem/VCU /TQO/TQOAll/TQDIS" /begin SUB_GROUP S3888_TQDIS /end SUB_GROUP /end GROUP
/begin GROUP S3882_TQDMP "VBU0706/Task_10ms/Subsystem/VCU /TQO/TQOAll/TQDMP" /begin SUB_GROUP S3889_TQDMP /end SUB_GROUP /end GROUP
/begin GROUP S3882_TQO "VBU0706/Task_10ms/Subsystem/VCU /TQO/TQOAll/TQO" /begin SUB_GROUP S3890_TQO /end SUB_GROUP /end GROUP
/begin GROUP S4001_Subsystem "VBU0706/Task_10ms/Subsystem/VCU /VTQA/Subsystem/Subsystem" /begin SUB_GROUP S4002_MTrqLim S4002_VehTrqArb /end SUB_GROUP /end GROUP
/begin GROUP S4034_APD "VBU0706/Task_10ms/Subsystem/VCU /VehINP/VehINP_Logic/APD" /begin SUB_GROUP S4035_APD /end SUB_GROUP /end GROUP
/begin GROUP S4034_FPV "VBU0706/Task_10ms/Subsystem/VCU /VehINP/VehINP_Logic/FPV" /begin SUB_GROUP S4037_IF_Then_Else1 /end SUB_GROUP
 /begin REF_CHARACTERISTIC FPV_st4WayVlvPosFdbkPosition1_SY FPV_st4WayVlvPosFdbkPosition2_SY FPV_st4WayVlvPosFdbkUnknow_SY INP_numEXVPosition1Lower_C INP_numEXVPosition1Upper_C INP_numEXVPosition2Upper_C /end REF_CHARACTERISTIC
/end GROUP
/begin GROUP S4034_GearShift "VBU0706/Task_10ms/Subsystem/VCU /VehINP/VehINP_Logic/GearShift" /begin SUB_GROUP S4038_Gear1 /end SUB_GROUP /end GROUP
/begin GROUP S4034_Mode "VBU0706/Task_10ms/Subsystem/VCU /VehINP/VehINP_Logic/Mode" /begin SUB_GROUP S4039_VehMode /end SUB_GROUP /end GROUP
/begin GROUP S4034_PEU_InverterStatus "VBU0706/Task_10ms/Subsystem/VCU /VehINP/VehINP_Logic/PEU_InverterStatus"
 /begin REF_CHARACTERISTIC Veh_stIMInverterON_C Veh_stInverterOFF_C Veh_stInverterON_C /end REF_CHARACTERISTIC
/end GROUP
/begin GROUP S4034_VacuumPump_Control "VBU0706/Task_10ms/Subsystem/VCU /VehINP/VehINP_Logic/VacuumPump Control" /begin SUB_GROUP S4043_Hysteresis_LLC_RHC /end SUB_GROUP /begin REF_CHARACTERISTIC Veh_pVacPumpRun_C Veh_pVacPumpStop_C Veh_pVacPumpWarning_C /end REF_CHARACTERISTIC /begin REF_MEASUREMENT Veh_flgVacPressWarning /end REF_MEASUREMENT /end GROUP
/begin GROUP S4034_VehINP_BPD "VBU0706/Task_10ms/Subsystem/VCU /VehINP/VehINP_Logic/VehINP_BPD"
 /begin SUB_GROUP S4044_BPD_BrakePercent S4044_BPD_BrakeSwitch S4044_VehINP_BrkPedOverride /end SUB_GROUP
/end GROUP
/begin GROUP S4034_Veh_Status "VBU0706/Task_10ms/Subsystem/VCU /VehINP/VehINP_Logic/Veh_Status" /begin SUB_GROUP S4045_VehHVIL /end SUB_GROUP /end GROUP
/begin GROUP S32_TP "VBU0706/Function-Call Subsystem/Subsystem/CHGCAN/CanMsgUnpack/MsgRxData_Unpack10/CanRxData_Unpack/TP" /begin REF_MEASUREMENT CtrlByte Packs Rsv Src TotalBytes /end REF_MEASUREMENT /end GROUP
/begin GROUP S316_Check_BatteryCurrent_Valid "VBU0706/Function-Call Subsystem/Subsystem1/BCV/BCV/Subsystem/Calculate_BatteryCurrent/Check_BatteryCurrent_Valid" /begin REF_CHARACTERISTIC CcBCV_ABatteryCurrentOoR_C /end REF_CHARACTERISTIC /end GROUP
/begin GROUP S316_Correct_BatteryCurrent "VBU0706/Function-Call Subsystem/Subsystem1/BCV/BCV/Subsystem/Calculate_BatteryCurrent/Correct_BatteryCurrent"
 /begin SUB_GROUP S334_Calculate_BatteryCurrent_ZeroDrift S334_Delay_RisingEdge /end SUB_GROUP
 /begin REF_CHARACTERISTIC CbBCV_BatteryCurrentZeroDriftEnable_flg CcBCV_BatteryCurrentDelay_ms /end REF_CHARACTERISTIC
 /begin REF_MEASUREMENT BCV_iABatteryCurrent /end REF_MEASUREMENT
/end GROUP
/begin GROUP S316_UpdateBatteryCurrent "VBU0706/Function-Call Subsystem/Subsystem1/BCV/BCV/Subsystem/Calculate_BatteryCurrent/UpdateBatteryCurrent" /begin REF_MEASUREMENT BCV_iAUpdateBatteryCurrent /end REF_MEASUREMENT /end GROUP
/begin GROUP S317_Check_BatteryVoltage_Valid "VBU0706/Function-Call Subsystem/Subsystem1/BCV/BCV/Subsystem/Calculate_BatteryVoltage/Check_BatteryVoltage_Valid" /begin SUB_GROUP S348_Delay_FallingEdge /end SUB_GROUP
 /begin REF_CHARACTERISTIC CcBCV_BatteryVoltageOoRHigh_V CcBCV_BatteryVoltageOoRLow_V CcBCV_HighVoltageDelay_ms /end REF_CHARACTERISTIC
/end GROUP
/begin GROUP S317_Check_BusNegativeVoltage_Valid "VBU0706/Function-Call Subsystem/Subsystem1/BCV/BCV/Subsystem/Calculate_BatteryVoltage/Check_BusNegativeVoltage_Valid" /begin SUB_GROUP S349_Delay_FallingEdge /end SUB_GROUP /begin REF_CHARACTERISTIC CcBCV_HighVoltageDelay_ms /end REF_CHARACTERISTIC /end GROUP
/begin GROUP S317_Check_BusVoltage_Valid "VBU0706/Function-Call Subsystem/Subsystem1/BCV/BCV/Subsystem/Calculate_BatteryVoltage/Check_BusVoltage_Valid" /begin SUB_GROUP S350_Delay_FallingEdge /end SUB_GROUP /begin REF_CHARACTERISTIC CcBCV_HighVoltageDelay_ms /end REF_CHARACTERISTIC /end GROUP
/begin GROUP S317_Check_FuseVoltage_Valid "VBU0706/Function-Call Subsystem/Subsystem1/BCV/BCV/Subsystem/Calculate_BatteryVoltage/Check_FuseVoltage_Valid" /begin SUB_GROUP S351_Delay_FallingEdge /end SUB_GROUP /begin REF_CHARACTERISTIC CcBCV_HighVoltageDelay_ms /end REF_CHARACTERISTIC /end GROUP
/begin GROUP S317_Check_PrechargeVoltage_Valid "VBU0706/Function-Call Subsystem/Subsystem1/BCV/BCV/Subsystem/Calculate_BatteryVoltage/Check_PrechargeVoltage_Valid" /begin SUB_GROUP S352_Delay_FallingEdge /end SUB_GROUP /begin REF_CHARACTERISTIC CcBCV_HighVoltageDelay_ms /end REF_CHARACTERISTIC /end GROUP
/begin GROUP S317_Check_Vx1Voltage_Valid "VBU0706/Function-Call Subsystem/Subsystem1/BCV/BCV/Subsystem/Calculate_BatteryVoltage/Check_Vx1Voltage_Valid" /begin SUB_GROUP S353_Delay_FallingEdge /end SUB_GROUP
 /begin REF_CHARACTERISTIC CcBCV_BatteryVoltageOoRHigh_V CcBCV_BatteryVoltageOoRLow_V CcBCV_HighVoltageDelay_ms /end REF_CHARACTERISTIC
/end GROUP
/begin GROUP S317_Check_Vx2Voltage_Valid "VBU0706/Function-Call Subsystem/Subsystem1/BCV/BCV/Subsystem/Calculate_BatteryVoltage/Check_Vx2Voltage_Valid" /begin SUB_GROUP S354_Delay_FallingEdge /end SUB_GROUP /begin REF_CHARACTERISTIC CcBCV_HighVoltageDelay_ms /end REF_CHARACTERISTIC /end GROUP
/begin GROUP S317_Update_BatteryVoltage "VBU0706/Function-Call Subsystem/Subsystem1/BCV/BCV/Subsystem/Calculate_BatteryVoltage/Update_BatteryVoltage" /begin REF_MEASUREMENT BCV_uBatteryVoltage /end REF_MEASUREMENT /end GROUP
/begin GROUP S317_Update_BusNegativeVoltage "VBU0706/Function-Call Subsystem/Subsystem1/BCV/BCV/Subsystem/Calculate_BatteryVoltage/Update_BusNegativeVoltage" /begin REF_MEASUREMENT BCV_uBusNegativeVoltage /end REF_MEASUREMENT /end GROUP
/begin GROUP S317_Update_BusVoltage "VBU0706/Function-Call Subsystem/Subsystem1/BCV/BCV/Subsystem/Calculate_BatteryVoltage/Update_BusVoltage" /begin REF_MEASUREMENT BCV_uBusVoltage /end REF_MEASUREMENT /end GROUP
/begin GROUP S317_Update_FuseVoltage "VBU0706/Function-Call Subsystem/Subsystem1/BCV/BCV/Subsystem/Calculate_BatteryVoltage/Update_FuseVoltage" /begin REF_MEASUREMENT BCV_uFuseVoltage /end REF_MEASUREMENT /end GROUP
/begin GROUP S317_Update_PrechargeVoltage "VBU0706/Function-Call Subsystem/Subsystem1/BCV/BCV/Subsystem/Calculate_BatteryVoltage/Update_PrechargeVoltage" /begin REF_MEASUREMENT BCV_uPrechargeVoltage /end REF_MEASUREMENT /end GROUP
/begin GROUP S317_Update_Vx2Voltage "VBU0706/Function-Call Subsystem/Subsystem1/BCV/BCV/Subsystem/Calculate_BatteryVoltage/Update_Vx2Voltage" /begin REF_MEASUREMENT BCV_uVx2Voltage /end REF_MEASUREMENT /end GROUP
/begin GROUP S318_Calculate_FuseProtect_Counter "VBU0706/Function-Call Subsystem/Subsystem1/BCV/BCV/Subsystem/Calculate_Lifetime_Data/Calculate_FuseProtect_Counter"
 /begin REF_CHARACTERISTIC CcBCV_FuseCurrentFactor1_n CcBCV_FuseCurrentFactor2_n CcBCV_FuseCurrentFactor3_n CcBCV_FuseCurrentHigh1_A CcBCV_FuseCurrentHigh2_A CcBCV_FuseCurrentHigh3_A CcBCV_FuseCurrentHigh4_A CcBCV_FuseCurrentLow1_A CcBCV_FuseCurrentLow2_A CcBCV_FuseCurrentLow3_A CcBCV_FuseCurrentLow4_A CcBCV_FuseHealthThreshold_n CcBCV_FuseProtectDelay1_ms CcBCV_FuseProtectDelay2_ms CcBCV_FuseProtectDelay3_ms CcBCV_FuseProtectDelay4_ms EcBCV_nbrFuseProtectCounter3W /end REF_CHARACTERISTIC
 /begin REF_MEASUREMENT BCV_flgFuseHealthWarning EcBCV_nbrFuseProtectCounter3r /end REF_MEASUREMENT
/end GROUP
/begin GROUP S318_Calculate_LifeTimeCharge "VBU0706/Function-Call Subsystem/Subsystem1/BCV/BCV/Subsystem/Calculate_Lifetime_Data/Calculate_LifeTimeCharge" /begin REF_MEASUREMENT BCV_AhLifeTimeCharge /end REF_MEASUREMENT /end GROUP
/begin GROUP S318_Calculate_LifeTimeCoulomb "VBU0706/Function-Call Subsystem/Subsystem1/BCV/BCV/Subsystem/Calculate_Lifetime_Data/Calculate_LifeTimeCoulomb" /begin REF_CHARACTERISTIC SECONDS_PER_HOUR /end REF_CHARACTERISTIC /begin REF_MEASUREMENT LcSOC_AhLifeTimeCoulomb /end REF_MEASUREMENT /end GROUP
/begin GROUP S318_Calculate_LifeTimeDischarge "VBU0706/Function-Call Subsystem/Subsystem1/BCV/BCV/Subsystem/Calculate_Lifetime_Data/Calculate_LifeTimeDischarge" /begin REF_MEASUREMENT BCV_AhLifeTimeDischarge /end REF_MEASUREMENT /end GROUP
/begin GROUP S318_Calculate_LifeTimeFastcharge "VBU0706/Function-Call Subsystem/Subsystem1/BCV/BCV/Subsystem/Calculate_Lifetime_Data/Calculate_LifeTimeFastcharge" /begin SUB_GROUP S387_Accumulate_Carry S387_Equal_FASTCHARGE /end SUB_GROUP /begin REF_MEASUREMENT BCV_AhLifeTimeFastcharge /end REF_MEASUREMENT /end GROUP
/begin GROUP S319_DIagnose_OutOfRange_Fault "VBU0706/Function-Call Subsystem/Subsystem1/BCV/BCV/Subsystem/Diagnose_BCV_Communication_Fault/DIagnose_OutOfRange_Fault"
 /begin REF_CHARACTERISTIC BCV_BATTERY_VOLTAGE_SENSE_OOR_FAULT BCV_LEM_CURRENT_SENSE_OOR_FAULT CbBCV_BatteryCurrentOoR_flg CbBCV_BatteryVoltageOoR_flg CcBCV_BatteryCurrentOoRFaultFIC_n CcBCV_BatteryCurrentOoRFaultPIC_n CcBCV_BatteryCurrentOoR_A CcBCV_BatteryVoltageOoRFaultFIC_n CcBCV_BatteryVoltageOoRFaultPIC_n CcBCV_BatteryVoltageOoRHigh_V CcBCV_BatteryVoltageOoRLow_V /end REF_CHARACTERISTIC
 /begin REF_MEASUREMENT BCV_stBatteryCurrentOoRFault BCV_stBatteryVoltageOoRFault /end REF_MEASUREMENT
/end GROUP
/begin GROUP S320_Diagnose_BatteryBusVoltageMismatch_Fault "VBU0706/Function-Call Subsystem/Subsystem1/BCV/BCV/Subsystem/Diagnose_BCV_Data_Fault/Diagnose_BatteryBusVoltageMismatch_Fault"
 /begin REF_CHARACTERISTIC BCV_BATTERY_BUS_VOLTAGE_MISMATCH_FAULT CbBCV_BatteryBusVoltageMismatch_flg CcBCV_BatteryBusVoltageMismatchFaultDelta_V CcBCV_BatteryBusVoltageMismatchFaultFIC_n CcBCV_BatteryBusVoltageMismatchFaultPIC_n CcBCV_BatteryBusVoltageMismatchFault_V /end REF_CHARACTERISTIC
 /begin REF_MEASUREMENT BCV_stBatteryBusVoltageMismatchFault /end REF_MEASUREMENT
/end GROUP
/begin GROUP S320_Diagnose_VoltageCurrent_Fault "VBU0706/Function-Call Subsystem/Subsystem1/BCV/BCV/Subsystem/Diagnose_BCV_Data_Fault/Diagnose_VoltageCurrent_Fault"
 /begin SUB_GROUP S416_EVM_FDC_Handler S416_EVM_FDC_Handler1 S416_EVM_FDC_Handler2 /end SUB_GROUP
 /begin REF_CHARACTERISTIC BCV_BATTERY_OVER_CURRENT_WARNING_FAULT BCV_BATTERY_UNDER_VOLTAGEEVM_FAULT BCV_BATTERY_UNDER_VOLTAGE_FAULT CbBCV_BatteryOverCurrentWarning_flg CbBCV_BatteryOverCurrent_flg CbBCV_BatteryOverVoltageEVMFaultEnable_flg CbBCV_BatteryOverVoltageWarning_flg CbBCV_BatteryOverVoltage_flg CbBCV_BatteryUnderVoltageEVMFaultEnable_flg CbBCV_BatteryUnderVoltage_flg CcBCV_BatteryOverCurrentFaultFIC_n CcBCV_BatteryOverCurrentFaultPIC_n CcBCV_BatteryOverCurrentWarningFaultDelay_ms CcBCV_BatteryOverCurrentWarningFaultFIC_n CcBCV_BatteryOverCurrentWarningFaultPIC_n CcBCV_BatteryOverCurrentWarning_A CcBCV_BatteryOverCurrent_A CcBCV_BatteryOverVoltageEVMFaultFIC_n CcBCV_BatteryOverVoltageEVMFaultPIC_n CcBCV_BatteryOverVoltageEVM_V CcBCV_BatteryOverVoltageFaultFIC_n CcBCV_BatteryOverVoltageFaultPIC_n CcBCV_BatteryOverVoltageWarningFaultDelay_ms CcBCV_BatteryOverVoltageWarningFaultFIC_n CcBCV_BatteryOverVoltageWarningFaultPIC_n CcBCV_BatteryOverVoltageWarning_V CcBCV_BatteryOverVoltage_V CcBCV_BatteryUnderVoltage1_V CcBCV_BatteryUnderVoltage2_V CcBCV_BatteryUnderVoltageEVM1_V CcBCV_BatteryUnderVoltageEVM2_V CcBCV_BatteryUnderVoltageEVMFaultFIC_n CcBCV_BatteryUnderVoltageEVMFaultPIC_n CcBCV_BatteryUnderVoltageFaultFIC_n CcBCV_BatteryUnderVoltageFaultPIC_n CcBCV_BatteryUnderVoltageTemp_C /end REF_CHARACTERISTIC
 /begin REF_MEASUREMENT BCV_stBatteryOverCurrentFault BCV_stBatteryOverCurrentWarningFault BCV_stBatteryOverVoltageEVMFault BCV_stBatteryOverVoltageFault BCV_stBatteryOverVoltageWarningFault BCV_stBatteryUnderVoltageEVMFault BCV_stBatteryUnderVoltageFault /end REF_MEASUREMENT
/end GROUP
/begin GROUP S331_Diagnose_BDM_BCV_Communication_Fault "VBU0706/Function-Call Subsystem/Subsystem1/BCV/BCV/Subsystem/Monitor_BCV_Performance/Diagnose_BDM_BCV_Communication_Fault" /begin SUB_GROUP S466_Diagnose_BdmOutOfRange_Fault /end SUB_GROUP /end GROUP
/begin GROUP S331_Diagnose_BDM_BCV_Data_Fault "VBU0706/Function-Call Subsystem/Subsystem1/BCV/BCV/Subsystem/Monitor_BCV_Performance/Diagnose_BDM_BCV_Data_Fault"
 /begin SUB_GROUP S467_Diagnose_BdmBatteryBusVoltageMismatch_Fault S467_Diagnose_BdmVoltageCurrent_Fault /end SUB_GROUP
/end GROUP
/begin GROUP S331_Diagnose_BDM_FastChargeContactorOverCurrentAlarm "VBU0706/Function-Call Subsystem/Subsystem1/BCV/BCV/Subsystem/Monitor_BCV_Performance/Diagnose_BDM_FastChargeContactorOverCurrentAlarm" /begin SUB_GROUP S468_Equal_FASTCHARGE /end SUB_GROUP /begin REF_CHARACTERISTIC CcBCV_DCContactorOverCurrent_A /end REF_CHARACTERISTIC /end GROUP
/begin GROUP S564_DetermineBalance_EnableCondition "VBU0706/Function-Call Subsystem/Subsystem1/CBL/Subsystem8/Subsystem/Balance_EnableCondition/DetermineBalance_EnableCondition"
 /begin REF_CHARACTERISTIC CbCBL_CellBalanceEnable_flg CbCBL_CellTempCheckEnable_flg CbCBL_IsolationResistanceEnable_flg CcCBL_BalanceStartCellSoc_pct CcCBL_BalanceStartCellTempMaxHysteresis_C CcCBL_BalanceStartCellTempMax_C CcCBL_BalanceStartCellVoltageMinHysteresis_mV CcCBL_BalanceStartCellVoltageMin_mV CcCBL_BalanceStartIsoResistance_Kohm CcCBL_SystemVoltageMaxHysteresis_V CcCBL_SystemVoltageMax_V CcCBL_SystemVoltageMinHysteresis_V CcCBL_SystemVoltageMin_V /end REF_CHARACTERISTIC
 /begin REF_MEASUREMENT LbCBL_flgBalanceEnableCondition /end REF_MEASUREMENT
/end GROUP
/begin GROUP S564_DetermineSOCBalance_EnableCondition "VBU0706/Function-Call Subsystem/Subsystem1/CBL/Subsystem8/Subsystem/Balance_EnableCondition/DetermineSOCBalance_EnableCondition"
 /begin REF_CHARACTERISTIC CcCBL_SocBalanceChargeCurrentHysteresis_A CcCBL_SocBalanceChargeCurrent_A CcCBL_SocBalanceCurrentCheckTime_s CcCBL_SocBalanceDischargeCurrentHysteresis_A CcCBL_SocBalanceDischargeCurrent_A /end REF_CHARACTERISTIC
 /begin REF_MEASUREMENT CBL_flgSocBalanceEnable /end REF_MEASUREMENT
/end GROUP
/begin GROUP S564_DetermineVoltaageBalance_EnableCondition "VBU0706/Function-Call Subsystem/Subsystem1/CBL/Subsystem8/Subsystem/Balance_EnableCondition/DetermineVoltaageBalance_EnableCondition"
 /begin REF_CHARACTERISTIC CbCBL_CellBalanceOCVCheckEnable_flg CcCBL_CellBalanceChargeCurrentHysteresis_A CcCBL_CellBalanceChargeCurrent_A CcCBL_CellBalanceCurrentCheckTime_s CcCBL_CellBalanceDischargeCurrentHysteresis_A CcCBL_CellBalanceDischargeCurrent_A /end REF_CHARACTERISTIC
 /begin REF_MEASUREMENT CBL_flgVoltageBalanceEnable /end REF_MEASUREMENT
/end GROUP
/begin GROUP S566_Determin_MinSocCellCapacity "VBU0706/Function-Call Subsystem/Subsystem1/CBL/Subsystem8/Subsystem/Determine_CSCCellBalanceRequest/Determin_MinSocCellCapacity" /begin REF_MEASUREMENT LcSOH_AhMinSocCellCapacity /end REF_MEASUREMENT /end GROUP
/begin GROUP S566_Determine_CellBalanceNumber "VBU0706/Function-Call Subsystem/Subsystem1/CBL/Subsystem8/Subsystem/Determine_CSCCellBalanceRequest/Determine_CellBalanceNumber" /begin REF_MEASUREMENT CBL_numCellBalanceNumber /end REF_MEASUREMENT /end GROUP
/begin GROUP S566_Determine_CellBalanceRequest "VBU0706/Function-Call Subsystem/Subsystem1/CBL/Subsystem8/Subsystem/Determine_CSCCellBalanceRequest/Determine_CellBalanceRequest"
 /begin REF_CHARACTERISTIC CcCBL_BalanceStartDeltaSoc_pct CcCBL_BalanceStartDeltaVoltage_mV /end REF_CHARACTERISTIC
 /begin REF_MEASUREMENT CBL_mvBalanceTargetVoltage CBL_pctBalanceTargeSoc /end REF_MEASUREMENT
/end GROUP
/begin GROUP S566_Determine_TotalCellBalanceState "VBU0706/Function-Call Subsystem/Subsystem1/CBL/Subsystem8/Subsystem/Determine_CSCCellBalanceRequest/Determine_TotalCellBalanceState" /begin REF_MEASUREMENT CBL_flgBalanceStatus /end REF_MEASUREMENT /end GROUP
/begin GROUP S567_LOW_HIGH1 "VBU0706/Function-Call Subsystem/Subsystem1/CBL/Subsystem8/Subsystem/Override/LOW_HIGH1" /begin REF_MEASUREMENT CBL_tCTMBoardTempMaxORV /end REF_MEASUREMENT /end GROUP
/begin GROUP S567_LOW_HIGH2 "VBU0706/Function-Call Subsystem/Subsystem1/CBL/Subsystem8/Subsystem/Override/LOW_HIGH2" /begin REF_MEASUREMENT CBL_flgCTMBoardTempValidORV /end REF_MEASUREMENT /end GROUP
/begin GROUP S651_DetermineRatioPEUtoBat "VBU0706/Function-Call Subsystem/Subsystem1/CTD/Subsystem/Subsystem4/DiagnoseRelayWeld/DetermineRatioPEUtoBat"
 /begin REF_CHARACTERISTIC CcCTD_PEURVtoBatVThresholdLower_pct CcCTD_PEURVtoBatVThresholdUpper_pct /end REF_CHARACTERISTIC
/end GROUP
/begin GROUP S651_MNC_Weld_Check "VBU0706/Function-Call Subsystem/Subsystem1/CTD/Subsystem/Subsystem4/DiagnoseRelayWeld/MNC_Weld_Check"
 /begin SUB_GROUP S663_CONTACTOR_STATUS_OPENED1 S663_Determine_Diagnostic_Status S663_Equal_to_LOW1 /end SUB_GROUP
 /begin REF_CHARACTERISTIC CbCTD_MnNegContactorWeldFaultEnable_flg CcCTD_MNCWeldTestEnablePEURVoltageRatio_pct CcCTD_MnNegContactorCloseDeltaVoltage_V CcCTD_MnNegContactorWeldFaultFIC_n CcCTD_MnNegContactorWeldFaultPIC_n /end REF_CHARACTERISTIC
 /begin REF_MEASUREMENT LbCTD_MnNegContactorWeldTestFail_flg /end REF_MEASUREMENT
/end GROUP
/begin GROUP S651_MPC_Weld_Check "VBU0706/Function-Call Subsystem/Subsystem1/CTD/Subsystem/Subsystem4/DiagnoseRelayWeld/MPC_Weld_Check"
 /begin SUB_GROUP S664_CONTACTOR_STATUS_OPENED S664_CONTACTOR_STATUS_OPENED1 S664_Determine_Diagnostic_Status S664_Equal_to_LOW1 S664_Equal_to_LOW2 /end SUB_GROUP
 /begin REF_CHARACTERISTIC CbCTD_MnPosContactorWeldFaultEnable_flg CcCTD_MnPosContactorCloseDeltaVoltage_V CcCTD_MnPosContactorWeldFaultFIC_n CcCTD_MnPosContactorWeldFaultPIC_n /end REF_CHARACTERISTIC
 /begin REF_MEASUREMENT CTD_MnPosContactorWeldTestEnable_flg CTD_stMnPosContactorWeldFault /end REF_MEASUREMENT
/end GROUP
/begin GROUP S653_Determine_Fail_Lockout "VBU0706/Function-Call Subsystem/Subsystem1/CTD/Subsystem/Subsystem4/Lockout_Precharge_Process/Determine_Fail_Lockout"
 /begin REF_CHARACTERISTIC CTD_PRECHARGE_STATUS_CHARGING CcCTD_PrechargeFailLockoutInterval_s /end REF_CHARACTERISTIC
/end GROUP
/begin GROUP S653_Determine_Lockout_Time "VBU0706/Function-Call Subsystem/Subsystem1/CTD/Subsystem/Subsystem4/Lockout_Precharge_Process/Determine_Lockout_Time" /begin REF_MEASUREMENT CTD_tisPrechargeLockoutTime /end REF_MEASUREMENT /end GROUP
/begin GROUP S653_Determine_Overload_Lockout "VBU0706/Function-Call Subsystem/Subsystem1/CTD/Subsystem/Subsystem4/Lockout_Precharge_Process/Determine_Overload_Lockout"
 /begin REF_CHARACTERISTIC CbCTD_PrechargeOverEnergyLockoutEnable_flg CcCTD_PrechargeOverEnergyLockoutInterval_s /end REF_CHARACTERISTIC
/end GROUP
/begin GROUP S653_HeatProtection_Lockout "VBU0706/Function-Call Subsystem/Subsystem1/CTD/Subsystem/Subsystem4/Lockout_Precharge_Process/HeatProtection_Lockout"
 /begin SUB_GROUP S704_Determine_Heat_LockTime S704_Determine_LockPoint_AvaliableHeat /end SUB_GROUP
/end GROUP
/begin GROUP S654_Determine_Diagnostic_Status "VBU0706/Function-Call Subsystem/Subsystem1/CTD/Subsystem/Subsystem4/MainFuseDiagnostic/Determine_Diagnostic_Status" /begin REF_CHARACTERISTIC CcFDC_MaxCount_n CcFDC_MinCount_n DIAGNOSTIC_ON_GOING /end REF_CHARACTERISTIC /begin REF_MEASUREMENT CTD_stMainFuseBlownDiagnosticStatus /end REF_MEASUREMENT /end GROUP
/begin GROUP S655_Determine_Diagnostic_Status "VBU0706/Function-Call Subsystem/Subsystem1/CTD/Subsystem/Subsystem4/Precharge_Resistance_Diagnostic/Determine_Diagnostic_Status" /begin REF_CHARACTERISTIC CcFDC_MaxCount_n CcFDC_MinCount_n DIAGNOSTIC_ON_GOING /end REF_CHARACTERISTIC /begin REF_MEASUREMENT CTD_stPrechargeRelayBlownDiagnosticStatus /end REF_MEASUREMENT /end GROUP
/begin GROUP S656_Determine_PrechargeDiag_Disable "VBU0706/Function-Call Subsystem/Subsystem1/CTD/Subsystem/Subsystem4/PrechrgProcessMonitoring/Determine_PrechargeDiag_Disable" /begin REF_CHARACTERISTIC CcCTD_VehSpdPrechargeDiag_kmh /end REF_CHARACTERISTIC /begin REF_MEASUREMENT CTD_flgDisablePrechargeDiagInAbnormalPowerOff /end REF_MEASUREMENT /end GROUP
/begin GROUP S656_Determine_Precharge_Timer "VBU0706/Function-Call Subsystem/Subsystem1/CTD/Subsystem/Subsystem4/PrechrgProcessMonitoring/Determine_Precharge_Timer" /begin REF_MEASUREMENT CTD_tiLastPrechargeStartTime CTD_timsPrechargeTimer /end REF_MEASUREMENT /end GROUP
/begin GROUP S656_Determine_Ratio_BusVBatV "VBU0706/Function-Call Subsystem/Subsystem1/CTD/Subsystem/Subsystem4/PrechrgProcessMonitoring/Determine_Ratio_BusVBatV" /begin REF_MEASUREMENT CTD_pctBusOfBatteryVoltage /end REF_MEASUREMENT /end GROUP
/begin GROUP S656_Precharge_Thermal_Management "VBU0706/Function-Call Subsystem/Subsystem1/CTD/Subsystem/Subsystem4/PrechrgProcessMonitoring/Precharge_Thermal_Management"
 /begin SUB_GROUP S730_Determine_Precharge_JouleHeat S730_Perform_OverEnergy_Diagnostic /end SUB_GROUP
/end GROUP
/begin GROUP S656_Precharge_Timeout_Diagnostic "VBU0706/Function-Call Subsystem/Subsystem1/CTD/Subsystem/Subsystem4/PrechrgProcessMonitoring/Precharge_Timeout_Diagnostic"
 /begin REF_CHARACTERISTIC CbCTD_PrechargeTimeoutFaultEnable_flg CcCTD_PrechargeTimeoutFaultFIC_n CcCTD_PrechargeTimeoutFaultPIC_n /end REF_CHARACTERISTIC
 /begin REF_MEASUREMENT CTD_stPrechargeTimeoutFault /end REF_MEASUREMENT
/end GROUP
/begin GROUP S656_Precharging_Process_Monitoring "VBU0706/Function-Call Subsystem/Subsystem1/CTD/Subsystem/Subsystem4/PrechrgProcessMonitoring/Precharging_Process_Monitoring"
 /begin SUB_GROUP S732_Status_Charging S732_Status_Fail S732_Status_Idle S732_Status_Success /end SUB_GROUP
 /begin REF_CHARACTERISTIC CcCTD_PrechargeSuccessMax_pct CcCTD_PrechargeSuccessMin_pct CcCTD_PrechargeTimeMax_ms /end REF_CHARACTERISTIC
 /begin REF_MEASUREMENT CTD_stPrechargeStatus /end REF_MEASUREMENT
/end GROUP
/begin GROUP S657_MNC_Stuck_Open "VBU0706/Function-Call Subsystem/Subsystem1/CTD/Subsystem/Subsystem4/Stuck_Open_Diagnostic/MNC_Stuck_Open"
 /begin SUB_GROUP S752_MNC_Stuck_Open_With_VehicleSpeed S752_MNC_Stuck_Open_Without_VehicleSpeed /end SUB_GROUP
/end GROUP
/begin GROUP S657_MPC_Stuck_Open "VBU0706/Function-Call Subsystem/Subsystem1/CTD/Subsystem/Subsystem4/Stuck_Open_Diagnostic/MPC_Stuck_Open"
 /begin SUB_GROUP S753_MPC_Stuck_Open_Within_VehicleSpeed S753_MPC_Stuck_Open_Without_VehicleSpeed /end SUB_GROUP
/end GROUP
/begin GROUP S657_MPR_Stuck_Open "VBU0706/Function-Call Subsystem/Subsystem1/CTD/Subsystem/Subsystem4/Stuck_Open_Diagnostic/MPR_Stuck_Open"
 /begin SUB_GROUP S754_CONTACTOR_STATUS_CLOSED1 S754_Determine_Diagnostic_Status S754_Equal_to_HIGH /end SUB_GROUP
 /begin REF_CHARACTERISTIC CbCTD_PrechargeRelayStuckOpenFaultEnable_flg CcCTD_PrechargeRelayStuckOpenDeltaVoltage_V CcCTD_PrechargeRelayStuckOpenFaultFIC_n CcCTD_PrechargeRelayStuckOpenFaultPIC_n /end REF_CHARACTERISTIC
 /begin REF_MEASUREMENT CTD_stPrechargeRelayStuckOpenFault /end REF_MEASUREMENT
/end GROUP
/begin GROUP S657_StuckOpenAssistantConditons "VBU0706/Function-Call Subsystem/Subsystem1/CTD/Subsystem/Subsystem4/Stuck_Open_Diagnostic/StuckOpenAssistantConditons"
 /begin REF_CHARACTERISTIC CcCTD_MessageDataValidDelay_ms CcCTD_MnCntcStuckOpenVhclSpdThreshold_kmh CcCTD_PEURDCVoltageThreshold_V /end REF_CHARACTERISTIC
/end GROUP
/begin GROUP S823_EVM_FDC_Handler1 "VBU0706/Function-Call Subsystem/Subsystem1/CTM/CTM/Subsystem/Determine_CellTemp_OverDeviationFaults/EVM_FDC_Handler1" /begin SUB_GROUP S835_DetermineFault S835_DetermineFaultCounter /end SUB_GROUP /end GROUP
/begin GROUP S824_EVM_FDC_Handler "VBU0706/Function-Call Subsystem/Subsystem1/CTM/CTM/Subsystem/Determine_CellTemp_OverUnderFaults/EVM_FDC_Handler" /begin SUB_GROUP S845_DetermineFault S845_DetermineFaultCounter /end SUB_GROUP /end GROUP
/begin GROUP S826_CellThermalRunaway_FaultArrayCheck "VBU0706/Function-Call Subsystem/Subsystem1/CTM/CTM/Subsystem/Determine_Thermal_Runaway/CellThermalRunaway_FaultArrayCheck"
 /begin REF_CHARACTERISTIC CTM_CELL_THERMAL_RUNAWAY_FAULT CbCTM_CellThermalRunawayEnable_flg CbCTM_ThermalRunawayTestFailORF_flg CbCTM_ThermalRunawayTestFailORV_flg CcCTM_ThermalRunawayFaultFIC_n CcCTM_ThermalRunawayFaultPIC_n CcCTM_ThermalRunawayValidDelayTime_ms /end REF_CHARACTERISTIC
/end GROUP
/begin GROUP S826_DetermineTempRiseRate "VBU0706/Function-Call Subsystem/Subsystem1/CTM/CTM/Subsystem/Determine_Thermal_Runaway/DetermineTempRiseRate" /begin SUB_GROUP S869_CellTemp_ChangeRate_Calculate /end SUB_GROUP
 /begin REF_CHARACTERISTIC CcCTM_CellThermalRunawayFaultFIC_n CcCTM_CellThermalRunawayFaultPIC_n /end REF_CHARACTERISTIC
/end GROUP
/begin GROUP S826_TriggerCycle "VBU0706/Function-Call Subsystem/Subsystem1/CTM/CTM/Subsystem/Determine_Thermal_Runaway/TriggerCycle" /begin REF_CHARACTERISTIC CcCTM_ThermalRunawayTriggerTime_ms /end REF_CHARACTERISTIC /end GROUP
/begin GROUP S897_Cell_DataValid_Check "VBU0706/Function-Call Subsystem/Subsystem1/CTS/CTS/Subsystem/DeterminePrechargeConditions/Cell_DataValid_Check"
 /begin REF_CHARACTERISTIC CbCTS_CellDataInvalidSerialCheckEnable_flg CcSYS_NoOfInvalidCellVoltages_n /end REF_CHARACTERISTIC
 /begin REF_MEASUREMENT CTS_CellDataInvalidInhibitPrecharge_flg /end REF_MEASUREMENT
/end GROUP
/begin GROUP S897_Energy_Protection_Check "VBU0706/Function-Call Subsystem/Subsystem1/CTS/CTS/Subsystem/DeterminePrechargeConditions/Energy_Protection_Check"
 /begin REF_CHARACTERISTIC CbCTS_EnergyProtectEnable_flg CcCTS_BatteryDisplaySocLimit_pct CcCTS_BatteryVoltageMinLimit_V CcCTS_CellVoltageMinLimitDelta_mV CcCTS_CellVoltageMinLimit_mV CcCTS_SocMinLimit_pct /end REF_CHARACTERISTIC
 /begin REF_MEASUREMENT CTS_flgEnergyProtectInhibitPrecharge /end REF_MEASUREMENT
/end GROUP
/begin GROUP S897_Fault_Check "VBU0706/Function-Call Subsystem/Subsystem1/CTS/CTS/Subsystem/DeterminePrechargeConditions/Fault_Check"
 /begin REF_MEASUREMENT LbCTS_FaultAbortPrecharge_flg LbCTS_FaultInhibitPrecharge_flg /end REF_MEASUREMENT
/end GROUP
/begin GROUP S897_HV_DataValid_Check "VBU0706/Function-Call Subsystem/Subsystem1/CTS/CTS/Subsystem/DeterminePrechargeConditions/HV_DataValid_Check" /begin REF_MEASUREMENT CTS_flgHVDataInvalidInhibitPrecharge /end REF_MEASUREMENT /end GROUP
/begin GROUP S897_HV_Safety_Check "VBU0706/Function-Call Subsystem/Subsystem1/CTS/CTS/Subsystem/DeterminePrechargeConditions/HV_Safety_Check" /begin REF_MEASUREMENT LbCTS_HVSafetyStatusInhibitPrecharge_flg /end REF_MEASUREMENT /end GROUP
/begin GROUP S897_Precharge_Inhibit_Abort "VBU0706/Function-Call Subsystem/Subsystem1/CTS/CTS/Subsystem/DeterminePrechargeConditions/Precharge_Inhibit_Abort" /begin SUB_GROUP S907_Combine_Precharge_Conditions /end SUB_GROUP /end GROUP
/begin GROUP S897_SoC_Initialization_Check "VBU0706/Function-Call Subsystem/Subsystem1/CTS/CTS/Subsystem/DeterminePrechargeConditions/SoC_Initialization_Check"
 /begin REF_CHARACTERISTIC CbCTS_SocInitialInhibitEnable_flg CcCTS_SocInitialDelayTime_s /end REF_CHARACTERISTIC
 /begin REF_MEASUREMENT CTS_SocInitialInhibitPrecharge_flg /end REF_MEASUREMENT
/end GROUP
/begin GROUP S898_Close_Comamnd "VBU0706/Function-Call Subsystem/Subsystem1/CTS/CTS/Subsystem/Determine_Contactor_Request/Close_Comamnd"
 /begin REF_CHARACTERISTIC BMM_STATE_POWER_SWAP CbCTS_ContactorComandBypassBMUModeEnable_flg CcCTS_ContactorRequestCloseDelay_ms /end REF_CHARACTERISTIC
/end GROUP
/begin GROUP S928_EVM_FDC_Handler "VBU0706/Function-Call Subsystem/Subsystem1/CVT/CVT/Subsystem/Determine_CellVoltage_OverUnderFaults/EVM_FDC_Handler" /begin SUB_GROUP S935_DetermineFault S935_DetermineFaultCounter /end SUB_GROUP /end GROUP
/begin GROUP S928_EVM_FDC_Handler1 "VBU0706/Function-Call Subsystem/Subsystem1/CVT/CVT/Subsystem/Determine_CellVoltage_OverUnderFaults/EVM_FDC_Handler1" /begin SUB_GROUP S936_DetermineFault S936_DetermineFaultCounter /end SUB_GROUP /end GROUP
/begin GROUP S928_EVM_FDC_Handler2 "VBU0706/Function-Call Subsystem/Subsystem1/CVT/CVT/Subsystem/Determine_CellVoltage_OverUnderFaults/EVM_FDC_Handler2" /begin SUB_GROUP S937_DetermineFault S937_DetermineFaultCounter /end SUB_GROUP /end GROUP
/begin GROUP S1001_For_Iterator_Subsystem "VBU0706/Function-Call Subsystem/Subsystem1/DSM/Subsystem10/Subsystem/Determine_Abnormal_In_PeriodicalUpload/For_Iterator_Subsystem" /begin REF_CHARACTERISTIC CaDSM_CycleUploadAbnormalEvent_flg /end REF_CHARACTERISTIC /end GROUP
/begin GROUP S1002_For_Iterator_Subsystem "VBU0706/Function-Call Subsystem/Subsystem1/DSM/Subsystem10/Subsystem/Determine_CSC_Inhibit/For_Iterator_Subsystem" /begin REF_CHARACTERISTIC CaDSM_CscValueUncertainFault_flg /end REF_CHARACTERISTIC /end GROUP
/begin GROUP S1004_Clear_Fault_Category "VBU0706/Function-Call Subsystem/Subsystem1/DSM/Subsystem10/Subsystem/Determine_Fault_Category/Clear_Fault_Category" /begin REF_CHARACTERISTIC FAULT_CAT_NONE /end REF_CHARACTERISTIC /begin REF_MEASUREMENT DSM_stFaultCat /end REF_MEASUREMENT /end GROUP
/begin GROUP S1006_Clear_MIL_Request "VBU0706/Function-Call Subsystem/Subsystem1/DSM/Subsystem10/Subsystem/Determine_MIL_Request/Clear_MIL_Request" /begin REF_MEASUREMENT DSM_flgMILRequest /end REF_MEASUREMENT /end GROUP
/begin GROUP S1006_Determine_Local_MILRequest "VBU0706/Function-Call Subsystem/Subsystem1/DSM/Subsystem10/Subsystem/Determine_MIL_Request/Determine_Local_MILRequest" /begin REF_CHARACTERISTIC CmDSM_MILFaultCat_enum FAULT_CAT_NONE /end REF_CHARACTERISTIC /end GROUP
/begin GROUP S1007_For_Iterator_Subsystem "VBU0706/Function-Call Subsystem/Subsystem1/DSM/Subsystem10/Subsystem/Determine_No_Charge/For_Iterator_Subsystem" /begin REF_CHARACTERISTIC CaDSM_NoChargeFault_flg /end REF_CHARACTERISTIC /end GROUP
/begin GROUP S1037_Turn_On_Delay_Time "VBU0706/Function-Call Subsystem/Subsystem1/FCC /DCH_Overall/DCH_DCChargeCtrlOverall/DCH_BMSChgrReq/Turn_On_Delay_Time" /begin REF_MEASUREMENT DCH_flgStationCrrntLimd /end REF_MEASUREMENT /end GROUP
/begin GROUP S1037_Turn_On_Delay_Time1 "VBU0706/Function-Call Subsystem/Subsystem1/FCC /DCH_Overall/DCH_DCChargeCtrlOverall/DCH_BMSChgrReq/Turn_On_Delay_Time1" /begin REF_MEASUREMENT DCH_flgChargingPortTempHigh /end REF_MEASUREMENT /end GROUP
/begin GROUP S1038_DCH_CtrlStateflowPostProcess "VBU0706/Function-Call Subsystem/Subsystem1/FCC /DCH_Overall/DCH_DCChargeCtrlOverall/DCH_DCChargeCtrlStateflow/DCH_CtrlStateflowPostProcess"
 /begin REF_CHARACTERISTIC DCH_flgPosDCRlyReqOvrdVal_C DCH_flgPosDCRlyReqOvrd_C DCH_tiDCChRlyOpClsdDly_C /end REF_CHARACTERISTIC
/end GROUP
/begin GROUP S1038_DCH_InputSignalPreProcess "VBU0706/Function-Call Subsystem/Subsystem1/FCC /DCH_Overall/DCH_DCChargeCtrlOverall/DCH_DCChargeCtrlStateflow/DCH_InputSignalPreProcess"
 /begin SUB_GROUP S1053_DCH_BMSChAvlDebounce S1053_DCH_DCRelayCloseDiagnose S1053_DCH_VehStateAnalyze /end SUB_GROUP
/end GROUP
/begin GROUP S1038_DCH_SignalPreProcessForStateflow "VBU0706/Function-Call Subsystem/Subsystem1/FCC /DCH_Overall/DCH_DCChargeCtrlOverall/DCH_DCChargeCtrlStateflow/DCH_SignalPreProcessForStateflow"
 /begin SUB_GROUP S1054_DCH_BMSErrorDetect S1054_DCH_ChargeStopCalc S1054_DCH_ChgerZeroCurrentDiagnose S1054_DCH_ChgrAvlDiagnose S1054_DCH_OpenPDURelayValid /end SUB_GROUP
/end GROUP
/begin GROUP S1039_DCH_BmsVoltagCurrentDiagnose "VBU0706/Function-Call Subsystem/Subsystem1/FCC /DCH_Overall/DCH_DCChargeCtrlOverall/DCH_Diagnose/DCH_BmsVoltagCurrentDiagnose"
 /begin REF_CHARACTERISTIC DCH_iDiaDCChOvrCrntDiff_C DCH_stBMSChrging_SY DCH_uDiaDCChOvrVltgDiff_C /end REF_CHARACTERISTIC
 /begin REF_MEASUREMENT DCH_flgDftDCChOvrCrnt DCH_flgDftDCChOvrVltg /end REF_MEASUREMENT
/end GROUP
/begin GROUP S1039_DCH_ChargeErrDetect "VBU0706/Function-Call Subsystem/Subsystem1/FCC /DCH_Overall/DCH_DCChargeCtrlOverall/DCH_Diagnose/DCH_ChargeErrDetect"
 /begin REF_CHARACTERISTIC DCH_flgDCChDiagCmdOvrdVal_C DCH_flgDCChDiagCmdOvrd_C DCH_stHVCntctClosed_SY DCH_tiDiagRlyCmd_C /end REF_CHARACTERISTIC
 /begin REF_MEASUREMENT DCH_flgDCChDiagCmd DCH_flgMonDCChOvrCrnt /end REF_MEASUREMENT
/end GROUP
/begin GROUP S1039_DCH_VehErrDetect "VBU0706/Function-Call Subsystem/Subsystem1/FCC /DCH_Overall/DCH_DCChargeCtrlOverall/DCH_Diagnose/DCH_VehErrDetect"
 /begin REF_CHARACTERISTIC DCH_tDCChPortTempLowLim_C DCH_tReStartDCChPortTemp_C DCH_tStopForDCChPortTemp_C /end REF_CHARACTERISTIC
 /begin REF_MEASUREMENT DCH_flgDCChPortTempLimEna DCH_flgDftDCPortOvrTemp DCH_flgMonDCPortOvrTemp /end REF_MEASUREMENT
/end GROUP
/begin GROUP S1040_DCH_ChargeStopErrDiagnose "VBU0706/Function-Call Subsystem/Subsystem1/FCC /DCH_Overall/DCH_DCChargeCtrlOverall/DCH_EepromStore/DCH_ChargeStopErrDiagnose" /begin SUB_GROUP S1097_DCH_BSTOrCSTTrigger /end SUB_GROUP /end GROUP
/begin GROUP S1040_DCH_ChargeTimeOutDiagnose "VBU0706/Function-Call Subsystem/Subsystem1/FCC /DCH_Overall/DCH_DCChargeCtrlOverall/DCH_EepromStore/DCH_ChargeTimeOutDiagnose" /begin SUB_GROUP S1098_BEM_EEPROM /end SUB_GROUP /end GROUP
/begin GROUP S1040_DataConvertandCSTEEPROM "VBU0706/Function-Call Subsystem/Subsystem1/FCC /DCH_Overall/DCH_DCChargeCtrlOverall/DCH_EepromStore/DataConvertandCSTEEPROM" /begin SUB_GROUP S1099_CSTTrigDly S1099_CST_EEPROM /end SUB_GROUP /end GROUP
/begin GROUP S1158_Calculate_FastChargeBaseRemainTime "VBU0706/Function-Call Subsystem/Subsystem1/FCC /FCC/Subsystem/Calculate_Fastcharge_Time/Calculate_FastChargeBaseRemainTime"
 /begin REF_CHARACTERISTIC CaFCC_CurrentLimitRemainChargeTimeSocTempMapDimension_n CaFCC_CurrentLimitRemainChargeTimeSocTempMapZ_min CaFCC_IdealRemainChargeTimeSocTempMapDimension_n CaFCC_IdealRemainChargeTimeSocTempMapZ_min CcFCC_BatteryCapacityCycle1_n CcFCC_BatteryCapacityCycle2_n CcFCC_CustomSetSOCEnable_pct CcFCC_FullChargeSoc1_pct CcFCC_FullChargeSoc2_pct CcFCC_FullChargeSoc3_pct MINUTES_PER_HOUR /end REF_CHARACTERISTIC
 /begin REF_MEASUREMENT FCC_timinFastChargeBaseRemainTime /end REF_MEASUREMENT
/end GROUP
/begin GROUP S1158_EightyPercentCustomSOC_CaculateChargeTime "VBU0706/Function-Call Subsystem/Subsystem1/FCC /FCC/Subsystem/Calculate_Fastcharge_Time/EightyPercentCustomSOC_CaculateChargeTime"
 /begin REF_CHARACTERISTIC CaFCC_CurrentLimitRemainChargeTimeSocTempMapDimension_n CaFCC_CurrentLimitRemainChargeTimeSocTempMapZ_min CaFCC_IdealRemainChargeTimeSocTempMapDimension_n CaFCC_IdealRemainChargeTimeSocTempMapZ_min MINUTES_PER_HOUR /end REF_CHARACTERISTIC
 /begin REF_MEASUREMENT LcFCC_timinEstimatePercTime /end REF_MEASUREMENT
/end GROUP
/begin GROUP S1158_EightyPercentCustomSOC_EnableInvalidChargeTimeFlag "VBU0706/Function-Call Subsystem/Subsystem1/FCC /FCC/Subsystem/Calculate_Fastcharge_Time/EightyPercentCustomSOC_EnableInvalidChargeTimeFlag" /begin REF_CHARACTERISTIC CcFCC_CurrentValueCrossZeroFlagDelay_ms /end REF_CHARACTERISTIC /begin REF_MEASUREMENT LbFCC_flgInvalidEstimatedChargeTimeCFT /end REF_MEASUREMENT /end GROUP
/begin GROUP S1158_EightyPercentCustomSOC_UpdateChargeTimeFlag "VBU0706/Function-Call Subsystem/Subsystem1/FCC /FCC/Subsystem/Calculate_Fastcharge_Time/EightyPercentCustomSOC_UpdateChargeTimeFlag"
 /begin REF_CHARACTERISTIC CaFCC_EstimateChargingTimeDeltaMapY_min CcFCC_EstimateChargeTimeCurrent_A CcFCC_EstimateChargeTimeRefresh_s /end REF_CHARACTERISTIC
 /begin REF_MEASUREMENT FCC_flgPackCurrentUpdatePercTime /end REF_MEASUREMENT
/end GROUP
/begin GROUP S1158_EstimateChargeTime_CellVoltageMax_Coefficient "VBU0706/Function-Call Subsystem/Subsystem1/FCC /FCC/Subsystem/Calculate_Fastcharge_Time/EstimateChargeTime_CellVoltageMax_Coefficient"
 /begin REF_CHARACTERISTIC CcFCC_CellVoltageMaxCorrectEndDelta_mV CcFCC_CellVoltageMaxCorrectMiddleDelta_mV CcFCC_CellVoltageMaxCorrectStartDelta_mV CcFCC_CellVoltageMaxFactorEnd_nbr CcFCC_CellVoltageMaxFactorMiddle_nbr CcFCC_CellVoltageMaxFactorStart_nbr /end REF_CHARACTERISTIC
/end GROUP
/begin GROUP S1158_EstimateChargeTime_CellVoltageMax_Slop "VBU0706/Function-Call Subsystem/Subsystem1/FCC /FCC/Subsystem/Calculate_Fastcharge_Time/EstimateChargeTime_CellVoltageMax_Slop"
 /begin REF_CHARACTERISTIC CcFCC_CellVoltageMaxCorrectSlopMax_nbr CcFCC_CellVoltageMaxCorrectSlopMin_nbr /end REF_CHARACTERISTIC
/end GROUP
/begin GROUP S1158_SOC_Mapping "VBU0706/Function-Call Subsystem/Subsystem1/FCC /FCC/Subsystem/Calculate_Fastcharge_Time/SOC_Mapping"
 /begin SUB_GROUP S1170_EqualPorportionMapping3 S1170_EqualPorportionMapping4 S1170_EqualPorportionMapping5 /end SUB_GROUP
/end GROUP
/begin GROUP S1158_SendInvalidTime_flg "VBU0706/Function-Call Subsystem/Subsystem1/FCC /FCC/Subsystem/Calculate_Fastcharge_Time/SendInvalidTime_flg" /begin REF_CHARACTERISTIC CcFCC_CurrentValueCrossZeroFlagDelay_ms /end REF_CHARACTERISTIC /begin REF_MEASUREMENT FCC_flgInvalidEstimatedChargeTime /end REF_MEASUREMENT /end GROUP
/begin GROUP S1158_UpdateTimeTrigger "VBU0706/Function-Call Subsystem/Subsystem1/FCC /FCC/Subsystem/Calculate_Fastcharge_Time/UpdateTimeTrigger"
 /begin REF_CHARACTERISTIC CaFCC_EstimateChargingTimeDeltaMapY_min CcFCC_EstimateChargeTimeCurrent_A CcFCC_EstimateChargeTimeRefresh_s /end REF_CHARACTERISTIC
/end GROUP
/begin GROUP S1158_Update_CustomSOC100RemainTime "VBU0706/Function-Call Subsystem/Subsystem1/FCC /FCC/Subsystem/Calculate_Fastcharge_Time/Update_CustomSOC100RemainTime" /begin REF_CHARACTERISTIC CcFCC_MaxValidChargeTime_min /end REF_CHARACTERISTIC /end GROUP
/begin GROUP S1158_Update_CustomSOC80RemainTime "VBU0706/Function-Call Subsystem/Subsystem1/FCC /FCC/Subsystem/Calculate_Fastcharge_Time/Update_CustomSOC80RemainTime" /begin REF_CHARACTERISTIC CcFCC_MaxValidChargeTime_min /end REF_CHARACTERISTIC /end GROUP
/begin GROUP S1159_Charge_Request_Protection "VBU0706/Function-Call Subsystem/Subsystem1/FCC /FCC/Subsystem/Determine_Fastcharge_Request/Charge_Request_Protection"
 /begin SUB_GROUP S1214_Decrease_ChargeCurrentRequest S1214_Override_Block1 S1214_Override_Voltage_Request S1214_Rate_Limiter /end SUB_GROUP
 /begin REF_CHARACTERISTIC CcFCC_ChargePowerDecRate_Kw CcFCC_ChargePowerIncRate_Kw CcFCC_ComputeResistanceCurrentDecRate_A CcFCC_ComputeResistanceCurrentIncRate_A CcFCC_NoChargeHighTemp_C CcFCC_NoChargeLowTemp_C /end REF_CHARACTERISTIC
 /begin REF_MEASUREMENT FCC_iAChargeCurrentRequestFnl /end REF_MEASUREMENT
/end GROUP
/begin GROUP S1159_DetermineComputeResistancePulseCurrent "VBU0706/Function-Call Subsystem/Subsystem1/FCC /FCC/Subsystem/Determine_Fastcharge_Request/DetermineComputeResistancePulseCurrent"
 /begin SUB_GROUP S1215_Determine_ComputeResistanceCondition S1215_Determine_ComputeResistancePulseRequest S1215_Determine_FastChargeRequest /end SUB_GROUP
/end GROUP
/begin GROUP S1159_Determine_Base_ChargeRequest "VBU0706/Function-Call Subsystem/Subsystem1/FCC /FCC/Subsystem/Determine_Fastcharge_Request/Determine_Base_ChargeRequest" /begin SUB_GROUP S1216_Request_At_Charging S1216_Request_At_NoCharging /end SUB_GROUP
 /begin REF_MEASUREMENT FCC_iABaseChargeCurrentRequest FCC_kwBaseChargePowerRequest FCC_uBaseChargeVoltageRequest /end REF_MEASUREMENT
/end GROUP
/begin GROUP S1159_Determine_DiagnosedAndLimitedChargeRequestCurrent "VBU0706/Function-Call Subsystem/Subsystem1/FCC /FCC/Subsystem/Determine_Fastcharge_Request/Determine_DiagnosedAndLimitedChargeRequestCurrent"
 /begin REF_CHARACTERISTIC CcFCC_BatteryChargeCurrentFactor_n CcFCC_StandardPowerLimit_Kw CcFCC_TrickleChargeCurrent_A CcSYS_MappedCellCapacity_Ah /end REF_CHARACTERISTIC
 /begin REF_MEASUREMENT FCC_iAChargeRequestCurrentLimit /end REF_MEASUREMENT
/end GROUP
/begin GROUP S1160_Condition_Categorize "VBU0706/Function-Call Subsystem/Subsystem1/FCC /FCC/Subsystem/Fastcharge_Conditions_Check/Condition_Categorize"
 /begin SUB_GROUP S1248_Cell_Temp_Protection S1248_Full_Charge_Determination S1248_Voltage_Protection /end SUB_GROUP
 /begin REF_CHARACTERISTIC CmFCC_NoChargeFaultCat_enum /end REF_CHARACTERISTIC
 /begin REF_MEASUREMENT FCC_flgChargeNoFault FCC_flgChargeProtection /end REF_MEASUREMENT
/end GROUP
/begin GROUP S1160_Determine_NoCharge_Cause "VBU0706/Function-Call Subsystem/Subsystem1/FCC /FCC/Subsystem/Fastcharge_Conditions_Check/Determine_NoCharge_Cause"
 /begin REF_CHARACTERISTIC CmFCC_NoChargeCellTempHigh_enum CmFCC_NoChargeCellTempLow_enum CmFCC_NoChargeFault_enum CmFCC_NoChargeVoltageHigh_enum /end REF_CHARACTERISTIC
 /begin REF_MEASUREMENT FCC_flgChargeAvailable FCC_stNoChargeCause /end REF_MEASUREMENT
/end GROUP
/begin GROUP S1456_Determine_OCV_Criteria "VBU0706/Function-Call Subsystem/Subsystem1/OCV/OCV/Subsystem/Determine_Criteria/Determine_OCV_Criteria" /begin REF_MEASUREMENT OCV_flgOcvCriteriaMet /end REF_MEASUREMENT /end GROUP
/begin GROUP S1456_Determine_QOCV_Criteria "VBU0706/Function-Call Subsystem/Subsystem1/OCV/OCV/Subsystem/Determine_Criteria/Determine_QOCV_Criteria" /begin REF_CHARACTERISTIC CaOCV_QuasiOCVCurrentDimension_n CaOCV_QuasiOCVCurrentZ_A /end REF_CHARACTERISTIC /begin REF_MEASUREMENT OCV_flgQuasiOcvCriteria /end REF_MEASUREMENT /end GROUP
/begin GROUP S1493_Determine_AhIntegral_Capacity "VBU0706/Function-Call Subsystem/Subsystem1/SOC/Subsystem5/Subsystem/Determine_AhIntegral_SoC/Determine_AhIntegral_Capacity" /begin SUB_GROUP S1518_Determine_Cell_Balanced_Capacity /end SUB_GROUP
 /begin REF_CHARACTERISTIC CcSOC_MaxBalancedCapacity_As CcSOC_MaxCurrentIntegral_As CcSOC_MinBalancedCapacity_As CcSOC_MinCurrentIntegral_As /end REF_CHARACTERISTIC
/end GROUP
/begin GROUP S1493_Determine_AhIntegral_SOC "VBU0706/Function-Call Subsystem/Subsystem1/SOC/Subsystem5/Subsystem/Determine_AhIntegral_SoC/Determine_AhIntegral_SOC"
 /begin REF_CHARACTERISTIC CbSOC_CellCapacityOvrdFlg_flg CcSOC_CellCapacityOvrdVal_Ah SECONDS_PER_HOUR /end REF_CHARACTERISTIC
/end GROUP
/begin GROUP S1493_Determine_Module_Current "VBU0706/Function-Call Subsystem/Subsystem1/SOC/Subsystem5/Subsystem/Determine_AhIntegral_SoC/Determine_Module_Current" /begin SUB_GROUP S1520_CONTACTOR_STATUS_OPENED1 /end SUB_GROUP /begin REF_MEASUREMENT SOC_iAModuleCurrent /end REF_MEASUREMENT /end GROUP
/begin GROUP S1498_Determine_BatterySOC_ChangeRate "VBU0706/Function-Call Subsystem/Subsystem1/SOC/Subsystem5/Subsystem/Determine_Display_SOC/Determine_BatterySOC_ChangeRate" /begin REF_CHARACTERISTIC SECONDS_PER_HOUR /end REF_CHARACTERISTIC /end GROUP
/begin GROUP S1498_DisplaySOC_Driving_Calculation "VBU0706/Function-Call Subsystem/Subsystem1/SOC/Subsystem5/Subsystem/Determine_Display_SOC/DisplaySOC_Driving_Calculation" /begin SUB_GROUP S1554_Determine_SOC_RateLimit /end SUB_GROUP /begin REF_CHARACTERISTIC CcSOC_ChargeStateDelay_ms /end REF_CHARACTERISTIC /end GROUP
/begin GROUP S1498_DisplaySOC_Startup_Calculation "VBU0706/Function-Call Subsystem/Subsystem1/SOC/Subsystem5/Subsystem/Determine_Display_SOC/DisplaySOC_Startup_Calculation"
 /begin REF_CHARACTERISTIC CcSOC_BatteryDisplaySocUpdateInterval_s CcSOC_InvalidLastShutdownTime_s /end REF_CHARACTERISTIC
 /begin REF_MEASUREMENT SOC_flgRelaxationST /end REF_MEASUREMENT
/end GROUP
/begin GROUP S1498_NoJumpSOC_Startup_Calculation "VBU0706/Function-Call Subsystem/Subsystem1/SOC/Subsystem5/Subsystem/Determine_Display_SOC/NoJumpSOC_Startup_Calculation"
 /begin REF_CHARACTERISTIC CcSOC_BatteryDisplaySocUpdateInterval_s CcSOC_InvalidLastShutdownTime_s /end REF_CHARACTERISTIC
/end GROUP
/begin GROUP S3555_PwrMod_Ctrl "VBU0706/Task_10ms/Subsystem/VCU /PMM/PMM_Ctrl/PMM/PwrMod_Ctrl" /begin REF_CHARACTERISTIC PMM_stInitMode_SY PMM_stShutDown_SY /end REF_CHARACTERISTIC /end GROUP
/begin GROUP S3749_ESSPmpCmdRaw "VBU0706/Task_10ms/Subsystem/VCU /THM/THM/PumpRaw/ESSPmpCmdRaw" /begin REF_CHARACTERISTIC PMM_stInitMode_SY PMM_stShutDown_SY /end REF_CHARACTERISTIC /end GROUP
/begin GROUP S3749_RearPmpCmdRaw "VBU0706/Task_10ms/Subsystem/VCU /THM/THM/PumpRaw/RearPmpCmdRaw" /begin REF_CHARACTERISTIC PMM_stInitMode_SY PMM_stShutDown_SY /end REF_CHARACTERISTIC /end GROUP
/begin GROUP S466_Diagnose_BdmOutOfRange_Fault "VBU0706/Function-Call Subsystem/Subsystem1/BCV/BCV/Subsystem/Monitor_BCV_Performance/Diagnose_BDM_BCV_Communication_Fault/Diagnose_BdmOutOfRange_Fault"
 /begin REF_CHARACTERISTIC BCV_BATTERY_VOLTAGE_SENSE_OOR_FAULT BCV_LEM_CURRENT_SENSE_OOR_FAULT /end REF_CHARACTERISTIC
/end GROUP
/begin GROUP S467_Diagnose_BdmBatteryBusVoltageMismatch_Fault "VBU0706/Function-Call Subsystem/Subsystem1/BCV/BCV/Subsystem/Monitor_BCV_Performance/Diagnose_BDM_BCV_Data_Fault/Diagnose_BdmBatteryBusVoltageMismatch_Fault" /begin REF_CHARACTERISTIC BCV_BATTERY_BUS_VOLTAGE_MISMATCH_FAULT /end REF_CHARACTERISTIC /end GROUP
/begin GROUP S467_Diagnose_BdmVoltageCurrent_Fault "VBU0706/Function-Call Subsystem/Subsystem1/BCV/BCV/Subsystem/Monitor_BCV_Performance/Diagnose_BDM_BCV_Data_Fault/Diagnose_BdmVoltageCurrent_Fault" /begin REF_CHARACTERISTIC BCV_BATTERY_UNDER_VOLTAGE_FAULT /end REF_CHARACTERISTIC /end GROUP
/begin GROUP S663_Determine_Diagnostic_Status "VBU0706/Function-Call Subsystem/Subsystem1/CTD/Subsystem/Subsystem4/DiagnoseRelayWeld/MNC_Weld_Check/Determine_Diagnostic_Status" /begin REF_CHARACTERISTIC CcFDC_MaxCount_n CcFDC_MinCount_n DIAGNOSTIC_ON_GOING /end REF_CHARACTERISTIC /end GROUP
/begin GROUP S664_Determine_Diagnostic_Status "VBU0706/Function-Call Subsystem/Subsystem1/CTD/Subsystem/Subsystem4/DiagnoseRelayWeld/MPC_Weld_Check/Determine_Diagnostic_Status" /begin REF_CHARACTERISTIC CcFDC_MaxCount_n CcFDC_MinCount_n DIAGNOSTIC_ON_GOING /end REF_CHARACTERISTIC /end GROUP
/begin GROUP S732_Status_Charging "VBU0706/Function-Call Subsystem/Subsystem1/CTD/Subsystem/Subsystem4/PrechrgProcessMonitoring/Precharging_Process_Monitoring/Status_Charging" /begin REF_CHARACTERISTIC CTD_PRECHARGE_STATUS_CHARGING /end REF_CHARACTERISTIC /end GROUP
/begin GROUP S754_Determine_Diagnostic_Status "VBU0706/Function-Call Subsystem/Subsystem1/CTD/Subsystem/Subsystem4/Stuck_Open_Diagnostic/MPR_Stuck_Open/Determine_Diagnostic_Status" /begin REF_CHARACTERISTIC CcFDC_MaxCount_n CcFDC_MinCount_n DIAGNOSTIC_ON_GOING /end REF_CHARACTERISTIC /end GROUP
/begin GROUP S835_DetermineFault "VBU0706/Function-Call Subsystem/Subsystem1/CTM/CTM/Subsystem/Determine_CellTemp_OverDeviationFaults/EVM_FDC_Handler1/DetermineFault" /begin REF_CHARACTERISTIC CcFDC_MaxCount_n CcFDC_MinCount_n /end REF_CHARACTERISTIC /end GROUP
/begin GROUP S835_DetermineFaultCounter "VBU0706/Function-Call Subsystem/Subsystem1/CTM/CTM/Subsystem/Determine_CellTemp_OverDeviationFaults/EVM_FDC_Handler1/DetermineFaultCounter" /begin REF_CHARACTERISTIC CcFDC_MaxCount_n CcFDC_MinCount_n /end REF_CHARACTERISTIC /end GROUP
/begin GROUP S845_DetermineFault "VBU0706/Function-Call Subsystem/Subsystem1/CTM/CTM/Subsystem/Determine_CellTemp_OverUnderFaults/EVM_FDC_Handler/DetermineFault" /begin REF_CHARACTERISTIC CcFDC_MaxCount_n CcFDC_MinCount_n /end REF_CHARACTERISTIC /end GROUP
/begin GROUP S845_DetermineFaultCounter "VBU0706/Function-Call Subsystem/Subsystem1/CTM/CTM/Subsystem/Determine_CellTemp_OverUnderFaults/EVM_FDC_Handler/DetermineFaultCounter" /begin REF_CHARACTERISTIC CcFDC_MaxCount_n CcFDC_MinCount_n /end REF_CHARACTERISTIC /end GROUP
/begin GROUP S869_CellTemp_ChangeRate_Calculate "VBU0706/Function-Call Subsystem/Subsystem1/CTM/CTM/Subsystem/Determine_Thermal_Runaway/DetermineTempRiseRate/CellTemp_ChangeRate_Calculate"
 /begin REF_CHARACTERISTIC CbCTM_CellThermalRunawayEnable_flg CcCTM_ThermalRunawayTriggerTime_ms /end REF_CHARACTERISTIC
/end GROUP
/begin GROUP S935_DetermineFault "VBU0706/Function-Call Subsystem/Subsystem1/CVT/CVT/Subsystem/Determine_CellVoltage_OverUnderFaults/EVM_FDC_Handler/DetermineFault" /begin REF_CHARACTERISTIC CcFDC_MaxCount_n CcFDC_MinCount_n /end REF_CHARACTERISTIC /end GROUP
/begin GROUP S935_DetermineFaultCounter "VBU0706/Function-Call Subsystem/Subsystem1/CVT/CVT/Subsystem/Determine_CellVoltage_OverUnderFaults/EVM_FDC_Handler/DetermineFaultCounter" /begin REF_CHARACTERISTIC CcFDC_MaxCount_n CcFDC_MinCount_n /end REF_CHARACTERISTIC /end GROUP
/begin GROUP S936_DetermineFault "VBU0706/Function-Call Subsystem/Subsystem1/CVT/CVT/Subsystem/Determine_CellVoltage_OverUnderFaults/EVM_FDC_Handler1/DetermineFault" /begin REF_CHARACTERISTIC CcFDC_MaxCount_n CcFDC_MinCount_n /end REF_CHARACTERISTIC /end GROUP
/begin GROUP S936_DetermineFaultCounter "VBU0706/Function-Call Subsystem/Subsystem1/CVT/CVT/Subsystem/Determine_CellVoltage_OverUnderFaults/EVM_FDC_Handler1/DetermineFaultCounter" /begin REF_CHARACTERISTIC CcFDC_MaxCount_n CcFDC_MinCount_n /end REF_CHARACTERISTIC /end GROUP
/begin GROUP S937_DetermineFault "VBU0706/Function-Call Subsystem/Subsystem1/CVT/CVT/Subsystem/Determine_CellVoltage_OverUnderFaults/EVM_FDC_Handler2/DetermineFault" /begin REF_CHARACTERISTIC CcFDC_MaxCount_n CcFDC_MinCount_n /end REF_CHARACTERISTIC /end GROUP
/begin GROUP S937_DetermineFaultCounter "VBU0706/Function-Call Subsystem/Subsystem1/CVT/CVT/Subsystem/Determine_CellVoltage_OverUnderFaults/EVM_FDC_Handler2/DetermineFaultCounter" /begin REF_CHARACTERISTIC CcFDC_MaxCount_n CcFDC_MinCount_n /end REF_CHARACTERISTIC /end GROUP
/begin GROUP S1053_DCH_VehStateAnalyze "VBU0706/Function-Call Subsystem/Subsystem1/FCC /DCH_Overall/DCH_DCChargeCtrlOverall/DCH_DCChargeCtrlStateflow/DCH_InputSignalPreProcess/DCH_VehStateAnalyze" /begin REF_CHARACTERISTIC DCH_stHVCntctClosed_SY /end REF_CHARACTERISTIC /end GROUP
/begin GROUP S1214_Decrease_ChargeCurrentRequest "VBU0706/Function-Call Subsystem/Subsystem1/FCC /FCC/Subsystem/Determine_Fastcharge_Request/Charge_Request_Protection/Decrease_ChargeCurrentRequest"
 /begin REF_CHARACTERISTIC CcFCC_BatteryChargeCurrentFactor_n CcFCC_TrickleChargeCurrent_A CcSYS_MappedCellCapacity_Ah /end REF_CHARACTERISTIC
/end GROUP
/begin GROUP S1215_Determine_ComputeResistancePulseRequest "VBU0706/Function-Call Subsystem/Subsystem1/FCC /FCC/Subsystem/Determine_Fastcharge_Request/DetermineComputeResistancePulseCurrent/Determine_ComputeResistancePulseRequest"
 /begin REF_CHARACTERISTIC CcFCC_BatteryChargeCurrentFactor_n CcFCC_StandardPowerLimit_Kw CcFCC_TrickleChargeCurrent_A CcSYS_MappedCellCapacity_Ah /end REF_CHARACTERISTIC
/end GROUP
/begin GROUP S1216_Request_At_Charging "VBU0706/Function-Call Subsystem/Subsystem1/FCC /FCC/Subsystem/Determine_Fastcharge_Request/Determine_Base_ChargeRequest/Request_At_Charging"
 /begin REF_CHARACTERISTIC CcFCC_BatteryChargeCurrentFactor_n CcFCC_StandardPowerLimit_Kw CcFCC_TrickleChargeCurrent_A CcSYS_MappedCellCapacity_Ah /end REF_CHARACTERISTIC
/end GROUP
/begin GROUP S1248_Cell_Temp_Protection "VBU0706/Function-Call Subsystem/Subsystem1/FCC /FCC/Subsystem/Fastcharge_Conditions_Check/Condition_Categorize/Cell_Temp_Protection" /begin REF_CHARACTERISTIC CcFCC_NoChargeHighTemp_C CcFCC_NoChargeLowTemp_C /end REF_CHARACTERISTIC /end GROUP
/begin GROUP S1964_Determine_SlowCharge "VBU0706/Function-Call Subsystem/Subsystem1/SOH/Subsystem4/Subsystem1/Calculate_Capacity/Determine_CalculateCellCapacity_Condition/Determine_SlowCharge" /begin REF_CHARACTERISTIC CcSYS_NoOfInvalidCellVoltages_n /end REF_CHARACTERISTIC /end GROUP
/begin GROUP S1964_Determine_SlowChargeEnd "VBU0706/Function-Call Subsystem/Subsystem1/SOH/Subsystem4/Subsystem1/Calculate_Capacity/Determine_CalculateCellCapacity_Condition/Determine_SlowChargeEnd" /begin REF_CHARACTERISTIC CcSYS_NoOfInvalidCellVoltages_n /end REF_CHARACTERISTIC /end GROUP
/begin GROUP S1964_Determine_SlowChargeStart "VBU0706/Function-Call Subsystem/Subsystem1/SOH/Subsystem4/Subsystem1/Calculate_Capacity/Determine_CalculateCellCapacity_Condition/Determine_SlowChargeStart" /begin REF_CHARACTERISTIC CcSYS_NoOfInvalidCellVoltages_n /end REF_CHARACTERISTIC /end GROUP
/begin GROUP S2030_ResistanceCalc_Check "VBU0706/Function-Call Subsystem/Subsystem1/SOH/Subsystem4/Subsystem1/Calculate_Resistance/BasicCellResistance_Calculation_Check/ResistanceCalc_Check" /begin REF_CHARACTERISTIC CcSYS_NoOfInvalidCellVoltages_n /end REF_CHARACTERISTIC /end GROUP
/begin GROUP S3348_ChargeConditon "VBU0706/Task_10ms/Subsystem/VCU /DSPL/DSPL/DriveRange/RemainingRange/ChargeConditon" /begin REF_CHARACTERISTIC DSPL_tiSample_SY /end REF_CHARACTERISTIC /end GROUP
/begin GROUP S3348_DriveTemp "VBU0706/Task_10ms/Subsystem/VCU /DSPL/DSPL/DriveRange/RemainingRange/DriveTemp" /begin REF_CHARACTERISTIC DSPL_tiSample_SY /end REF_CHARACTERISTIC /end GROUP
/begin GROUP S3598_DVM_SetRdy "VBU0706/Task_10ms/Subsystem/VCU /PMM/PMM_Ctrl/PMM/DrvMod_Ctrl/DVM_SetRdy" /begin REF_CHARACTERISTIC PMM_flgVehRdyOvrdVal_C /end REF_CHARACTERISTIC /end GROUP
/begin GROUP S3601_SelfRoutine "VBU0706/Task_10ms/Subsystem/VCU /PMM/PMM_Ctrl/PMM/PwrMod_Ctrl/SelfRoutine" /begin REF_CHARACTERISTIC PMM_stInitMode_SY PMM_stShutDown_SY /end REF_CHARACTERISTIC /end GROUP
/begin GROUP S423_DetermineFault "VBU0706/Function-Call Subsystem/Subsystem1/BCV/BCV/Subsystem/Diagnose_BCV_Data_Fault/Diagnose_VoltageCurrent_Fault/EVM_FDC_Handler/DetermineFault" /begin REF_CHARACTERISTIC CcFDC_MaxCount_n CcFDC_MinCount_n /end REF_CHARACTERISTIC /end GROUP
/begin GROUP S423_DetermineFaultCounter "VBU0706/Function-Call Subsystem/Subsystem1/BCV/BCV/Subsystem/Diagnose_BCV_Data_Fault/Diagnose_VoltageCurrent_Fault/EVM_FDC_Handler/DetermineFaultCounter" /begin REF_CHARACTERISTIC CcFDC_MaxCount_n CcFDC_MinCount_n /end REF_CHARACTERISTIC /end GROUP
/begin GROUP S424_DetermineFault "VBU0706/Function-Call Subsystem/Subsystem1/BCV/BCV/Subsystem/Diagnose_BCV_Data_Fault/Diagnose_VoltageCurrent_Fault/EVM_FDC_Handler1/DetermineFault" /begin REF_CHARACTERISTIC CcFDC_MaxCount_n CcFDC_MinCount_n /end REF_CHARACTERISTIC /end GROUP
/begin GROUP S424_DetermineFaultCounter "VBU0706/Function-Call Subsystem/Subsystem1/BCV/BCV/Subsystem/Diagnose_BCV_Data_Fault/Diagnose_VoltageCurrent_Fault/EVM_FDC_Handler1/DetermineFaultCounter" /begin REF_CHARACTERISTIC CcFDC_MaxCount_n CcFDC_MinCount_n /end REF_CHARACTERISTIC /end GROUP
/begin GROUP S425_DetermineFault "VBU0706/Function-Call Subsystem/Subsystem1/BCV/BCV/Subsystem/Diagnose_BCV_Data_Fault/Diagnose_VoltageCurrent_Fault/EVM_FDC_Handler2/DetermineFault" /begin REF_CHARACTERISTIC CcFDC_MaxCount_n CcFDC_MinCount_n /end REF_CHARACTERISTIC /end GROUP
/begin GROUP S425_DetermineFaultCounter "VBU0706/Function-Call Subsystem/Subsystem1/BCV/BCV/Subsystem/Diagnose_BCV_Data_Fault/Diagnose_VoltageCurrent_Fault/EVM_FDC_Handler2/DetermineFaultCounter" /begin REF_CHARACTERISTIC CcFDC_MaxCount_n CcFDC_MinCount_n /end REF_CHARACTERISTIC /end GROUP
/begin GROUP S756_Determine_Diagnostic_Status "VBU0706/Function-Call Subsystem/Subsystem1/CTD/Subsystem/Subsystem4/Stuck_Open_Diagnostic/MNC_Stuck_Open/MNC_Stuck_Open_With_VehicleSpeed/Determine_Diagnostic_Status" /begin REF_CHARACTERISTIC CcFDC_MaxCount_n CcFDC_MinCount_n DIAGNOSTIC_ON_GOING /end REF_CHARACTERISTIC /end GROUP
/begin GROUP S780_Determine_Diagnostic_Status "VBU0706/Function-Call Subsystem/Subsystem1/CTD/Subsystem/Subsystem4/Stuck_Open_Diagnostic/MPC_Stuck_Open/MPC_Stuck_Open_Without_VehicleSpeed/Determine_Diagnostic_Status" /begin REF_CHARACTERISTIC CcFDC_MaxCount_n CcFDC_MinCount_n DIAGNOSTIC_ON_GOING /end REF_CHARACTERISTIC /end GROUP
/begin GROUP S1257_FullCharge_criteria4 "VBU0706/Function-Call Subsystem/Subsystem1/FCC /FCC/Subsystem/Fastcharge_Conditions_Check/Condition_Categorize/Full_Charge_Determination/FullCharge_criteria4"
 /begin REF_CHARACTERISTIC CcFCC_BatteryCapacityCycle1_n CcFCC_BatteryCapacityCycle2_n CcFCC_CustomSetSOCEnable_pct CcFCC_FullChargeSoc1_pct CcFCC_FullChargeSoc2_pct CcFCC_FullChargeSoc3_pct /end REF_CHARACTERISTIC
/end GROUP
/begin GROUP S1767_Enable_Voltage_Correction "VBU0706/Function-Call Subsystem/Subsystem1/SOF/Subsystem6/Subsystem/Determine_Currentlimit_Target/Calculate_CurrentLimit_Target/CurrentLimit_Voltage_Correct/Enable_Voltage_Correction" /begin REF_CHARACTERISTIC CcSYS_NoOfInvalidCellVoltages_n /end REF_CHARACTERISTIC /end GROUP
/begin GROUP S2000_Determine_AhIntegral_Q "VBU0706/Function-Call Subsystem/Subsystem1/SOH/Subsystem4/Subsystem1/Calculate_Capacity/Calculate_CellCapacity_SlowCharge/Determine_AhIntegral_DeltaQ/Determine_AhIntegral_Q" /begin REF_CHARACTERISTIC SECONDS_PER_HOUR /end REF_CHARACTERISTIC /end GROUP
/begin GROUP S3349_DSPL_EnergyComsumptionCal "VBU0706/Task_10ms/Subsystem/VCU /DSPL/DSPL/DriveRange/DSPL_Consumption/DSPL_EnergySelfLearn/DSPL_EnergyComsumptionCal" /begin REF_CHARACTERISTIC DSPL_tiSample_SY /end REF_CHARACTERISTIC /end GROUP
/begin GROUP S3398_SOCDeclineFactorCalculation "VBU0706/Task_10ms/Subsystem/VCU /DSPL/DSPL/DriveRange/RemainingRange/FullRangeAndSocDeclineFactor/SOCDeclineFactorCalculation" /begin REF_CHARACTERISTIC DSPL_tiSample_SY /end REF_CHARACTERISTIC /end GROUP
/begin GROUP S3400_Charge "VBU0706/Task_10ms/Subsystem/VCU /DSPL/DSPL/DriveRange/RemainingRange/SelectDisplayRange/Charge" /begin REF_CHARACTERISTIC DSPL_tiSample_SY /end REF_CHARACTERISTIC /end GROUP
/begin GROUP S3400_Drive "VBU0706/Task_10ms/Subsystem/VCU /DSPL/DSPL/DriveRange/RemainingRange/SelectDisplayRange/Drive" /begin REF_CHARACTERISTIC DSPL_tiSample_SY /end REF_CHARACTERISTIC /end GROUP
/begin GROUP S3400_storeRange "VBU0706/Task_10ms/Subsystem/VCU /DSPL/DSPL/DriveRange/RemainingRange/SelectDisplayRange/storeRange" /begin REF_CHARACTERISTIC DSPL_tiSample_SY /end REF_CHARACTERISTIC /end GROUP
/begin GROUP S3656_CtrlSht "VBU0706/Task_10ms/Subsystem/VCU /PMM/PMM_Ctrl/PMM/PwrMod_Ctrl/PwrMod_PowerUp/CtrlSht" /begin REF_CHARACTERISTIC PMM_stInitMode_SY PMM_stShutDown_SY /end REF_CHARACTERISTIC /end GROUP
/begin GROUP S3656_EmgcySht "VBU0706/Task_10ms/Subsystem/VCU /PMM/PMM_Ctrl/PMM/PwrMod_Ctrl/PwrMod_PowerUp/EmgcySht" /begin REF_CHARACTERISTIC PMM_stInitMode_SY PMM_stShutDown_SY /end REF_CHARACTERISTIC /end GROUP
/begin GROUP S3658_Routine_PwrDwn "VBU0706/Task_10ms/Subsystem/VCU /PMM/PMM_Ctrl/PMM/PwrMod_Ctrl/Routine/Routine_PwrDwn" /begin REF_CHARACTERISTIC PMM_stInitMode_SY PMM_stShutDown_SY /end REF_CHARACTERISTIC /end GROUP
/begin GROUP S473_DetermineFault "VBU0706/Function-Call Subsystem/Subsystem1/BCV/BCV/Subsystem/Monitor_BCV_Performance/Diagnose_BDM_BCV_Communication_Fault/Diagnose_BdmOutOfRange_Fault/BigDataMonitor_Handler/DetermineFault" /begin REF_CHARACTERISTIC CcFDC_MaxCount_n CcFDC_MinCount_n /end REF_CHARACTERISTIC /end GROUP
/begin GROUP S473_DetermineFaultCounter "VBU0706/Function-Call Subsystem/Subsystem1/BCV/BCV/Subsystem/Monitor_BCV_Performance/Diagnose_BDM_BCV_Communication_Fault/Diagnose_BdmOutOfRange_Fault/BigDataMonitor_Handler/DetermineFaultCounter" /begin REF_CHARACTERISTIC CcFDC_MaxCount_n CcFDC_MinCount_n /end REF_CHARACTERISTIC /end GROUP
/begin GROUP S474_DetermineFault "VBU0706/Function-Call Subsystem/Subsystem1/BCV/BCV/Subsystem/Monitor_BCV_Performance/Diagnose_BDM_BCV_Communication_Fault/Diagnose_BdmOutOfRange_Fault/BigDataMonitor_Handler1/DetermineFault" /begin REF_CHARACTERISTIC CcFDC_MaxCount_n CcFDC_MinCount_n /end REF_CHARACTERISTIC /end GROUP
/begin GROUP S474_DetermineFaultCounter "VBU0706/Function-Call Subsystem/Subsystem1/BCV/BCV/Subsystem/Monitor_BCV_Performance/Diagnose_BDM_BCV_Communication_Fault/Diagnose_BdmOutOfRange_Fault/BigDataMonitor_Handler1/DetermineFaultCounter" /begin REF_CHARACTERISTIC CcFDC_MaxCount_n CcFDC_MinCount_n /end REF_CHARACTERISTIC /end GROUP
/begin GROUP S485_DetermineFault "VBU0706/Function-Call Subsystem/Subsystem1/BCV/BCV/Subsystem/Monitor_BCV_Performance/Diagnose_BDM_BCV_Data_Fault/Diagnose_BdmBatteryBusVoltageMismatch_Fault/BigDataMonitor_Handler1/DetermineFault" /begin REF_CHARACTERISTIC CcFDC_MaxCount_n CcFDC_MinCount_n /end REF_CHARACTERISTIC /end GROUP
/begin GROUP S485_DetermineFaultCounter "VBU0706/Function-Call Subsystem/Subsystem1/BCV/BCV/Subsystem/Monitor_BCV_Performance/Diagnose_BDM_BCV_Data_Fault/Diagnose_BdmBatteryBusVoltageMismatch_Fault/BigDataMonitor_Handler1/DetermineFaultCounter" /begin REF_CHARACTERISTIC CcFDC_MaxCount_n CcFDC_MinCount_n /end REF_CHARACTERISTIC /end GROUP
/begin GROUP S491_DetermineFault "VBU0706/Function-Call Subsystem/Subsystem1/BCV/BCV/Subsystem/Monitor_BCV_Performance/Diagnose_BDM_BCV_Data_Fault/Diagnose_BdmVoltageCurrent_Fault/BigDataMonitor_Handler/DetermineFault" /begin REF_CHARACTERISTIC CcFDC_MaxCount_n CcFDC_MinCount_n /end REF_CHARACTERISTIC /end GROUP
/begin GROUP S491_DetermineFaultCounter "VBU0706/Function-Call Subsystem/Subsystem1/BCV/BCV/Subsystem/Monitor_BCV_Performance/Diagnose_BDM_BCV_Data_Fault/Diagnose_BdmVoltageCurrent_Fault/BigDataMonitor_Handler/DetermineFaultCounter" /begin REF_CHARACTERISTIC CcFDC_MaxCount_n CcFDC_MinCount_n /end REF_CHARACTERISTIC /end GROUP
/begin GROUP S492_DetermineFault "VBU0706/Function-Call Subsystem/Subsystem1/BCV/BCV/Subsystem/Monitor_BCV_Performance/Diagnose_BDM_BCV_Data_Fault/Diagnose_BdmVoltageCurrent_Fault/BigDataMonitor_Handler1/DetermineFault" /begin REF_CHARACTERISTIC CcFDC_MaxCount_n CcFDC_MinCount_n /end REF_CHARACTERISTIC /end GROUP
/begin GROUP S492_DetermineFaultCounter "VBU0706/Function-Call Subsystem/Subsystem1/BCV/BCV/Subsystem/Monitor_BCV_Performance/Diagnose_BDM_BCV_Data_Fault/Diagnose_BdmVoltageCurrent_Fault/BigDataMonitor_Handler1/DetermineFaultCounter" /begin REF_CHARACTERISTIC CcFDC_MaxCount_n CcFDC_MinCount_n /end REF_CHARACTERISTIC /end GROUP
/begin GROUP S493_DetermineFault "VBU0706/Function-Call Subsystem/Subsystem1/BCV/BCV/Subsystem/Monitor_BCV_Performance/Diagnose_BDM_BCV_Data_Fault/Diagnose_BdmVoltageCurrent_Fault/BigDataMonitor_Handler2/DetermineFault" /begin REF_CHARACTERISTIC CcFDC_MaxCount_n CcFDC_MinCount_n /end REF_CHARACTERISTIC /end GROUP
/begin GROUP S493_DetermineFaultCounter "VBU0706/Function-Call Subsystem/Subsystem1/BCV/BCV/Subsystem/Monitor_BCV_Performance/Diagnose_BDM_BCV_Data_Fault/Diagnose_BdmVoltageCurrent_Fault/BigDataMonitor_Handler2/DetermineFaultCounter" /begin REF_CHARACTERISTIC CcFDC_MaxCount_n CcFDC_MinCount_n /end REF_CHARACTERISTIC /end GROUP
/begin GROUP S3610_VCUActSrc "VBU0706/Task_10ms/Subsystem/VCU /PMM/PMM_Ctrl/PMM/LvWakeUp_Ctrl/LvWakeUp_State_Calc/LVWSrc/VCUActSrc" /begin REF_CHARACTERISTIC PMM_stInitMode_SY PMM_stShutDown_SY /end REF_CHARACTERISTIC /end GROUP
/end MODULE
/end PROJECT
