ASAP2_VERSION 1 31
/begin PROJECT ProjectName "Project Comment Goes Here"
/begin HEADER "Header Comments go here" /end HEADER
/begin MODULE ModuleName "Module Comment Goes Here"
/begin MOD_COMMON "Mod Common Comment Here" ALIGNMENT_WORD 1 ALIGNMENT_LONG 1 ALIGNMENT_FLOAT32_IEEE 1 ALIGNMENT_FLOAT64_IEEE 1 BYTE_ORDER MSB_LAST /end MOD_COMMON
/begin RECORD_LAYOUT Scalar_BOOLEAN FNC_VALUES 1 UBYTE COLUMN_DIR DIRECT /end RECORD_LAYOUT
/begin RECORD_LAYOUT Scalar_UBYTE FNC_VALUES 1 UBYTE COLUMN_DIR DIRECT /end RECORD_LAYOUT
/begin RECORD_LAYOUT Scalar_BYTE FNC_VALUES 1 SBYTE COLUMN_DIR DIRECT /end RECORD_LAYOUT
/begin RECORD_LAYOUT Scalar_UWORD FNC_VALUES 1 UWORD COLUMN_DIR DIRECT /end RECORD_LAYOUT
/begin RECORD_LAYOUT Scalar_ULONG FNC_VALUES 1 ULONG COLUMN_DIR DIRECT /end RECORD_LAYOUT
/begin RECORD_LAYOUT Scalar_FLOAT32_IEEE FNC_VALUES 1 FLOAT32_IEEE COLUMN_DIR DIRECT /end RECORD_LAYOUT
/begin RECORD_LAYOUT Scalar_FLOAT64_IEEE FNC_VALUES 1 FLOAT64_IEEE COLUMN_DIR DIRECT /end RECORD_LAYOUT
/begin RECORD_LAYOUT Lookup1D_X_LONG AXIS_PTS_X 1 SLONG INDEX_INCR DIRECT /end RECORD_LAYOUT
/begin RECORD_LAYOUT Lookup1D_FLOAT32_IEEE FNC_VALUES 1 FLOAT32_IEEE COLUMN_DIR DIRECT /end RECORD_LAYOUT
/begin RECORD_LAYOUT Lookup1D_X_FLOAT32_IEEE AXIS_PTS_X 1 FLOAT32_IEEE INDEX_INCR DIRECT /end RECORD_LAYOUT
/begin RECORD_LAYOUT Lookup1D_FLOAT64_IEEE FNC_VALUES 1 FLOAT64_IEEE COLUMN_DIR DIRECT /end RECORD_LAYOUT
/begin RECORD_LAYOUT Lookup2D_BOOLEAN FNC_VALUES 1 UBYTE COLUMN_DIR DIRECT /end RECORD_LAYOUT
/begin RECORD_LAYOUT Lookup2D_X_BOOLEAN AXIS_PTS_X 1 UBYTE INDEX_INCR DIRECT /end RECORD_LAYOUT
/begin RECORD_LAYOUT Lookup2D_FLOAT32_IEEE FNC_VALUES 1 FLOAT32_IEEE COLUMN_DIR DIRECT /end RECORD_LAYOUT
/begin RECORD_LAYOUT Lookup2D_X_FLOAT32_IEEE AXIS_PTS_X 1 FLOAT32_IEEE INDEX_INCR DIRECT /end RECORD_LAYOUT
/begin CHARACTERISTIC CaSOC_OcvSocMapZ_pct "" MAP 0x7000ad50 Lookup2D_FLOAT32_IEEE 0 VBU0706_CM_single_cnt -3.4028234663852886E+38 3.4028234663852886E+38
 /begin AXIS_DESCR COM_AXIS NO_INPUT_QUANTITY VBU0706_CM_single_cnt 21 -3.4028234663852886E+38 3.4028234663852886E+38 AXIS_PTS_REF CaSOC_OcvSocMapY_mV /end AXIS_DESCR
 /begin AXIS_DESCR COM_AXIS CTM_tCellTempAve VBU0706_CM_single_cnt 11 -3.4028234663852886E+38 3.4028234663852886E+38 AXIS_PTS_REF CaSOC_OcvSocMapX_C /end AXIS_DESCR
/end CHARACTERISTIC
/begin AXIS_PTS CaSOC_OcvSocMapX_C "" 0x700025e6 CTM_tCellTempAve Lookup2D_X_FLOAT32_IEEE 0 VBU0706_CM_single_cnt 11 -3.4028234663852886E+38 3.4028234663852886E+38 /end AXIS_PTS
/begin AXIS_PTS CaSOC_OcvSocMapY_mV "" 0x70003cac NO_INPUT_QUANTITY Lookup2D_X_FLOAT32_IEEE 0 VBU0706_CM_single_cnt 21 -3.4028234663852886E+38 3.4028234663852886E+38 /end AXIS_PTS
/begin CHARACTERISTIC CaSOF_mvDischargeOcvSocTempMap_v "" MAP 0x7000c608 Lookup2D_FLOAT32_IEEE 0 VBU0706_CM_single_v 0.0 5.0
 /begin AXIS_DESCR COM_AXIS NO_INPUT_QUANTITY VBU0706_CM_single_pct 21 0.0 100.0 AXIS_PTS_REF CaSOF_pctDischargeOcvSocTempMap_y /end AXIS_DESCR
 /begin AXIS_DESCR COM_AXIS CTM_tCellTempAve VBU0706_CM_single_t 19 -40.0 120.0 AXIS_PTS_REF CaSOF_tDischargeOcvSocTempMap_x /end AXIS_DESCR
/end CHARACTERISTIC
/begin AXIS_PTS CaSOF_tDischargeOcvSocTempMap_x "" 0x70003a40 CTM_tCellTempAve Lookup2D_X_FLOAT32_IEEE 0 VBU0706_CM_single_t 19 -40.0 120.0 /end AXIS_PTS
/begin AXIS_PTS CaSOF_pctDischargeOcvSocTempMap_y "" 0x70003ea4 NO_INPUT_QUANTITY Lookup2D_X_FLOAT32_IEEE 0 VBU0706_CM_single_pct 21 0.0 100.0 /end AXIS_PTS
/begin CHARACTERISTIC CaSOF_mvChargeOcvSocTempMap_v "" MAP 0x7000b560 Lookup2D_FLOAT32_IEEE 0 VBU0706_CM_single_v 0.0 5.0
 /begin AXIS_DESCR COM_AXIS NO_INPUT_QUANTITY VBU0706_CM_single_pct 20 0.0 100.0 AXIS_PTS_REF CaSOF_pctChargeOcvSocTempMap_y /end AXIS_DESCR
 /begin AXIS_DESCR COM_AXIS CTM_tCellTempAve VBU0706_CM_single_t 17 -40.0 120.0 AXIS_PTS_REF CaSOF_tChargeOcvSocTempMap_x /end AXIS_DESCR
/end CHARACTERISTIC
/begin AXIS_PTS CaSOF_tChargeOcvSocTempMap_x "" 0x700036c4 CTM_tCellTempAve Lookup2D_X_FLOAT32_IEEE 0 VBU0706_CM_single_t 17 -40.0 120.0 /end AXIS_PTS
/begin AXIS_PTS CaSOF_pctChargeOcvSocTempMap_y "" 0x70003bbc NO_INPUT_QUANTITY Lookup2D_X_FLOAT32_IEEE 0 VBU0706_CM_single_pct 20 0.0 100.0 /end AXIS_PTS
/begin CHARACTERISTIC CaSOF_SocpDischargeSocMinMapY_pct "" CURVE 0x70001666 Lookup1D_FLOAT32_IEEE 0 VBU0706_CM_single_cnt -3.4028234663852886E+38 3.4028234663852886E+38
 /begin AXIS_DESCR COM_AXIS CTM_tCellTempMin VBU0706_CM_single_cnt 4 -3.4028234663852886E+38 3.4028234663852886E+38 AXIS_PTS_REF CaSOF_SocpDischargeSocMinMapX_C /end AXIS_DESCR
/end CHARACTERISTIC
/begin AXIS_PTS CaSOF_SocpDischargeSocMinMapX_C "" 0x70001656 CTM_tCellTempMin Lookup1D_X_FLOAT32_IEEE 0 VBU0706_CM_single_cnt 4 -3.4028234663852886E+38 3.4028234663852886E+38 /end AXIS_PTS
/begin CHARACTERISTIC CaTHM_FccSohFactorMapY_n "" CURVE 0x7000185e Lookup1D_FLOAT32_IEEE 0 VBU0706_CM_single_cnt 0.0 1.0
 /begin AXIS_DESCR COM_AXIS NO_INPUT_QUANTITY VBU0706_CM_single_cnt 5 0.0 100.0 AXIS_PTS_REF CaTHM_PackSohMapX_pct /end AXIS_DESCR
/end CHARACTERISTIC
/begin AXIS_PTS CaTHM_PackSohMapX_pct "" 0x7000189a NO_INPUT_QUANTITY Lookup1D_X_FLOAT32_IEEE 0 VBU0706_CM_single_cnt 5 0.0 100.0 /end AXIS_PTS
/begin CHARACTERISTIC CaTHM_FccHighSocRequestTempMapZ_C "" MAP 0x70004720 Lookup2D_FLOAT32_IEEE 0 VBU0706_CM_single_cnt -40.0 80.0
 /begin AXIS_DESCR COM_AXIS SOC_pctCellSocMax VBU0706_CM_single_cnt 5 0.0 100.0 AXIS_PTS_REF CaTHM_CellSocMaxMapY_pct /end AXIS_DESCR
 /begin AXIS_DESCR COM_AXIS CTM_tCellTempMax VBU0706_CM_single_cnt 6 -40.0 80.0 AXIS_PTS_REF CaTHM_CellTempMaxMapX_C /end AXIS_DESCR
/end CHARACTERISTIC
/begin AXIS_PTS CaTHM_CellTempMaxMapX_C "" 0x70001a5e CTM_tCellTempMax Lookup2D_X_FLOAT32_IEEE 0 VBU0706_CM_single_cnt 6 -40.0 80.0 /end AXIS_PTS
/begin AXIS_PTS CaTHM_CellSocMaxMapY_pct "" 0x7000184a SOC_pctCellSocMax Lookup2D_X_FLOAT32_IEEE 0 VBU0706_CM_single_cnt 5 0.0 100.0 /end AXIS_PTS
/begin CHARACTERISTIC EDIS_pwrChDynSpare_CUR_v "" CURVE 0x70001aa6 Lookup1D_FLOAT32_IEEE 0 VBU0706_CM_single_cnt -3.4028234663852886E+38 3.4028234663852886E+38
 /begin AXIS_DESCR COM_AXIS EDIS_pwrChLimLTRaw VBU0706_CM_single_cnt 6 -3.4028234663852886E+38 3.4028234663852886E+38 AXIS_PTS_REF EDIS_pwrChDyn_CUR_x /end AXIS_DESCR
/end CHARACTERISTIC
/begin AXIS_PTS EDIS_pwrChDyn_CUR_x "" 0x70001abe EDIS_pwrChLimLTRaw Lookup1D_X_FLOAT32_IEEE 0 VBU0706_CM_single_cnt 6 -3.4028234663852886E+38 3.4028234663852886E+38 /end AXIS_PTS
/begin CHARACTERISTIC THM_pctESSPumpCool_v "" CURVE 0x700018d6 Lookup1D_FLOAT32_IEEE 0 VBU0706_CM_single_cnt -3.4028234663852886E+38 3.4028234663852886E+38
 /begin AXIS_DESCR COM_AXIS NO_INPUT_QUANTITY VBU0706_CM_single_cnt 5 -3.4028234663852886E+38 3.4028234663852886E+38 AXIS_PTS_REF THM_tESSPumpCoolTarDeltaTemp_x /end AXIS_DESCR
/end CHARACTERISTIC
/begin AXIS_PTS THM_tESSPumpCoolTarDeltaTemp_x "" 0x700018ea NO_INPUT_QUANTITY Lookup1D_X_FLOAT32_IEEE 0 VBU0706_CM_single_cnt 5 -3.4028234663852886E+38 3.4028234663852886E+38 /end AXIS_PTS
/begin CHARACTERISTIC THM_facDeltaCellTempESSPump_v "" CURVE 0x70001b36 Lookup1D_FLOAT32_IEEE 0 VBU0706_CM_single_cnt -3.4028234663852886E+38 3.4028234663852886E+38
 /begin AXIS_DESCR COM_AXIS NO_INPUT_QUANTITY VBU0706_CM_single_cnt 6 -3.4028234663852886E+38 3.4028234663852886E+38 AXIS_PTS_REF THM_tDeltaCellTemp_x /end AXIS_DESCR
/end CHARACTERISTIC
/begin AXIS_PTS THM_tDeltaCellTemp_x "" 0x70001bde NO_INPUT_QUANTITY Lookup1D_X_FLOAT32_IEEE 0 VBU0706_CM_single_cnt 6 -3.4028234663852886E+38 3.4028234663852886E+38 /end AXIS_PTS
/begin CHARACTERISTIC THM_facVheSpdRearPump_v "" CURVE 0x700018c2 Lookup1D_FLOAT32_IEEE 0 VBU0706_CM_single_cnt -3.4028234663852886E+38 3.4028234663852886E+38
 /begin AXIS_DESCR COM_AXIS NO_INPUT_QUANTITY VBU0706_CM_single_cnt 5 -3.4028234663852886E+38 3.4028234663852886E+38 AXIS_PTS_REF THM_vVheSpdRearPump_x /end AXIS_DESCR
/end CHARACTERISTIC
/begin AXIS_PTS THM_vVheSpdRearPump_x "" 0x700018fe NO_INPUT_QUANTITY Lookup1D_X_FLOAT32_IEEE 0 VBU0706_CM_single_cnt 5 -3.4028234663852886E+38 3.4028234663852886E+38 /end AXIS_PTS
/begin CHARACTERISTIC THM_pctPEUStrRearPump_v "" CURVE 0x70001bae Lookup1D_FLOAT32_IEEE 0 VBU0706_CM_single_cnt -3.4028234663852886E+38 3.4028234663852886E+38
 /begin AXIS_DESCR COM_AXIS NO_INPUT_QUANTITY VBU0706_CM_single_cnt 6 -3.4028234663852886E+38 3.4028234663852886E+38 AXIS_PTS_REF THM_tPEUMaxStr_x /end AXIS_DESCR
/end CHARACTERISTIC
/begin AXIS_PTS THM_tPEUMaxStr_x "" 0x70001bf6 NO_INPUT_QUANTITY Lookup1D_X_FLOAT32_IEEE 0 VBU0706_CM_single_cnt 6 -3.4028234663852886E+38 3.4028234663852886E+38 /end AXIS_PTS
/begin CHARACTERISTIC THM_pctDCDCRearPump_v "" CURVE 0x70001b4e Lookup1D_FLOAT32_IEEE 0 VBU0706_CM_single_cnt -3.4028234663852886E+38 3.4028234663852886E+38
 /begin AXIS_DESCR COM_AXIS NO_INPUT_QUANTITY VBU0706_CM_single_cnt 6 -3.4028234663852886E+38 3.4028234663852886E+38 AXIS_PTS_REF THM_tDCDC_x /end AXIS_DESCR
/end CHARACTERISTIC
/begin AXIS_PTS THM_tDCDC_x "" 0x70001bc6 NO_INPUT_QUANTITY Lookup1D_X_FLOAT32_IEEE 0 VBU0706_CM_single_cnt 6 -3.4028234663852886E+38 3.4028234663852886E+38 /end AXIS_PTS
/begin CHARACTERISTIC THM_pctPEUPhUVWRearPump_v "" CURVE 0x70001b96 Lookup1D_FLOAT32_IEEE 0 VBU0706_CM_single_cnt -3.4028234663852886E+38 3.4028234663852886E+38
 /begin AXIS_DESCR COM_AXIS NO_INPUT_QUANTITY VBU0706_CM_single_cnt 6 -3.4028234663852886E+38 3.4028234663852886E+38 AXIS_PTS_REF THM_tPEUPhUVW_x /end AXIS_DESCR
/end CHARACTERISTIC
/begin AXIS_PTS THM_tPEUPhUVW_x "" 0x70001c0e NO_INPUT_QUANTITY Lookup1D_X_FLOAT32_IEEE 0 VBU0706_CM_single_cnt 6 -3.4028234663852886E+38 3.4028234663852886E+38 /end AXIS_PTS
/begin CHARACTERISTIC TQD_trqTrqSetNormal_MAP_v "" MAP 0x7000bab0 Lookup2D_FLOAT32_IEEE 0 VBU0706_CM_single_Nm -10000.0 10000.0
 /begin AXIS_DESCR COM_AXIS TQD_vVehSpd VBU0706_CM_single_kph 21 0.0 110.0 AXIS_PTS_REF TQD_vSgndSpd_MAP_y /end AXIS_DESCR
 /begin AXIS_DESCR COM_AXIS TQD_pctAccPedPosFlt VBU0706_CM_single_pct 17 0.0 100.0 AXIS_PTS_REF TQD_pctAccPdl_MAP_x /end AXIS_DESCR
/end CHARACTERISTIC
/begin AXIS_PTS TQD_pctAccPdl_MAP_x "" 0x7000396c TQD_pctAccPedPosFlt Lookup2D_X_FLOAT32_IEEE 0 VBU0706_CM_single_pct 17 0.0 100.0 /end AXIS_PTS
/begin AXIS_PTS TQD_vSgndSpd_MAP_y "" 0x700042e8 TQD_vVehSpd Lookup2D_X_FLOAT32_IEEE 0 VBU0706_CM_single_kph 21 0.0 110.0 /end AXIS_PTS
/begin CHARACTERISTIC TQD_facTrqDesGrR_CUR_v "" CURVE 0x70002282 Lookup1D_FLOAT32_IEEE 0 VBU0706_CM_single_pct 0.0 100.0
 /begin AXIS_DESCR COM_AXIS TQD_vVehSpd VBU0706_CM_single_kph 9 0.0 110.0 AXIS_PTS_REF TQD_vSgndSpdGrFac_CUR_x /end AXIS_DESCR
/end CHARACTERISTIC
/begin AXIS_PTS TQD_vSgndSpdGrFac_CUR_x "" 0x700022a6 TQD_vVehSpd Lookup1D_X_FLOAT32_IEEE 0 VBU0706_CM_single_kph 9 0.0 110.0 /end AXIS_PTS
/begin CHARACTERISTIC TQD_pctCrpOff_CUR_v "" CURVE 0x700039b0 Lookup1D_FLOAT32_IEEE 0 VBU0706_CM_single_pct 0.0 100.0
 /begin AXIS_DESCR COM_AXIS APD_pctAccPedPos VBU0706_CM_single_pct 17 0.0 100.0 AXIS_PTS_REF TQD_pctAccPdl_CUR_x /end AXIS_DESCR
/end CHARACTERISTIC
/begin AXIS_PTS TQD_pctAccPdl_CUR_x "" 0x70003928 APD_pctAccPedPos Lookup1D_X_FLOAT32_IEEE 0 VBU0706_CM_single_pct 17 0.0 100.0 /end AXIS_PTS
/begin CHARACTERISTIC TQD_trqRoad_CUR_v "" CURVE 0x70004240 Lookup1D_FLOAT32_IEEE 0 VBU0706_CM_single_Nm -10000.0 10000.0
 /begin AXIS_DESCR COM_AXIS TQD_vVehSpd VBU0706_CM_single_kph 21 -250.0 250.0 AXIS_PTS_REF TQD_vSgndSpd_CUR_x /end AXIS_DESCR
/end CHARACTERISTIC
/begin AXIS_PTS TQD_vSgndSpd_CUR_x "" 0x70004294 TQD_vVehSpd Lookup1D_X_FLOAT32_IEEE 0 VBU0706_CM_single_kph 21 -250.0 250.0 /end AXIS_PTS
/begin CHARACTERISTIC PMM_tiActvDisCh_C "" VALUE 0x70000f24 Scalar_FLOAT64_IEEE 0 VBU0706_CM_double_cnt -3.4028234663852886E+38 3.4028234663852886E+38 /end CHARACTERISTIC
/begin CHARACTERISTIC BPD_pctBrkPosOverrideVal_C "" VALUE 0x70000294 Scalar_FLOAT32_IEEE 0 VBU0706_CM_single_cnt -3.4028234663852886E+38 3.4028234663852886E+38 /end CHARACTERISTIC
/begin CHARACTERISTIC CcBCV_BdmBatteryBusVoltageMismatchFaultDelta_V "" VALUE 0x700002fc Scalar_FLOAT32_IEEE 0 VBU0706_CM_single_cnt -3.4028234663852886E+38 3.4028234663852886E+38 /end CHARACTERISTIC
/begin CHARACTERISTIC CcBCV_BdmBatteryBusVoltageMismatchFault_V "" VALUE 0x70000300 Scalar_FLOAT32_IEEE 0 VBU0706_CM_single_cnt -3.4028234663852886E+38 3.4028234663852886E+38 /end CHARACTERISTIC
/begin CHARACTERISTIC CcBCV_BdmBatteryCurrentOoR_A "" VALUE 0x70000304 Scalar_FLOAT32_IEEE 0 VBU0706_CM_single_cnt -3.4028234663852886E+38 3.4028234663852886E+38 /end CHARACTERISTIC
/begin CHARACTERISTIC CcBCV_BdmBatteryOverCurrent_A "" VALUE 0x70000308 Scalar_FLOAT32_IEEE 0 VBU0706_CM_single_cnt -3.4028234663852886E+38 3.4028234663852886E+38 /end CHARACTERISTIC
/begin CHARACTERISTIC CcBCV_BdmBatteryOverVoltage_V "" VALUE 0x7000030c Scalar_FLOAT32_IEEE 0 VBU0706_CM_single_cnt -3.4028234663852886E+38 3.4028234663852886E+38 /end CHARACTERISTIC
/begin CHARACTERISTIC CcBCV_BdmBatteryUnderVoltage1_V "" VALUE 0x70000310 Scalar_FLOAT32_IEEE 0 VBU0706_CM_single_cnt -3.4028234663852886E+38 3.4028234663852886E+38 /end CHARACTERISTIC
/begin CHARACTERISTIC CcBCV_BdmBatteryUnderVoltage2_V "" VALUE 0x70000314 Scalar_FLOAT32_IEEE 0 VBU0706_CM_single_cnt -3.4028234663852886E+38 3.4028234663852886E+38 /end CHARACTERISTIC
/begin CHARACTERISTIC CcBCV_BdmBatteryUnderVoltageTemp_C "" VALUE 0x70000318 Scalar_FLOAT32_IEEE 0 VBU0706_CM_single_cnt -3.4028234663852886E+38 3.4028234663852886E+38 /end CHARACTERISTIC
/begin CHARACTERISTIC CcBCV_BdmBatteryVoltageOoRHigh_V "" VALUE 0x7000031c Scalar_FLOAT32_IEEE 0 VBU0706_CM_single_cnt -3.4028234663852886E+38 3.4028234663852886E+38 /end CHARACTERISTIC
/begin CHARACTERISTIC CcBCV_BdmBatteryVoltageOoRLow_V "" VALUE 0x70000320 Scalar_FLOAT32_IEEE 0 VBU0706_CM_single_cnt -3.4028234663852886E+38 3.4028234663852886E+38 /end CHARACTERISTIC
/begin CHARACTERISTIC CcCTD_MNCStuckOpenCurrentMax_A "" VALUE 0x700003d8 Scalar_FLOAT32_IEEE 0 VBU0706_CM_single_cnt -3.4028234663852886E+38 3.4028234663852886E+38 /end CHARACTERISTIC
/begin CHARACTERISTIC CcCTD_MaxJouleHeat_J "" VALUE 0x700003e4 Scalar_FLOAT32_IEEE 0 VBU0706_CM_single_cnt -3.4028234663852886E+38 3.4028234663852886E+38 /end CHARACTERISTIC
/begin CHARACTERISTIC CcCTD_MinHeatDissipation_J "" VALUE 0x700003ec Scalar_FLOAT32_IEEE 0 VBU0706_CM_single_cnt -3.4028234663852886E+38 3.4028234663852886E+38 /end CHARACTERISTIC
/begin CHARACTERISTIC CcCTD_MnNegContactorOpenDeltaVoltage_V "" VALUE 0x700003f4 Scalar_FLOAT32_IEEE 0 VBU0706_CM_single_cnt -3.4028234663852886E+38 3.4028234663852886E+38 /end CHARACTERISTIC
/begin CHARACTERISTIC CcCTD_MnPosContactorOpenDeltaVoltage_V "" VALUE 0x700003fc Scalar_FLOAT32_IEEE 0 VBU0706_CM_single_cnt -3.4028234663852886E+38 3.4028234663852886E+38 /end CHARACTERISTIC
/begin CHARACTERISTIC CcCTD_OnePrechargeHeat_J "" VALUE 0x70000400 Scalar_FLOAT32_IEEE 0 VBU0706_CM_single_cnt -3.4028234663852886E+38 3.4028234663852886E+38 /end CHARACTERISTIC
/begin CHARACTERISTIC CcCTD_PrechargeOverEnergy_J "" VALUE 0x70000414 Scalar_FLOAT32_IEEE 0 VBU0706_CM_single_cnt -3.4028234663852886E+38 3.4028234663852886E+38 /end CHARACTERISTIC
/begin CHARACTERISTIC CcCTD_PrechargeResistance_ohm "" VALUE 0x70000420 Scalar_FLOAT32_IEEE 0 VBU0706_CM_single_cnt -3.4028234663852886E+38 3.4028234663852886E+38 /end CHARACTERISTIC
/begin CHARACTERISTIC CcCTD_RnMNCStuckOpenCurrentMax_A "" VALUE 0x7000042c Scalar_FLOAT32_IEEE 0 VBU0706_CM_single_cnt -3.4028234663852886E+38 3.4028234663852886E+38 /end CHARACTERISTIC
/begin CHARACTERISTIC CcCTD_RnMnNegContactorOpenDeltaVoltage_V "" VALUE 0x70000430 Scalar_FLOAT32_IEEE 0 VBU0706_CM_single_cnt -3.4028234663852886E+38 3.4028234663852886E+38 /end CHARACTERISTIC
/begin CHARACTERISTIC CcCTD_RnMnPosContactorOpenDeltaVoltage_V "" VALUE 0x70000434 Scalar_FLOAT32_IEEE 0 VBU0706_CM_single_cnt -3.4028234663852886E+38 3.4028234663852886E+38 /end CHARACTERISTIC
/begin CHARACTERISTIC CcCTM_CellThermalRunawayRatePerSecond_C "" VALUE 0x70000460 Scalar_FLOAT32_IEEE 0 VBU0706_CM_single_cnt -3.4028234663852886E+38 3.4028234663852886E+38 /end CHARACTERISTIC
/begin CHARACTERISTIC CcSOC_BatteryDisplaySocUpdateDelta_pct "" VALUE 0x700005a8 Scalar_FLOAT32_IEEE 0 VBU0706_CM_single_cnt -3.4028234663852886E+38 3.4028234663852886E+38 /end CHARACTERISTIC
/begin CHARACTERISTIC CcSOC_BatterySOCOvrdVal_pct "" VALUE 0x700005b4 Scalar_FLOAT32_IEEE 0 VBU0706_CM_single_cnt -3.4028234663852886E+38 3.4028234663852886E+38 /end CHARACTERISTIC
/begin CHARACTERISTIC CcSOC_BatterySocUpdateDelta_pct "" VALUE 0x700005c8 Scalar_FLOAT32_IEEE 0 VBU0706_CM_single_cnt -3.4028234663852886E+38 3.4028234663852886E+38 /end CHARACTERISTIC
/begin CHARACTERISTIC CcSOC_CCCorrectionDisableTem_C "" VALUE 0x700005f0 Scalar_FLOAT32_IEEE 0 VBU0706_CM_single_cnt -3.4028234663852886E+38 3.4028234663852886E+38 /end CHARACTERISTIC
/begin CHARACTERISTIC CcSOC_CCCorrectionEnableTem_C "" VALUE 0x700005f4 Scalar_FLOAT32_IEEE 0 VBU0706_CM_single_cnt -3.4028234663852886E+38 3.4028234663852886E+38 /end CHARACTERISTIC
/begin CHARACTERISTIC CcSOC_CellSocDefault_pct "" VALUE 0x70000604 Scalar_FLOAT32_IEEE 0 VBU0706_CM_single_cnt -3.4028234663852886E+38 3.4028234663852886E+38 /end CHARACTERISTIC
/begin CHARACTERISTIC CcSOC_CellSocMaxOverrunLimit_pct "" VALUE 0x7000060c Scalar_FLOAT32_IEEE 0 VBU0706_CM_single_cnt -3.4028234663852886E+38 3.4028234663852886E+38 /end CHARACTERISTIC
/begin CHARACTERISTIC CcSOC_CellSocMinOverrunLimit_pct "" VALUE 0x70000610 Scalar_FLOAT32_IEEE 0 VBU0706_CM_single_cnt -3.4028234663852886E+38 3.4028234663852886E+38 /end CHARACTERISTIC
/begin CHARACTERISTIC CcSOC_FastChargeTOCCurrentThld_A "" VALUE 0x70000628 Scalar_FLOAT32_IEEE 0 VBU0706_CM_single_cnt -3.4028234663852886E+38 3.4028234663852886E+38 /end CHARACTERISTIC
/begin CHARACTERISTIC CcSOC_FastChargeTOCVoltageThld_mV "" VALUE 0x70000634 Scalar_FLOAT32_IEEE 0 VBU0706_CM_single_cnt -3.4028234663852886E+38 3.4028234663852886E+38 /end CHARACTERISTIC
/begin CHARACTERISTIC CcSOC_MaxAllowSOCDeviation_pct "" VALUE 0x70000640 Scalar_FLOAT32_IEEE 0 VBU0706_CM_single_cnt -3.4028234663852886E+38 3.4028234663852886E+38 /end CHARACTERISTIC
/begin CHARACTERISTIC CcSOC_NoJumpSocChargeRate_pct "" VALUE 0x70000654 Scalar_FLOAT32_IEEE 0 VBU0706_CM_single_cnt -3.4028234663852886E+38 3.4028234663852886E+38 /end CHARACTERISTIC
/begin CHARACTERISTIC CcSOC_OcvCorrectionTempThld_C "" VALUE 0x70000658 Scalar_FLOAT32_IEEE 0 VBU0706_CM_single_cnt -3.4028234663852886E+38 3.4028234663852886E+38 /end CHARACTERISTIC
/begin CHARACTERISTIC CcSOC_SocLowValue_pct "" VALUE 0x70000668 Scalar_FLOAT32_IEEE 0 VBU0706_CM_single_cnt -3.4028234663852886E+38 3.4028234663852886E+38 /end CHARACTERISTIC
/begin CHARACTERISTIC CcSOE_CellEnergyBoL_Kwh "" VALUE 0x70000670 Scalar_FLOAT32_IEEE 0 VBU0706_CM_single_cnt -3.4028234663852886E+38 3.4028234663852886E+38 /end CHARACTERISTIC
/begin CHARACTERISTIC CcSOE_CellSocDelta_pct "" VALUE 0x70000674 Scalar_FLOAT32_IEEE 0 VBU0706_CM_single_cnt -3.4028234663852886E+38 3.4028234663852886E+38 /end CHARACTERISTIC
/begin CHARACTERISTIC CcSOE_CellSocEndPredictUpperLimit_pct "" VALUE 0x70000678 Scalar_FLOAT32_IEEE 0 VBU0706_CM_single_cnt -3.4028234663852886E+38 3.4028234663852886E+38 /end CHARACTERISTIC
/begin CHARACTERISTIC CcSOE_HistoryAveCurrentTimeIntervalNumber_n "" VALUE 0x7000068c Scalar_FLOAT32_IEEE 0 VBU0706_CM_single_cnt -3.4028234663852886E+38 3.4028234663852886E+38 /end CHARACTERISTIC
/begin CHARACTERISTIC CcSOE_HistoryAveCurrentTotalTime_s "" VALUE 0x70000690 Scalar_FLOAT32_IEEE 0 VBU0706_CM_single_cnt -3.4028234663852886E+38 3.4028234663852886E+38 /end CHARACTERISTIC
/begin CHARACTERISTIC CcSOF_DischargeOCVInLowSOCforPowerLimit_V "" VALUE 0x70000724 Scalar_FLOAT32_IEEE 0 VBU0706_CM_single_cnt -3.4028234663852886E+38 3.4028234663852886E+38 /end CHARACTERISTIC
/begin CHARACTERISTIC CcSOF_SOCLowValueForConstantOCV_pct "" VALUE 0x700007cc Scalar_FLOAT32_IEEE 0 VBU0706_CM_single_cnt -3.4028234663852886E+38 3.4028234663852886E+38 /end CHARACTERISTIC
/begin CHARACTERISTIC CcSOH_CellCapacityOverDeviationFault_Ah "" VALUE 0x70000840 Scalar_FLOAT32_IEEE 0 VBU0706_CM_single_cnt -3.4028234663852886E+38 3.4028234663852886E+38 /end CHARACTERISTIC
/begin CHARACTERISTIC CcSOH_FastChargeFactor_n "" VALUE 0x70000868 Scalar_FLOAT32_IEEE 0 VBU0706_CM_single_cnt -3.4028234663852886E+38 3.4028234663852886E+38 /end CHARACTERISTIC
/begin CHARACTERISTIC CcSOH_NotCalculatedSoh_pct "" VALUE 0x70000884 Scalar_FLOAT32_IEEE 0 VBU0706_CM_single_cnt -3.4028234663852886E+38 3.4028234663852886E+38 /end CHARACTERISTIC
/begin CHARACTERISTIC CcSOH_ResistanceBase_mohm "" VALUE 0x7000088c Scalar_FLOAT32_IEEE 0 VBU0706_CM_single_cnt -3.4028234663852886E+38 3.4028234663852886E+38 /end CHARACTERISTIC
/begin CHARACTERISTIC CcTHM_ChargeTempRequestHighThreshold_C "" VALUE 0x700008c8 Scalar_FLOAT32_IEEE 0 VBU0706_CM_single_cnt -3.4028234663852886E+38 3.4028234663852886E+38 /end CHARACTERISTIC
/begin CHARACTERISTIC CcTHM_FccChargeTempRequestLowThreshold_C "" VALUE 0x700008e8 Scalar_FLOAT32_IEEE 0 VBU0706_CM_single_cnt -3.4028234663852886E+38 3.4028234663852886E+38 /end CHARACTERISTIC
/begin CHARACTERISTIC CcTHM_FccSohTempLowThreshold_C "" VALUE 0x700008f0 Scalar_FLOAT32_IEEE 0 VBU0706_CM_single_cnt -3.4028234663852886E+38 3.4028234663852886E+38 /end CHARACTERISTIC
/begin CHARACTERISTIC CcTHM_InvaildTempRequest_C "" VALUE 0x700008fc Scalar_FLOAT32_IEEE 0 VBU0706_CM_single_cnt -3.4028234663852886E+38 3.4028234663852886E+38 /end CHARACTERISTIC
/begin CHARACTERISTIC CcTHM_PackSohORV_pct "" VALUE 0x70000918 Scalar_FLOAT32_IEEE 0 VBU0706_CM_single_cnt -3.4028234663852886E+38 3.4028234663852886E+38 /end CHARACTERISTIC
/begin CHARACTERISTIC CcVCT_BMSCellTempStandardDeviationORV_C "" VALUE 0x7000091c Scalar_FLOAT32_IEEE 0 VBU0706_CM_single_cnt -3.4028234663852886E+38 3.4028234663852886E+38 /end CHARACTERISTIC
/begin CHARACTERISTIC CcVCT_BMSCellVoltageAveORV_V "" VALUE 0x70000920 Scalar_FLOAT32_IEEE 0 VBU0706_CM_single_V -3.4028234663852886E+38 3.4028234663852886E+38 /end CHARACTERISTIC
/begin CHARACTERISTIC CcVCT_BMSCellVoltageMaxORV_V "" VALUE 0x70000924 Scalar_FLOAT32_IEEE 0 VBU0706_CM_single_V -3.4028234663852886E+38 3.4028234663852886E+38 /end CHARACTERISTIC
/begin CHARACTERISTIC CcVCT_BMSCellVoltageMinORV_V "" VALUE 0x70000928 Scalar_FLOAT32_IEEE 0 VBU0706_CM_single_V -3.4028234663852886E+38 3.4028234663852886E+38 /end CHARACTERISTIC
/begin CHARACTERISTIC CcVCT_BMSChgPowerLimitDynamicORV_Kw "" VALUE 0x7000092c Scalar_FLOAT32_IEEE 0 VBU0706_CM_single_Kw -3.4028234663852886E+38 3.4028234663852886E+38 /end CHARACTERISTIC
/begin CHARACTERISTIC CcVCT_BMSChgPowerLimitLTORV_Kw "" VALUE 0x70000930 Scalar_FLOAT32_IEEE 0 VBU0706_CM_single_Kw -3.4028234663852886E+38 3.4028234663852886E+38 /end CHARACTERISTIC
/begin CHARACTERISTIC CcVCT_BMSChgPowerLimitSTORV_Kw "" VALUE 0x70000934 Scalar_FLOAT32_IEEE 0 VBU0706_CM_single_Kw -3.4028234663852886E+38 3.4028234663852886E+38 /end CHARACTERISTIC
/begin CHARACTERISTIC CcVCT_BMSCustomerUsageSOCORV_pct "" VALUE 0x70000938 Scalar_FLOAT32_IEEE 0 VBU0706_CM_single_pct -3.4028234663852886E+38 3.4028234663852886E+38 /end CHARACTERISTIC
/begin CHARACTERISTIC CcVCT_BMSDCChrgFinalSOCORV_pct "" VALUE 0x7000093c Scalar_FLOAT32_IEEE 0 VBU0706_CM_single_pct -3.4028234663852886E+38 3.4028234663852886E+38 /end CHARACTERISTIC
/begin CHARACTERISTIC CcVCT_BMSDischgPowerLimitDynamicORV_Kw "" VALUE 0x70000940 Scalar_FLOAT32_IEEE 0 VBU0706_CM_single_Kw -3.4028234663852886E+38 3.4028234663852886E+38 /end CHARACTERISTIC
/begin CHARACTERISTIC CcVCT_BMSDischgPowerLimitLTIORV_Kw "" VALUE 0x70000944 Scalar_FLOAT32_IEEE 0 VBU0706_CM_single_Kw -3.4028234663852886E+38 3.4028234663852886E+38 /end CHARACTERISTIC
/begin CHARACTERISTIC CcVCT_BMSDischgPowerLimitSTORV_Kw "" VALUE 0x70000948 Scalar_FLOAT32_IEEE 0 VBU0706_CM_single_Kw -3.4028234663852886E+38 3.4028234663852886E+38 /end CHARACTERISTIC
/begin CHARACTERISTIC CcVCT_BMSEstimateChargingTimeORV_min "" VALUE 0x7000094c Scalar_FLOAT32_IEEE 0 VBU0706_CM_single_min -3.4028234663852886E+38 3.4028234663852886E+38 /end CHARACTERISTIC
/begin CHARACTERISTIC CcVCT_BMSInletTempRequestORV_C "" VALUE 0x70000950 Scalar_FLOAT32_IEEE 0 VBU0706_CM_single_cnt -3.4028234663852886E+38 3.4028234663852886E+38 /end CHARACTERISTIC
/begin CHARACTERISTIC CcVCT_BMSInletWaterTempORV_C "" VALUE 0x70000954 Scalar_FLOAT32_IEEE 0 VBU0706_CM_single_cnt -3.4028234663852886E+38 3.4028234663852886E+38 /end CHARACTERISTIC
/begin CHARACTERISTIC CcVCT_BMSInsulationResistanceValueORV_Kohm "" VALUE 0x70000958 Scalar_FLOAT32_IEEE 0 VBU0706_CM_single_Kohm -3.4028234663852886E+38 3.4028234663852886E+38 /end CHARACTERISTIC
/begin CHARACTERISTIC CcVCT_BMSMaximumCellTempORV_C "" VALUE 0x7000095c Scalar_FLOAT32_IEEE 0 VBU0706_CM_single_cnt -3.4028234663852886E+38 3.4028234663852886E+38 /end CHARACTERISTIC
/begin CHARACTERISTIC CcVCT_BMSMinimumCellTempORV_C "" VALUE 0x70000960 Scalar_FLOAT32_IEEE 0 VBU0706_CM_single_cnt -3.4028234663852886E+38 3.4028234663852886E+38 /end CHARACTERISTIC
/begin CHARACTERISTIC CcVCT_BMSOutletWaterTempORV_C "" VALUE 0x70000964 Scalar_FLOAT32_IEEE 0 VBU0706_CM_single_cnt -3.4028234663852886E+38 3.4028234663852886E+38 /end CHARACTERISTIC
/begin CHARACTERISTIC CcVCT_BMSPackCrntORV_A "" VALUE 0x70000968 Scalar_FLOAT32_IEEE 0 VBU0706_CM_single_A -3.4028234663852886E+38 3.4028234663852886E+38 /end CHARACTERISTIC
/begin CHARACTERISTIC CcVCT_BMSPackEnergyAvailableORV_Kwh "" VALUE 0x7000096c Scalar_FLOAT32_IEEE 0 VBU0706_CM_single_Kwh -3.4028234663852886E+38 3.4028234663852886E+38 /end CHARACTERISTIC
/begin CHARACTERISTIC CcVCT_BMSPackVoltageORV_V "" VALUE 0x70000970 Scalar_FLOAT32_IEEE 0 VBU0706_CM_single_V -3.4028234663852886E+38 3.4028234663852886E+38 /end CHARACTERISTIC
/begin CHARACTERISTIC CcVCT_BMSSOCORV_pct "" VALUE 0x70000974 Scalar_FLOAT32_IEEE 0 VBU0706_CM_single_pct -3.4028234663852886E+38 3.4028234663852886E+38 /end CHARACTERISTIC
/begin CHARACTERISTIC CcVCT_BMSTemperatureAverageORV_C "" VALUE 0x70000978 Scalar_FLOAT32_IEEE 0 VBU0706_CM_single_cnt -3.4028234663852886E+38 3.4028234663852886E+38 /end CHARACTERISTIC
/begin CHARACTERISTIC CcVCT_BMSTemperatureMaxORV_C "" VALUE 0x7000097c Scalar_FLOAT32_IEEE 0 VBU0706_CM_single_cnt -3.4028234663852886E+38 3.4028234663852886E+38 /end CHARACTERISTIC
/begin CHARACTERISTIC CcVCT_BMSTemperatureMinORF_flg "" VALUE 0x70000980 Scalar_FLOAT32_IEEE 0 VBU0706_CM_single_flg -3.4028234663852886E+38 3.4028234663852886E+38 /end CHARACTERISTIC
/begin CHARACTERISTIC CcVCT_BMSTemperatureMinORV_C "" VALUE 0x70000984 Scalar_FLOAT32_IEEE 0 VBU0706_CM_single_cnt -3.4028234663852886E+38 3.4028234663852886E+38 /end CHARACTERISTIC
/begin CHARACTERISTIC CcVCT_EstimatePercTimeORV_min "" VALUE 0x7000098c Scalar_FLOAT32_IEEE 0 VBU0706_CM_single_min -3.4028234663852886E+38 3.4028234663852886E+38 /end CHARACTERISTIC
/begin CHARACTERISTIC DCH_tiAPlusVldDly_C "" VALUE 0x70000a8c Scalar_FLOAT32_IEEE 0 VBU0706_CM_single_cnt -3.4028234663852886E+38 3.4028234663852886E+38 /end CHARACTERISTIC
/begin CHARACTERISTIC DCH_tiAplusConfirmT_C "" VALUE 0x70000a90 Scalar_FLOAT32_IEEE 0 VBU0706_CM_single_cnt -3.4028234663852886E+38 3.4028234663852886E+38 /end CHARACTERISTIC
/begin CHARACTERISTIC DCH_tiBMSChAvlDly_C "" VALUE 0x70000aa0 Scalar_FLOAT32_IEEE 0 VBU0706_CM_single_cnt -3.4028234663852886E+38 3.4028234663852886E+38 /end CHARACTERISTIC
/begin CHARACTERISTIC DCH_tiBMSChAvlTrnOffDly_C "" VALUE 0x70000aa4 Scalar_FLOAT32_IEEE 0 VBU0706_CM_single_cnt -3.4028234663852886E+38 3.4028234663852886E+38 /end CHARACTERISTIC
/begin CHARACTERISTIC DCH_tiCC2ConfirmT_C "" VALUE 0x70000aa8 Scalar_FLOAT32_IEEE 0 VBU0706_CM_single_cnt -3.4028234663852886E+38 3.4028234663852886E+38 /end CHARACTERISTIC
/begin CHARACTERISTIC DCH_tiDCChRlyTurnOffConfrmDly_C "" VALUE 0x70000ae4 Scalar_FLOAT32_IEEE 0 VBU0706_CM_single_cnt -3.4028234663852886E+38 3.4028234663852886E+38 /end CHARACTERISTIC
/begin CHARACTERISTIC DCH_uDCRlyClosedJudged_C "" VALUE 0x70000b3c Scalar_FLOAT32_IEEE 0 VBU0706_CM_single_cnt -3.4028234663852886E+38 3.4028234663852886E+38 /end CHARACTERISTIC
/begin CHARACTERISTIC DCH_uMaxCCToConn_C "" VALUE 0x70000b44 Scalar_FLOAT32_IEEE 0 VBU0706_CM_single_cnt -3.4028234663852886E+38 3.4028234663852886E+38 /end CHARACTERISTIC
/begin CHARACTERISTIC DCH_uMinCCToConn_C "" VALUE 0x70000b48 Scalar_FLOAT32_IEEE 0 VBU0706_CM_single_cnt -3.4028234663852886E+38 3.4028234663852886E+38 /end CHARACTERISTIC
/begin CHARACTERISTIC DCH_vMaxSpdLim_C "" VALUE 0x70000b4c Scalar_FLOAT32_IEEE 0 VBU0706_CM_single_cnt -3.4028234663852886E+38 3.4028234663852886E+38 /end CHARACTERISTIC
/begin CHARACTERISTIC DCH_vMinSpdLim_C "" VALUE 0x70000b50 Scalar_FLOAT32_IEEE 0 VBU0706_CM_single_cnt -3.4028234663852886E+38 3.4028234663852886E+38 /end CHARACTERISTIC
/begin CHARACTERISTIC EDIS_pwrDrvRstn_C "" VALUE 0x70000cc4 Scalar_FLOAT32_IEEE 0 VBU0706_CM_single_cnt 0.0 1.0E+23 /end CHARACTERISTIC
/begin CHARACTERISTIC PMM_tiDCDCDisbl_C "" VALUE 0x70000f2c Scalar_FLOAT32_IEEE 0 VBU0706_CM_single_cnt -3.4028234663852886E+38 3.4028234663852886E+38 /end CHARACTERISTIC
/begin CHARACTERISTIC PMM_tiDlyInitRst_C "" VALUE 0x70000f40 Scalar_FLOAT32_IEEE 0 VBU0706_CM_single_cnt -3.4028234663852886E+38 3.4028234663852886E+38 /end CHARACTERISTIC
/begin CHARACTERISTIC PMM_tiHVRlyOpenReq_C "" VALUE 0x70000f6c Scalar_FLOAT32_IEEE 0 VBU0706_CM_single_cnt -3.4028234663852886E+38 3.4028234663852886E+38 /end CHARACTERISTIC
/begin CHARACTERISTIC PMM_tiHVRlyT_C "" VALUE 0x70000f70 Scalar_FLOAT32_IEEE 0 VBU0706_CM_single_cnt -3.4028234663852886E+38 3.4028234663852886E+38 /end CHARACTERISTIC
/begin CHARACTERISTIC PMM_tiRstKeep_C "" VALUE 0x70000f7c Scalar_FLOAT32_IEEE 0 VBU0706_CM_single_cnt -3.4028234663852886E+38 3.4028234663852886E+38 /end CHARACTERISTIC
/begin CHARACTERISTIC PMM_tiSmplT_SY "" VALUE 0x70000f80 Scalar_FLOAT32_IEEE 0 VBU0706_CM_single_cnt -3.4028234663852886E+38 3.4028234663852886E+38 /end CHARACTERISTIC
/begin CHARACTERISTIC PTC_PwrMax_C "" VALUE 0x70000f90 Scalar_FLOAT32_IEEE 0 VBU0706_CM_single_cnt 0.0 1.0E+23 /end CHARACTERISTIC
/begin CHARACTERISTIC SPD_nRPM4Backward "" VALUE 0x70000fb8 Scalar_FLOAT32_IEEE 0 VBU0706_CM_single -3.4E+38 3.4E+38 /end CHARACTERISTIC
/begin CHARACTERISTIC SPD_nRPM4Forward "" VALUE 0x70000fbc Scalar_FLOAT32_IEEE 0 VBU0706_CM_single -3.4E+38 3.4E+38 /end CHARACTERISTIC
/begin CHARACTERISTIC SPD_tiAxUpdate2_C "" VALUE 0x70000fc0 Scalar_FLOAT32_IEEE 0 VBU0706_CM_single_cnt -3.4028234663852886E+38 3.4028234663852886E+38 /end CHARACTERISTIC
/begin CHARACTERISTIC SPD_tiAxUpdate_C "" VALUE 0x70000fc4 Scalar_FLOAT32_IEEE 0 VBU0706_CM_single_cnt -3.4028234663852886E+38 3.4028234663852886E+38 /end CHARACTERISTIC
/begin CHARACTERISTIC SYS_facRPM2KPH_SY "" VALUE 0x70000ff4 Scalar_FLOAT32_IEEE 0 VBU0706_CM_single_cnt -3.4028234663852886E+38 3.4028234663852886E+38 /end CHARACTERISTIC
/begin CHARACTERISTIC THM_pctESSPmpDecGrad_C "" VALUE 0x7000103c Scalar_FLOAT32_IEEE 0 VBU0706_CM_single_cnt -3.4028234663852886E+38 3.4028234663852886E+38 /end CHARACTERISTIC
/begin CHARACTERISTIC THM_pctESSPmpIncGrad_C "" VALUE 0x70001040 Scalar_FLOAT32_IEEE 0 VBU0706_CM_single_cnt -3.4028234663852886E+38 3.4028234663852886E+38 /end CHARACTERISTIC
/begin CHARACTERISTIC THM_pctESSPumpDftCmd_C "" VALUE 0x70001044 Scalar_FLOAT32_IEEE 0 VBU0706_CM_single_cnt -3.4028234663852886E+38 3.4028234663852886E+38 /end CHARACTERISTIC
/begin CHARACTERISTIC THM_pctRearPmpDecGrad_C "" VALUE 0x70001070 Scalar_FLOAT32_IEEE 0 VBU0706_CM_single_cnt -3.4028234663852886E+38 3.4028234663852886E+38 /end CHARACTERISTIC
/begin CHARACTERISTIC THM_pctRearPmpIncGrad_C "" VALUE 0x70001074 Scalar_FLOAT32_IEEE 0 VBU0706_CM_single_cnt -3.4028234663852886E+38 3.4028234663852886E+38 /end CHARACTERISTIC
/begin CHARACTERISTIC THM_ptcActvThemalMaxESSPump_C "" VALUE 0x7000107c Scalar_FLOAT32_IEEE 0 VBU0706_CM_single_cnt -3.4028234663852886E+38 3.4028234663852886E+38 /end CHARACTERISTIC
/begin CHARACTERISTIC THM_tCoolDeltaMaxTemp_C "" VALUE 0x70001098 Scalar_FLOAT32_IEEE 0 VBU0706_CM_single_cnt -3.4028234663852886E+38 3.4028234663852886E+38 /end CHARACTERISTIC
/begin CHARACTERISTIC THM_tCoolDeltaMinTemp_C "" VALUE 0x7000109c Scalar_FLOAT32_IEEE 0 VBU0706_CM_single_cnt -3.4028234663852886E+38 3.4028234663852886E+38 /end CHARACTERISTIC
/begin CHARACTERISTIC THM_tCoolFrstDeltaMaxTemp_C "" VALUE 0x700010a0 Scalar_FLOAT32_IEEE 0 VBU0706_CM_single_cnt -3.4028234663852886E+38 3.4028234663852886E+38 /end CHARACTERISTIC
/begin CHARACTERISTIC THM_tDCChCoolTar_C "" VALUE 0x700010a4 Scalar_FLOAT32_IEEE 0 VBU0706_CM_single_cnt -3.4028234663852886E+38 3.4028234663852886E+38 /end CHARACTERISTIC
/begin CHARACTERISTIC THM_tDCChHeatTar_C "" VALUE 0x700010a8 Scalar_FLOAT32_IEEE 0 VBU0706_CM_single_cnt -3.4028234663852886E+38 3.4028234663852886E+38 /end CHARACTERISTIC
/begin CHARACTERISTIC THM_tDrvCoolTar_C "" VALUE 0x700010ac Scalar_FLOAT32_IEEE 0 VBU0706_CM_single_cnt -3.4028234663852886E+38 3.4028234663852886E+38 /end CHARACTERISTIC
/begin CHARACTERISTIC THM_tDrvHeatTar_C "" VALUE 0x700010b0 Scalar_FLOAT32_IEEE 0 VBU0706_CM_single_cnt -3.4028234663852886E+38 3.4028234663852886E+38 /end CHARACTERISTIC
/begin CHARACTERISTIC THM_tHeatDeltaMaxTemp_C "" VALUE 0x700010b4 Scalar_FLOAT32_IEEE 0 VBU0706_CM_single_cnt -3.4028234663852886E+38 3.4028234663852886E+38 /end CHARACTERISTIC
/begin CHARACTERISTIC THM_tHeatDeltaMinTemp_C "" VALUE 0x700010b8 Scalar_FLOAT32_IEEE 0 VBU0706_CM_single_cnt -3.4028234663852886E+38 3.4028234663852886E+38 /end CHARACTERISTIC
/begin CHARACTERISTIC TQCMP_trqLowSpdRA "" VALUE 0x70001104 Scalar_FLOAT32_IEEE 0 VBU0706_CM_single_cnt -3.4028234663852886E+38 3.4028234663852886E+38 /end CHARACTERISTIC
/begin CHARACTERISTIC TQD_facBrkPressFilt_C "" VALUE 0x700012a4 Scalar_FLOAT32_IEEE 0 VBU0706_CM_single_cnt -3.4028234663852886E+38 3.4028234663852886E+38 /end CHARACTERISTIC
/begin CHARACTERISTIC TQD_facVehSpdFlt_C "" VALUE 0x700012a8 Scalar_FLOAT32_IEEE 0 VBU0706_CM_single_cnt -3.4028234663852886E+38 3.4028234663852886E+38 /end CHARACTERISTIC
/begin CHARACTERISTIC TQD_facVehSpdHys_C "" VALUE 0x700012ac Scalar_FLOAT32_IEEE 0 VBU0706_CM_single_cnt -3.4028234663852886E+38 3.4028234663852886E+38 /end CHARACTERISTIC
/begin CHARACTERISTIC TQD_pctAccPedalDeadband_C "" VALUE 0x700012b0 Scalar_FLOAT32_IEEE 0 VBU0706_CM_single_cnt -3.4028234663852886E+38 3.4028234663852886E+38 /end CHARACTERISTIC
/begin CHARACTERISTIC TQD_pctVehSlideRes_C "" VALUE 0x700012b4 Scalar_FLOAT32_IEEE 0 VBU0706_CM_single_cnt -3.4028234663852886E+38 3.4028234663852886E+38 /end CHARACTERISTIC
/begin CHARACTERISTIC TQD_vVehSlideEna_C "" VALUE 0x700012cc Scalar_FLOAT32_IEEE 0 VBU0706_CM_single_cnt -3.4028234663852886E+38 3.4028234663852886E+38 /end CHARACTERISTIC
/begin CHARACTERISTIC TQD_vVehSlideRes_C "" VALUE 0x700012d0 Scalar_FLOAT32_IEEE 0 VBU0706_CM_single_cnt -3.4028234663852886E+38 3.4028234663852886E+38 /end CHARACTERISTIC
/begin CHARACTERISTIC CaSOC_OcvSocMapDimension_n "" VAL_BLK 0x700013ee Scalar_ULONG 0 VBU0706_CM_uint32_cnt 0.0 4.294967295E+9 NUMBER 2 /end CHARACTERISTIC
/begin CHARACTERISTIC CcSOC_BatteryPolarizationMaxTime_ms "" VALUE 0x700005b0 Scalar_ULONG 0 VBU0706_CM_uint32_cnt 0.0 4.294967295E+9 /end CHARACTERISTIC
/begin CHARACTERISTIC CcSOC_CellSOCStorageTime_ms "" VALUE 0x70000600 Scalar_ULONG 0 VBU0706_CM_uint32_cnt 0.0 4.294967295E+9 /end CHARACTERISTIC
/begin CHARACTERISTIC CcSOC_FastChargeTOCCurrentTime_ms "" VALUE 0x7000062c Scalar_ULONG 0 VBU0706_CM_uint32_cnt 0.0 4.294967295E+9 /end CHARACTERISTIC
/begin CHARACTERISTIC CcSOC_FastChargeTOCVoltageTime_ms "" VALUE 0x70000638 Scalar_ULONG 0 VBU0706_CM_uint32_cnt 0.0 4.294967295E+9 /end CHARACTERISTIC
/begin CHARACTERISTIC CcSOF_BatteryCycleLevel1_n "" VALUE 0x700006a0 Scalar_ULONG 0 VBU0706_CM_uint32_cnt 0.0 4.294967295E+9 /end CHARACTERISTIC
/begin CHARACTERISTIC CcSOF_BatteryCycleLevel2_n "" VALUE 0x700006a4 Scalar_ULONG 0 VBU0706_CM_uint32_cnt 0.0 4.294967295E+9 /end CHARACTERISTIC
/begin CHARACTERISTIC CcSOH_CellResistanceIncRatioUpdateTime_s "" VALUE 0x70000844 Scalar_ULONG 0 VBU0706_CM_uint32_cnt 0.0 4.294967295E+9 /end CHARACTERISTIC
/begin CHARACTERISTIC CcSOC_CorrectionEnableCellVoltageDeviation_mV "" VALUE 0x7000009c Scalar_UWORD 0 VBU0706_CM_uint16_cnt 0.0 65535.0 /end CHARACTERISTIC
/begin CHARACTERISTIC CcSOC_OcvCorrectionCVLowThld_mV "" VALUE 0x700000a4 Scalar_UWORD 0 VBU0706_CM_uint16_cnt 0.0 65535.0 /end CHARACTERISTIC
/begin CHARACTERISTIC CcSOC_OcvCorrectionCVUpThld_mV "" VALUE 0x700000a6 Scalar_UWORD 0 VBU0706_CM_uint16_cnt 0.0 65535.0 /end CHARACTERISTIC
/begin CHARACTERISTIC CcSOC_OneThirdRateDeviationCellVoltage_mV "" VALUE 0x700000b2 Scalar_UWORD 0 VBU0706_CM_uint16_cnt 0.0 65535.0 /end CHARACTERISTIC
/begin CHARACTERISTIC CcSOC_RelaxationDeviationCellVoltage_mV "" VALUE 0x700000b4 Scalar_UWORD 0 VBU0706_CM_uint16_cnt 0.0 65535.0 /end CHARACTERISTIC
/begin CHARACTERISTIC CcSOF_PowerOnDiscOcvSloDelay_ms "" VALUE 0x700000da Scalar_UWORD 0 VBU0706_CM_uint16_cnt 0.0 65535.0 /end CHARACTERISTIC
/begin CHARACTERISTIC ABS_flgMsg068ChksmDisbl_C "" VALUE 0x70010718 Scalar_BOOLEAN 0 VBU0706_CM_boolean_flg 0.0 1.0 /end CHARACTERISTIC
/begin CHARACTERISTIC ABS_flgMsg068RollCntDisbl_C "" VALUE 0x70010719 Scalar_BOOLEAN 0 VBU0706_CM_boolean_flg 0.0 1.0 /end CHARACTERISTIC
/begin CHARACTERISTIC ABS_flgMsg075ChksmDisbl_C "" VALUE 0x7001071a Scalar_BOOLEAN 0 VBU0706_CM_boolean_flg 0.0 1.0 /end CHARACTERISTIC
/begin CHARACTERISTIC ABS_flgMsg075RollCntDisbl_C "" VALUE 0x7001071b Scalar_BOOLEAN 0 VBU0706_CM_boolean_flg 0.0 1.0 /end CHARACTERISTIC
/begin CHARACTERISTIC ABS_flgMsg079ChksmDisbl_C "" VALUE 0x7001071c Scalar_BOOLEAN 0 VBU0706_CM_boolean_flg 0.0 1.0 /end CHARACTERISTIC
/begin CHARACTERISTIC ABS_flgMsg079RollCntDisbl_C "" VALUE 0x7001071d Scalar_BOOLEAN 0 VBU0706_CM_boolean_flg 0.0 1.0 /end CHARACTERISTIC
/begin CHARACTERISTIC BPD_flgBrkPosOverride_C "" VALUE 0x700107a3 Scalar_BOOLEAN 0 VBU0706_CM_boolean_cnt 0.0 1.0 /end CHARACTERISTIC
/begin CHARACTERISTIC BPD_flgBrkPosVldOverrideVal_C "" VALUE 0x700107a4 Scalar_BOOLEAN 0 VBU0706_CM_boolean_cnt 0.0 1.0 /end CHARACTERISTIC
/begin CHARACTERISTIC BPD_flgBrkPosVldOverride_C "" VALUE 0x700107a5 Scalar_BOOLEAN 0 VBU0706_CM_boolean_cnt 0.0 1.0 /end CHARACTERISTIC
/begin CHARACTERISTIC BPD_flgBrkSwtOverride_C "" VALUE 0x700107a6 Scalar_BOOLEAN 0 VBU0706_CM_boolean_cnt 0.0 1.0 /end CHARACTERISTIC
/begin CHARACTERISTIC CDC_flgMsg220ChksmDisbl_C "" VALUE 0x700107b4 Scalar_BOOLEAN 0 VBU0706_CM_boolean_flg 0.0 1.0 /end CHARACTERISTIC
/begin CHARACTERISTIC CDC_flgMsg220RollCntDisbl_C "" VALUE 0x700107b5 Scalar_BOOLEAN 0 VBU0706_CM_boolean_flg 0.0 1.0 /end CHARACTERISTIC
/begin CHARACTERISTIC CbBCV_BdmBatteryBusVoltageMismatch_flg "" VALUE 0x70010817 Scalar_BOOLEAN 0 VBU0706_CM_boolean_cnt 0.0 1.0 /end CHARACTERISTIC
/begin CHARACTERISTIC CbBCV_BdmBatteryCurrentOoR_flg "" VALUE 0x70010818 Scalar_BOOLEAN 0 VBU0706_CM_boolean_cnt 0.0 1.0 /end CHARACTERISTIC
/begin CHARACTERISTIC CbBCV_BdmBatteryOverCurrent_flg "" VALUE 0x70010819 Scalar_BOOLEAN 0 VBU0706_CM_boolean_cnt 0.0 1.0 /end CHARACTERISTIC
/begin CHARACTERISTIC CbBCV_BdmBatteryOverVoltage_flg "" VALUE 0x7001081a Scalar_BOOLEAN 0 VBU0706_CM_boolean_cnt 0.0 1.0 /end CHARACTERISTIC
/begin CHARACTERISTIC CbBCV_BdmBatteryUnderVoltage_flg "" VALUE 0x7001081b Scalar_BOOLEAN 0 VBU0706_CM_boolean_cnt 0.0 1.0 /end CHARACTERISTIC
/begin CHARACTERISTIC CbBCV_BdmBatteryVoltageOoR_flg "" VALUE 0x7001081c Scalar_BOOLEAN 0 VBU0706_CM_boolean_cnt 0.0 1.0 /end CHARACTERISTIC
/begin CHARACTERISTIC CbCTD_MnNegContactorStuckOpenFaultEnable_flg "" VALUE 0x7001083a Scalar_BOOLEAN 0 VBU0706_CM_boolean_cnt 0.0 1.0 /end CHARACTERISTIC
/begin CHARACTERISTIC CbCTD_MnPosContactorStuckOpenFaultEnable_flg "" VALUE 0x7001083c Scalar_BOOLEAN 0 VBU0706_CM_boolean_cnt 0.0 1.0 /end CHARACTERISTIC
/begin CHARACTERISTIC CbCTD_PrechargeEnergyHighFaultEnable_flg "" VALUE 0x7001083e Scalar_BOOLEAN 0 VBU0706_CM_boolean_cnt 0.0 1.0 /end CHARACTERISTIC
/begin CHARACTERISTIC CbCTD_PrechargeHeatProtectionEnable_flg "" VALUE 0x7001083f Scalar_BOOLEAN 0 VBU0706_CM_boolean_cnt 0.0 1.0 /end CHARACTERISTIC
/begin CHARACTERISTIC CbCTD_RnMnNegContactorStuckOpenFaultEnable_flg "" VALUE 0x70010844 Scalar_BOOLEAN 0 VBU0706_CM_boolean_cnt 0.0 1.0 /end CHARACTERISTIC
/begin CHARACTERISTIC CbCTD_RnMnPosContactorStuckOpenFaultEnable_flg "" VALUE 0x70010845 Scalar_BOOLEAN 0 VBU0706_CM_boolean_cnt 0.0 1.0 /end CHARACTERISTIC
/begin CHARACTERISTIC CbSOC_BatterySOCOvrdFlg_flg "" VALUE 0x7001086d Scalar_BOOLEAN 0 VBU0706_CM_boolean_cnt 0.0 1.0 /end CHARACTERISTIC
/begin CHARACTERISTIC CbSOC_ForceOcvSocInitialize_flg "" VALUE 0x70010872 Scalar_BOOLEAN 0 VBU0706_CM_boolean_cnt 0.0 1.0 /end CHARACTERISTIC
/begin CHARACTERISTIC CbSOC_ReadMemorySOCEnable_flg "" VALUE 0x70010874 Scalar_BOOLEAN 0 VBU0706_CM_boolean_cnt 0.0 1.0 /end CHARACTERISTIC
/begin CHARACTERISTIC CbSOH_CellCapacityOverDeviationFaultEnable_flg "" VALUE 0x7001087a Scalar_BOOLEAN 0 VBU0706_CM_boolean_cnt 0.0 1.0 /end CHARACTERISTIC
/begin CHARACTERISTIC CbSOH_ComputeResistanceRequestORF_flg "" VALUE 0x7001087b Scalar_BOOLEAN 0 VBU0706_CM_boolean_cnt 0.0 1.0 /end CHARACTERISTIC
/begin CHARACTERISTIC CbSOH_ComputeResistanceRequestORV_flg "" VALUE 0x7001087c Scalar_BOOLEAN 0 VBU0706_CM_boolean_cnt 0.0 1.0 /end CHARACTERISTIC
/begin CHARACTERISTIC CbVCT_BMSBMSRollingCounterORF_flg "" VALUE 0x70010886 Scalar_BOOLEAN 0 VBU0706_CM_boolean_flg 0.0 1.0 /end CHARACTERISTIC
/begin CHARACTERISTIC CbVCT_BMSCellTempStandardDeviationORF_flg "" VALUE 0x70010887 Scalar_BOOLEAN 0 VBU0706_CM_boolean_flg 0.0 1.0 /end CHARACTERISTIC
/begin CHARACTERISTIC CbVCT_BMSCellVoltageAveORF_flg "" VALUE 0x70010888 Scalar_BOOLEAN 0 VBU0706_CM_boolean_flg 0.0 1.0 /end CHARACTERISTIC
/begin CHARACTERISTIC CbVCT_BMSCellVoltageAveValidityORF_flg "" VALUE 0x70010889 Scalar_BOOLEAN 0 VBU0706_CM_boolean_flg 0.0 1.0 /end CHARACTERISTIC
/begin CHARACTERISTIC CbVCT_BMSCellVoltageAveValidityORV_flg "" VALUE 0x7001088a Scalar_BOOLEAN 0 VBU0706_CM_boolean_flg 0.0 1.0 /end CHARACTERISTIC
/begin CHARACTERISTIC CbVCT_BMSCellVoltageMaxORF_flg "" VALUE 0x7001088b Scalar_BOOLEAN 0 VBU0706_CM_boolean_flg 0.0 1.0 /end CHARACTERISTIC
/begin CHARACTERISTIC CbVCT_BMSCellVoltageMaxValidityORF_flg "" VALUE 0x7001088c Scalar_BOOLEAN 0 VBU0706_CM_boolean_flg 0.0 1.0 /end CHARACTERISTIC
/begin CHARACTERISTIC CbVCT_BMSCellVoltageMaxValidityORV_flg "" VALUE 0x7001088d Scalar_BOOLEAN 0 VBU0706_CM_boolean_flg 0.0 1.0 /end CHARACTERISTIC
/begin CHARACTERISTIC CbVCT_BMSCellVoltageMinORF_flg "" VALUE 0x7001088e Scalar_BOOLEAN 0 VBU0706_CM_boolean_flg 0.0 1.0 /end CHARACTERISTIC
/begin CHARACTERISTIC CbVCT_BMSCellVoltageMinValidityORF_flg "" VALUE 0x7001088f Scalar_BOOLEAN 0 VBU0706_CM_boolean_flg 0.0 1.0 /end CHARACTERISTIC
/begin CHARACTERISTIC CbVCT_BMSCellVoltageMinValidityORV_flg "" VALUE 0x70010890 Scalar_BOOLEAN 0 VBU0706_CM_boolean_flg 0.0 1.0 /end CHARACTERISTIC
/begin CHARACTERISTIC CbVCT_BMSCellVoltageOverUnderORF_flg "" VALUE 0x70010891 Scalar_BOOLEAN 0 VBU0706_CM_boolean_flg 0.0 1.0 /end CHARACTERISTIC
/begin CHARACTERISTIC CbVCT_BMSChgPowerLimitDynamicORF_flg "" VALUE 0x70010892 Scalar_BOOLEAN 0 VBU0706_CM_boolean_flg 0.0 1.0 /end CHARACTERISTIC
/begin CHARACTERISTIC CbVCT_BMSChgPowerLimitLTORF_flg "" VALUE 0x70010893 Scalar_BOOLEAN 0 VBU0706_CM_boolean_flg 0.0 1.0 /end CHARACTERISTIC
/begin CHARACTERISTIC CbVCT_BMSChgPowerLimitSTORF_flg "" VALUE 0x70010894 Scalar_BOOLEAN 0 VBU0706_CM_boolean_flg 0.0 1.0 /end CHARACTERISTIC
/begin CHARACTERISTIC CbVCT_BMSContactorStateORF_flg "" VALUE 0x70010895 Scalar_BOOLEAN 0 VBU0706_CM_boolean_flg 0.0 1.0 /end CHARACTERISTIC
/begin CHARACTERISTIC CbVCT_BMSCustomerUsageSOCORF_flg "" VALUE 0x70010896 Scalar_BOOLEAN 0 VBU0706_CM_boolean_flg 0.0 1.0 /end CHARACTERISTIC
/begin CHARACTERISTIC CbVCT_BMSDCChargeCurrentOverUnderORF_flg "" VALUE 0x70010897 Scalar_BOOLEAN 0 VBU0706_CM_boolean_flg 0.0 1.0 /end CHARACTERISTIC
/begin CHARACTERISTIC CbVCT_BMSDCChrgFinalSOCORF_flg "" VALUE 0x70010898 Scalar_BOOLEAN 0 VBU0706_CM_boolean_flg 0.0 1.0 /end CHARACTERISTIC
/begin CHARACTERISTIC CbVCT_BMSDischgPowerLimitDynamicORF_flg "" VALUE 0x70010899 Scalar_BOOLEAN 0 VBU0706_CM_boolean_flg 0.0 1.0 /end CHARACTERISTIC
/begin CHARACTERISTIC CbVCT_BMSDischgPowerLimitLTORF_flg "" VALUE 0x7001089a Scalar_BOOLEAN 0 VBU0706_CM_boolean_flg 0.0 1.0 /end CHARACTERISTIC
/begin CHARACTERISTIC CbVCT_BMSDischgPowerLimitSTORF_flg "" VALUE 0x7001089b Scalar_BOOLEAN 0 VBU0706_CM_boolean_flg 0.0 1.0 /end CHARACTERISTIC
/begin CHARACTERISTIC CbVCT_BMSESSInletTempMaskORF_flg "" VALUE 0x7001089c Scalar_BOOLEAN 0 VBU0706_CM_boolean_flg 0.0 1.0 /end CHARACTERISTIC
/begin CHARACTERISTIC CbVCT_BMSESSInletTempMaskORV_flg "" VALUE 0x7001089d Scalar_BOOLEAN 0 VBU0706_CM_boolean_flg 0.0 1.0 /end CHARACTERISTIC
/begin CHARACTERISTIC CbVCT_BMSESSInletTempValidityORF_flg "" VALUE 0x7001089e Scalar_BOOLEAN 0 VBU0706_CM_boolean_flg 0.0 1.0 /end CHARACTERISTIC
/begin CHARACTERISTIC CbVCT_BMSESSInletTempValidityORV_flg "" VALUE 0x7001089f Scalar_BOOLEAN 0 VBU0706_CM_boolean_flg 0.0 1.0 /end CHARACTERISTIC
/begin CHARACTERISTIC CbVCT_BMSESSOutletTempMaskORF_flg "" VALUE 0x700108a0 Scalar_BOOLEAN 0 VBU0706_CM_boolean_flg 0.0 1.0 /end CHARACTERISTIC
/begin CHARACTERISTIC CbVCT_BMSESSOutletTempMaskORV_flg "" VALUE 0x700108a1 Scalar_BOOLEAN 0 VBU0706_CM_boolean_flg 0.0 1.0 /end CHARACTERISTIC
/begin CHARACTERISTIC CbVCT_BMSESSOutletTempValidityORF_flg "" VALUE 0x700108a2 Scalar_BOOLEAN 0 VBU0706_CM_boolean_flg 0.0 1.0 /end CHARACTERISTIC
/begin CHARACTERISTIC CbVCT_BMSESSOutletTempValidityORV_flg "" VALUE 0x700108a3 Scalar_BOOLEAN 0 VBU0706_CM_boolean_flg 0.0 1.0 /end CHARACTERISTIC
/begin CHARACTERISTIC CbVCT_BMSEstimateChargingTimeORF_flg "" VALUE 0x700108a4 Scalar_BOOLEAN 0 VBU0706_CM_boolean_flg 0.0 1.0 /end CHARACTERISTIC
/begin CHARACTERISTIC CbVCT_BMSFaultCatORF_flg "" VALUE 0x700108a5 Scalar_BOOLEAN 0 VBU0706_CM_boolean_flg 0.0 1.0 /end CHARACTERISTIC
/begin CHARACTERISTIC CbVCT_BMSFaultLvlORF_flg "" VALUE 0x700108a6 Scalar_BOOLEAN 0 VBU0706_CM_boolean_flg 0.0 1.0 /end CHARACTERISTIC
/begin CHARACTERISTIC CbVCT_BMSHVShutdownReqORF_flg "" VALUE 0x700108a7 Scalar_BOOLEAN 0 VBU0706_CM_boolean_flg 0.0 1.0 /end CHARACTERISTIC
/begin CHARACTERISTIC CbVCT_BMSHVShutdownReqORV_flg "" VALUE 0x700108a8 Scalar_BOOLEAN 0 VBU0706_CM_boolean_flg 0.0 1.0 /end CHARACTERISTIC
/begin CHARACTERISTIC CbVCT_BMSInletTempRequestORF_flg "" VALUE 0x700108a9 Scalar_BOOLEAN 0 VBU0706_CM_boolean_flg 0.0 1.0 /end CHARACTERISTIC
/begin CHARACTERISTIC CbVCT_BMSInletWaterTempORF_flg "" VALUE 0x700108aa Scalar_BOOLEAN 0 VBU0706_CM_boolean_flg 0.0 1.0 /end CHARACTERISTIC
/begin CHARACTERISTIC CbVCT_BMSInsulationResistanceValueORF_flg "" VALUE 0x700108ab Scalar_BOOLEAN 0 VBU0706_CM_boolean_flg 0.0 1.0 /end CHARACTERISTIC
/begin CHARACTERISTIC CbVCT_BMSMaximumCellTempORF_flg "" VALUE 0x700108ac Scalar_BOOLEAN 0 VBU0706_CM_boolean_flg 0.0 1.0 /end CHARACTERISTIC
/begin CHARACTERISTIC CbVCT_BMSMaximumCellVoltageNumberORF_flg "" VALUE 0x700108ad Scalar_BOOLEAN 0 VBU0706_CM_boolean_flg 0.0 1.0 /end CHARACTERISTIC
/begin CHARACTERISTIC CbVCT_BMSMaximumTempNumberORF_flg "" VALUE 0x700108ae Scalar_BOOLEAN 0 VBU0706_CM_boolean_flg 0.0 1.0 /end CHARACTERISTIC
/begin CHARACTERISTIC CbVCT_BMSMinimumCellTempORF_flg "" VALUE 0x700108af Scalar_BOOLEAN 0 VBU0706_CM_boolean_flg 0.0 1.0 /end CHARACTERISTIC
/begin CHARACTERISTIC CbVCT_BMSMinimumTempNumberORF_flg "" VALUE 0x700108b0 Scalar_BOOLEAN 0 VBU0706_CM_boolean_flg 0.0 1.0 /end CHARACTERISTIC
/begin CHARACTERISTIC CbVCT_BMSOutletWaterTempORF_flg "" VALUE 0x700108b1 Scalar_BOOLEAN 0 VBU0706_CM_boolean_flg 0.0 1.0 /end CHARACTERISTIC
/begin CHARACTERISTIC CbVCT_BMSPackCrntORF_flg "" VALUE 0x700108b2 Scalar_BOOLEAN 0 VBU0706_CM_boolean_flg 0.0 1.0 /end CHARACTERISTIC
/begin CHARACTERISTIC CbVCT_BMSPackEnergyAvailableORF_flg "" VALUE 0x700108b3 Scalar_BOOLEAN 0 VBU0706_CM_boolean_flg 0.0 1.0 /end CHARACTERISTIC
/begin CHARACTERISTIC CbVCT_BMSPackVoltageORF_flg "" VALUE 0x700108b4 Scalar_BOOLEAN 0 VBU0706_CM_boolean_flg 0.0 1.0 /end CHARACTERISTIC
/begin CHARACTERISTIC CbVCT_BMSRollingCounter225ORF_flg "" VALUE 0x700108b5 Scalar_BOOLEAN 0 VBU0706_CM_boolean_flg 0.0 1.0 /end CHARACTERISTIC
/begin CHARACTERISTIC CbVCT_BMSSOCORF_flg "" VALUE 0x700108b6 Scalar_BOOLEAN 0 VBU0706_CM_boolean_flg 0.0 1.0 /end CHARACTERISTIC
/begin CHARACTERISTIC CbVCT_BMSSOCOverUnderORF_flg "" VALUE 0x700108b7 Scalar_BOOLEAN 0 VBU0706_CM_boolean_flg 0.0 1.0 /end CHARACTERISTIC
/begin CHARACTERISTIC CbVCT_BMSStsORF_flg "" VALUE 0x700108b8 Scalar_BOOLEAN 0 VBU0706_CM_boolean_flg 0.0 1.0 /end CHARACTERISTIC
/begin CHARACTERISTIC CbVCT_BMSTempAverageValidityORF_flg "" VALUE 0x700108b9 Scalar_BOOLEAN 0 VBU0706_CM_boolean_flg 0.0 1.0 /end CHARACTERISTIC
/begin CHARACTERISTIC CbVCT_BMSTempAverageValidityORV_flg "" VALUE 0x700108ba Scalar_BOOLEAN 0 VBU0706_CM_boolean_flg 0.0 1.0 /end CHARACTERISTIC
/begin CHARACTERISTIC CbVCT_BMSTempMaxValidityORF_flg "" VALUE 0x700108bb Scalar_BOOLEAN 0 VBU0706_CM_boolean_flg 0.0 1.0 /end CHARACTERISTIC
/begin CHARACTERISTIC CbVCT_BMSTempMaxValidityORV_flg "" VALUE 0x700108bc Scalar_BOOLEAN 0 VBU0706_CM_boolean_flg 0.0 1.0 /end CHARACTERISTIC
/begin CHARACTERISTIC CbVCT_BMSTempMinValidityORF_flg "" VALUE 0x700108bd Scalar_BOOLEAN 0 VBU0706_CM_boolean_flg 0.0 1.0 /end CHARACTERISTIC
/begin CHARACTERISTIC CbVCT_BMSTempMinValidityORV_flg "" VALUE 0x700108be Scalar_BOOLEAN 0 VBU0706_CM_boolean_flg 0.0 1.0 /end CHARACTERISTIC
/begin CHARACTERISTIC CbVCT_BMSTempRequestValidORF_flg "" VALUE 0x700108bf Scalar_BOOLEAN 0 VBU0706_CM_boolean_flg 0.0 1.0 /end CHARACTERISTIC
/begin CHARACTERISTIC CbVCT_BMSTempRequestValidORV_flg "" VALUE 0x700108c0 Scalar_BOOLEAN 0 VBU0706_CM_boolean_flg 0.0 1.0 /end CHARACTERISTIC
/begin CHARACTERISTIC CbVCT_BMSTemperatureAverageORF_flg "" VALUE 0x700108c1 Scalar_BOOLEAN 0 VBU0706_CM_boolean_flg 0.0 1.0 /end CHARACTERISTIC
/begin CHARACTERISTIC CbVCT_BMSTemperatureMaxORF_flg "" VALUE 0x700108c2 Scalar_BOOLEAN 0 VBU0706_CM_boolean_flg 0.0 1.0 /end CHARACTERISTIC
/begin CHARACTERISTIC CbVCT_BatteryAbnormalAlarm1ORF_flg "" VALUE 0x700108c3 Scalar_BOOLEAN 0 VBU0706_CM_boolean_flg 0.0 1.0 /end CHARACTERISTIC
/begin CHARACTERISTIC CbVCT_BatteryAbnormalAlarm1ORV_flg "" VALUE 0x700108c4 Scalar_BOOLEAN 0 VBU0706_CM_boolean_flg 0.0 1.0 /end CHARACTERISTIC
/begin CHARACTERISTIC CbVCT_BatteryAbnormalAlarm2ORF_flg "" VALUE 0x700108c5 Scalar_BOOLEAN 0 VBU0706_CM_boolean_flg 0.0 1.0 /end CHARACTERISTIC
/begin CHARACTERISTIC CbVCT_BatteryAbnormalAlarm2ORV_flg "" VALUE 0x700108c6 Scalar_BOOLEAN 0 VBU0706_CM_boolean_flg 0.0 1.0 /end CHARACTERISTIC
/begin CHARACTERISTIC CbVCT_BatteryAbnormalAlarm3ORF_flg "" VALUE 0x700108c7 Scalar_BOOLEAN 0 VBU0706_CM_boolean_flg 0.0 1.0 /end CHARACTERISTIC
/begin CHARACTERISTIC CbVCT_BatteryAbnormalAlarm3ORV_flg "" VALUE 0x700108c8 Scalar_BOOLEAN 0 VBU0706_CM_boolean_flg 0.0 1.0 /end CHARACTERISTIC
/begin CHARACTERISTIC CbVCT_BatteryConsistencyAlarmORF_flg "" VALUE 0x700108c9 Scalar_BOOLEAN 0 VBU0706_CM_boolean_flg 0.0 1.0 /end CHARACTERISTIC
/begin CHARACTERISTIC CbVCT_BatteryOutputConnectorStateORF_flg "" VALUE 0x700108ca Scalar_BOOLEAN 0 VBU0706_CM_boolean_flg 0.0 1.0 /end CHARACTERISTIC
/begin CHARACTERISTIC CbVCT_BatteryTempDifferAlarmORF_flg "" VALUE 0x700108cb Scalar_BOOLEAN 0 VBU0706_CM_boolean_flg 0.0 1.0 /end CHARACTERISTIC
/begin CHARACTERISTIC CbVCT_BatteryTempOverORF_flg "" VALUE 0x700108cc Scalar_BOOLEAN 0 VBU0706_CM_boolean_flg 0.0 1.0 /end CHARACTERISTIC
/begin CHARACTERISTIC CbVCT_BatteryTypeDismatchAlarmORF_flg "" VALUE 0x700108cd Scalar_BOOLEAN 0 VBU0706_CM_boolean_flg 0.0 1.0 /end CHARACTERISTIC
/begin CHARACTERISTIC CbVCT_BetteryCellTempHighAlarmORF_flg "" VALUE 0x700108ce Scalar_BOOLEAN 0 VBU0706_CM_boolean_flg 0.0 1.0 /end CHARACTERISTIC
/begin CHARACTERISTIC CbVCT_BetteryCellTempLowAlarmORF_flg "" VALUE 0x700108cf Scalar_BOOLEAN 0 VBU0706_CM_boolean_flg 0.0 1.0 /end CHARACTERISTIC
/begin CHARACTERISTIC CbVCT_BetteryCellVolHighAlarmORF_flg "" VALUE 0x700108d0 Scalar_BOOLEAN 0 VBU0706_CM_boolean_flg 0.0 1.0 /end CHARACTERISTIC
/begin CHARACTERISTIC CbVCT_BetteryCellVolLowAlarmORF_flg "" VALUE 0x700108d1 Scalar_BOOLEAN 0 VBU0706_CM_boolean_flg 0.0 1.0 /end CHARACTERISTIC
/begin CHARACTERISTIC CbVCT_BetteryPckVoltOverAlarmORF_flg "" VALUE 0x700108d2 Scalar_BOOLEAN 0 VBU0706_CM_boolean_flg 0.0 1.0 /end CHARACTERISTIC
/begin CHARACTERISTIC CbVCT_BetteryPckVoltUnderAlarmORF_flg "" VALUE 0x700108d3 Scalar_BOOLEAN 0 VBU0706_CM_boolean_flg 0.0 1.0 /end CHARACTERISTIC
/begin CHARACTERISTIC CbVCT_CTDMnNegContactorWeldORF_flg "" VALUE 0x700108d4 Scalar_BOOLEAN 0 VBU0706_CM_boolean_flg 0.0 1.0 /end CHARACTERISTIC
/begin CHARACTERISTIC CbVCT_CTDMnPosContactorWeldORF_flg "" VALUE 0x700108d5 Scalar_BOOLEAN 0 VBU0706_CM_boolean_flg 0.0 1.0 /end CHARACTERISTIC
/begin CHARACTERISTIC CbVCT_CTDPrechargeEnergyHighORF_flg "" VALUE 0x700108d6 Scalar_BOOLEAN 0 VBU0706_CM_boolean_flg 0.0 1.0 /end CHARACTERISTIC
/begin CHARACTERISTIC CbVCT_CTDPrechargeRelayBlownORF_flg "" VALUE 0x700108d7 Scalar_BOOLEAN 0 VBU0706_CM_boolean_flg 0.0 1.0 /end CHARACTERISTIC
/begin CHARACTERISTIC CbVCT_CTDPrechargeRelayStuckOpenORF_flg "" VALUE 0x700108d8 Scalar_BOOLEAN 0 VBU0706_CM_boolean_flg 0.0 1.0 /end CHARACTERISTIC
/begin CHARACTERISTIC CbVCT_CTDPrechargeTimeoutORF_flg "" VALUE 0x700108d9 Scalar_BOOLEAN 0 VBU0706_CM_boolean_flg 0.0 1.0 /end CHARACTERISTIC
/begin CHARACTERISTIC CbVCT_CTMCellThermalRunawayORF_flg "" VALUE 0x700108da Scalar_BOOLEAN 0 VBU0706_CM_boolean_flg 0.0 1.0 /end CHARACTERISTIC
/begin CHARACTERISTIC CbVCT_CTMCellThermalRunawayValidORF_flg "" VALUE 0x700108db Scalar_BOOLEAN 0 VBU0706_CM_boolean_flg 0.0 1.0 /end CHARACTERISTIC
/begin CHARACTERISTIC CbVCT_CTMCellThermalRunawayValidORV_flg "" VALUE 0x700108dc Scalar_BOOLEAN 0 VBU0706_CM_boolean_flg 0.0 1.0 /end CHARACTERISTIC
/begin CHARACTERISTIC CbVCT_ChargeAvailableORF_flg "" VALUE 0x700108dd Scalar_BOOLEAN 0 VBU0706_CM_boolean_flg 0.0 1.0 /end CHARACTERISTIC
/begin CHARACTERISTIC CbVCT_ChargeAvailableORV_flg "" VALUE 0x700108de Scalar_BOOLEAN 0 VBU0706_CM_boolean_flg 0.0 1.0 /end CHARACTERISTIC
/begin CHARACTERISTIC CbVCT_DCChargingPermitStatusORF_flg "" VALUE 0x700108df Scalar_BOOLEAN 0 VBU0706_CM_boolean_flg 0.0 1.0 /end CHARACTERISTIC
/begin CHARACTERISTIC CbVCT_EstimatePercTimeORF_flg "" VALUE 0x700108e0 Scalar_BOOLEAN 0 VBU0706_CM_boolean_flg 0.0 1.0 /end CHARACTERISTIC
/begin CHARACTERISTIC CbVCT_HVBattSOCLowCritORF_flg "" VALUE 0x700108e1 Scalar_BOOLEAN 0 VBU0706_CM_boolean_flg 0.0 1.0 /end CHARACTERISTIC
/begin CHARACTERISTIC CbVCT_HVBattSOCLowCritORV_flg "" VALUE 0x700108e2 Scalar_BOOLEAN 0 VBU0706_CM_boolean_flg 0.0 1.0 /end CHARACTERISTIC
/begin CHARACTERISTIC CbVCT_HVBattSOCLowWarnORF_flg "" VALUE 0x700108e3 Scalar_BOOLEAN 0 VBU0706_CM_boolean_flg 0.0 1.0 /end CHARACTERISTIC
/begin CHARACTERISTIC CbVCT_HVBattSOCLowWarnORV_flg "" VALUE 0x700108e4 Scalar_BOOLEAN 0 VBU0706_CM_boolean_flg 0.0 1.0 /end CHARACTERISTIC
/begin CHARACTERISTIC CbVCT_InhibitPrechargeCauseORF_flg "" VALUE 0x700108e5 Scalar_BOOLEAN 0 VBU0706_CM_boolean_flg 0.0 1.0 /end CHARACTERISTIC
/begin CHARACTERISTIC CbVCT_SOCJumpAlarmORF_flg "" VALUE 0x700108e6 Scalar_BOOLEAN 0 VBU0706_CM_boolean_flg 0.0 1.0 /end CHARACTERISTIC
/begin CHARACTERISTIC CbVCT_SOCJumpReasonORF_flg "" VALUE 0x700108e7 Scalar_BOOLEAN 0 VBU0706_CM_boolean_flg 0.0 1.0 /end CHARACTERISTIC
/begin CHARACTERISTIC CcTHM_PackSohORF_flg "" VALUE 0x7001096d Scalar_BOOLEAN 0 VBU0706_CM_boolean_cnt 0.0 1.0 /end CHARACTERISTIC
/begin CHARACTERISTIC DCDC_flgMsg303ChksmDisbl_C "" VALUE 0x7001099a Scalar_BOOLEAN 0 VBU0706_CM_boolean_flg 0.0 1.0 /end CHARACTERISTIC
/begin CHARACTERISTIC DCDC_flgMsg303RollCntDisbl_C "" VALUE 0x7001099b Scalar_BOOLEAN 0 VBU0706_CM_boolean_flg 0.0 1.0 /end CHARACTERISTIC
/begin CHARACTERISTIC DCDC_flgMsg509ChksmDisbl_C "" VALUE 0x7001099c Scalar_BOOLEAN 0 VBU0706_CM_boolean_flg 0.0 1.0 /end CHARACTERISTIC
/begin CHARACTERISTIC DCDC_flgMsg509RollCntDisbl_C "" VALUE 0x7001099d Scalar_BOOLEAN 0 VBU0706_CM_boolean_flg 0.0 1.0 /end CHARACTERISTIC
/begin CHARACTERISTIC EPB_flgMsg080ChksmDisbl_C "" VALUE 0x70010a8f Scalar_BOOLEAN 0 VBU0706_CM_boolean_flg 0.0 1.0 /end CHARACTERISTIC
/begin CHARACTERISTIC EPB_flgMsg080RollCntDisbl_C "" VALUE 0x70010a90 Scalar_BOOLEAN 0 VBU0706_CM_boolean_flg 0.0 1.0 /end CHARACTERISTIC
/begin CHARACTERISTIC EPS_flgMsg070ChksmDisbl_C "" VALUE 0x70010a93 Scalar_BOOLEAN 0 VBU0706_CM_boolean_flg 0.0 1.0 /end CHARACTERISTIC
/begin CHARACTERISTIC EPS_flgMsg070RollCntDisbl_C "" VALUE 0x70010a94 Scalar_BOOLEAN 0 VBU0706_CM_boolean_flg 0.0 1.0 /end CHARACTERISTIC
/begin CHARACTERISTIC HIGH "" VALUE 0x70010ade Scalar_BOOLEAN 0 VBU0706_CM_boolean_cnt 0.0 1.0 /end CHARACTERISTIC
/begin CHARACTERISTIC IC_flgMsg401ChksmDisbl_C "" VALUE 0x70010ae0 Scalar_BOOLEAN 0 VBU0706_CM_boolean_flg 0.0 1.0 /end CHARACTERISTIC
/begin CHARACTERISTIC IC_flgMsg401RollCntDisbl_C "" VALUE 0x70010ae1 Scalar_BOOLEAN 0 VBU0706_CM_boolean_flg 0.0 1.0 /end CHARACTERISTIC
/begin CHARACTERISTIC LOW "" VALUE 0x70010b0c Scalar_BOOLEAN 0 VBU0706_CM_boolean_cnt 0.0 1.0 /end CHARACTERISTIC
/begin CHARACTERISTIC LbCTS_AbortPrechargeOvrdVal_flg "" VALUE 0x70010b10 Scalar_BOOLEAN 0 VBU0706_CM_boolean_cnt 0.0 1.0 /end CHARACTERISTIC
/begin CHARACTERISTIC LbCTS_AbortPrechargeOvrd_flg "" VALUE 0x70010b11 Scalar_BOOLEAN 0 VBU0706_CM_boolean_cnt 0.0 1.0 /end CHARACTERISTIC
/begin CHARACTERISTIC LbCTS_InhibitPrechargeOvrdVal_flg "" VALUE 0x70010b12 Scalar_BOOLEAN 0 VBU0706_CM_boolean_cnt 0.0 1.0 /end CHARACTERISTIC
/begin CHARACTERISTIC LbCTS_InhibitPrechargeOvrd_flg "" VALUE 0x70010b13 Scalar_BOOLEAN 0 VBU0706_CM_boolean_cnt 0.0 1.0 /end CHARACTERISTIC
/begin CHARACTERISTIC MCU_flgMsg205ChksmDisbl_C "" VALUE 0x70010b1f Scalar_BOOLEAN 0 VBU0706_CM_boolean_flg 0.0 1.0 /end CHARACTERISTIC
/begin CHARACTERISTIC MCU_flgMsg205RollCntDisbl_C "" VALUE 0x70010b20 Scalar_BOOLEAN 0 VBU0706_CM_boolean_flg 0.0 1.0 /end CHARACTERISTIC
/begin CHARACTERISTIC MCU_flgMsg405ChksmDisbl_C "" VALUE 0x70010b21 Scalar_BOOLEAN 0 VBU0706_CM_boolean_flg 0.0 1.0 /end CHARACTERISTIC
/begin CHARACTERISTIC MCU_flgMsg405RollCntDisbl_C "" VALUE 0x70010b22 Scalar_BOOLEAN 0 VBU0706_CM_boolean_flg 0.0 1.0 /end CHARACTERISTIC
/begin CHARACTERISTIC PEUR_flgMsg305ChksmDisbl_C "" VALUE 0x70010b37 Scalar_BOOLEAN 0 VBU0706_CM_boolean_flg 0.0 1.0 /end CHARACTERISTIC
/begin CHARACTERISTIC PEUR_flgMsg305RollCntDisbl_C "" VALUE 0x70010b38 Scalar_BOOLEAN 0 VBU0706_CM_boolean_flg 0.0 1.0 /end CHARACTERISTIC
/begin CHARACTERISTIC PEUR_flgMsg505ChksmDisbl_C "" VALUE 0x70010b39 Scalar_BOOLEAN 0 VBU0706_CM_boolean_flg 0.0 1.0 /end CHARACTERISTIC
/begin CHARACTERISTIC PEUR_flgMsg505RollCntDisbl_C "" VALUE 0x70010b3a Scalar_BOOLEAN 0 VBU0706_CM_boolean_flg 0.0 1.0 /end CHARACTERISTIC
/begin CHARACTERISTIC TQD_flgVectorSpdUsed_C "" VALUE 0x70010bc8 Scalar_BOOLEAN 0 VBU0706_CM_boolean_cnt 0.0 1.0 /end CHARACTERISTIC
/begin CHARACTERISTIC TQD_flgVirtualNeutralEnable_C "" VALUE 0x70010bc9 Scalar_BOOLEAN 0 VBU0706_CM_boolean_cnt 0.0 1.0 /end CHARACTERISTIC
/begin CHARACTERISTIC CcBCV_BdmBatteryBusVoltageMismatchFaultFIC_n "" VALUE 0x700108fd Scalar_BYTE 0 VBU0706_CM_int8_cnt -128.0 127.0 /end CHARACTERISTIC
/begin CHARACTERISTIC CcBCV_BdmBatteryBusVoltageMismatchFaultPIC_n "" VALUE 0x700108fe Scalar_BYTE 0 VBU0706_CM_int8_cnt -128.0 127.0 /end CHARACTERISTIC
/begin CHARACTERISTIC CcBCV_BdmBatteryCurrentOoRFaultFIC_n "" VALUE 0x700108ff Scalar_BYTE 0 VBU0706_CM_int8_cnt -128.0 127.0 /end CHARACTERISTIC
/begin CHARACTERISTIC CcBCV_BdmBatteryCurrentOoRFaultPIC_n "" VALUE 0x70010900 Scalar_BYTE 0 VBU0706_CM_int8_cnt -128.0 127.0 /end CHARACTERISTIC
/begin CHARACTERISTIC CcBCV_BdmBatteryOverCurrentFaultFIC_n "" VALUE 0x70010901 Scalar_BYTE 0 VBU0706_CM_int8_cnt -128.0 127.0 /end CHARACTERISTIC
/begin CHARACTERISTIC CcBCV_BdmBatteryOverCurrentFaultPIC_n "" VALUE 0x70010902 Scalar_BYTE 0 VBU0706_CM_int8_cnt -128.0 127.0 /end CHARACTERISTIC
/begin CHARACTERISTIC CcBCV_BdmBatteryOverVoltageFaultFIC_n "" VALUE 0x70010903 Scalar_BYTE 0 VBU0706_CM_int8_cnt -128.0 127.0 /end CHARACTERISTIC
/begin CHARACTERISTIC CcBCV_BdmBatteryOverVoltageFaultPIC_n "" VALUE 0x70010904 Scalar_BYTE 0 VBU0706_CM_int8_cnt -128.0 127.0 /end CHARACTERISTIC
/begin CHARACTERISTIC CcBCV_BdmBatteryUnderVoltageFaultFIC_n "" VALUE 0x70010905 Scalar_BYTE 0 VBU0706_CM_int8_cnt -128.0 127.0 /end CHARACTERISTIC
/begin CHARACTERISTIC CcBCV_BdmBatteryUnderVoltageFaultPIC_n "" VALUE 0x70010906 Scalar_BYTE 0 VBU0706_CM_int8_cnt -128.0 127.0 /end CHARACTERISTIC
/begin CHARACTERISTIC CcBCV_BdmBatteryVoltageOoRFaultFIC_n "" VALUE 0x70010907 Scalar_BYTE 0 VBU0706_CM_int8_cnt -128.0 127.0 /end CHARACTERISTIC
/begin CHARACTERISTIC CcBCV_BdmBatteryVoltageOoRFaultPIC_n "" VALUE 0x70010908 Scalar_BYTE 0 VBU0706_CM_int8_cnt -128.0 127.0 /end CHARACTERISTIC
/begin CHARACTERISTIC CcCTD_MnNegContactorStuckOpenFaultFIC_n "" VALUE 0x7001090e Scalar_BYTE 0 VBU0706_CM_int8_cnt -128.0 127.0 /end CHARACTERISTIC
/begin CHARACTERISTIC CcCTD_MnNegContactorStuckOpenFaultPIC_n "" VALUE 0x7001090f Scalar_BYTE 0 VBU0706_CM_int8_cnt -128.0 127.0 /end CHARACTERISTIC
/begin CHARACTERISTIC CcCTD_MnPosContactorStuckOpenFaultFIC_n "" VALUE 0x70010912 Scalar_BYTE 0 VBU0706_CM_int8_cnt -128.0 127.0 /end CHARACTERISTIC
/begin CHARACTERISTIC CcCTD_MnPosContactorStuckOpenFaultPIC_n "" VALUE 0x70010913 Scalar_BYTE 0 VBU0706_CM_int8_cnt -128.0 127.0 /end CHARACTERISTIC
/begin CHARACTERISTIC CcCTD_PrechargeEnergyHighFaultFIC_n "" VALUE 0x70010916 Scalar_BYTE 0 VBU0706_CM_int8_cnt -128.0 127.0 /end CHARACTERISTIC
/begin CHARACTERISTIC CcCTD_PrechargeEnergyHighFaultPIC_n "" VALUE 0x70010917 Scalar_BYTE 0 VBU0706_CM_int8_cnt -128.0 127.0 /end CHARACTERISTIC
/begin CHARACTERISTIC CcCTD_RnMnNegContactorStuckOpenFaultFIC_n "" VALUE 0x7001091e Scalar_BYTE 0 VBU0706_CM_int8_cnt -128.0 127.0 /end CHARACTERISTIC
/begin CHARACTERISTIC CcCTD_RnMnNegContactorStuckOpenFaultPIC_n "" VALUE 0x7001091f Scalar_BYTE 0 VBU0706_CM_int8_cnt -128.0 127.0 /end CHARACTERISTIC
/begin CHARACTERISTIC CcCTD_RnMnPosContactorStuckOpenFaultFIC_n "" VALUE 0x70010920 Scalar_BYTE 0 VBU0706_CM_int8_cnt -128.0 127.0 /end CHARACTERISTIC
/begin CHARACTERISTIC CcCTD_RnMnPosContactorStuckOpenFaultPIC_n "" VALUE 0x70010921 Scalar_BYTE 0 VBU0706_CM_int8_cnt -128.0 127.0 /end CHARACTERISTIC
/begin CHARACTERISTIC CcSOH_CellCapacityOverDeviationFaultFIC_n "" VALUE 0x7001095d Scalar_BYTE 0 VBU0706_CM_int8_cnt -128.0 127.0 /end CHARACTERISTIC
/begin CHARACTERISTIC CcSOH_CellCapacityOverDeviationFaultPIC_n "" VALUE 0x7001095e Scalar_BYTE 0 VBU0706_CM_int8_cnt -128.0 127.0 /end CHARACTERISTIC
/begin CHARACTERISTIC BPD_stBrkPedPrsNoActv_C "" VALUE 0x700107a8 Scalar_UBYTE 0 VBU0706_CM_uint8_cnt 0.0 15.0 /end CHARACTERISTIC
/begin CHARACTERISTIC BPD_stBrkSwtOverrideVal_C "" VALUE 0x700107ab Scalar_UBYTE 0 VBU0706_CM_uint8_cnt 0.0 15.0 /end CHARACTERISTIC
/begin CHARACTERISTIC CTD_MAIN_NEGATIVE_CONTACTOR_STUCK_OPEN_FAULT "" VALUE 0x700107ec Scalar_UBYTE 0 VBU0706_CM_uint8_cnt 0.0 255.0 /end CHARACTERISTIC
/begin CHARACTERISTIC CTD_MAIN_POSITIVE_CONTACTOR_STUCK_OPEN_FAULT "" VALUE 0x700107ed Scalar_UBYTE 0 VBU0706_CM_uint8_cnt 0.0 255.0 /end CHARACTERISTIC
/begin CHARACTERISTIC CTD_PRECHARGE_STATUS_IDLE "" VALUE 0x700107f0 Scalar_UBYTE 0 VBU0706_CM_uint8_cnt 0.0 255.0 /end CHARACTERISTIC
/begin CHARACTERISTIC CaSOE_InvalidHistoryCurrentData_A "" VALUE 0x7001080b Scalar_UBYTE 0 VBU0706_CM_uint8_cnt 0.0 255.0 /end CHARACTERISTIC
/begin CHARACTERISTIC CcSOE_HistoryCurrentDataDimension_n "" VALUE 0x70010953 Scalar_UBYTE 0 VBU0706_CM_uint8_cnt 0.0 255.0 /end CHARACTERISTIC
/begin CHARACTERISTIC CcSOH_ComputeResistanceUpdateCycle_n "" VALUE 0x7001095f Scalar_UBYTE 0 VBU0706_CM_uint8_cnt 0.0 255.0 /end CHARACTERISTIC
/begin CHARACTERISTIC CcVCT_BMSMaximumCellVoltageNumberORV_n "" VALUE 0x7001096f Scalar_UBYTE 0 VBU0706_CM_uint8_n 0.0 255.0 /end CHARACTERISTIC
/begin CHARACTERISTIC CcVCT_BMSMaximumTempNumberORV_n "" VALUE 0x70010970 Scalar_UBYTE 0 VBU0706_CM_uint8_n 0.0 255.0 /end CHARACTERISTIC
/begin CHARACTERISTIC CcVCT_BMSMinimumTempNumberORV_n "" VALUE 0x70010971 Scalar_UBYTE 0 VBU0706_CM_uint8_n 0.0 255.0 /end CHARACTERISTIC
/begin CHARACTERISTIC CcVCT_BMSRollingCounter225ORV_n "" VALUE 0x70010972 Scalar_UBYTE 0 VBU0706_CM_uint8_n 0.0 255.0 /end CHARACTERISTIC
/begin CHARACTERISTIC CeVCT_BMSBMSRollingCounterORV_enum "" VALUE 0x70010973 Scalar_UBYTE 0 VBU0706_CM_uint8_enum 0.0 255.0 /end CHARACTERISTIC
/begin CHARACTERISTIC CeVCT_BMSCellVoltageOverUnderORV_enum "" VALUE 0x70010975 Scalar_UBYTE 0 VBU0706_CM_uint8_enum 0.0 255.0 /end CHARACTERISTIC
/begin CHARACTERISTIC CeVCT_BMSContactorStateORV_enum "" VALUE 0x70010976 Scalar_UBYTE 0 VBU0706_CM_uint8_enum 0.0 255.0 /end CHARACTERISTIC
/begin CHARACTERISTIC CeVCT_BMSDCChargeCurrentOverUnderORV_enum "" VALUE 0x70010977 Scalar_UBYTE 0 VBU0706_CM_uint8_enum 0.0 255.0 /end CHARACTERISTIC
/begin CHARACTERISTIC CeVCT_BMSFaultCatORV_enum "" VALUE 0x70010978 Scalar_UBYTE 0 VBU0706_CM_uint8_enum 0.0 255.0 /end CHARACTERISTIC
/begin CHARACTERISTIC CeVCT_BMSFaultLvlORV_enum "" VALUE 0x70010979 Scalar_UBYTE 0 VBU0706_CM_uint8_enum 0.0 255.0 /end CHARACTERISTIC
/begin CHARACTERISTIC CeVCT_BMSSOCOverUnderORV_enum "" VALUE 0x7001097a Scalar_UBYTE 0 VBU0706_CM_uint8_enum 0.0 255.0 /end CHARACTERISTIC
/begin CHARACTERISTIC CeVCT_BMSStsORV_enum "" VALUE 0x7001097b Scalar_UBYTE 0 VBU0706_CM_uint8_enum 0.0 255.0 /end CHARACTERISTIC
/begin CHARACTERISTIC CeVCT_BatteryConsistencyAlarmORV_enum "" VALUE 0x7001097c Scalar_UBYTE 0 VBU0706_CM_uint8_enum 0.0 255.0 /end CHARACTERISTIC
/begin CHARACTERISTIC CeVCT_BatteryOutputConnectorStateORV_enum "" VALUE 0x7001097d Scalar_UBYTE 0 VBU0706_CM_uint8_enum 0.0 255.0 /end CHARACTERISTIC
/begin CHARACTERISTIC CeVCT_BatteryTempDifferAlarmORV_enum "" VALUE 0x7001097e Scalar_UBYTE 0 VBU0706_CM_uint8_enum 0.0 255.0 /end CHARACTERISTIC
/begin CHARACTERISTIC CeVCT_BatteryTempOverORV_enum "" VALUE 0x7001097f Scalar_UBYTE 0 VBU0706_CM_uint8_enum 0.0 255.0 /end CHARACTERISTIC
/begin CHARACTERISTIC CeVCT_BatteryTypeDismatchAlarmORV_enum "" VALUE 0x70010980 Scalar_UBYTE 0 VBU0706_CM_uint8_enum 0.0 255.0 /end CHARACTERISTIC
/begin CHARACTERISTIC CeVCT_BetteryCellTempHighAlarmORV_enum "" VALUE 0x70010981 Scalar_UBYTE 0 VBU0706_CM_uint8_enum 0.0 255.0 /end CHARACTERISTIC
/begin CHARACTERISTIC CeVCT_BetteryCellTempLowAlarmORV_enum "" VALUE 0x70010982 Scalar_UBYTE 0 VBU0706_CM_uint8_enum 0.0 255.0 /end CHARACTERISTIC
/begin CHARACTERISTIC CeVCT_BetteryCellVolHighAlarmORV_enum "" VALUE 0x70010983 Scalar_UBYTE 0 VBU0706_CM_uint8_enum 0.0 255.0 /end CHARACTERISTIC
/begin CHARACTERISTIC CeVCT_BetteryCellVolLowAlarmORV_enum "" VALUE 0x70010984 Scalar_UBYTE 0 VBU0706_CM_uint8_enum 0.0 255.0 /end CHARACTERISTIC
/begin CHARACTERISTIC CeVCT_BetteryPckVoltOverAlarmORV_enum "" VALUE 0x70010985 Scalar_UBYTE 0 VBU0706_CM_uint8_enum 0.0 255.0 /end CHARACTERISTIC
/begin CHARACTERISTIC CeVCT_BetteryPckVoltUnderAlarmORV_enum "" VALUE 0x70010986 Scalar_UBYTE 0 VBU0706_CM_uint8_enum 0.0 255.0 /end CHARACTERISTIC
/begin CHARACTERISTIC CeVCT_CTDMnNegContactorWeldORV_enum "" VALUE 0x70010987 Scalar_UBYTE 0 VBU0706_CM_uint8_enum 0.0 255.0 /end CHARACTERISTIC
/begin CHARACTERISTIC CeVCT_CTDMnPosContactorWeldORV_enum "" VALUE 0x70010988 Scalar_UBYTE 0 VBU0706_CM_uint8_enum 0.0 255.0 /end CHARACTERISTIC
/begin CHARACTERISTIC CeVCT_CTDPrechargeEnergyHighORV_enum "" VALUE 0x70010989 Scalar_UBYTE 0 VBU0706_CM_uint8_enum 0.0 255.0 /end CHARACTERISTIC
/begin CHARACTERISTIC CeVCT_CTDPrechargeRelayBlownORV_enum "" VALUE 0x7001098a Scalar_UBYTE 0 VBU0706_CM_uint8_enum 0.0 255.0 /end CHARACTERISTIC
/begin CHARACTERISTIC CeVCT_CTDPrechargeRelayStuckOpenORV_enum "" VALUE 0x7001098b Scalar_UBYTE 0 VBU0706_CM_uint8_enum 0.0 255.0 /end CHARACTERISTIC
/begin CHARACTERISTIC CeVCT_CTDPrechargeTimeoutORV_enum "" VALUE 0x7001098c Scalar_UBYTE 0 VBU0706_CM_uint8_enum 0.0 255.0 /end CHARACTERISTIC
/begin CHARACTERISTIC CeVCT_CTMCellThermalRunawayORV_enum "" VALUE 0x7001098d Scalar_UBYTE 0 VBU0706_CM_uint8_enum 0.0 255.0 /end CHARACTERISTIC
/begin CHARACTERISTIC CeVCT_DCChargingPermitStatusORV_enum "" VALUE 0x7001098e Scalar_UBYTE 0 VBU0706_CM_uint8_enum 0.0 255.0 /end CHARACTERISTIC
/begin CHARACTERISTIC CeVCT_InhibitPrechargeCauseORV_enum "" VALUE 0x7001098f Scalar_UBYTE 0 VBU0706_CM_uint8_enum 0.0 255.0 /end CHARACTERISTIC
/begin CHARACTERISTIC CeVCT_SOCJumpAlarmORV_enum "" VALUE 0x70010990 Scalar_UBYTE 0 VBU0706_CM_uint8_enum 0.0 255.0 /end CHARACTERISTIC
/begin CHARACTERISTIC CeVCT_SOCJumpReasonORV_enum "" VALUE 0x70010991 Scalar_UBYTE 0 VBU0706_CM_uint8_enum 0.0 255.0 /end CHARACTERISTIC
/begin CHARACTERISTIC DCH_stSysIsoCriticalFault_SY "" VALUE 0x70010a5e Scalar_UBYTE 0 VBU0706_CM_uint8_cnt 0.0 255.0 /end CHARACTERISTIC
/begin CHARACTERISTIC DCH_stVehIsoCriticalFault_SY "" VALUE 0x70010a60 Scalar_UBYTE 0 VBU0706_CM_uint8_cnt 0.0 255.0 /end CHARACTERISTIC
/begin CHARACTERISTIC NVM_EEPROM_CRC_CHECK_FAULT "" VALUE 0x70010b31 Scalar_UBYTE 0 VBU0706_CM_uint8_cnt 0.0 255.0 /end CHARACTERISTIC
/begin CHARACTERISTIC PMM_stActvDisCh_SY "" VALUE 0x70010b57 Scalar_UBYTE 0 VBU0706_CM_uint8_cnt 0.0 255.0 /end CHARACTERISTIC
/begin CHARACTERISTIC PMM_stDCDCDisbl_SY "" VALUE 0x70010b59 Scalar_UBYTE 0 VBU0706_CM_uint8_cnt 0.0 255.0 /end CHARACTERISTIC
/begin CHARACTERISTIC PMM_stHVCntctStClosed_SY "" VALUE 0x70010b5e Scalar_UBYTE 0 VBU0706_CM_uint8_cnt 0.0 255.0 /end CHARACTERISTIC
/begin CHARACTERISTIC PMM_stHVCntctStInit_SY "" VALUE 0x70010b5f Scalar_UBYTE 0 VBU0706_CM_uint8_cnt 0.0 255.0 /end CHARACTERISTIC
/begin CHARACTERISTIC PMM_stHVCntctStPreCh_SY "" VALUE 0x70010b60 Scalar_UBYTE 0 VBU0706_CM_uint8_cnt 0.0 255.0 /end CHARACTERISTIC
/begin CHARACTERISTIC PMM_stHVRlyClose_SY "" VALUE 0x70010b61 Scalar_UBYTE 0 VBU0706_CM_uint8_cnt 0.0 255.0 /end CHARACTERISTIC
/begin CHARACTERISTIC PMM_stHVRlyConnReq_SY "" VALUE 0x70010b62 Scalar_UBYTE 0 VBU0706_CM_uint8_cnt 0.0 255.0 /end CHARACTERISTIC
/begin CHARACTERISTIC PMM_stHVRlyConn_SY "" VALUE 0x70010b63 Scalar_UBYTE 0 VBU0706_CM_uint8_cnt 0.0 255.0 /end CHARACTERISTIC
/begin CHARACTERISTIC PMM_stHVRlyNoReq_SY "" VALUE 0x70010b64 Scalar_UBYTE 0 VBU0706_CM_uint8_cnt 0.0 255.0 /end CHARACTERISTIC
/begin CHARACTERISTIC PMM_stHVRlyOpenReq_SY "" VALUE 0x70010b65 Scalar_UBYTE 0 VBU0706_CM_uint8_cnt 0.0 255.0 /end CHARACTERISTIC
/begin CHARACTERISTIC PMM_stHVRlyOpen_SY "" VALUE 0x70010b66 Scalar_UBYTE 0 VBU0706_CM_uint8_cnt 0.0 255.0 /end CHARACTERISTIC
/begin CHARACTERISTIC PMM_stInitRst_SY "" VALUE 0x70010b6a Scalar_UBYTE 0 VBU0706_CM_uint8_cnt 0.0 255.0 /end CHARACTERISTIC
/begin CHARACTERISTIC PMM_stMCUACOff_SY "" VALUE 0x70010b6b Scalar_UBYTE 0 VBU0706_CM_uint8_cnt 0.0 255.0 /end CHARACTERISTIC
/begin CHARACTERISTIC PMM_stRstKeep_SY "" VALUE 0x70010b71 Scalar_UBYTE 0 VBU0706_CM_uint8_cnt 0.0 255.0 /end CHARACTERISTIC
/begin CHARACTERISTIC SOH_CELL_CAPACITY_OVER_DEVIATION_FAULT "" VALUE 0x70010b89 Scalar_UBYTE 0 VBU0706_CM_uint8_cnt 0.0 255.0 /end CHARACTERISTIC
/begin CHARACTERISTIC SPD_stMovDirBwrd_SY "" VALUE 0x70010b8b Scalar_UBYTE 0 VBU0706_CM_uint8_cnt 0.0 255.0 /end CHARACTERISTIC
/begin CHARACTERISTIC SPD_stMovDirFwrd_SY "" VALUE 0x70010b8c Scalar_UBYTE 0 VBU0706_CM_uint8_cnt 0.0 255.0 /end CHARACTERISTIC
/begin CHARACTERISTIC SPD_stMovDirInvd_SY "" VALUE 0x70010b8d Scalar_UBYTE 0 VBU0706_CM_uint8_cnt 0.0 255.0 /end CHARACTERISTIC
/begin CHARACTERISTIC SPD_stMovDirStdstill_SY "" VALUE 0x70010b8e Scalar_UBYTE 0 VBU0706_CM_uint8 0 255 /end CHARACTERISTIC
/begin MEASUREMENT LcCTD_tiPrechargeHeatProtectionTime "" ULONG VBU0706_CM_uint32 0 0 0 4294967295 ECU_ADDRESS 0x700116f2 /end MEASUREMENT
/begin MEASUREMENT THM_tInletCoolantTemp "" FLOAT32_IEEE VBU0706_CM_single 0 0 -3.4E+38 3.4E+38 ECU_ADDRESS 0x70011972 /end MEASUREMENT
/begin MEASUREMENT THM_tOutletCoolantTemp "" FLOAT32_IEEE VBU0706_CM_single 0 0 -3.4E+38 3.4E+38 ECU_ADDRESS 0x7001197a /end MEASUREMENT
/begin MEASUREMENT SOF_uPackChargeOcv "" FLOAT32_IEEE VBU0706_CM_single 0 0 -3.4E+38 3.4E+38 ECU_ADDRESS 0x700118e2 /end MEASUREMENT
/begin MEASUREMENT SOF_uPackDischargeOcv "" FLOAT32_IEEE VBU0706_CM_single 0 0 -3.4E+38 3.4E+38 ECU_ADDRESS 0x700118e6 /end MEASUREMENT
/begin MEASUREMENT LcSOF_kwChargePowerLimitCycle "" FLOAT32_IEEE VBU0706_CM_single 0 0 -3.4E+38 3.4E+38 ECU_ADDRESS 0x7001170e /end MEASUREMENT
/begin MEASUREMENT SOE_kwhPackRemainingEnergySoc "" FLOAT32_IEEE VBU0706_CM_single 0 0 -3.4E+38 3.4E+38 ECU_ADDRESS 0x700117e2 /end MEASUREMENT
/begin MEASUREMENT SOC_pctCellBatterySOCDeviation "" FLOAT32_IEEE VBU0706_CM_single 0 0 -3.4E+38 3.4E+38 ECU_ADDRESS 0x700117c6 /end MEASUREMENT
/begin MEASUREMENT LcCTD_PrechargeJouleHeat_J "" FLOAT32_IEEE VBU0706_CM_single 0 0 -3.4E+38 3.4E+38 ECU_ADDRESS 0x700116ee /end MEASUREMENT
/begin MEASUREMENT BCV_AhOverallCoulombFCCChgCarry "" FLOAT32_IEEE VBU0706_CM_single 0 0 -3.4E+38 3.4E+38 ECU_ADDRESS 0x70011442 /end MEASUREMENT
/begin MEASUREMENT INP_uBrkPres "" FLOAT32_IEEE VBU0706_CM_single 0 0 0.0 5000.0 ECU_ADDRESS 0x700116c2 /end MEASUREMENT
/begin MEASUREMENT INP_pVacPres "" FLOAT32_IEEE VBU0706_CM_single 0 0 0.0 5000.0 ECU_ADDRESS 0x700116a2 /end MEASUREMENT
/begin MEASUREMENT OP_fLsWaterPump1 "" FLOAT32_IEEE VBU0706_CM_single 0 0 -3.4E+38 3.4E+38 ECU_ADDRESS 0x70011762 /end MEASUREMENT
/begin MEASUREMENT THM_tCoolTar "" FLOAT32_IEEE VBU0706_CM_single 0 0 -3.4E+38 3.4E+38 ECU_ADDRESS 0x7001196a /end MEASUREMENT
/begin MEASUREMENT THM_tHeatTar "" FLOAT32_IEEE VBU0706_CM_single 0 0 -3.4E+38 3.4E+38 ECU_ADDRESS 0x7001196e /end MEASUREMENT
/begin MEASUREMENT INP_tEDSInletCoolTemp "" FLOAT32_IEEE VBU0706_CM_single 0 0 -100.0 200.0 ECU_ADDRESS 0x700116b6 /end MEASUREMENT
/begin MEASUREMENT THM_pctESSPumpReq "" FLOAT32_IEEE VBU0706_CM_single 0 0 -3.4E+38 3.4E+38 ECU_ADDRESS 0x70011946 /end MEASUREMENT
/begin MEASUREMENT OP_pctLsWaterPump1 "" FLOAT32_IEEE VBU0706_CM_single 0 0 -3.4E+38 3.4E+38 ECU_ADDRESS 0x7001177a /end MEASUREMENT
/begin MEASUREMENT OP_fLsWaterPump2 "" FLOAT32_IEEE VBU0706_CM_single 0 0 -3.4E+38 3.4E+38 ECU_ADDRESS 0x70011766 /end MEASUREMENT
/begin MEASUREMENT THM_pctRearPumpReq "" FLOAT32_IEEE VBU0706_CM_single 0 0 -3.4E+38 3.4E+38 ECU_ADDRESS 0x7001195e /end MEASUREMENT
/begin MEASUREMENT OP_pctLsWaterPump2 "" FLOAT32_IEEE VBU0706_CM_single 0 0 -3.4E+38 3.4E+38 ECU_ADDRESS 0x7001177e /end MEASUREMENT
/begin MEASUREMENT OP_fLsFan "" FLOAT32_IEEE VBU0706_CM_single 0 0 -3.4E+38 3.4E+38 ECU_ADDRESS 0x7001175a /end MEASUREMENT
/begin MEASUREMENT THM_nACSpdSet "" FLOAT32_IEEE VBU0706_CM_single 0 0 -3.4E+38 3.4E+38 ECU_ADDRESS 0x7001193a /end MEASUREMENT
/begin MEASUREMENT THM_pctFANRaw "" FLOAT32_IEEE VBU0706_CM_single 0 0 -3.4E+38 3.4E+38 ECU_ADDRESS 0x70011952 /end MEASUREMENT
/begin MEASUREMENT OP_pctLsFan "" FLOAT32_IEEE VBU0706_CM_single 0 0 -3.4E+38 3.4E+38 ECU_ADDRESS 0x70011772 /end MEASUREMENT
/begin MEASUREMENT THM_pctEXVPosReq "" FLOAT32_IEEE VBU0706_CM_single 0 0 -3.4E+38 3.4E+38 ECU_ADDRESS 0x7001194a /end MEASUREMENT
/begin MEASUREMENT OP_pctLsACPump "" FLOAT32_IEEE VBU0706_CM_single 0 0 -3.4E+38 3.4E+38 ECU_ADDRESS 0x7001176e /end MEASUREMENT
/begin MEASUREMENT OP_fLsACPump "" FLOAT32_IEEE VBU0706_CM_single 0 0 -3.4E+38 3.4E+38 ECU_ADDRESS 0x70011756 /end MEASUREMENT
/begin MEASUREMENT OP_pctLsHVIL1 "" FLOAT32_IEEE VBU0706_CM_single 0 0 -3.4E+38 3.4E+38 ECU_ADDRESS 0x70011776 /end MEASUREMENT
/begin MEASUREMENT OP_fLsHVIL1 "" FLOAT32_IEEE VBU0706_CM_single 0 0 -3.4E+38 3.4E+38 ECU_ADDRESS 0x7001175e /end MEASUREMENT
/begin MEASUREMENT SPD_nDeltaRALR "" FLOAT32_IEEE VBU0706_CM_single 0 0 -3.4E+38 3.4E+38 ECU_ADDRESS 0x70011906 /end MEASUREMENT
/begin MEASUREMENT INP_tDCChPortPosTemp "" FLOAT32_IEEE VBU0706_CM_single 0 0 -100.0 200.0 ECU_ADDRESS 0x700116b2 /end MEASUREMENT
/begin MEASUREMENT INP_fHVILFrq "" FLOAT32_IEEE VBU0706_CM_single 0 0 -3.4E+38 3.4E+38 ECU_ADDRESS 0x7001169e /end MEASUREMENT
/begin MEASUREMENT INP_pctHVILDty "" FLOAT32_IEEE VBU0706_CM_single 0 0 0.0 100.0 ECU_ADDRESS 0x700116aa /end MEASUREMENT
/begin MEASUREMENT INP_uAccPed1 "" FLOAT32_IEEE VBU0706_CM_single 0 0 0.0 5000.0 ECU_ADDRESS 0x700116ba /end MEASUREMENT
/begin MEASUREMENT INP_uAccPed2 "" FLOAT32_IEEE VBU0706_CM_single 0 0 0.0 5000.0 ECU_ADDRESS 0x700116be /end MEASUREMENT
/begin MEASUREMENT SPD_vVehSpdSlp "" FLOAT32_IEEE VBU0706_CM_single 0 0 -3.4E+38 3.4E+38 ECU_ADDRESS 0x7001192e /end MEASUREMENT
/begin MEASUREMENT SPD_nDSpdTarFR "" FLOAT32_IEEE VBU0706_CM_single 0 0 -3.4E+38 3.4E+38 ECU_ADDRESS 0x70011902 /end MEASUREMENT
/begin MEASUREMENT SPD_nRA "" FLOAT32_IEEE VBU0706_CM_single 0 0 -3.4E+38 3.4E+38 ECU_ADDRESS 0x70011912 /end MEASUREMENT
/begin MEASUREMENT SPD_nFA "" FLOAT32_IEEE VBU0706_CM_single 0 0 -3.4E+38 3.4E+38 ECU_ADDRESS 0x7001190a /end MEASUREMENT
/begin MEASUREMENT SPD_nFARADelta "" FLOAT32_IEEE VBU0706_CM_single 0 0 -3.4E+38 3.4E+38 ECU_ADDRESS 0x7001190e /end MEASUREMENT
/begin MEASUREMENT INP_tDCChPortNegTemp "" FLOAT32_IEEE VBU0706_CM_single 0 0 -100.0 200.0 ECU_ADDRESS 0x700116ae /end MEASUREMENT
/begin MEASUREMENT INP_uDCCHCC2 "" FLOAT32_IEEE VBU0706_CM_single 0 0 0.0 30.0 ECU_ADDRESS 0x700116ca /end MEASUREMENT
/begin MEASUREMENT INP_pctBattPresDty "" FLOAT32_IEEE VBU0706_CM_single 0 0 -3.4E+38 3.4E+38 ECU_ADDRESS 0x700116a6 /end MEASUREMENT
/begin MEASUREMENT INP_fBattPresFrq "" FLOAT32_IEEE VBU0706_CM_single 0 0 -3.4E+38 3.4E+38 ECU_ADDRESS 0x7001169a /end MEASUREMENT
/begin MEASUREMENT TQD_pctAccPedPosFlt "" FLOAT32_IEEE VBU0706_CM_single 0 0 0.0 100.0 ECU_ADDRESS 0x70011a42 /end MEASUREMENT
/begin MEASUREMENT TQD_trqRoad "" FLOAT32_IEEE VBU0706_CM_single 0 0 -10000.0 10000.0 ECU_ADDRESS 0x70011a76 /end MEASUREMENT
/begin MEASUREMENT TQD_trqDesWeighted "" FLOAT32_IEEE VBU0706_CM_single 0 0 -10000.0 10000.0 ECU_ADDRESS 0x70011a6a /end MEASUREMENT
/begin MEASUREMENT TQD_trqDesDecel "" FLOAT32_IEEE VBU0706_CM_single 0 0 -10000.0 10000.0 ECU_ADDRESS 0x70011a62 /end MEASUREMENT
/begin MEASUREMENT TQD_trqDemRegen "" FLOAT32_IEEE VBU0706_CM_single 0 0 -10000.0 10000.0 ECU_ADDRESS 0x70011a5a /end MEASUREMENT
/begin MEASUREMENT TQD_trqNrmDes "" FLOAT32_IEEE VBU0706_CM_single 0 0 -10000.0 10000.0 ECU_ADDRESS 0x70011a72 /end MEASUREMENT
/begin MEASUREMENT TQD_facDesTrqGr "" FLOAT32_IEEE VBU0706_CM_single 0 0 0.0 1.0 ECU_ADDRESS 0x70011a3a /end MEASUREMENT
/begin MEASUREMENT TQD_trqDesRaw "" FLOAT32_IEEE VBU0706_CM_single 0 0 -10000.0 10000.0 ECU_ADDRESS 0x70011a66 /end MEASUREMENT
/begin MEASUREMENT TQD_trqZrPed "" FLOAT32_IEEE VBU0706_CM_single 0 0 -3.4E+38 3.4E+38 ECU_ADDRESS 0x70011a7a /end MEASUREMENT
/begin MEASUREMENT SPD_aXSlope "" FLOAT32_IEEE VBU0706_CM_single 0 0 -3.4E+38 3.4E+38 ECU_ADDRESS 0x700118fe /end MEASUREMENT
/begin MEASUREMENT PMM_tiStDurT "" FLOAT32_IEEE VBU0706_CM_single 0 0 -3.4E+38 3.4E+38 ECU_ADDRESS 0x7001179e /end MEASUREMENT
/begin MEASUREMENT EDIS_pwrAcsyAct "" FLOAT32_IEEE VBU0706_CM_single 0 0 0.0 1000.0 ECU_ADDRESS 0x70011566 /end MEASUREMENT
/begin MEASUREMENT EDIS_pwrDrvPwrLimDrvMode "" FLOAT32_IEEE VBU0706_CM_single 0 0 -3.4E+38 3.4E+38 ECU_ADDRESS 0x700115be /end MEASUREMENT
/begin MEASUREMENT DCDC_pwrLVOut "" FLOAT32_IEEE VBU0706_CM_single 0 0 -3.4E+38 3.4E+38 ECU_ADDRESS 0x70011502 /end MEASUREMENT
/begin MEASUREMENT DCDC_pwrHVInput "" FLOAT32_IEEE VBU0706_CM_single 0 0 -3.4E+38 3.4E+38 ECU_ADDRESS 0x700114fe /end MEASUREMENT
/begin MEASUREMENT PEUR_trqMaxLimit "" FLOAT32_IEEE VBU0706_CM_single 0 0 -3.4E+38 3.4E+38 ECU_ADDRESS 0x70011796 /end MEASUREMENT
/begin MEASUREMENT PEUR_trqAct "" FLOAT32_IEEE VBU0706_CM_single 0 0 -3.4E+38 3.4E+38 ECU_ADDRESS 0x70011792 /end MEASUREMENT
/begin MEASUREMENT EXV_St_Voltage "" FLOAT32_IEEE VBU0706_CM_single 0 0 -3.4E+38 3.4E+38 ECU_ADDRESS 0x700115fa /end MEASUREMENT
/begin MEASUREMENT CTD_stRnMnPosContactorStuckOpenFault "" UWORD VBU0706_CM_uint16 0 0 0 65535 ECU_ADDRESS 0x700111fe /end MEASUREMENT
/begin MEASUREMENT CTD_stMnPosContactorStuckOpenFault "" UWORD VBU0706_CM_uint16 0 0 0 65535 ECU_ADDRESS 0x700111f0 /end MEASUREMENT
/begin MEASUREMENT CTD_stMnNegContactorStuckOpenFault "" UWORD VBU0706_CM_uint16 0 0 0 65535 ECU_ADDRESS 0x700111ee /end MEASUREMENT
/begin MEASUREMENT CTD_stRnMnNegContactorStuckOpenFault "" UWORD VBU0706_CM_uint16 0 0 0 65535 ECU_ADDRESS 0x700111fc /end MEASUREMENT
/begin MEASUREMENT CTD_stPrechargeEnergyHighFault "" UWORD VBU0706_CM_uint16 0 0 0 65535 ECU_ADDRESS 0x700111f4 /end MEASUREMENT
/begin MEASUREMENT VCT_stBatteryAbnormalAlarm1 "" UBYTE VBU0706_CM_uint8 0 0 0 255 ECU_ADDRESS 0x70011f37 /end MEASUREMENT
/begin MEASUREMENT VCT_stBatteryAbnormalAlarm2 "" UBYTE VBU0706_CM_uint8 0 0 0 255 ECU_ADDRESS 0x70011f38 /end MEASUREMENT
/begin MEASUREMENT VCT_stBatteryAbnormalAlarm3 "" UBYTE VBU0706_CM_uint8 0 0 0 255 ECU_ADDRESS 0x70011f39 /end MEASUREMENT
/begin MEASUREMENT VCT_stCTDPrechargeTimeout "" UBYTE VBU0706_CM_uint8 0 0 0 255 ECU_ADDRESS 0x70011f4a /end MEASUREMENT
/begin MEASUREMENT VCT_stCTDPrechargeEnergyHigh "" UBYTE VBU0706_CM_uint8 0 0 0 255 ECU_ADDRESS 0x70011f47 /end MEASUREMENT
/begin MEASUREMENT VCT_stCTDPrechargeRelayBlown "" UBYTE VBU0706_CM_uint8 0 0 0 255 ECU_ADDRESS 0x70011f48 /end MEASUREMENT
/begin MEASUREMENT VCT_stCTDPrechargeRelayStuckOpen "" UBYTE VBU0706_CM_uint8 0 0 0 255 ECU_ADDRESS 0x70011f49 /end MEASUREMENT
/begin MEASUREMENT VCT_stCTDMnPosContactorWeld "" UBYTE VBU0706_CM_uint8 0 0 0 255 ECU_ADDRESS 0x70011f46 /end MEASUREMENT
/begin MEASUREMENT VCT_stCTDMnNegContactorWeld "" UBYTE VBU0706_CM_uint8 0 0 0 255 ECU_ADDRESS 0x70011f45 /end MEASUREMENT
/begin MEASUREMENT SOC_stBatterySocJump "" UBYTE VBU0706_CM_uint8 0 0 0 255 ECU_ADDRESS 0x70011ee4 /end MEASUREMENT
/begin MEASUREMENT CTD_stPrechargeRelayStuckOpenDiagnosticStatus "" UBYTE VBU0706_CM_uint8 0 0 0 255 ECU_ADDRESS 0x70011d3e /end MEASUREMENT
/begin MEASUREMENT CTD_stMnPosContactorWeldDiagnosticStatus "" UBYTE VBU0706_CM_uint8 0 0 0 255 ECU_ADDRESS 0x70011d3c /end MEASUREMENT
/begin MEASUREMENT CTD_stMnNegContactorWeldDiagnosticStatus "" UBYTE VBU0706_CM_uint8 0 0 0 255 ECU_ADDRESS 0x70011d3a /end MEASUREMENT
/begin MEASUREMENT THM_stOperateMode "" UBYTE VBU0706_CM_uint8 0 0 0 255 ECU_ADDRESS 0x70011f09 /end MEASUREMENT
/begin MEASUREMENT THM_stOperateCycle "" UBYTE VBU0706_CM_uint8 0 0 0 255 ECU_ADDRESS 0x70011f08 /end MEASUREMENT
/begin MEASUREMENT INP_stHVILDty "" UBYTE VBU0706_CM_uint8 0 0 0.0 255.0 ECU_ADDRESS 0x70011e44 /end MEASUREMENT
/begin MEASUREMENT INP_stHVILFrq "" UBYTE VBU0706_CM_uint8 0 0 0.0 255.0 ECU_ADDRESS 0x70011e45 /end MEASUREMENT
/begin MEASUREMENT INP_stBattPresDty "" UBYTE VBU0706_CM_uint8 0 0 0 255 ECU_ADDRESS 0x70011e42 /end MEASUREMENT
/begin MEASUREMENT INP_stBattPresFrq "" UBYTE VBU0706_CM_uint8 0 0 0 255 ECU_ADDRESS 0x70011e43 /end MEASUREMENT
/begin MEASUREMENT FPV_st4WayVlvPosFdbk "" UBYTE VBU0706_CM_uint8 0 0 0 255 ECU_ADDRESS 0x70011df6 /end MEASUREMENT
/begin MEASUREMENT TQD_stVehCreepMode "" UBYTE VBU0706_CM_uint8 0 0 0.0 15.0 ECU_ADDRESS 0x70011f17 /end MEASUREMENT
/begin MEASUREMENT SPD_stAX "" UBYTE VBU0706_CM_uint8 0 0 0.0 15.0 ECU_ADDRESS 0x70011ef3 /end MEASUREMENT
/begin MEASUREMENT PMM_stHVRlyReqTmp "" UBYTE VBU0706_CM_uint8 0 0 0 255 ECU_ADDRESS 0x70011eba /end MEASUREMENT
/begin MEASUREMENT PMM_stPwrModeSt "" UBYTE VBU0706_CM_uint8 0 0 0 255 ECU_ADDRESS 0x70011ebc /end MEASUREMENT
/begin MEASUREMENT FPV_VoltState "" UBYTE VBU0706_CM_uint8 0 0 0 255 ECU_ADDRESS 0x70011df5 /end MEASUREMENT
/begin MEASUREMENT FPV_TempState "" UBYTE VBU0706_CM_uint8 0 0 0 255 ECU_ADDRESS 0x70011df4 /end MEASUREMENT
/begin MEASUREMENT FPV_FaultState "" UBYTE VBU0706_CM_uint8 0 0 0 255 ECU_ADDRESS 0x70011df1 /end MEASUREMENT
/begin MEASUREMENT FPV_CommError "" UBYTE VBU0706_CM_uint8 0 0 0 255 ECU_ADDRESS 0x70011df0 /end MEASUREMENT
/begin MEASUREMENT FPV_RunState "" UBYTE VBU0706_CM_uint8 0 0 0 255 ECU_ADDRESS 0x70011df3 /end MEASUREMENT
/begin MEASUREMENT FPV_Position "" UBYTE VBU0706_CM_uint8 0 0 0 255 ECU_ADDRESS 0x70011df2 /end MEASUREMENT
/begin MEASUREMENT EXV_St_Initial "" UBYTE VBU0706_CM_uint8 0 0 0 255 ECU_ADDRESS 0x70011dd4 /end MEASUREMENT
/begin MEASUREMENT EXV_St_Fault "" UBYTE VBU0706_CM_uint8 0 0 0 255 ECU_ADDRESS 0x70011dd3 /end MEASUREMENT
/begin MEASUREMENT EXV_N_Position "" UBYTE VBU0706_CM_uint8 0 0 0 255 ECU_ADDRESS 0x70011dd2 /end MEASUREMENT
/begin MEASUREMENT TP_CM_RX_CANRX_Cnt "" UBYTE VBU0706_CM_uint8 0 0 0 255 ECU_ADDRESS 0x70011f0a /end MEASUREMENT
/begin MEASUREMENT SOC_flgInternalResistanceCausedDevCellVoltage "" UBYTE VBU0706_CM_boolean 0 0 0 1 ECU_ADDRESS 0x70011ed6 /end MEASUREMENT
/begin MEASUREMENT SOC_flgFastChargeCorrectionEnable "" UBYTE VBU0706_CM_boolean 0 0 0 1 ECU_ADDRESS 0x70011ed5 /end MEASUREMENT
/begin MEASUREMENT THM_flgSystemCoolingAbilityDecrease "" UBYTE VBU0706_CM_boolean 0 0 0 1 ECU_ADDRESS 0x70011f03 /end MEASUREMENT
/begin MEASUREMENT SOF_flgCurrentLimitTargetCalculateEnable "" UBYTE VBU0706_CM_boolean 0 0 0 1 ECU_ADDRESS 0x70011ee7 /end MEASUREMENT
/begin MEASUREMENT LbSOC_EolFlashingInitialize_flg "" UBYTE VBU0706_CM_boolean 0 0 0 1 ECU_ADDRESS 0x70011e58 /end MEASUREMENT
/begin MEASUREMENT SOC_flgCellSOCArrayInvalid "" UBYTE VBU0706_CM_boolean 0 0 0 1 ECU_ADDRESS 0x70011ed3 /end MEASUREMENT
/begin MEASUREMENT DCH_flgBmsChCrntOver "" UBYTE VBU0706_CM_boolean 0 0 0.0 1.0 ECU_ADDRESS 0x70011d7b /end MEASUREMENT
/begin MEASUREMENT DCH_flgBmsIsoCriticalFault "" UBYTE VBU0706_CM_boolean 0 0 0.0 1.0 ECU_ADDRESS 0x70011d7c /end MEASUREMENT
/begin MEASUREMENT DCH_flgCC2Conn "" UBYTE VBU0706_CM_boolean 0 0 0.0 1.0 ECU_ADDRESS 0x70011d7d /end MEASUREMENT
/begin MEASUREMENT CTS_flgInhibitPrecharge "" UBYTE VBU0706_CM_boolean 0 0 0 1 ECU_ADDRESS 0x70011d4d /end MEASUREMENT
/begin MEASUREMENT CTS_flgAbortPrecharge "" UBYTE VBU0706_CM_boolean 0 0 0 1 ECU_ADDRESS 0x70011d47 /end MEASUREMENT
/begin MEASUREMENT LbCTD_RnMnPosContactorStuckOpenTestEnable_flg "" UBYTE VBU0706_CM_boolean 0 0 0 1 ECU_ADDRESS 0x70011e53 /end MEASUREMENT
/begin MEASUREMENT CTD_flgRnMnPosContactorStuckOpenTestFail "" UBYTE VBU0706_CM_boolean 0 0 0 1 ECU_ADDRESS 0x70011d36 /end MEASUREMENT
/begin MEASUREMENT CTD_flgRnMnNegContactorStuckOpenTestEnable "" UBYTE VBU0706_CM_boolean 0 0 0 1 ECU_ADDRESS 0x70011d34 /end MEASUREMENT
/begin MEASUREMENT CTD_flgRnMnNegContactorStuckOpenTestFail "" UBYTE VBU0706_CM_boolean 0 0 0 1 ECU_ADDRESS 0x70011d35 /end MEASUREMENT
/begin MEASUREMENT LbCTD_PrechargeEnergyHighTestEnable_flg "" UBYTE VBU0706_CM_boolean 0 0 0 1 ECU_ADDRESS 0x70011e51 /end MEASUREMENT
/begin MEASUREMENT LbCTD_PrechargeEnergyHighTestFail_flg "" UBYTE VBU0706_CM_boolean 0 0 0 1 ECU_ADDRESS 0x70011e52 /end MEASUREMENT
/begin MEASUREMENT BCV_flgBatteryVoltageValid "" UBYTE VBU0706_CM_boolean 0 0 0.0 1.0 ECU_ADDRESS 0x70011cf7 /end MEASUREMENT
/begin MEASUREMENT BCV_flgBusNegativeVoltageValid "" UBYTE VBU0706_CM_boolean 0 0 0 1 ECU_ADDRESS 0x70011cf8 /end MEASUREMENT
/begin MEASUREMENT BCV_flgBusVoltageValid "" UBYTE VBU0706_CM_boolean 0 0 0 1 ECU_ADDRESS 0x70011cf9 /end MEASUREMENT
/begin MEASUREMENT BCV_flgFuseVoltageValid "" UBYTE VBU0706_CM_boolean 0 0 0 1 ECU_ADDRESS 0x70011cfc /end MEASUREMENT
/begin MEASUREMENT BCV_flgPrechargeVoltageValid "" UBYTE VBU0706_CM_boolean 0 0 0 1 ECU_ADDRESS 0x70011cfd /end MEASUREMENT
/begin MEASUREMENT BCV_flgVx1VoltageValid "" UBYTE VBU0706_CM_boolean 0 0 0 1 ECU_ADDRESS 0x70011cfe /end MEASUREMENT
/begin MEASUREMENT BCV_flgVx2VoltageValid "" UBYTE VBU0706_CM_boolean 0 0 0 1 ECU_ADDRESS 0x70011cff /end MEASUREMENT
/begin MEASUREMENT BCV_flgBatteryCurrentValid "" UBYTE VBU0706_CM_boolean 0 0 0 1 ECU_ADDRESS 0x70011cf6 /end MEASUREMENT
/begin MEASUREMENT INP_flgBrkSwt "" UBYTE VBU0706_CM_boolean 0 0 0.0 1.0 ECU_ADDRESS 0x70011e3a /end MEASUREMENT
/begin MEASUREMENT INP_flgBrkLmpSwt "" UBYTE VBU0706_CM_boolean 0 0 0.0 1.0 ECU_ADDRESS 0x70011e39 /end MEASUREMENT
/begin MEASUREMENT OD_LsMainRly "" UBYTE VBU0706_CM_boolean 0 0 0 1 ECU_ADDRESS 0x70011e8c /end MEASUREMENT
/begin MEASUREMENT Veh_flgVacPumpReq "" UBYTE VBU0706_CM_boolean 0 0 0 1 ECU_ADDRESS 0x70011f51 /end MEASUREMENT
/begin MEASUREMENT OD_HsWakeUp1 "" UBYTE VBU0706_CM_boolean 0 0 0 1 ECU_ADDRESS 0x70011e8a /end MEASUREMENT
/begin MEASUREMENT INP_flgACMidPresSwitch "" UBYTE VBU0706_CM_boolean 0 0 0.0 1.0 ECU_ADDRESS 0x70011e38 /end MEASUREMENT
/begin MEASUREMENT INP_flgDriverACOn "" UBYTE VBU0706_CM_boolean 0 0 0.0 1.0 ECU_ADDRESS 0x70011e3d /end MEASUREMENT
/begin MEASUREMENT OD_flgVBUSleepEnable "" UBYTE VBU0706_CM_boolean 0 0 0 1 ECU_ADDRESS 0x70011e8d /end MEASUREMENT
/begin MEASUREMENT THM_flgEXVEna "" UBYTE VBU0706_CM_boolean 0 0 0.0 1.0 ECU_ADDRESS 0x70011efd /end MEASUREMENT
/begin MEASUREMENT BPD_flgBrkSwt "" UBYTE VBU0706_CM_boolean 0 0 0.0 1.0 ECU_ADDRESS 0x70011d0d /end MEASUREMENT
/begin MEASUREMENT INP_flgGearH1 "" UBYTE VBU0706_CM_boolean 0 0 0.0 1.0 ECU_ADDRESS 0x70011e3e /end MEASUREMENT
/begin MEASUREMENT INP_flgGearH2 "" UBYTE VBU0706_CM_boolean 0 0 0.0 1.0 ECU_ADDRESS 0x70011e3f /end MEASUREMENT
/begin MEASUREMENT INP_flgGearH3 "" UBYTE VBU0706_CM_boolean 0 0 0.0 1.0 ECU_ADDRESS 0x70011e40 /end MEASUREMENT
/begin MEASUREMENT INP_flgCrankConfirm "" UBYTE VBU0706_CM_boolean 0 0 0 1 ECU_ADDRESS 0x70011e3b /end MEASUREMENT
/begin MEASUREMENT TQD_flgSlideRst "" UBYTE VBU0706_CM_boolean 0 0 0.0 1.0 ECU_ADDRESS 0x70011f14 /end MEASUREMENT
/begin MEASUREMENT TQD_flgVirtualNeutral "" UBYTE VBU0706_CM_boolean 0 0 0.0 1.0 ECU_ADDRESS 0x70011f16 /end MEASUREMENT
/begin MEASUREMENT PMM_flgHVRLyCloseTimeOut "" UBYTE VBU0706_CM_boolean 0 0 0 1 ECU_ADDRESS 0x70011ea1 /end MEASUREMENT
/begin MEASUREMENT PMM_flgACTstTimeOut "" UBYTE VBU0706_CM_boolean 0 0 0 1 ECU_ADDRESS 0x70011e92 /end MEASUREMENT
/begin MEASUREMENT PMM_flgHVRlyOpenTimeOut "" UBYTE VBU0706_CM_boolean 0 0 0 1 ECU_ADDRESS 0x70011ea9 /end MEASUREMENT
/begin MEASUREMENT PMM_flgActvDisChTimeOut "" UBYTE VBU0706_CM_boolean 0 0 0 1 ECU_ADDRESS 0x70011e95 /end MEASUREMENT
/begin MEASUREMENT PMM_flgOffLoadTimeOut "" UBYTE VBU0706_CM_boolean 0 0 0 1 ECU_ADDRESS 0x70011eac /end MEASUREMENT
/begin MEASUREMENT PMM_flgAccDisable "" UBYTE VBU0706_CM_boolean 0 0 0 1 ECU_ADDRESS 0x70011e93 /end MEASUREMENT
/begin MEASUREMENT PMM_flgDCDCEna "" UBYTE VBU0706_CM_boolean 0 0 0 1 ECU_ADDRESS 0x70011e9a /end MEASUREMENT
/begin MEASUREMENT PEUR_flgMotrSpdVld "" UBYTE VBU0706_CM_boolean 0 0 0.0 1.0 ECU_ADDRESS 0x70011e90 /end MEASUREMENT
/begin MEASUREMENT EXV_St_Running "" UBYTE VBU0706_CM_boolean 0 0 0 1 ECU_ADDRESS 0x70011dd5 /end MEASUREMENT
/begin MEASUREMENT EXV_F_Response "" UBYTE VBU0706_CM_boolean 0 0 0 1 ECU_ADDRESS 0x70011dd1 /end MEASUREMENT
/begin MEASUREMENT EXV_W_OverTemp "" UBYTE VBU0706_CM_boolean 0 0 0 1 ECU_ADDRESS 0x70011dd6 /end MEASUREMENT
/begin MEASUREMENT SPD_tiStAx "" FLOAT32_IEEE VBU0706_CM_single 0 0 -3.4E+38 3.4E+38 ECU_ADDRESS 0x7001191a /end MEASUREMENT
/begin COMPU_METHOD VBU0706_CM_single_cnt "Q = V" RAT_FUNC "%8.6" "cnt" COEFFS 0 1 0 0 0 1 /end COMPU_METHOD
/begin COMPU_METHOD VBU0706_CM_uint16_cnt "Q = V" RAT_FUNC "%5.0" "cnt" COEFFS 0 1 0 0 0 1 /end COMPU_METHOD
/begin COMPU_METHOD VBU0706_CM_single_Nm "Q = V" RAT_FUNC "%8.6" "Nm" COEFFS 0 1 0 0 0 1 /end COMPU_METHOD
/begin COMPU_METHOD VBU0706_CM_single_kph "Q = V" RAT_FUNC "%8.6" "kph" COEFFS 0 1 0 0 0 1 /end COMPU_METHOD
/begin COMPU_METHOD VBU0706_CM_single_v "Q = V" RAT_FUNC "%8.6" "v" COEFFS 0 1 0 0 0 1 /end COMPU_METHOD
/begin COMPU_METHOD VBU0706_CM_single_pct "Q = V" RAT_FUNC "%8.6" "pct" COEFFS 0 1 0 0 0 1 /end COMPU_METHOD
/begin COMPU_METHOD VBU0706_CM_single_t "Q = V" RAT_FUNC "%8.6" "t" COEFFS 0 1 0 0 0 1 /end COMPU_METHOD
/begin COMPU_METHOD VBU0706_CM_single_A "Q = V" RAT_FUNC "%8.6" "A" COEFFS 0 1 0 0 0 1 /end COMPU_METHOD
/begin COMPU_METHOD VBU0706_CM_double_cnt "Q = V" RAT_FUNC "%15.10" "cnt" COEFFS 0 1 0 0 0 1 /end COMPU_METHOD
/begin COMPU_METHOD VBU0706_CM_single_V "Q = V" RAT_FUNC "%8.6" "V" COEFFS 0 1 0 0 0 1 /end COMPU_METHOD
/begin COMPU_METHOD VBU0706_CM_uint16 "Q = V" RAT_FUNC "%5.0" "" COEFFS 0 1 0 0 0 1 /end COMPU_METHOD
/begin COMPU_METHOD VBU0706_CM_uint8 "Q = V" RAT_FUNC "%3.0" "" COEFFS 0 1 0 0 0 1 /end COMPU_METHOD
/begin COMPU_METHOD VBU0706_CM_single "Q = V" RAT_FUNC "%8.6" "" COEFFS 0 1 0 0 0 1 /end COMPU_METHOD
/begin COMPU_METHOD VBU0706_CM_single_Kw "Q = V" RAT_FUNC "%8.6" "Kw" COEFFS 0 1 0 0 0 1 /end COMPU_METHOD
/begin COMPU_METHOD VBU0706_CM_single_min "Q = V" RAT_FUNC "%8.6" "min" COEFFS 0 1 0 0 0 1 /end COMPU_METHOD
/begin COMPU_METHOD VBU0706_CM_single_Kohm "Q = V" RAT_FUNC "%8.6" "Kohm" COEFFS 0 1 0 0 0 1 /end COMPU_METHOD
/begin COMPU_METHOD VBU0706_CM_single_Kwh "Q = V" RAT_FUNC "%8.6" "Kwh" COEFFS 0 1 0 0 0 1 /end COMPU_METHOD
/begin COMPU_METHOD VBU0706_CM_single_flg "Q = V" RAT_FUNC "%8.6" "flg" COEFFS 0 1 0 0 0 1 /end COMPU_METHOD
/begin COMPU_METHOD VBU0706_CM_uint32_cnt "Q = V" RAT_FUNC "%10.0" "cnt" COEFFS 0 1 0 0 0 1 /end COMPU_METHOD
/begin COMPU_METHOD VBU0706_CM_boolean_flg "Q = V" RAT_FUNC "%1.0" "flg" COEFFS 0 1 0 0 0 1 /end COMPU_METHOD
/begin COMPU_METHOD VBU0706_CM_boolean "Q = V" RAT_FUNC "%1.0" "" COEFFS 0 1 0 0 0 1 /end COMPU_METHOD
/begin COMPU_METHOD VBU0706_CM_boolean_cnt "Q = V" RAT_FUNC "%1.0" "cnt" COEFFS 0 1 0 0 0 1 /end COMPU_METHOD
/begin COMPU_METHOD VBU0706_CM_int8_cnt "Q = V" RAT_FUNC "%3.0" "cnt" COEFFS 0 1 0 0 0 1 /end COMPU_METHOD
/begin COMPU_METHOD VBU0706_CM_uint8_cnt "Q = V" RAT_FUNC "%3.0" "cnt" COEFFS 0 1 0 0 0 1 /end COMPU_METHOD
/begin COMPU_METHOD VBU0706_CM_uint8_n "Q = V" RAT_FUNC "%3.0" "n" COEFFS 0 1 0 0 0 1 /end COMPU_METHOD
/begin COMPU_METHOD VBU0706_CM_uint8_enum "Q = V" RAT_FUNC "%3.0" "enum" COEFFS 0 1 0 0 0 1 /end COMPU_METHOD
/begin COMPU_METHOD VBU0706_CM_uint32 "Q = V" RAT_FUNC "%10.0" "" COEFFS 0 1 0 0 0 1 /end COMPU_METHOD
/begin GROUP S1498_NoJumpSOC_Driving_Calculation "VBU0706/Function-Call Subsystem/Subsystem1/SOC/Subsystem5/Subsystem/Determine_Display_SOC/NoJumpSOC_Driving_Calculation" /begin REF_CHARACTERISTIC CcSOC_NoJumpSocChargeRate_pct /end REF_CHARACTERISTIC /end GROUP
/begin GROUP S1498_NoJumpSOC_Startup_Calculation "VBU0706/Function-Call Subsystem/Subsystem1/SOC/Subsystem5/Subsystem/Determine_Display_SOC/NoJumpSOC_Startup_Calculation" /begin REF_CHARACTERISTIC CbSOC_ReadMemorySOCEnable_flg /end REF_CHARACTERISTIC /end GROUP
/begin GROUP S1499_Determine_FastChargeCorrectionEnable "VBU0706/Function-Call Subsystem/Subsystem1/SOC/Subsystem5/Subsystem/Determine_FastChargeCorrection_Soc/Determine_FastChargeCorrectionEnable"
 /begin REF_CHARACTERISTIC CcSOC_BatteryPolarizationMaxTime_ms CcSOC_CCCorrectionDisableTem_C CcSOC_CCCorrectionEnableTem_C CcSOC_CorrectionEnableCellVoltageDeviation_mV /end REF_CHARACTERISTIC
 /begin REF_MEASUREMENT SOC_flgFastChargeCorrectionEnable /end REF_MEASUREMENT
/end GROUP
/begin GROUP S1499_Determine_InternalResistanceCausedDevCellVoltage "VBU0706/Function-Call Subsystem/Subsystem1/SOC/Subsystem5/Subsystem/Determine_FastChargeCorrection_Soc/Determine_InternalResistanceCausedDevCellVoltage"
 /begin REF_CHARACTERISTIC CcSOC_OneThirdRateDeviationCellVoltage_mV CcSOC_RelaxationDeviationCellVoltage_mV /end REF_CHARACTERISTIC
 /begin REF_MEASUREMENT SOC_flgInternalResistanceCausedDevCellVoltage /end REF_MEASUREMENT
/end GROUP
/begin GROUP S1499_FastCharge_DynamicCorrection "VBU0706/Function-Call Subsystem/Subsystem1/SOC/Subsystem5/Subsystem/Determine_FastChargeCorrection_Soc/FastCharge_DynamicCorrection" /begin SUB_GROUP S1578_FastCharge_DynamicCorrection_Enable /end SUB_GROUP /end GROUP
/begin GROUP S1499_FastCharge_PreCorrection "VBU0706/Function-Call Subsystem/Subsystem1/SOC/Subsystem5/Subsystem/Determine_FastChargeCorrection_Soc/FastCharge_PreCorrection"
 /begin SUB_GROUP S1579_Calculate_WindowAverage_BatteryCurrent S1579_FastCharge_PreCorrectionMain /end SUB_GROUP
 /begin REF_CHARACTERISTIC CcSOC_CCCorrectionDisableTem_C CcSOC_CCCorrectionEnableTem_C CcSOC_FastChargeTOCCurrentThld_A CcSOC_FastChargeTOCCurrentTime_ms /end REF_CHARACTERISTIC
/end GROUP
/begin GROUP S1499_FastCharge_TopofChargeCorrection "VBU0706/Function-Call Subsystem/Subsystem1/SOC/Subsystem5/Subsystem/Determine_FastChargeCorrection_Soc/FastCharge_TopofChargeCorrection"
 /begin SUB_GROUP S1580_Calculate_WindowAverage_BatteryCurrent S1580_FastCharge_TOCAdjustAllSOC S1580_RiseEdge /end SUB_GROUP
 /begin REF_CHARACTERISTIC CcSOC_CCCorrectionDisableTem_C CcSOC_CCCorrectionEnableTem_C CcSOC_FastChargeTOCCurrentThld_A CcSOC_FastChargeTOCCurrentTime_ms CcSOC_FastChargeTOCVoltageThld_mV CcSOC_FastChargeTOCVoltageTime_ms /end REF_CHARACTERISTIC
/end GROUP
/begin GROUP S1500_CellSOC_Startup_AbnormalPoweroff "VBU0706/Function-Call Subsystem/Subsystem1/SOC/Subsystem5/Subsystem/Determine_Initial_SoC/CellSOC_Startup_AbnormalPoweroff" /begin REF_CHARACTERISTIC CbSOC_ForceOcvSocInitialize_flg CcSOC_CellSocDefault_pct /end REF_CHARACTERISTIC /end GROUP
/begin GROUP S1500_CellSOC_Startup_AbnormalReset "VBU0706/Function-Call Subsystem/Subsystem1/SOC/Subsystem5/Subsystem/Determine_Initial_SoC/CellSOC_Startup_AbnormalReset" /begin SUB_GROUP S1615_Battery_SOC_Calculation /end SUB_GROUP
 /begin REF_CHARACTERISTIC CbSOC_ForceOcvSocInitialize_flg CcSOC_MaxAllowSOCDeviation_pct /end REF_CHARACTERISTIC
 /begin REF_MEASUREMENT SOC_flgCellSOCArrayInvalid SOC_pctCellBatterySOCDeviation /end REF_MEASUREMENT
/end GROUP
/begin GROUP S1500_CellSOC_Startup_EolFlashing "VBU0706/Function-Call Subsystem/Subsystem1/SOC/Subsystem5/Subsystem/Determine_Initial_SoC/CellSOC_Startup_EolFlashing" /begin REF_CHARACTERISTIC CcSOC_CellSocDefault_pct /end REF_CHARACTERISTIC /end GROUP
/begin GROUP S1500_CellSOC_Startup_Normal "VBU0706/Function-Call Subsystem/Subsystem1/SOC/Subsystem5/Subsystem/Determine_Initial_SoC/CellSOC_Startup_Normal" /begin SUB_GROUP S1617_Battery_SOC_Calculation /end SUB_GROUP
 /begin REF_CHARACTERISTIC CbSOC_ForceOcvSocInitialize_flg CcSOC_CellSocDefault_pct CcSOC_MaxAllowSOCDeviation_pct /end REF_CHARACTERISTIC
/end GROUP
/begin GROUP S1500_Determine_EOL_Flashing "VBU0706/Function-Call Subsystem/Subsystem1/SOC/Subsystem5/Subsystem/Determine_Initial_SoC/Determine_EOL_Flashing" /begin REF_MEASUREMENT LbSOC_EolFlashingInitialize_flg /end REF_MEASUREMENT /end GROUP
/begin GROUP S1500_Determine_Soc_Jump "VBU0706/Function-Call Subsystem/Subsystem1/SOC/Subsystem5/Subsystem/Determine_Initial_SoC/Determine_Soc_Jump" /begin SUB_GROUP S1619_After_Startup S1619_Startup /end SUB_GROUP /begin REF_MEASUREMENT SOC_stBatterySocJump /end REF_MEASUREMENT /end GROUP
/begin GROUP S1502_Replace_Invalid_CellVoltage "VBU0706/Function-Call Subsystem/Subsystem1/SOC/Subsystem5/Subsystem/Determine_OcvSoc/Replace_Invalid_CellVoltage"
 /begin REF_CHARACTERISTIC CaSOC_OcvSocMapDimension_n CaSOC_OcvSocMapZ_pct CcSOC_OcvCorrectionCVLowThld_mV CcSOC_OcvCorrectionCVUpThld_mV CcSOC_OcvCorrectionTempThld_C CcSOC_SocLowValue_pct /end REF_CHARACTERISTIC
/end GROUP
/begin GROUP S1503_Current_Limit_Condition "VBU0706/Function-Call Subsystem/Subsystem1/SOC/Subsystem5/Subsystem/Determine_ShortTimeCorrection_Condition/Current_Limit_Condition" /begin SUB_GROUP S1648_Current_Limit /end SUB_GROUP /end GROUP
/begin GROUP S1506_Data_Storage "VBU0706/Function-Call Subsystem/Subsystem1/SOC/Subsystem5/Subsystem/Soc_Data_Storage/Data_Storage"
 /begin REF_CHARACTERISTIC CbSOC_BatterySOCOvrdFlg_flg CcSOC_BatteryDisplaySocUpdateDelta_pct CcSOC_BatterySOCOvrdVal_pct CcSOC_BatterySocUpdateDelta_pct CcSOC_CellSOCStorageTime_ms CcSOC_CellSocMaxOverrunLimit_pct CcSOC_CellSocMinOverrunLimit_pct NVM_EEPROM_CRC_CHECK_FAULT /end REF_CHARACTERISTIC
/end GROUP
/begin GROUP S1670_Determine_History_Current_Data "VBU0706/Function-Call Subsystem/Subsystem1/SOE/Subsystem2/Subsystem/Calculate_History_Average_Current/Determine_History_Current_Data"
 /begin REF_CHARACTERISTIC CaSOE_InvalidHistoryCurrentData_A CcSOE_HistoryAveCurrentTimeIntervalNumber_n CcSOE_HistoryAveCurrentTotalTime_s CcSOE_HistoryCurrentDataDimension_n /end REF_CHARACTERISTIC
/end GROUP
/begin GROUP S1670_Time_Counter "VBU0706/Function-Call Subsystem/Subsystem1/SOE/Subsystem2/Subsystem/Calculate_History_Average_Current/Time_Counter"
 /begin REF_CHARACTERISTIC CcSOE_HistoryAveCurrentTimeIntervalNumber_n CcSOE_HistoryAveCurrentTotalTime_s /end REF_CHARACTERISTIC
/end GROUP
/begin GROUP S1671_Charge_and_Idle_Mode "VBU0706/Function-Call Subsystem/Subsystem1/SOE/Subsystem2/Subsystem/Calculate_Pack_Remaining_Energy/Charge_and_Idle_Mode" /begin REF_CHARACTERISTIC CcSOE_CellEnergyBoL_Kwh /end REF_CHARACTERISTIC /end GROUP
/begin GROUP S1671_Discharge_Mode "VBU0706/Function-Call Subsystem/Subsystem1/SOE/Subsystem2/Subsystem/Calculate_Pack_Remaining_Energy/Discharge_Mode"
 /begin SUB_GROUP S1682_Calculate_Energy_Retention_Factor S1682_Calculate_Remaining_Energy S1682_Predict_SOC_End /end SUB_GROUP
 /begin REF_CHARACTERISTIC CcSOE_CellSocDelta_pct CcSOE_CellSocEndPredictUpperLimit_pct /end REF_CHARACTERISTIC
/end GROUP
/begin GROUP S1674_Rate_Limiter_Reset1 "VBU0706/Function-Call Subsystem/Subsystem1/SOE/Subsystem2/Subsystem/Rate_Limit_and_Output_SOC/Rate_Limiter_Reset1" /begin REF_MEASUREMENT SOE_kwhPackRemainingEnergySoc /end REF_MEASUREMENT /end GROUP
/begin GROUP S1723_Calculate_Pack_OCV "VBU0706/Function-Call Subsystem/Subsystem1/SOF/Subsystem6/Subsystem/Calculate_PowerLimit/Calculate_Pack_OCV" /begin SUB_GROUP S1729_Calculate_Locked_SOC S1729_Rate_Limiter /end SUB_GROUP
 /begin REF_CHARACTERISTIC CaSOF_mvChargeOcvSocTempMap_v CaSOF_mvDischargeOcvSocTempMap_v CcSOF_DischargeOCVInLowSOCforPowerLimit_V CcSOF_PowerOnDiscOcvSloDelay_ms CcSOF_SOCLowValueForConstantOCV_pct /end REF_CHARACTERISTIC
 /begin REF_MEASUREMENT SOF_uPackChargeOcv SOF_uPackDischargeOcv /end REF_MEASUREMENT
/end GROUP
/begin GROUP S1723_Determine_Capacity_Cycle_PowerLimit "VBU0706/Function-Call Subsystem/Subsystem1/SOF/Subsystem6/Subsystem/Calculate_PowerLimit/Determine_Capacity_Cycle_PowerLimit"
 /begin SUB_GROUP S1730_Power_Limit_Cycle_Level1 S1730_Power_Limit_Cycle_Level2 S1730_Power_Limit_Cycle_Level3 /end SUB_GROUP
 /begin REF_CHARACTERISTIC CcSOF_BatteryCycleLevel1_n CcSOF_BatteryCycleLevel2_n /end REF_CHARACTERISTIC
 /begin REF_MEASUREMENT LcSOF_kwChargePowerLimitCycle /end REF_MEASUREMENT
/end GROUP
/begin GROUP S1723_Determine_SOCP_PowerLimit "VBU0706/Function-Call Subsystem/Subsystem1/SOF/Subsystem6/Subsystem/Calculate_PowerLimit/Determine_SOCP_PowerLimit"
 /begin SUB_GROUP S1731_Calculate_Locked_SOC S1731_Determine_ContinuousDischargePowerLimitTarget S1731_Determine_DischargePowerLimitTarget /end SUB_GROUP
 /begin REF_CHARACTERISTIC CaSOF_SocpDischargeSocMinMapY_pct /end REF_CHARACTERISTIC
/end GROUP
/begin GROUP S1725_Calculate_CurrentLimit_Target "VBU0706/Function-Call Subsystem/Subsystem1/SOF/Subsystem6/Subsystem/Determine_Currentlimit_Target/Calculate_CurrentLimit_Target"
 /begin SUB_GROUP S1761_Calculate_CurrentLimit_Base S1761_Calculate_Dynamic_CurrentLimit S1761_CurrentLimit_FastCharge_Check S1761_CurrentLimit_Fault_Correct S1761_CurrentLimit_Voltage_Correct S1761_FastChrgCurr1 /end SUB_GROUP
/end GROUP
/begin GROUP S1725_Determine_CurrentLimitTarget_Enable "VBU0706/Function-Call Subsystem/Subsystem1/SOF/Subsystem6/Subsystem/Determine_Currentlimit_Target/Determine_CurrentLimitTarget_Enable" /begin REF_MEASUREMENT SOF_flgCurrentLimitTargetCalculateEnable /end REF_MEASUREMENT /end GROUP
/begin GROUP S1955_Calculate_CellCapacity "VBU0706/Function-Call Subsystem/Subsystem1/SOH/Subsystem4/Subsystem1/Calculate_Capacity/Calculate_CellCapacity"
 /begin SUB_GROUP S1961_Caculate_CellCapacity_LifeTimeQ S1961_CellCapacity_Limit S1961_Determine_CellCapacity S1961_Determine_PackSoh S1961_PackSoh_Storage /end SUB_GROUP
/end GROUP
/begin GROUP S1955_Calculate_CellCapacity_SlowCharge "VBU0706/Function-Call Subsystem/Subsystem1/SOH/Subsystem4/Subsystem1/Calculate_Capacity/Calculate_CellCapacity_SlowCharge"
 /begin SUB_GROUP S1962_Caculate_CellCapacity S1962_Determine_AhIntegral_DeltaQ S1962_Determine_Soc S1962_Determine_SocEndandCondition S1962_Determine_SocStart /end SUB_GROUP
/end GROUP
/begin GROUP S1955_Calculate_MinCellCapacity274_SlowCharge "VBU0706/Function-Call Subsystem/Subsystem1/SOH/Subsystem4/Subsystem1/Calculate_Capacity/Calculate_MinCellCapacity274_SlowCharge" /begin REF_CHARACTERISTIC CcSOH_NotCalculatedSoh_pct /end REF_CHARACTERISTIC /end GROUP
/begin GROUP S1955_Determine_CalculateCellCapacity_Condition "VBU0706/Function-Call Subsystem/Subsystem1/SOH/Subsystem4/Subsystem1/Calculate_Capacity/Determine_CalculateCellCapacity_Condition"
 /begin SUB_GROUP S1964_Determine_SlowCharge S1964_Determine_SlowChargeEnd S1964_Determine_SlowChargeStart /end SUB_GROUP
/end GROUP
/begin GROUP S1956_BasicCellResistance_Calculation_Check "VBU0706/Function-Call Subsystem/Subsystem1/SOH/Subsystem4/Subsystem1/Calculate_Resistance/BasicCellResistance_Calculation_Check"
 /begin SUB_GROUP S2030_BeforStep_DuringStep_AfterStep_Check S2030_ResistanceCalc_Check /end SUB_GROUP
/end GROUP
/begin GROUP S1956_Caculate_CellResistance "VBU0706/Function-Call Subsystem/Subsystem1/SOH/Subsystem4/Subsystem1/Calculate_Resistance/Caculate_CellResistance" /begin REF_CHARACTERISTIC CcSOH_ResistanceBase_mohm /end REF_CHARACTERISTIC /end GROUP
/begin GROUP S1956_Calculate_ModuleCurrent "VBU0706/Function-Call Subsystem/Subsystem1/SOH/Subsystem4/Subsystem1/Calculate_Resistance/Calculate_ModuleCurrent" /begin SUB_GROUP S2032_CONTACTOR_STATUS_CLOSED /end SUB_GROUP /end GROUP
/begin GROUP S1956_Calculate_Relaxation_Average_CurrentVoltage "VBU0706/Function-Call Subsystem/Subsystem1/SOH/Subsystem4/Subsystem1/Calculate_Resistance/Calculate_Relaxation_Average_CurrentVoltage" /begin SUB_GROUP S2033_CalCurrent_Data_BeforeStep /end SUB_GROUP /end GROUP
/begin GROUP S1956_Compute_Resistance_Request "VBU0706/Function-Call Subsystem/Subsystem1/SOH/Subsystem4/Subsystem1/Calculate_Resistance/Compute_Resistance_Request"
 /begin REF_CHARACTERISTIC CbSOH_ComputeResistanceRequestORF_flg CbSOH_ComputeResistanceRequestORV_flg CcSOH_CellResistanceIncRatioUpdateTime_s CcSOH_ComputeResistanceUpdateCycle_n CcSOH_FastChargeFactor_n /end REF_CHARACTERISTIC
/end GROUP
/begin GROUP S1956_Determine_Condition_Calculate_Pulse_Average_CurrentVoltage "VBU0706/Function-Call Subsystem/Subsystem1/SOH/Subsystem4/Subsystem1/Calculate_Resistance/Determine_Condition_Calculate_Pulse_Average_CurrentVoltage"
 /begin SUB_GROUP S2037_Calculate_Pulse_Average_CurrentVoltage S2037_Determine_Condition /end SUB_GROUP
/end GROUP
/begin GROUP S1959_CellCapacity_Diagnostic "VBU0706/Function-Call Subsystem/Subsystem1/SOH/Subsystem4/Subsystem1/SOH_Diagnositic/CellCapacity_Diagnostic"
 /begin REF_CHARACTERISTIC CbSOH_CellCapacityOverDeviationFaultEnable_flg CcSOH_CellCapacityOverDeviationFaultFIC_n CcSOH_CellCapacityOverDeviationFaultPIC_n CcSOH_CellCapacityOverDeviationFault_Ah SOH_CELL_CAPACITY_OVER_DEVIATION_FAULT /end REF_CHARACTERISTIC
/end GROUP
/begin GROUP S2086_Determine_CoolantSensorTemp_Validation "VBU0706/Function-Call Subsystem/Subsystem1/THM/Subsystem/Subsystem/Calculate_PipeTemperature/Determine_CoolantSensorTemp_Validation"
 /begin SUB_GROUP S2096_Determine_InletTemp_Validation S2096_Determine_OutletTemp_Validation /end SUB_GROUP
 /begin REF_MEASUREMENT THM_tInletCoolantTemp THM_tOutletCoolantTemp /end REF_MEASUREMENT
/end GROUP
/begin GROUP S2087_FCC_Temp_Request "VBU0706/Function-Call Subsystem/Subsystem1/THM/Subsystem/Subsystem/Charge_Mode_Temp_Request/FCC_Temp_Request"
 /begin REF_CHARACTERISTIC CaTHM_FccHighSocRequestTempMapZ_C CaTHM_FccSohFactorMapY_n CcTHM_ChargeTempRequestHighThreshold_C CcTHM_FccChargeTempRequestLowThreshold_C CcTHM_FccSohTempLowThreshold_C CcTHM_PackSohORF_flg CcTHM_PackSohORV_pct /end REF_CHARACTERISTIC
/end GROUP
/begin GROUP S2087_Invaild_Temp_Request "VBU0706/Function-Call Subsystem/Subsystem1/THM/Subsystem/Subsystem/Charge_Mode_Temp_Request/Invaild_Temp_Request" /begin REF_CHARACTERISTIC CcTHM_InvaildTempRequest_C /end REF_CHARACTERISTIC /end GROUP
/begin GROUP S2087_OBC_Temp_Request "VBU0706/Function-Call Subsystem/Subsystem1/THM/Subsystem/Subsystem/Charge_Mode_Temp_Request/OBC_Temp_Request" /begin SUB_GROUP S2108_Normal_Condition /end SUB_GROUP /end GROUP
/begin GROUP S2094_Delay_FallingEdge "VBU0706/Function-Call Subsystem/Subsystem1/THM/Subsystem/Subsystem/Thermal_System_Damage_Judgement/Delay_FallingEdge" /begin REF_MEASUREMENT THM_flgSystemCoolingAbilityDecrease /end REF_MEASUREMENT /end GROUP
/begin GROUP S2095_FCC_Temp_Valid "VBU0706/Function-Call Subsystem/Subsystem1/THM/Subsystem/Subsystem/Valid_Condition_Determination/FCC_Temp_Valid"
 /begin SUB_GROUP S2149_SOC_Hysteretic_Determination S2149_Temp_Hysteretic_Determination /end SUB_GROUP
/end GROUP
/begin GROUP S2095_OBC_Temp_Valid "VBU0706/Function-Call Subsystem/Subsystem1/THM/Subsystem/Subsystem/Valid_Condition_Determination/OBC_Temp_Valid"
 /begin SUB_GROUP S2151_Hysteretic_Determination S2151_SOC_Hysteretic_Determination /end SUB_GROUP
/end GROUP
/begin GROUP S2160_Override "VBU0706/Function-Call Subsystem/Subsystem1/VCT/Subsystem/Subsystem/Determine_BMS_VCU_267/Override" /begin SUB_GROUP S2169_LOW_HIGH3 S2169_LOW_HIGH5 S2169_LOW_HIGH7 /end SUB_GROUP
 /begin REF_CHARACTERISTIC CbVCT_BMSPackEnergyAvailableORF_flg CbVCT_CTMCellThermalRunawayORF_flg CbVCT_CTMCellThermalRunawayValidORF_flg CbVCT_CTMCellThermalRunawayValidORV_flg CcVCT_BMSPackEnergyAvailableORV_Kwh CeVCT_CTMCellThermalRunawayORV_enum /end REF_CHARACTERISTIC
/end GROUP
/begin GROUP S2161_Override "VBU0706/Function-Call Subsystem/Subsystem1/VCT/Subsystem/Subsystem/Determine_BMS_VCU_268/Override"
 /begin SUB_GROUP S2174_LOW_HIGH1 S2174_LOW_HIGH14 S2174_LOW_HIGH2 S2174_LOW_HIGH3 /end SUB_GROUP
 /begin REF_CHARACTERISTIC CbVCT_BMSDischgPowerLimitDynamicORF_flg CbVCT_BMSDischgPowerLimitLTORF_flg CbVCT_BMSDischgPowerLimitSTORF_flg CbVCT_BMSInsulationResistanceValueORF_flg CcVCT_BMSDischgPowerLimitDynamicORV_Kw CcVCT_BMSDischgPowerLimitLTIORV_Kw CcVCT_BMSDischgPowerLimitSTORV_Kw CcVCT_BMSInsulationResistanceValueORV_Kohm /end REF_CHARACTERISTIC
/end GROUP
/begin GROUP S2162_Override "VBU0706/Function-Call Subsystem/Subsystem1/VCT/Subsystem/Subsystem/Determine_BMS_VCU_269/Override"
 /begin SUB_GROUP S2182_LOW_HIGH1 S2182_LOW_HIGH17 S2182_LOW_HIGH2 S2182_LOW_HIGH3 S2182_LOW_HIGH4 S2182_LOW_HIGH5 S2182_LOW_HIGH6 /end SUB_GROUP
 /begin REF_CHARACTERISTIC CbVCT_BMSCellVoltageAveORF_flg CbVCT_BMSCellVoltageAveValidityORF_flg CbVCT_BMSCellVoltageAveValidityORV_flg CbVCT_BMSCellVoltageMaxORF_flg CbVCT_BMSCellVoltageMaxValidityORF_flg CbVCT_BMSCellVoltageMaxValidityORV_flg CbVCT_BMSCellVoltageMinORF_flg CbVCT_BMSCellVoltageMinValidityORF_flg CbVCT_BMSCellVoltageMinValidityORV_flg CbVCT_BMSEstimateChargingTimeORF_flg CcVCT_BMSCellVoltageAveORV_V CcVCT_BMSCellVoltageMaxORV_V CcVCT_BMSCellVoltageMinORV_V CcVCT_BMSEstimateChargingTimeORV_min /end REF_CHARACTERISTIC
/end GROUP
/begin GROUP S2163_Override "VBU0706/Function-Call Subsystem/Subsystem1/VCT/Subsystem/Subsystem/Determine_BMS_VCU_26A/Override"
 /begin SUB_GROUP S2190_LOW_HIGH1 S2190_LOW_HIGH14 S2190_LOW_HIGH2 S2190_LOW_HIGH3 /end SUB_GROUP
 /begin REF_CHARACTERISTIC CbVCT_BMSChgPowerLimitDynamicORF_flg CbVCT_BMSChgPowerLimitLTORF_flg CbVCT_BMSChgPowerLimitSTORF_flg CbVCT_EstimatePercTimeORF_flg CcVCT_BMSChgPowerLimitDynamicORV_Kw CcVCT_BMSChgPowerLimitLTORV_Kw CcVCT_BMSChgPowerLimitSTORV_Kw CcVCT_EstimatePercTimeORV_min /end REF_CHARACTERISTIC
/end GROUP
/begin GROUP S2164_Override "VBU0706/Function-Call Subsystem/Subsystem1/VCT/Subsystem/Subsystem/Determine_BMS_VCU_271/Override"
 /begin SUB_GROUP S2195_LOW_HIGH1 S2195_LOW_HIGH14 S2195_LOW_HIGH2 S2195_LOW_HIGH3 S2195_LOW_HIGH4 S2195_LOW_HIGH5 /end SUB_GROUP
 /begin REF_CHARACTERISTIC CbVCT_BMSDCChrgFinalSOCORF_flg CbVCT_BMSMaximumCellTempORF_flg CbVCT_BMSMaximumCellVoltageNumberORF_flg CbVCT_BMSMaximumTempNumberORF_flg CbVCT_BMSMinimumCellTempORF_flg CbVCT_BMSMinimumTempNumberORF_flg CcVCT_BMSDCChrgFinalSOCORV_pct CcVCT_BMSMaximumCellTempORV_C CcVCT_BMSMaximumCellVoltageNumberORV_n CcVCT_BMSMaximumTempNumberORV_n CcVCT_BMSMinimumCellTempORV_C CcVCT_BMSMinimumTempNumberORV_n /end REF_CHARACTERISTIC
/end GROUP
/begin GROUP S2165_Override "VBU0706/Function-Call Subsystem/Subsystem1/VCT/Subsystem/Subsystem/Determine_BMS_VCU_272/Override"
 /begin SUB_GROUP S2203_LOW_HIGH1 S2203_LOW_HIGH10 S2203_LOW_HIGH11 S2203_LOW_HIGH12 S2203_LOW_HIGH13 S2203_LOW_HIGH14 S2203_LOW_HIGH16 S2203_LOW_HIGH17 S2203_LOW_HIGH18 S2203_LOW_HIGH2 S2203_LOW_HIGH3 S2203_LOW_HIGH4 S2203_LOW_HIGH5 S2203_LOW_HIGH6 S2203_LOW_HIGH7 S2203_LOW_HIGH8 S2203_LOW_HIGH9 /end SUB_GROUP
 /begin REF_CHARACTERISTIC CbVCT_BMSCellVoltageOverUnderORF_flg CbVCT_BMSDCChargeCurrentOverUnderORF_flg CbVCT_BMSSOCOverUnderORF_flg CbVCT_BatteryAbnormalAlarm1ORF_flg CbVCT_BatteryAbnormalAlarm1ORV_flg CbVCT_BatteryAbnormalAlarm2ORF_flg CbVCT_BatteryAbnormalAlarm2ORV_flg CbVCT_BatteryAbnormalAlarm3ORF_flg CbVCT_BatteryAbnormalAlarm3ORV_flg CbVCT_BatteryConsistencyAlarmORF_flg CbVCT_BatteryOutputConnectorStateORF_flg CbVCT_BatteryTempDifferAlarmORF_flg CbVCT_BatteryTempOverORF_flg CbVCT_BatteryTypeDismatchAlarmORF_flg CbVCT_BetteryCellTempHighAlarmORF_flg CbVCT_BetteryCellTempLowAlarmORF_flg CbVCT_BetteryCellVolHighAlarmORF_flg CbVCT_BetteryCellVolLowAlarmORF_flg CbVCT_BetteryPckVoltOverAlarmORF_flg CbVCT_BetteryPckVoltUnderAlarmORF_flg CbVCT_CTDMnNegContactorWeldORF_flg CbVCT_CTDMnPosContactorWeldORF_flg CbVCT_CTDPrechargeEnergyHighORF_flg CbVCT_CTDPrechargeRelayBlownORF_flg CbVCT_CTDPrechargeRelayStuckOpenORF_flg CbVCT_CTDPrechargeTimeoutORF_flg CbVCT_DCChargingPermitStatusORF_flg CbVCT_SOCJumpAlarmORF_flg CbVCT_SOCJumpReasonORF_flg CeVCT_BMSCellVoltageOverUnderORV_enum CeVCT_BMSDCChargeCurrentOverUnderORV_enum CeVCT_BMSSOCOverUnderORV_enum CeVCT_BatteryConsistencyAlarmORV_enum CeVCT_BatteryOutputConnectorStateORV_enum CeVCT_BatteryTempDifferAlarmORV_enum CeVCT_BatteryTempOverORV_enum CeVCT_BatteryTypeDismatchAlarmORV_enum CeVCT_BetteryCellTempHighAlarmORV_enum CeVCT_BetteryCellTempLowAlarmORV_enum CeVCT_BetteryCellVolHighAlarmORV_enum CeVCT_BetteryCellVolLowAlarmORV_enum CeVCT_BetteryPckVoltOverAlarmORV_enum CeVCT_BetteryPckVoltUnderAlarmORV_enum CeVCT_CTDMnNegContactorWeldORV_enum CeVCT_CTDMnPosContactorWeldORV_enum CeVCT_CTDPrechargeEnergyHighORV_enum CeVCT_CTDPrechargeRelayBlownORV_enum CeVCT_CTDPrechargeRelayStuckOpenORV_enum CeVCT_CTDPrechargeTimeoutORV_enum CeVCT_DCChargingPermitStatusORV_enum CeVCT_SOCJumpAlarmORV_enum CeVCT_SOCJumpReasonORV_enum /end REF_CHARACTERISTIC
 /begin REF_MEASUREMENT VCT_stBatteryAbnormalAlarm1 VCT_stBatteryAbnormalAlarm2 VCT_stBatteryAbnormalAlarm3 VCT_stCTDMnNegContactorWeld VCT_stCTDMnPosContactorWeld VCT_stCTDPrechargeEnergyHigh VCT_stCTDPrechargeRelayBlown VCT_stCTDPrechargeRelayStuckOpen VCT_stCTDPrechargeTimeout /end REF_MEASUREMENT
/end GROUP
/begin GROUP S2166_Override "VBU0706/Function-Call Subsystem/Subsystem1/VCT/Subsystem/Subsystem/Determine_BMS_VCU_34/Override"
 /begin SUB_GROUP S2253_LOW_HIGH1 S2253_LOW_HIGH2 S2253_LOW_HIGH3 S2253_LOW_HIGH5 /end SUB_GROUP
 /begin REF_CHARACTERISTIC CbVCT_BMSBMSRollingCounterORF_flg CbVCT_BMSContactorStateORF_flg CbVCT_BMSStsORF_flg CbVCT_InhibitPrechargeCauseORF_flg CeVCT_BMSBMSRollingCounterORV_enum CeVCT_BMSContactorStateORV_enum CeVCT_BMSStsORV_enum CeVCT_InhibitPrechargeCauseORV_enum /end REF_CHARACTERISTIC
/end GROUP
/begin GROUP S2167_Override "VBU0706/Function-Call Subsystem/Subsystem1/VCT/Subsystem/Subsystem/Determine_BMS_VCU_373/Override"
 /begin SUB_GROUP S2262_LOW_HIGH1 S2262_LOW_HIGH10 S2262_LOW_HIGH11 S2262_LOW_HIGH12 S2262_LOW_HIGH13 S2262_LOW_HIGH14 S2262_LOW_HIGH15 S2262_LOW_HIGH17 S2262_LOW_HIGH2 S2262_LOW_HIGH3 S2262_LOW_HIGH4 S2262_LOW_HIGH5 S2262_LOW_HIGH6 S2262_LOW_HIGH7 S2262_LOW_HIGH8 S2262_LOW_HIGH9 /end SUB_GROUP
 /begin REF_CHARACTERISTIC CbVCT_BMSCellTempStandardDeviationORF_flg CbVCT_BMSESSInletTempMaskORF_flg CbVCT_BMSESSInletTempMaskORV_flg CbVCT_BMSESSInletTempValidityORF_flg CbVCT_BMSESSInletTempValidityORV_flg CbVCT_BMSESSOutletTempMaskORF_flg CbVCT_BMSESSOutletTempMaskORV_flg CbVCT_BMSESSOutletTempValidityORF_flg CbVCT_BMSESSOutletTempValidityORV_flg CbVCT_BMSHVShutdownReqORF_flg CbVCT_BMSHVShutdownReqORV_flg CbVCT_BMSInletTempRequestORF_flg CbVCT_BMSInletWaterTempORF_flg CbVCT_BMSOutletWaterTempORF_flg CbVCT_BMSTempAverageValidityORF_flg CbVCT_BMSTempAverageValidityORV_flg CbVCT_BMSTempMaxValidityORF_flg CbVCT_BMSTempMaxValidityORV_flg CbVCT_BMSTempMinValidityORF_flg CbVCT_BMSTempMinValidityORV_flg CbVCT_BMSTempRequestValidORF_flg CbVCT_BMSTempRequestValidORV_flg CbVCT_BMSTemperatureAverageORF_flg CbVCT_BMSTemperatureMaxORF_flg CcVCT_BMSCellTempStandardDeviationORV_C CcVCT_BMSInletTempRequestORV_C CcVCT_BMSInletWaterTempORV_C CcVCT_BMSOutletWaterTempORV_C CcVCT_BMSTemperatureAverageORV_C CcVCT_BMSTemperatureMaxORV_C CcVCT_BMSTemperatureMinORF_flg CcVCT_BMSTemperatureMinORV_C /end REF_CHARACTERISTIC
/end GROUP
/begin GROUP S2168_Override "VBU0706/Function-Call Subsystem/Subsystem1/VCT/Subsystem/Subsystem/Determine_BMS_VCU_AC/Override"
 /begin SUB_GROUP S2281_LOW_HIGH1 S2281_LOW_HIGH10 S2281_LOW_HIGH17 S2281_LOW_HIGH2 S2281_LOW_HIGH3 S2281_LOW_HIGH4 S2281_LOW_HIGH5 S2281_LOW_HIGH7 S2281_LOW_HIGH8 S2281_LOW_HIGH9 /end SUB_GROUP
 /begin REF_CHARACTERISTIC CbVCT_BMSCustomerUsageSOCORF_flg CbVCT_BMSFaultCatORF_flg CbVCT_BMSFaultLvlORF_flg CbVCT_BMSPackCrntORF_flg CbVCT_BMSPackVoltageORF_flg CbVCT_BMSRollingCounter225ORF_flg CbVCT_BMSSOCORF_flg CbVCT_ChargeAvailableORF_flg CbVCT_ChargeAvailableORV_flg CbVCT_HVBattSOCLowCritORF_flg CbVCT_HVBattSOCLowCritORV_flg CbVCT_HVBattSOCLowWarnORF_flg CbVCT_HVBattSOCLowWarnORV_flg CcVCT_BMSCustomerUsageSOCORV_pct CcVCT_BMSPackCrntORV_A CcVCT_BMSPackVoltageORV_V CcVCT_BMSRollingCounter225ORV_n CcVCT_BMSSOCORV_pct CeVCT_BMSFaultCatORV_enum CeVCT_BMSFaultLvlORV_enum /end REF_CHARACTERISTIC
/end GROUP
/begin GROUP S2331_CANRX_Cnt "VBU0706/Task_10ms/J1939/FCHG/TP_CM_RX/TP_CM RX/CANRX_Active/CANRX_Cnt" /begin REF_MEASUREMENT TP_CM_RX_CANRX_Cnt /end REF_MEASUREMENT /end GROUP
/begin GROUP S2344_override_signal_Status "VBU0706/Task_10ms/Subsystem/HALIn/HW/Subsystem/Input_HW_Signal_Range_Check2/override_signal_Status" /begin REF_MEASUREMENT INP_uAccPed1 /end REF_MEASUREMENT /end GROUP
/begin GROUP S2345_override_signal_Status "VBU0706/Task_10ms/Subsystem/HALIn/HW/Subsystem/Input_HW_Signal_Range_Check3/override_signal_Status" /begin REF_MEASUREMENT INP_uBrkPres /end REF_MEASUREMENT /end GROUP
/begin GROUP S2346_override_signal_Status "VBU0706/Task_10ms/Subsystem/HALIn/HW/Subsystem/Input_HW_Signal_Range_Check4/override_signal_Status" /begin REF_MEASUREMENT INP_uAccPed2 /end REF_MEASUREMENT /end GROUP
/begin GROUP S2347_override_signal_Status "VBU0706/Task_10ms/Subsystem/HALIn/HW/Subsystem/Input_HW_Signal_Range_Check6/override_signal_Status" /begin REF_MEASUREMENT INP_uDCCHCC2 /end REF_MEASUREMENT /end GROUP
/begin GROUP S2348_override_signal_Status "VBU0706/Task_10ms/Subsystem/HALIn/HW/Subsystem/Input_HW_Signal_Range_Check_Table1/override_signal_Status" /begin REF_MEASUREMENT INP_pVacPres /end REF_MEASUREMENT /end GROUP
/begin GROUP S2349_override_signal_Status "VBU0706/Task_10ms/Subsystem/HALIn/HW/Subsystem/Input_HW_Signal_Range_Check_Table2/override_signal_Status" /begin REF_MEASUREMENT INP_tDCChPortPosTemp /end REF_MEASUREMENT /end GROUP
/begin GROUP S2350_override_signal_Status "VBU0706/Task_10ms/Subsystem/HALIn/HW/Subsystem/Input_HW_Signal_Range_Check_Table4/override_signal_Status" /begin REF_MEASUREMENT INP_tDCChPortNegTemp /end REF_MEASUREMENT /end GROUP
/begin GROUP S2351_override_signal_Status "VBU0706/Task_10ms/Subsystem/HALIn/HW/Subsystem/Input_HW_Signal_Range_Check_Table5/override_signal_Status" /begin REF_MEASUREMENT INP_tEDSInletCoolTemp /end REF_MEASUREMENT /end GROUP
/begin GROUP S2425_override_signal "VBU0706/Task_10ms/Subsystem/HALIn/HW/Subsystem1/BrkLmpSwtConfirm/override_signal" /begin REF_MEASUREMENT INP_flgBrkLmpSwt /end REF_MEASUREMENT /end GROUP
/begin GROUP S2426_override_signal "VBU0706/Task_10ms/Subsystem/HALIn/HW/Subsystem1/BrkLmpSwtConfirm1/override_signal" /begin REF_MEASUREMENT INP_flgBrkSwt /end REF_MEASUREMENT /end GROUP
/begin GROUP S2427_override_signal "VBU0706/Task_10ms/Subsystem/HALIn/HW/Subsystem1/INP_flgGearH1Confirm/override_signal" /begin REF_MEASUREMENT INP_flgGearH1 /end REF_MEASUREMENT /end GROUP
/begin GROUP S2428_override_signal "VBU0706/Task_10ms/Subsystem/HALIn/HW/Subsystem1/INP_flgGearH2Confirm/override_signal" /begin REF_MEASUREMENT INP_flgGearH2 /end REF_MEASUREMENT /end GROUP
/begin GROUP S2429_override_signal "VBU0706/Task_10ms/Subsystem/HALIn/HW/Subsystem1/INP_flgGearH3Confirm/override_signal" /begin REF_MEASUREMENT INP_flgGearH3 /end REF_MEASUREMENT /end GROUP
/begin GROUP S2432_override_signal "VBU0706/Task_10ms/Subsystem/HALIn/HW/Subsystem1/IN_ACMidPreConfirm/override_signal" /begin REF_MEASUREMENT INP_flgACMidPresSwitch /end REF_MEASUREMENT /end GROUP
/begin GROUP S2433_override_signal "VBU0706/Task_10ms/Subsystem/HALIn/HW/Subsystem1/IN_CrankConfirm/override_signal" /begin REF_MEASUREMENT INP_flgCrankConfirm /end REF_MEASUREMENT /end GROUP
/begin GROUP S2434_override_signal "VBU0706/Task_10ms/Subsystem/HALIn/HW/Subsystem1/IN_DriverACOnConfirm/override_signal" /begin REF_MEASUREMENT INP_flgDriverACOn /end REF_MEASUREMENT /end GROUP
/begin GROUP S2455_override_signal_Status "VBU0706/Task_10ms/Subsystem/HALIn/HW/Subsystem2/Input_HW_Signal_Range_Check1/override_signal_Status" /begin REF_MEASUREMENT INP_pctHVILDty INP_stHVILDty /end REF_MEASUREMENT /end GROUP
/begin GROUP S2456_override_signal_Status "VBU0706/Task_10ms/Subsystem/HALIn/HW/Subsystem2/Input_HW_Signal_Range_Check2/override_signal_Status" /begin REF_MEASUREMENT INP_pctBattPresDty INP_stBattPresDty /end REF_MEASUREMENT /end GROUP
/begin GROUP S2457_override_signal_Status "VBU0706/Task_10ms/Subsystem/HALIn/HW/Subsystem2/Input_HW_Signal_Range_Check3/override_signal_Status" /begin REF_MEASUREMENT INP_fBattPresFrq INP_stBattPresFrq /end REF_MEASUREMENT /end GROUP
/begin GROUP S2458_override_signal_Status "VBU0706/Task_10ms/Subsystem/HALIn/HW/Subsystem2/Input_HW_Signal_Range_Check7/override_signal_Status" /begin REF_MEASUREMENT INP_fHVILFrq INP_stHVILFrq /end REF_MEASUREMENT /end GROUP
/begin GROUP S2497_EXV "VBU0706/Task_10ms/Subsystem/HALIn/LIN/MsgRxData_Unpack1/CanRxData_Unpack/EXV"
 /begin REF_MEASUREMENT EXV_F_Response EXV_N_Position EXV_St_Fault EXV_St_Initial EXV_St_Running EXV_St_Voltage EXV_W_OverTemp /end REF_MEASUREMENT
/end GROUP
/begin GROUP S2498_FPV "VBU0706/Task_10ms/Subsystem/HALIn/LIN/MsgRxData_Unpack1/CanRxData_Unpack1/FPV"
 /begin REF_MEASUREMENT FPV_CommError FPV_FaultState FPV_Position FPV_RunState FPV_TempState FPV_VoltState /end REF_MEASUREMENT
/end GROUP
/begin GROUP S2506_ABS_0x068 "VBU0706/Task_10ms/Subsystem/HALIn/PTCAN/Subsystem/20ms/ABS_0x068"
 /begin SUB_GROUP S2515_Input_CAN_Signal_No_Range_Check S2515_Input_CAN_Signal_No_Range_Check3 S2515_Input_CAN_Signal_No_Range_Check4 /end SUB_GROUP
 /begin REF_CHARACTERISTIC ABS_flgMsg068ChksmDisbl_C ABS_flgMsg068RollCntDisbl_C /end REF_CHARACTERISTIC
/end GROUP
/begin GROUP S2506_ABS_0x75 "VBU0706/Task_10ms/Subsystem/HALIn/PTCAN/Subsystem/20ms/ABS_0x75"
 /begin SUB_GROUP S2517_Input_CAN_Signal_No_Range_Check S2517_Input_CAN_Signal_No_Range_Check1 S2517_Input_CAN_Signal_No_Range_Check2 S2517_Input_CAN_Signal_No_Range_Check3 /end SUB_GROUP
 /begin REF_CHARACTERISTIC ABS_flgMsg075ChksmDisbl_C ABS_flgMsg075RollCntDisbl_C /end REF_CHARACTERISTIC
/end GROUP
/begin GROUP S2506_ABS_0x79 "VBU0706/Task_10ms/Subsystem/HALIn/PTCAN/Subsystem/20ms/ABS_0x79"
 /begin SUB_GROUP S2518_Input_CAN_Signal_No_Range_Check S2518_Input_CAN_Signal_No_Range_Check1 S2518_Input_CAN_Signal_No_Range_Check2 S2518_Input_CAN_Signal_No_Range_Check3 /end SUB_GROUP
 /begin REF_CHARACTERISTIC ABS_flgMsg079ChksmDisbl_C ABS_flgMsg079RollCntDisbl_C /end REF_CHARACTERISTIC
/end GROUP
/begin GROUP S2506_EPB_0x80 "VBU0706/Task_10ms/Subsystem/HALIn/PTCAN/Subsystem/20ms/EPB_0x80"
 /begin SUB_GROUP S2519_Input_CAN_Signal_No_Range_Check1 S2519_Input_CAN_Signal_No_Range_Check10 S2519_Input_CAN_Signal_No_Range_Check4 /end SUB_GROUP
 /begin REF_CHARACTERISTIC EPB_flgMsg080ChksmDisbl_C EPB_flgMsg080RollCntDisbl_C /end REF_CHARACTERISTIC
/end GROUP
/begin GROUP S2506_EPS_0x70 "VBU0706/Task_10ms/Subsystem/HALIn/PTCAN/Subsystem/20ms/EPS_0x70" /begin SUB_GROUP S2520_Input_CAN_Signal_No_Range_Check4 /end SUB_GROUP /begin REF_CHARACTERISTIC EPS_flgMsg070ChksmDisbl_C EPS_flgMsg070RollCntDisbl_C /end REF_CHARACTERISTIC /end GROUP
/begin GROUP S2506_MCU_205 "VBU0706/Task_10ms/Subsystem/HALIn/PTCAN/Subsystem/20ms/MCU_205"
 /begin SUB_GROUP S2521_Input_CAN_Signal_No_Range_Check1 S2521_Input_CAN_Signal_No_Range_Check2 S2521_Input_CAN_Signal_No_Range_Check3 S2521_Input_CAN_Signal_No_Range_Check4 S2521_Input_CAN_Signal_No_Range_Check5 S2521_Input_CAN_Signal_No_Range_Check6 S2521_Input_CAN_Signal_No_Range_Check7 /end SUB_GROUP
 /begin REF_CHARACTERISTIC MCU_flgMsg205ChksmDisbl_C MCU_flgMsg205RollCntDisbl_C /end REF_CHARACTERISTIC
 /begin REF_MEASUREMENT PEUR_flgMotrSpdVld PEUR_trqAct /end REF_MEASUREMENT
/end GROUP
/begin GROUP S2507_MCU_305 "VBU0706/Task_10ms/Subsystem/HALIn/PTCAN/Subsystem/50ms/MCU_305"
 /begin SUB_GROUP S2710_Input_CAN_Signal_No_Range_Check S2710_Input_CAN_Signal_No_Range_Check1 S2710_Input_CAN_Signal_No_Range_Check2 /end SUB_GROUP
 /begin REF_CHARACTERISTIC PEUR_flgMsg305ChksmDisbl_C PEUR_flgMsg305RollCntDisbl_C /end REF_CHARACTERISTIC
 /begin REF_MEASUREMENT PEUR_trqMaxLimit /end REF_MEASUREMENT
/end GROUP
/begin GROUP S2510_MsgRxData_Unpack1 "VBU0706/Task_10ms/Subsystem/HALIn/PTCAN/Subsystem/CanMsgUnpack/MsgRxData_Unpack1" /begin SUB_GROUP S2893_CanRxData_Unpack /end SUB_GROUP /end GROUP
/begin GROUP S2510_MsgRxData_Unpack10 "VBU0706/Task_10ms/Subsystem/HALIn/PTCAN/Subsystem/CanMsgUnpack/MsgRxData_Unpack10" /begin SUB_GROUP S2894_CanRxData_Unpack /end SUB_GROUP /end GROUP
/begin GROUP S2510_MsgRxData_Unpack11 "VBU0706/Task_10ms/Subsystem/HALIn/PTCAN/Subsystem/CanMsgUnpack/MsgRxData_Unpack11" /begin SUB_GROUP S2895_CanRxData_Unpack /end SUB_GROUP /end GROUP
/begin GROUP S2510_MsgRxData_Unpack12 "VBU0706/Task_10ms/Subsystem/HALIn/PTCAN/Subsystem/CanMsgUnpack/MsgRxData_Unpack12" /begin SUB_GROUP S2896_CanRxData_Unpack /end SUB_GROUP /end GROUP
/begin GROUP S2510_MsgRxData_Unpack13 "VBU0706/Task_10ms/Subsystem/HALIn/PTCAN/Subsystem/CanMsgUnpack/MsgRxData_Unpack13" /begin SUB_GROUP S2897_CanRxData_Unpack /end SUB_GROUP /end GROUP
/begin GROUP S2510_MsgRxData_Unpack14 "VBU0706/Task_10ms/Subsystem/HALIn/PTCAN/Subsystem/CanMsgUnpack/MsgRxData_Unpack14" /begin SUB_GROUP S2898_CanRxData_Unpack /end SUB_GROUP /end GROUP
/begin GROUP S2510_MsgRxData_Unpack19 "VBU0706/Task_10ms/Subsystem/HALIn/PTCAN/Subsystem/CanMsgUnpack/MsgRxData_Unpack19" /begin SUB_GROUP S2903_CanRxData_Unpack /end SUB_GROUP /end GROUP
/begin GROUP S2510_MsgRxData_Unpack2 "VBU0706/Task_10ms/Subsystem/HALIn/PTCAN/Subsystem/CanMsgUnpack/MsgRxData_Unpack2" /begin SUB_GROUP S2904_CanRxData_Unpack /end SUB_GROUP /end GROUP
/begin GROUP S2510_MsgRxData_Unpack20 "VBU0706/Task_10ms/Subsystem/HALIn/PTCAN/Subsystem/CanMsgUnpack/MsgRxData_Unpack20" /begin SUB_GROUP S2905_CanRxData_Unpack /end SUB_GROUP /end GROUP
/begin GROUP S2510_MsgRxData_Unpack3 "VBU0706/Task_10ms/Subsystem/HALIn/PTCAN/Subsystem/CanMsgUnpack/MsgRxData_Unpack3" /begin SUB_GROUP S2906_CanRxData_Unpack /end SUB_GROUP /end GROUP
/begin GROUP S2510_MsgRxData_Unpack4 "VBU0706/Task_10ms/Subsystem/HALIn/PTCAN/Subsystem/CanMsgUnpack/MsgRxData_Unpack4" /begin SUB_GROUP S2907_CanRxData_Unpack /end SUB_GROUP /end GROUP
/begin GROUP S2510_MsgRxData_Unpack5 "VBU0706/Task_10ms/Subsystem/HALIn/PTCAN/Subsystem/CanMsgUnpack/MsgRxData_Unpack5" /begin SUB_GROUP S2908_CanRxData_Unpack /end SUB_GROUP /end GROUP
/begin GROUP S2510_MsgRxData_Unpack6 "VBU0706/Task_10ms/Subsystem/HALIn/PTCAN/Subsystem/CanMsgUnpack/MsgRxData_Unpack6" /begin SUB_GROUP S2909_CanRxData_Unpack /end SUB_GROUP /end GROUP
/begin GROUP S2510_MsgRxData_Unpack7 "VBU0706/Task_10ms/Subsystem/HALIn/PTCAN/Subsystem/CanMsgUnpack/MsgRxData_Unpack7" /begin SUB_GROUP S2910_CanRxData_Unpack /end SUB_GROUP /end GROUP
/begin GROUP S2510_MsgRxData_Unpack8 "VBU0706/Task_10ms/Subsystem/HALIn/PTCAN/Subsystem/CanMsgUnpack/MsgRxData_Unpack8" /begin SUB_GROUP S2911_CanRxData_Unpack /end SUB_GROUP /end GROUP
/begin GROUP S2510_MsgRxData_Unpack9 "VBU0706/Task_10ms/Subsystem/HALIn/PTCAN/Subsystem/CanMsgUnpack/MsgRxData_Unpack9" /begin SUB_GROUP S2912_CanRxData_Unpack /end SUB_GROUP /end GROUP
/begin GROUP S2512_IC_401 "VBU0706/Task_10ms/Subsystem/HALIn/PTCAN/Subsystem/Subsystem2/IC_401" /begin SUB_GROUP S2954_Input_CAN_Signal_No_Range_Check2 /end SUB_GROUP /begin REF_CHARACTERISTIC IC_flgMsg401ChksmDisbl_C IC_flgMsg401RollCntDisbl_C /end REF_CHARACTERISTIC /end GROUP
/begin GROUP S2512_MCU_505 "VBU0706/Task_10ms/Subsystem/HALIn/PTCAN/Subsystem/Subsystem2/MCU_505"
 /begin SUB_GROUP S2955_Input_CAN_Signal_No_Range_Check S2955_Input_CAN_Signal_No_Range_Check1 S2955_Input_CAN_Signal_No_Range_Check20 /end SUB_GROUP
 /begin REF_CHARACTERISTIC PEUR_flgMsg505ChksmDisbl_C PEUR_flgMsg505RollCntDisbl_C /end REF_CHARACTERISTIC
/end GROUP
/begin GROUP S2513_DCDC_509 "VBU0706/Task_10ms/Subsystem/HALIn/PTCAN/Subsystem/Subsystem3/DCDC_509" /begin SUB_GROUP S3040_Input_CAN_Signal_No_Range_Check /end SUB_GROUP /begin REF_CHARACTERISTIC DCDC_flgMsg509ChksmDisbl_C DCDC_flgMsg509RollCntDisbl_C /end REF_CHARACTERISTIC /end GROUP
/begin GROUP S2514_CDC_220 "VBU0706/Task_10ms/Subsystem/HALIn/PTCAN/Subsystem/Subsystem4/CDC_220"
 /begin SUB_GROUP S3076_Input_CAN_Signal_No_Range_Check S3076_Input_CAN_Signal_No_Range_Check3 S3076_Input_CAN_Signal_No_Range_Check4 /end SUB_GROUP
 /begin REF_CHARACTERISTIC CDC_flgMsg220ChksmDisbl_C CDC_flgMsg220RollCntDisbl_C /end REF_CHARACTERISTIC
/end GROUP
/begin GROUP S2514_DCDC_303 "VBU0706/Task_10ms/Subsystem/HALIn/PTCAN/Subsystem/Subsystem4/DCDC_303"
 /begin SUB_GROUP S3077_Input_CAN_Signal_No_Range_Check S3077_Input_CAN_Signal_No_Range_Check1 S3077_Input_CAN_Signal_No_Range_Check2 S3077_Input_CAN_Signal_No_Range_Check3 S3077_Input_CAN_Signal_No_Range_Check4 /end SUB_GROUP
 /begin REF_CHARACTERISTIC DCDC_flgMsg303ChksmDisbl_C DCDC_flgMsg303RollCntDisbl_C /end REF_CHARACTERISTIC
 /begin REF_MEASUREMENT DCDC_pwrHVInput DCDC_pwrLVOut /end REF_MEASUREMENT
/end GROUP
/begin GROUP S2514_MCU_405 "VBU0706/Task_10ms/Subsystem/HALIn/PTCAN/Subsystem/Subsystem4/MCU_405"
 /begin SUB_GROUP S3078_Input_CAN_Signal_No_Range_Check S3078_Input_CAN_Signal_No_Range_Check1 /end SUB_GROUP
 /begin REF_CHARACTERISTIC MCU_flgMsg405ChksmDisbl_C MCU_flgMsg405RollCntDisbl_C /end REF_CHARACTERISTIC
/end GROUP
/begin GROUP S3326_PropertyConfirm "VBU0706/Task_10ms/Subsystem/VCU /APO2HAL/Subsystem2/Subsystem/PropertyConfirm" /begin REF_MEASUREMENT OD_LsMainRly /end REF_MEASUREMENT /end GROUP
/begin GROUP S3326_PropertyConfirm1 "VBU0706/Task_10ms/Subsystem/VCU /APO2HAL/Subsystem2/Subsystem/PropertyConfirm1" /begin REF_MEASUREMENT OD_HsWakeUp1 /end REF_MEASUREMENT /end GROUP
/begin GROUP S3326_PropertyConfirm10 "VBU0706/Task_10ms/Subsystem/VCU /APO2HAL/Subsystem2/Subsystem/PropertyConfirm10" /begin REF_MEASUREMENT OP_fLsWaterPump1 /end REF_MEASUREMENT /end GROUP
/begin GROUP S3326_PropertyConfirm11 "VBU0706/Task_10ms/Subsystem/VCU /APO2HAL/Subsystem2/Subsystem/PropertyConfirm11" /begin REF_MEASUREMENT OP_pctLsWaterPump1 /end REF_MEASUREMENT /end GROUP
/begin GROUP S3326_PropertyConfirm12 "VBU0706/Task_10ms/Subsystem/VCU /APO2HAL/Subsystem2/Subsystem/PropertyConfirm12" /begin REF_MEASUREMENT OP_fLsWaterPump2 /end REF_MEASUREMENT /end GROUP
/begin GROUP S3326_PropertyConfirm13 "VBU0706/Task_10ms/Subsystem/VCU /APO2HAL/Subsystem2/Subsystem/PropertyConfirm13" /begin REF_MEASUREMENT OP_pctLsWaterPump2 /end REF_MEASUREMENT /end GROUP
/begin GROUP S3326_PropertyConfirm14 "VBU0706/Task_10ms/Subsystem/VCU /APO2HAL/Subsystem2/Subsystem/PropertyConfirm14" /begin REF_MEASUREMENT OP_fLsACPump /end REF_MEASUREMENT /end GROUP
/begin GROUP S3326_PropertyConfirm15 "VBU0706/Task_10ms/Subsystem/VCU /APO2HAL/Subsystem2/Subsystem/PropertyConfirm15" /begin REF_MEASUREMENT OP_pctLsACPump /end REF_MEASUREMENT /end GROUP
/begin GROUP S3326_PropertyConfirm4 "VBU0706/Task_10ms/Subsystem/VCU /APO2HAL/Subsystem2/Subsystem/PropertyConfirm4" /begin REF_MEASUREMENT OP_fLsHVIL1 /end REF_MEASUREMENT /end GROUP
/begin GROUP S3326_PropertyConfirm5 "VBU0706/Task_10ms/Subsystem/VCU /APO2HAL/Subsystem2/Subsystem/PropertyConfirm5" /begin REF_MEASUREMENT OD_flgVBUSleepEnable /end REF_MEASUREMENT /end GROUP
/begin GROUP S3326_PropertyConfirm6 "VBU0706/Task_10ms/Subsystem/VCU /APO2HAL/Subsystem2/Subsystem/PropertyConfirm6" /begin REF_MEASUREMENT OP_pctLsHVIL1 /end REF_MEASUREMENT /end GROUP
/begin GROUP S3326_PropertyConfirm8 "VBU0706/Task_10ms/Subsystem/VCU /APO2HAL/Subsystem2/Subsystem/PropertyConfirm8" /begin REF_MEASUREMENT OP_fLsFan /end REF_MEASUREMENT /end GROUP
/begin GROUP S3326_PropertyConfirm9 "VBU0706/Task_10ms/Subsystem/VCU /APO2HAL/Subsystem2/Subsystem/PropertyConfirm9" /begin REF_MEASUREMENT OP_pctLsFan /end REF_MEASUREMENT /end GROUP
/begin GROUP S3344_DSPL_Consumption "VBU0706/Task_10ms/Subsystem/VCU /DSPL/DSPL/DriveRange/DSPL_Consumption" /begin SUB_GROUP S3347_DSPL_EnergySelfLearn /end SUB_GROUP /end GROUP
/begin GROUP S3344_RemainingRange "VBU0706/Task_10ms/Subsystem/VCU /DSPL/DSPL/DriveRange/RemainingRange"
 /begin SUB_GROUP S3348_ChargeConditon S3348_ChargeTemp S3348_DriveTemp S3348_FullRangeAndSocDeclineFactor S3348_RangeTempSelect S3348_SelectDisplayRange /end SUB_GROUP
/end GROUP
/begin GROUP S3471_Drive_Mode_Power_Calculate "VBU0706/Task_10ms/Subsystem/VCU /EDIS/EDIS_Ctrl/BatDis_Power_Lim_Calc/Drive_Mode_Power_Calculate" /begin REF_CHARACTERISTIC EDIS_pwrDrvRstn_C /end REF_CHARACTERISTIC /begin REF_MEASUREMENT EDIS_pwrDrvPwrLimDrvMode /end REF_MEASUREMENT /end GROUP
/begin GROUP S3471_Power_Arbitration "VBU0706/Task_10ms/Subsystem/VCU /EDIS/EDIS_Ctrl/BatDis_Power_Lim_Calc/Power_Arbitration"
 /begin SUB_GROUP S3475_accessory_power_limit_Calculate S3475_drive_power_limit_calculate /end SUB_GROUP
/end GROUP
/begin GROUP S3471_Regen_Mode_Power_Calculate "VBU0706/Task_10ms/Subsystem/VCU /EDIS/EDIS_Ctrl/BatDis_Power_Lim_Calc/Regen_Mode_Power_Calculate" /begin REF_CHARACTERISTIC EDIS_pwrChDynSpare_CUR_v /end REF_CHARACTERISTIC /end GROUP
/begin GROUP S3472_charge_power_calculate "VBU0706/Task_10ms/Subsystem/VCU /EDIS/EDIS_Ctrl/battery_power_calculate/charge_power_calculate" /begin SUB_GROUP S3494_BatDis_Regen_Power_PI_Filter S3494_ChPowSetPoint /end SUB_GROUP /end GROUP
/begin GROUP S3472_discharge_power_calculate "VBU0706/Task_10ms/Subsystem/VCU /EDIS/EDIS_Ctrl/battery_power_calculate/discharge_power_calculate" /begin SUB_GROUP S3495_DchPowSetpiont S3495_discharge_pid /end SUB_GROUP /end GROUP
/begin GROUP S3473_accessory_load_power "VBU0706/Task_10ms/Subsystem/VCU /EDIS/EDIS_Ctrl/drive_power_calculate/accessory_load_power" /begin REF_CHARACTERISTIC PTC_PwrMax_C /end REF_CHARACTERISTIC /begin REF_MEASUREMENT EDIS_pwrAcsyAct /end REF_MEASUREMENT /end GROUP
/begin GROUP S3554_LowVoltageBalanceControl "VBU0706/Task_10ms/Subsystem/VCU /PMM/PMM_Ctrl/LVC/LowVoltageBalanceControl" /begin SUB_GROUP S3557_LVC_DcdcSpCtl S3557_LVC_DcdcStCtl /end SUB_GROUP /end GROUP
/begin GROUP S3555_DrvMod_Ctrl "VBU0706/Task_10ms/Subsystem/VCU /PMM/PMM_Ctrl/PMM/DrvMod_Ctrl" /begin SUB_GROUP S3598_DVM_SetRdy S3598_DVM_VehRdy /end SUB_GROUP /end GROUP
/begin GROUP S3555_LvWakeUp_Ctrl "VBU0706/Task_10ms/Subsystem/VCU /PMM/PMM_Ctrl/PMM/LvWakeUp_Ctrl" /begin SUB_GROUP S3599_LvWakeUp_Mode_Calc S3599_LvWakeUp_State_Calc /end SUB_GROUP /end GROUP
/begin GROUP S3555_PwrMod_Ctrl "VBU0706/Task_10ms/Subsystem/VCU /PMM/PMM_Ctrl/PMM/PwrMod_Ctrl"
 /begin SUB_GROUP S3601_AcTvDisCh S3601_HVRlyCtrl S3601_PwrMod_PowerUp S3601_Routine S3601_RoutineOvrd S3601_SelfRoutine /end SUB_GROUP
 /begin REF_CHARACTERISTIC PMM_stACTest_SY PMM_stActvDisCh_SY PMM_stDCDCDisbl_SY PMM_stHVCntctStClosed_SY PMM_stHVCntctStInit_SY PMM_stHVCntctStPreCh_SY PMM_stHVRlyClose_SY PMM_stHVRlyConnReq_SY PMM_stHVRlyConn_SY PMM_stHVRlyNoReq_SY PMM_stHVRlyOpenReq_SY PMM_stHVRlyOpen_SY PMM_stInitRst_SY PMM_stMCUACOff_SY PMM_stRstKeep_SY PMM_tiACTst_C PMM_tiActvDisCh_C PMM_tiDCDCDisbl_C PMM_tiDlyInitRst_C PMM_tiHVRlyOpenReq_C PMM_tiHVRlyT_C PMM_tiRstKeep_C PMM_tiSmplT_SY /end REF_CHARACTERISTIC
 /begin REF_MEASUREMENT PMM_flgACTstTimeOut PMM_flgAccDisable PMM_flgActvDisChTimeOut PMM_flgDCDCEna PMM_flgHVRLyCloseTimeOut PMM_flgHVRlyOpenTimeOut PMM_flgOffLoadTimeOut PMM_stHVRlyReqTmp PMM_stPwrModeSt PMM_tiStDurT /end REF_MEASUREMENT
/end GROUP
/begin GROUP S3704_AxleSpeedDiff "VBU0706/Task_10ms/Subsystem/VCU /SPD/SPD/SignalProcessing_10ms/AxleSpeedDiff" /begin REF_CHARACTERISTIC SYS_facRPM2KPH_SY SYS_lFWhlRadius_SY SYS_lWheelBase_SY /end REF_CHARACTERISTIC
 /begin REF_MEASUREMENT SPD_nDSpdTarFR SPD_nDeltaRALR SPD_nFA SPD_nFARADelta SPD_nRA /end REF_MEASUREMENT
/end GROUP
/begin GROUP S3704_Bench "VBU0706/Task_10ms/Subsystem/VCU /SPD/SPD/SignalProcessing_10ms/Bench" /begin SUB_GROUP S3706_BenchArb /end SUB_GROUP /end GROUP
/begin GROUP S3704_MovingDirectionJudge "VBU0706/Task_10ms/Subsystem/VCU /SPD/SPD/SignalProcessing_10ms/MovingDirectionJudge"
 /begin REF_CHARACTERISTIC SPD_nRPM4Backward SPD_nRPM4Forward SPD_stMovDirBwrd_SY SPD_stMovDirFwrd_SY SPD_stMovDirInvd_SY SPD_stMovDirStdstill_SY /end REF_CHARACTERISTIC
/end GROUP
/begin GROUP S3704_SlopeCal1 "VBU0706/Task_10ms/Subsystem/VCU /SPD/SPD/SignalProcessing_10ms/SlopeCal1" /begin SUB_GROUP S3708_SlopeCal S3708_VehSt /end SUB_GROUP /begin REF_CHARACTERISTIC SPD_tiAxUpdate2_C SPD_tiAxUpdate_C /end REF_CHARACTERISTIC /begin REF_MEASUREMENT SPD_aXSlope SPD_stAX SPD_tiStAx /end REF_MEASUREMENT /end GROUP
/begin GROUP S3704_Subsystem1 "VBU0706/Task_10ms/Subsystem/VCU /SPD/SPD/SignalProcessing_10ms/Subsystem1" /begin SUB_GROUP S3709_vWhlProcess S3709_v_Axle /end SUB_GROUP /end GROUP
/begin GROUP S3704_VehDir "VBU0706/Task_10ms/Subsystem/VCU /SPD/SPD/SignalProcessing_10ms/VehDir" /begin SUB_GROUP S3710_RearWhl /end SUB_GROUP /begin REF_MEASUREMENT SPD_vVehSpdSlp /end REF_MEASUREMENT /end GROUP
/begin GROUP S3704_VehSpdNorm "VBU0706/Task_10ms/Subsystem/VCU /SPD/SPD/SignalProcessing_10ms/VehSpdNorm" /begin SUB_GROUP S3711_Normal_VehSpdCal S3711_nMotr2vVeh /end SUB_GROUP /end GROUP
/begin GROUP S3743_GradientLimiter "VBU0706/Task_10ms/Subsystem/VCU /THM/THM/Compr/GradientLimiter" /begin REF_MEASUREMENT THM_nACSpdSet /end REF_MEASUREMENT /end GROUP
/begin GROUP S3744_OperateCycle "VBU0706/Task_10ms/Subsystem/VCU /THM/THM/ESSThermalMode/OperateCycle" /begin SUB_GROUP S3753_Cool S3753_Heat /end SUB_GROUP /begin REF_MEASUREMENT THM_stOperateCycle /end REF_MEASUREMENT /end GROUP
/begin GROUP S3744_OperateMode "VBU0706/Task_10ms/Subsystem/VCU /THM/THM/ESSThermalMode/OperateMode"
 /begin REF_CHARACTERISTIC THM_tCoolDeltaMaxTemp_C THM_tCoolDeltaMinTemp_C THM_tCoolFrstDeltaMaxTemp_C THM_tHeatDeltaMaxTemp_C THM_tHeatDeltaMinTemp_C /end REF_CHARACTERISTIC
 /begin REF_MEASUREMENT THM_stOperateMode /end REF_MEASUREMENT
/end GROUP
/begin GROUP S3744_TempTar "VBU0706/Task_10ms/Subsystem/VCU /THM/THM/ESSThermalMode/TempTar"
 /begin REF_CHARACTERISTIC THM_tDCChCoolTar_C THM_tDCChHeatTar_C THM_tDrvCoolTar_C THM_tDrvHeatTar_C /end REF_CHARACTERISTIC
 /begin REF_MEASUREMENT THM_tCoolTar THM_tHeatTar /end REF_MEASUREMENT
/end GROUP
/begin GROUP S3745_GradientLimiter "VBU0706/Task_10ms/Subsystem/VCU /THM/THM/EXVRaw/GradientLimiter" /begin REF_MEASUREMENT THM_pctEXVPosReq /end REF_MEASUREMENT /end GROUP
/begin GROUP S3745_Turn_Off_Delay_Time "VBU0706/Task_10ms/Subsystem/VCU /THM/THM/EXVRaw/Turn_Off_Delay_Time" /begin REF_MEASUREMENT THM_flgEXVEna /end REF_MEASUREMENT /end GROUP
/begin GROUP S3746_GradientLimiter "VBU0706/Task_10ms/Subsystem/VCU /THM/THM/FANRaw/GradientLimiter" /begin REF_MEASUREMENT THM_pctFANRaw /end REF_MEASUREMENT /end GROUP
/begin GROUP S3749_ESSPmpCmdRaw "VBU0706/Task_10ms/Subsystem/VCU /THM/THM/PumpRaw/ESSPmpCmdRaw" /begin SUB_GROUP S3782_GradientLimiter /end SUB_GROUP
 /begin REF_CHARACTERISTIC THM_pctESSPmpDecGrad_C THM_pctESSPmpIncGrad_C THM_ptcActvThemalMaxESSPump_C /end REF_CHARACTERISTIC
/end GROUP
/begin GROUP S3749_PumpCmd "VBU0706/Task_10ms/Subsystem/VCU /THM/THM/PumpRaw/PumpCmd"
 /begin REF_CHARACTERISTIC THM_facDeltaCellTempESSPump_v THM_facVheSpdRearPump_v THM_pctDCDCRearPump_v THM_pctESSPumpCool_v THM_pctESSPumpDftCmd_C THM_pctPEUPhUVWRearPump_v THM_pctPEUStrRearPump_v /end REF_CHARACTERISTIC
 /begin REF_MEASUREMENT THM_pctESSPumpReq THM_pctRearPumpReq /end REF_MEASUREMENT
/end GROUP
/begin GROUP S3749_RearPmpCmdRaw "VBU0706/Task_10ms/Subsystem/VCU /THM/THM/PumpRaw/RearPmpCmdRaw" /begin SUB_GROUP S3784_GradientLimiter /end SUB_GROUP /begin REF_CHARACTERISTIC THM_pctRearPmpDecGrad_C THM_pctRearPmpIncGrad_C /end REF_CHARACTERISTIC /end GROUP
/begin GROUP S3811_TQC_VehSpdLimit "VBU0706/Task_10ms/Subsystem/VCU /TQC/TQC/Subsystem/TQC_VehSpdLimit" /begin SUB_GROUP S3812_Subsystem S3812_VLIMCal S3812_VMax S3812_VMaxServer /end SUB_GROUP /end GROUP
/begin GROUP S3811_VehInfo1 "VBU0706/Task_10ms/Subsystem/VCU /TQC/TQC/Subsystem/VehInfo1" /begin SUB_GROUP S3813_TQC_VehInfoAnalysis S3813_Veh_Drag S3813_Veh_a2Trq /end SUB_GROUP /end GROUP
/begin GROUP S3859_TrqDem_DrvTrq_Cal "VBU0706/Task_10ms/Subsystem/VCU /TQD/TrqDem/TrqDem_DrvTrq_Cal/TrqDem_DrvTrq_Cal" /begin REF_CHARACTERISTIC TQD_facTrqDesGrR_CUR_v TQD_trqTrqSetNormal_MAP_v /end REF_CHARACTERISTIC /begin REF_MEASUREMENT TQD_facDesTrqGr TQD_trqDesRaw TQD_trqZrPed /end REF_MEASUREMENT /end GROUP
/begin GROUP S3859_TrqDem_MinTrq_Cal "VBU0706/Task_10ms/Subsystem/VCU /TQD/TrqDem/TrqDem_DrvTrq_Cal/TrqDem_MinTrq_Cal"
 /begin SUB_GROUP S3862_BrakeCrpModify S3862_CrpEnaArb S3862_CrpRgnTrqArb S3862_CrpRgnTrqCal S3862_CrpRgnTrqLim /end SUB_GROUP
/end GROUP
/begin GROUP S3859_TrqDem_TrqDes_Cal "VBU0706/Task_10ms/Subsystem/VCU /TQD/TrqDem/TrqDem_DrvTrq_Cal/TrqDem_TrqDes_Cal" /begin REF_CHARACTERISTIC TQD_pctCrpOff_CUR_v TQD_trqRoad_CUR_v /end REF_CHARACTERISTIC
 /begin REF_MEASUREMENT TQD_trqDemRegen TQD_trqDesDecel TQD_trqDesWeighted TQD_trqNrmDes TQD_trqRoad /end REF_MEASUREMENT
/end GROUP
/begin GROUP S3860_BrakePressureFilter "VBU0706/Task_10ms/Subsystem/VCU /TQD/TrqDem/TrqDem_InputTransfer/BrakePressureFilter" /begin SUB_GROUP S3874_First_Order_Low_Pass_Filter /end SUB_GROUP /begin REF_CHARACTERISTIC TQD_facBrkPressFilt_C /end REF_CHARACTERISTIC /end GROUP
/begin GROUP S3860_TrqDem_AccPdl_Filter "VBU0706/Task_10ms/Subsystem/VCU /TQD/TrqDem/TrqDem_InputTransfer/TrqDem_AccPdl_Filter" /begin REF_CHARACTERISTIC TQD_flgAPDFltByp_C /end REF_CHARACTERISTIC /begin REF_MEASUREMENT TQD_pctAccPedPosFlt /end REF_MEASUREMENT /end GROUP
/begin GROUP S3860_TrqDem_GearDet "VBU0706/Task_10ms/Subsystem/VCU /TQD/TrqDem/TrqDem_InputTransfer/TrqDem_GearDet" /begin REF_CHARACTERISTIC TQD_flgVirtualNeutralEnable_C TQD_pctAccPedalDeadband_C /end REF_CHARACTERISTIC /begin REF_MEASUREMENT TQD_flgVirtualNeutral TQD_stVehCreepMode /end REF_MEASUREMENT /end GROUP
/begin GROUP S3860_TrqDem_VehSpeed_Filter "VBU0706/Task_10ms/Subsystem/VCU /TQD/TrqDem/TrqDem_InputTransfer/TrqDem_VehSpeed_Filter" /begin SUB_GROUP S3877_DejitterFIL S3877_SR_Flip_Flop /end SUB_GROUP
 /begin REF_CHARACTERISTIC TQD_facVehSpdFlt_C TQD_facVehSpdHys_C TQD_flgVectorSpdUsed_C TQD_pctVehSlideRes_C TQD_vVehSlideEna_C TQD_vVehSlideRes_C /end REF_CHARACTERISTIC
 /begin REF_MEASUREMENT TQD_flgSlideRst /end REF_MEASUREMENT
/end GROUP
/begin GROUP S3884_STC "VBU0706/Task_10ms/Subsystem/VCU /TQO/TQOAll/STC/STC" /begin SUB_GROUP S3892_DisableRgnTorque /end SUB_GROUP /end GROUP
/begin GROUP S3886_TQARB "VBU0706/Task_10ms/Subsystem/VCU /TQO/TQOAll/TQARB/TQARB" /begin SUB_GROUP S3896_Limitation S3896_TrqArb /end SUB_GROUP /end GROUP
/begin GROUP S3887_TQCMP "VBU0706/Task_10ms/Subsystem/VCU /TQO/TQOAll/TQCMP/TQCMP" /begin SUB_GROUP S3902_TrqPulse /end SUB_GROUP /begin REF_CHARACTERISTIC TQCMP_trqLowSpdRA /end REF_CHARACTERISTIC /end GROUP
/begin GROUP S3888_TQDIS "VBU0706/Task_10ms/Subsystem/VCU /TQO/TQOAll/TQDIS/TQDIS" /begin SUB_GROUP S3910_AxleArb S3910_Dmp S3910_TrqFilter S3910_TrqLim /end SUB_GROUP /end GROUP
/begin GROUP S3889_TQDMP "VBU0706/Task_10ms/Subsystem/VCU /TQO/TQOAll/TQDMP/TQDMP" /begin SUB_GROUP S3946_CMB S3946_Dibl S3946_RAROTC /end SUB_GROUP /end GROUP
/begin GROUP S3890_TQO "VBU0706/Task_10ms/Subsystem/VCU /TQO/TQOAll/TQO/TQO" /begin SUB_GROUP S3989_MotorTorque S3989_Subsystem S3989_Trq /end SUB_GROUP /end GROUP
/begin GROUP S4002_MTrqLim "VBU0706/Task_10ms/Subsystem/VCU /VTQA/Subsystem/Subsystem/MTrqLim"
 /begin SUB_GROUP S4003_TorqueRamp S4003_TrqCapacityArb S4003_TrqCapacityCal S4003_TrqCapacityLim /end SUB_GROUP
/end GROUP
/begin GROUP S4002_VehTrqArb "VBU0706/Task_10ms/Subsystem/VCU /VTQA/Subsystem/Subsystem/VehTrqArb" /begin SUB_GROUP S4004_BattLim_Transfer S4004_Trq_Arb /end SUB_GROUP /end GROUP
/begin GROUP S4035_APD "VBU0706/Task_10ms/Subsystem/VCU /VehINP/VehINP_Logic/APD/APD"
 /begin SUB_GROUP S4046_APD1_Norm S4046_APD2_Norm S4046_APD_Dejitter1 S4046_APD_Dejitter2 S4046_APD_Override S4046_Diag_Ratio S4046_Diag_Status S4046_Value_Selection /end SUB_GROUP
/end GROUP
/begin GROUP S4037_IF_Then_Else1 "VBU0706/Task_10ms/Subsystem/VCU /VehINP/VehINP_Logic/FPV/IF_Then_Else1" /begin REF_MEASUREMENT FPV_st4WayVlvPosFdbk /end REF_MEASUREMENT /end GROUP
/begin GROUP S4038_Gear1 "VBU0706/Task_10ms/Subsystem/VCU /VehINP/VehINP_Logic/GearShift/Gear1"
 /begin SUB_GROUP S4087_Digital_Gear_D_R S4087_Gear_BrakeCondition S4087_Gear_DriverShiftPReq S4087_Gear_EPBStatus S4087_Gear_ExternalReq S4087_Gear_P S4087_Gear_ProtectCondition S4087_Gear_Status S4087_Gear_VehSpeed S4087_Gear_VehicleStatus S4087_Subsystem /end SUB_GROUP
/end GROUP
/begin GROUP S4039_VehMode "VBU0706/Task_10ms/Subsystem/VCU /VehINP/VehINP_Logic/Mode/VehMode" /begin SUB_GROUP S4205_Veh_CreepMode S4205_Veh_DrvMode S4205_Veh_RgnMode /end SUB_GROUP /end GROUP
/begin GROUP S4043_Hysteresis_LLC_RHC "VBU0706/Task_10ms/Subsystem/VCU /VehINP/VehINP_Logic/VacuumPump Control/Hysteresis_LLC_RHC" /begin REF_MEASUREMENT Veh_flgVacPumpReq /end REF_MEASUREMENT /end GROUP
/begin GROUP S4044_BPD_BrakePercent "VBU0706/Task_10ms/Subsystem/VCU /VehINP/VehINP_Logic/VehINP_BPD/BPD_BrakePercent" /begin SUB_GROUP S4248_BPD_BrakePercentStatus S4248_BPD_PressBrake /end SUB_GROUP /end GROUP
/begin GROUP S4044_BPD_BrakeSwitch "VBU0706/Task_10ms/Subsystem/VCU /VehINP/VehINP_Logic/VehINP_BPD/BPD_BrakeSwitch" /begin SUB_GROUP S4249_BPD_BrakeSwitchHW S4249_BPD_BrakeSwitchSelect /end SUB_GROUP /end GROUP
/begin GROUP S4044_VehINP_BrkPedOverride "VBU0706/Task_10ms/Subsystem/VCU /VehINP/VehINP_Logic/VehINP_BPD/VehINP_BrkPedOverride" /begin SUB_GROUP S4251_override_signal1 S4251_override_signal4 /end SUB_GROUP
 /begin REF_CHARACTERISTIC BPD_flgBrkPosOverride_C BPD_flgBrkPosVldOverrideVal_C BPD_flgBrkPosVldOverride_C BPD_flgBrkSwtOverride_C BPD_pctBrkPosOverrideVal_C BPD_stBrkPedPrsNoActv_C BPD_stBrkSwtOverrideVal_C /end REF_CHARACTERISTIC
 /begin REF_MEASUREMENT BPD_flgBrkSwt /end REF_MEASUREMENT
/end GROUP
/begin GROUP S4045_VehHVIL "VBU0706/Task_10ms/Subsystem/VCU /VehINP/VehINP_Logic/Veh_Status/VehHVIL" /begin SUB_GROUP S4268_HVIL /end SUB_GROUP /end GROUP
/begin GROUP S334_Calculate_BatteryCurrent_ZeroDrift "VBU0706/Function-Call Subsystem/Subsystem1/BCV/BCV/Subsystem/Calculate_BatteryCurrent/Correct_BatteryCurrent/Calculate_BatteryCurrent_ZeroDrift"
 /begin SUB_GROUP S336_Calculate_Current_ZeroDruft S336_Calculate_ExtremeData /end SUB_GROUP
/end GROUP
/begin GROUP S334_Delay_RisingEdge "VBU0706/Function-Call Subsystem/Subsystem1/BCV/BCV/Subsystem/Calculate_BatteryCurrent/Correct_BatteryCurrent/Delay_RisingEdge" /begin REF_MEASUREMENT BCV_flgBatteryCurrentValid /end REF_MEASUREMENT /end GROUP
/begin GROUP S348_Delay_FallingEdge "VBU0706/Function-Call Subsystem/Subsystem1/BCV/BCV/Subsystem/Calculate_BatteryVoltage/Check_BatteryVoltage_Valid/Delay_FallingEdge" /begin REF_MEASUREMENT BCV_flgBatteryVoltageValid /end REF_MEASUREMENT /end GROUP
/begin GROUP S349_Delay_FallingEdge "VBU0706/Function-Call Subsystem/Subsystem1/BCV/BCV/Subsystem/Calculate_BatteryVoltage/Check_BusNegativeVoltage_Valid/Delay_FallingEdge" /begin REF_MEASUREMENT BCV_flgBusNegativeVoltageValid /end REF_MEASUREMENT /end GROUP
/begin GROUP S350_Delay_FallingEdge "VBU0706/Function-Call Subsystem/Subsystem1/BCV/BCV/Subsystem/Calculate_BatteryVoltage/Check_BusVoltage_Valid/Delay_FallingEdge" /begin REF_MEASUREMENT BCV_flgBusVoltageValid /end REF_MEASUREMENT /end GROUP
/begin GROUP S351_Delay_FallingEdge "VBU0706/Function-Call Subsystem/Subsystem1/BCV/BCV/Subsystem/Calculate_BatteryVoltage/Check_FuseVoltage_Valid/Delay_FallingEdge" /begin REF_MEASUREMENT BCV_flgFuseVoltageValid /end REF_MEASUREMENT /end GROUP
/begin GROUP S352_Delay_FallingEdge "VBU0706/Function-Call Subsystem/Subsystem1/BCV/BCV/Subsystem/Calculate_BatteryVoltage/Check_PrechargeVoltage_Valid/Delay_FallingEdge" /begin REF_MEASUREMENT BCV_flgPrechargeVoltageValid /end REF_MEASUREMENT /end GROUP
/begin GROUP S353_Delay_FallingEdge "VBU0706/Function-Call Subsystem/Subsystem1/BCV/BCV/Subsystem/Calculate_BatteryVoltage/Check_Vx1Voltage_Valid/Delay_FallingEdge" /begin REF_MEASUREMENT BCV_flgVx1VoltageValid /end REF_MEASUREMENT /end GROUP
/begin GROUP S354_Delay_FallingEdge "VBU0706/Function-Call Subsystem/Subsystem1/BCV/BCV/Subsystem/Calculate_BatteryVoltage/Check_Vx2Voltage_Valid/Delay_FallingEdge" /begin REF_MEASUREMENT BCV_flgVx2VoltageValid /end REF_MEASUREMENT /end GROUP
/begin GROUP S387_Accumulate_Carry "VBU0706/Function-Call Subsystem/Subsystem1/BCV/BCV/Subsystem/Calculate_Lifetime_Data/Calculate_LifeTimeFastcharge/Accumulate_Carry" /begin REF_MEASUREMENT BCV_AhOverallCoulombFCCChgCarry /end REF_MEASUREMENT /end GROUP
/begin GROUP S416_EVM_FDC_Handler "VBU0706/Function-Call Subsystem/Subsystem1/BCV/BCV/Subsystem/Diagnose_BCV_Data_Fault/Diagnose_VoltageCurrent_Fault/EVM_FDC_Handler" /begin SUB_GROUP S423_DetermineFault S423_DetermineFaultCounter /end SUB_GROUP /end GROUP
/begin GROUP S416_EVM_FDC_Handler1 "VBU0706/Function-Call Subsystem/Subsystem1/BCV/BCV/Subsystem/Diagnose_BCV_Data_Fault/Diagnose_VoltageCurrent_Fault/EVM_FDC_Handler1" /begin SUB_GROUP S424_DetermineFault S424_DetermineFaultCounter /end SUB_GROUP /end GROUP
/begin GROUP S416_EVM_FDC_Handler2 "VBU0706/Function-Call Subsystem/Subsystem1/BCV/BCV/Subsystem/Diagnose_BCV_Data_Fault/Diagnose_VoltageCurrent_Fault/EVM_FDC_Handler2" /begin SUB_GROUP S425_DetermineFault S425_DetermineFaultCounter /end SUB_GROUP /end GROUP
/begin GROUP S466_Diagnose_BdmOutOfRange_Fault "VBU0706/Function-Call Subsystem/Subsystem1/BCV/BCV/Subsystem/Monitor_BCV_Performance/Diagnose_BDM_BCV_Communication_Fault/Diagnose_BdmOutOfRange_Fault" /begin SUB_GROUP S472_BigDataMonitor_Handler S472_BigDataMonitor_Handler1 /end SUB_GROUP
 /begin REF_CHARACTERISTIC CbBCV_BdmBatteryCurrentOoR_flg CbBCV_BdmBatteryVoltageOoR_flg CcBCV_BdmBatteryCurrentOoRFaultFIC_n CcBCV_BdmBatteryCurrentOoRFaultPIC_n CcBCV_BdmBatteryCurrentOoR_A CcBCV_BdmBatteryVoltageOoRFaultFIC_n CcBCV_BdmBatteryVoltageOoRFaultPIC_n CcBCV_BdmBatteryVoltageOoRHigh_V CcBCV_BdmBatteryVoltageOoRLow_V /end REF_CHARACTERISTIC
/end GROUP
/begin GROUP S467_Diagnose_BdmBatteryBusVoltageMismatch_Fault "VBU0706/Function-Call Subsystem/Subsystem1/BCV/BCV/Subsystem/Monitor_BCV_Performance/Diagnose_BDM_BCV_Data_Fault/Diagnose_BdmBatteryBusVoltageMismatch_Fault" /begin SUB_GROUP S483_BigDataMonitor_Handler1 /end SUB_GROUP
 /begin REF_CHARACTERISTIC CbBCV_BdmBatteryBusVoltageMismatch_flg CcBCV_BdmBatteryBusVoltageMismatchFaultDelta_V CcBCV_BdmBatteryBusVoltageMismatchFaultFIC_n CcBCV_BdmBatteryBusVoltageMismatchFaultPIC_n CcBCV_BdmBatteryBusVoltageMismatchFault_V /end REF_CHARACTERISTIC
/end GROUP
/begin GROUP S467_Diagnose_BdmVoltageCurrent_Fault "VBU0706/Function-Call Subsystem/Subsystem1/BCV/BCV/Subsystem/Monitor_BCV_Performance/Diagnose_BDM_BCV_Data_Fault/Diagnose_BdmVoltageCurrent_Fault"
 /begin SUB_GROUP S484_BigDataMonitor_Handler S484_BigDataMonitor_Handler1 S484_BigDataMonitor_Handler2 /end SUB_GROUP
 /begin REF_CHARACTERISTIC CbBCV_BdmBatteryOverCurrent_flg CbBCV_BdmBatteryOverVoltage_flg CbBCV_BdmBatteryUnderVoltage_flg CcBCV_BdmBatteryOverCurrentFaultFIC_n CcBCV_BdmBatteryOverCurrentFaultPIC_n CcBCV_BdmBatteryOverCurrent_A CcBCV_BdmBatteryOverVoltageFaultFIC_n CcBCV_BdmBatteryOverVoltageFaultPIC_n CcBCV_BdmBatteryOverVoltage_V CcBCV_BdmBatteryUnderVoltage1_V CcBCV_BdmBatteryUnderVoltage2_V CcBCV_BdmBatteryUnderVoltageFaultFIC_n CcBCV_BdmBatteryUnderVoltageFaultPIC_n CcBCV_BdmBatteryUnderVoltageTemp_C /end REF_CHARACTERISTIC
/end GROUP
/begin GROUP S663_Determine_Diagnostic_Status "VBU0706/Function-Call Subsystem/Subsystem1/CTD/Subsystem/Subsystem4/DiagnoseRelayWeld/MNC_Weld_Check/Determine_Diagnostic_Status" /begin REF_MEASUREMENT CTD_stMnNegContactorWeldDiagnosticStatus /end REF_MEASUREMENT /end GROUP
/begin GROUP S663_Equal_to_LOW1 "VBU0706/Function-Call Subsystem/Subsystem1/CTD/Subsystem/Subsystem4/DiagnoseRelayWeld/MNC_Weld_Check/Equal_to_LOW1" /begin REF_CHARACTERISTIC LOW /end REF_CHARACTERISTIC /end GROUP
/begin GROUP S664_Determine_Diagnostic_Status "VBU0706/Function-Call Subsystem/Subsystem1/CTD/Subsystem/Subsystem4/DiagnoseRelayWeld/MPC_Weld_Check/Determine_Diagnostic_Status" /begin REF_MEASUREMENT CTD_stMnPosContactorWeldDiagnosticStatus /end REF_MEASUREMENT /end GROUP
/begin GROUP S664_Equal_to_LOW1 "VBU0706/Function-Call Subsystem/Subsystem1/CTD/Subsystem/Subsystem4/DiagnoseRelayWeld/MPC_Weld_Check/Equal_to_LOW1" /begin REF_CHARACTERISTIC LOW /end REF_CHARACTERISTIC /end GROUP
/begin GROUP S664_Equal_to_LOW2 "VBU0706/Function-Call Subsystem/Subsystem1/CTD/Subsystem/Subsystem4/DiagnoseRelayWeld/MPC_Weld_Check/Equal_to_LOW2" /begin REF_CHARACTERISTIC LOW /end REF_CHARACTERISTIC /end GROUP
/begin GROUP S704_Determine_Heat_LockTime "VBU0706/Function-Call Subsystem/Subsystem1/CTD/Subsystem/Subsystem4/Lockout_Precharge_Process/HeatProtection_Lockout/Determine_Heat_LockTime"
 /begin REF_CHARACTERISTIC CbCTD_PrechargeHeatProtectionEnable_flg CcCTD_MinHeatDissipation_J CcCTD_OnePrechargeHeat_J /end REF_CHARACTERISTIC
 /begin REF_MEASUREMENT LcCTD_tiPrechargeHeatProtectionTime /end REF_MEASUREMENT
/end GROUP
/begin GROUP S704_Determine_LockPoint_AvaliableHeat "VBU0706/Function-Call Subsystem/Subsystem1/CTD/Subsystem/Subsystem4/Lockout_Precharge_Process/HeatProtection_Lockout/Determine_LockPoint_AvaliableHeat" /begin REF_CHARACTERISTIC CcCTD_OnePrechargeHeat_J /end REF_CHARACTERISTIC /end GROUP
/begin GROUP S730_Determine_Precharge_JouleHeat "VBU0706/Function-Call Subsystem/Subsystem1/CTD/Subsystem/Subsystem4/PrechrgProcessMonitoring/Precharge_Thermal_Management/Determine_Precharge_JouleHeat" /begin SUB_GROUP S734_Determine_Accumulated_RemainingHeat /end SUB_GROUP /begin REF_CHARACTERISTIC CcCTD_MaxJouleHeat_J CcCTD_PrechargeResistance_ohm /end REF_CHARACTERISTIC /begin REF_MEASUREMENT LcCTD_PrechargeJouleHeat_J /end REF_MEASUREMENT /end GROUP
/begin GROUP S730_Perform_OverEnergy_Diagnostic "VBU0706/Function-Call Subsystem/Subsystem1/CTD/Subsystem/Subsystem4/PrechrgProcessMonitoring/Precharge_Thermal_Management/Perform_OverEnergy_Diagnostic"
 /begin REF_CHARACTERISTIC CbCTD_PrechargeEnergyHighFaultEnable_flg CcCTD_PrechargeEnergyHighFaultFIC_n CcCTD_PrechargeEnergyHighFaultPIC_n CcCTD_PrechargeOverEnergy_J /end REF_CHARACTERISTIC
 /begin REF_MEASUREMENT CTD_stPrechargeEnergyHighFault LbCTD_PrechargeEnergyHighTestEnable_flg LbCTD_PrechargeEnergyHighTestFail_flg /end REF_MEASUREMENT
/end GROUP
/begin GROUP S732_Status_Idle "VBU0706/Function-Call Subsystem/Subsystem1/CTD/Subsystem/Subsystem4/PrechrgProcessMonitoring/Precharging_Process_Monitoring/Status_Idle" /begin REF_CHARACTERISTIC CTD_PRECHARGE_STATUS_IDLE /end REF_CHARACTERISTIC /end GROUP
/begin GROUP S752_MNC_Stuck_Open_With_VehicleSpeed "VBU0706/Function-Call Subsystem/Subsystem1/CTD/Subsystem/Subsystem4/Stuck_Open_Diagnostic/MNC_Stuck_Open/MNC_Stuck_Open_With_VehicleSpeed"
 /begin SUB_GROUP S756_CONTACTOR_STATUS_CLOSED1 S756_Determine_Diagnostic_Status S756_Equal_to_HIGH1 /end SUB_GROUP
 /begin REF_CHARACTERISTIC CTD_MAIN_NEGATIVE_CONTACTOR_STUCK_OPEN_FAULT CbCTD_MnNegContactorStuckOpenFaultEnable_flg CcCTD_MNCStuckOpenCurrentMax_A CcCTD_MnNegContactorOpenDeltaVoltage_V CcCTD_MnNegContactorStuckOpenFaultFIC_n CcCTD_MnNegContactorStuckOpenFaultPIC_n /end REF_CHARACTERISTIC
 /begin REF_MEASUREMENT CTD_stMnNegContactorStuckOpenFault /end REF_MEASUREMENT
/end GROUP
/begin GROUP S752_MNC_Stuck_Open_Without_VehicleSpeed "VBU0706/Function-Call Subsystem/Subsystem1/CTD/Subsystem/Subsystem4/Stuck_Open_Diagnostic/MNC_Stuck_Open/MNC_Stuck_Open_Without_VehicleSpeed" /begin SUB_GROUP S757_CONTACTOR_STATUS_CLOSED1 S757_Equal_to_HIGH1 /end SUB_GROUP
 /begin REF_CHARACTERISTIC CbCTD_RnMnNegContactorStuckOpenFaultEnable_flg CcCTD_RnMNCStuckOpenCurrentMax_A CcCTD_RnMnNegContactorOpenDeltaVoltage_V CcCTD_RnMnNegContactorStuckOpenFaultFIC_n CcCTD_RnMnNegContactorStuckOpenFaultPIC_n /end REF_CHARACTERISTIC
 /begin REF_MEASUREMENT CTD_flgRnMnNegContactorStuckOpenTestEnable CTD_flgRnMnNegContactorStuckOpenTestFail CTD_stRnMnNegContactorStuckOpenFault /end REF_MEASUREMENT
/end GROUP
/begin GROUP S753_MPC_Stuck_Open_Within_VehicleSpeed "VBU0706/Function-Call Subsystem/Subsystem1/CTD/Subsystem/Subsystem4/Stuck_Open_Diagnostic/MPC_Stuck_Open/MPC_Stuck_Open_Within_VehicleSpeed" /begin SUB_GROUP S779_CONTACTOR_STATUS_CLOSED1 /end SUB_GROUP
 /begin REF_CHARACTERISTIC CbCTD_RnMnPosContactorStuckOpenFaultEnable_flg CcCTD_RnMnPosContactorOpenDeltaVoltage_V CcCTD_RnMnPosContactorStuckOpenFaultFIC_n CcCTD_RnMnPosContactorStuckOpenFaultPIC_n /end REF_CHARACTERISTIC
 /begin REF_MEASUREMENT CTD_flgRnMnPosContactorStuckOpenTestFail CTD_stRnMnPosContactorStuckOpenFault LbCTD_RnMnPosContactorStuckOpenTestEnable_flg /end REF_MEASUREMENT
/end GROUP
/begin GROUP S753_MPC_Stuck_Open_Without_VehicleSpeed "VBU0706/Function-Call Subsystem/Subsystem1/CTD/Subsystem/Subsystem4/Stuck_Open_Diagnostic/MPC_Stuck_Open/MPC_Stuck_Open_Without_VehicleSpeed"
 /begin SUB_GROUP S780_CONTACTOR_STATUS_CLOSED1 S780_Determine_Diagnostic_Status S780_Equal_to_HIGH1 /end SUB_GROUP
 /begin REF_CHARACTERISTIC CTD_MAIN_POSITIVE_CONTACTOR_STUCK_OPEN_FAULT CbCTD_MnPosContactorStuckOpenFaultEnable_flg CcCTD_MnPosContactorOpenDeltaVoltage_V CcCTD_MnPosContactorStuckOpenFaultFIC_n CcCTD_MnPosContactorStuckOpenFaultPIC_n /end REF_CHARACTERISTIC
 /begin REF_MEASUREMENT CTD_stMnPosContactorStuckOpenFault /end REF_MEASUREMENT
/end GROUP
/begin GROUP S754_Determine_Diagnostic_Status "VBU0706/Function-Call Subsystem/Subsystem1/CTD/Subsystem/Subsystem4/Stuck_Open_Diagnostic/MPR_Stuck_Open/Determine_Diagnostic_Status" /begin REF_MEASUREMENT CTD_stPrechargeRelayStuckOpenDiagnosticStatus /end REF_MEASUREMENT /end GROUP
/begin GROUP S754_Equal_to_HIGH "VBU0706/Function-Call Subsystem/Subsystem1/CTD/Subsystem/Subsystem4/Stuck_Open_Diagnostic/MPR_Stuck_Open/Equal_to_HIGH" /begin REF_CHARACTERISTIC HIGH /end REF_CHARACTERISTIC /end GROUP
/begin GROUP S869_CellTemp_ChangeRate_Calculate "VBU0706/Function-Call Subsystem/Subsystem1/CTM/CTM/Subsystem/Determine_Thermal_Runaway/DetermineTempRiseRate/CellTemp_ChangeRate_Calculate" /begin REF_CHARACTERISTIC CcCTM_CellThermalRunawayRatePerSecond_C /end REF_CHARACTERISTIC /end GROUP
/begin GROUP S907_Combine_Precharge_Conditions "VBU0706/Function-Call Subsystem/Subsystem1/CTS/CTS/Subsystem/DeterminePrechargeConditions/Precharge_Inhibit_Abort/Combine_Precharge_Conditions"
 /begin REF_CHARACTERISTIC LbCTS_AbortPrechargeOvrdVal_flg LbCTS_AbortPrechargeOvrd_flg LbCTS_InhibitPrechargeOvrdVal_flg LbCTS_InhibitPrechargeOvrd_flg /end REF_CHARACTERISTIC
 /begin REF_MEASUREMENT CTS_flgAbortPrecharge CTS_flgInhibitPrecharge /end REF_MEASUREMENT
/end GROUP
/begin GROUP S1053_DCH_BMSChAvlDebounce "VBU0706/Function-Call Subsystem/Subsystem1/FCC /DCH_Overall/DCH_DCChargeCtrlOverall/DCH_DCChargeCtrlStateflow/DCH_InputSignalPreProcess/DCH_BMSChAvlDebounce" /begin SUB_GROUP S1057_Turn_Off_Delay_Time /end SUB_GROUP /begin REF_CHARACTERISTIC DCH_tiBMSChAvlDly_C DCH_tiBMSChAvlTrnOffDly_C /end REF_CHARACTERISTIC /end GROUP
/begin GROUP S1053_DCH_DCRelayCloseDiagnose "VBU0706/Function-Call Subsystem/Subsystem1/FCC /DCH_Overall/DCH_DCChargeCtrlOverall/DCH_DCChargeCtrlStateflow/DCH_InputSignalPreProcess/DCH_DCRelayCloseDiagnose" /begin SUB_GROUP S1058_Turn_Off_Delay_Time2 /end SUB_GROUP /begin REF_CHARACTERISTIC DCH_tiDCChRlyTurnOffConfrmDly_C DCH_uDCRlyClosedJudged_C /end REF_CHARACTERISTIC /end GROUP
/begin GROUP S1053_DCH_VehStateAnalyze "VBU0706/Function-Call Subsystem/Subsystem1/FCC /DCH_Overall/DCH_DCChargeCtrlOverall/DCH_DCChargeCtrlStateflow/DCH_InputSignalPreProcess/DCH_VehStateAnalyze" /begin SUB_GROUP S1059_Turn_Off_Delay_Time2 /end SUB_GROUP
 /begin REF_CHARACTERISTIC DCH_tiAPlusVldDly_C DCH_tiAplusConfirmT_C DCH_tiCC2ConfirmT_C DCH_uMaxCCToConn_C DCH_uMinCCToConn_C DCH_vMaxSpdLim_C DCH_vMinSpdLim_C /end REF_CHARACTERISTIC
 /begin REF_MEASUREMENT DCH_flgCC2Conn /end REF_MEASUREMENT
/end GROUP
/begin GROUP S1054_DCH_BMSErrorDetect "VBU0706/Function-Call Subsystem/Subsystem1/FCC /DCH_Overall/DCH_DCChargeCtrlOverall/DCH_DCChargeCtrlStateflow/DCH_SignalPreProcessForStateflow/DCH_BMSErrorDetect" /begin REF_CHARACTERISTIC DCH_stSysIsoCriticalFault_SY DCH_stVehIsoCriticalFault_SY /end REF_CHARACTERISTIC /begin REF_MEASUREMENT DCH_flgBmsChCrntOver DCH_flgBmsIsoCriticalFault /end REF_MEASUREMENT /end GROUP
/begin GROUP S1682_Calculate_Remaining_Energy "VBU0706/Function-Call Subsystem/Subsystem1/SOE/Subsystem2/Subsystem/Calculate_Pack_Remaining_Energy/Discharge_Mode/Calculate_Remaining_Energy" /begin REF_CHARACTERISTIC CcSOE_CellEnergyBoL_Kwh /end REF_CHARACTERISTIC /end GROUP
/begin GROUP S1682_Predict_SOC_End "VBU0706/Function-Call Subsystem/Subsystem1/SOE/Subsystem2/Subsystem/Calculate_Pack_Remaining_Energy/Discharge_Mode/Predict_SOC_End" /begin REF_CHARACTERISTIC CcSOE_CellSocDelta_pct /end REF_CHARACTERISTIC /end GROUP
/begin GROUP S2108_Normal_Condition "VBU0706/Function-Call Subsystem/Subsystem1/THM/Subsystem/Subsystem/Charge_Mode_Temp_Request/OBC_Temp_Request/Normal_Condition"
 /begin REF_CHARACTERISTIC CcTHM_ChargeTempRequestHighThreshold_C CcTHM_PackSohORF_flg CcTHM_PackSohORV_pct /end REF_CHARACTERISTIC
/end GROUP
/begin GROUP S3598_DVM_VehRdy "VBU0706/Task_10ms/Subsystem/VCU /PMM/PMM_Ctrl/PMM/DrvMod_Ctrl/DVM_VehRdy" /begin REF_CHARACTERISTIC PMM_tiSmplT_SY /end REF_CHARACTERISTIC /end GROUP
/begin GROUP S3599_LvWakeUp_Mode_Calc "VBU0706/Task_10ms/Subsystem/VCU /PMM/PMM_Ctrl/PMM/LvWakeUp_Ctrl/LvWakeUp_Mode_Calc" /begin REF_CHARACTERISTIC PMM_tiSmplT_SY /end REF_CHARACTERISTIC /end GROUP
/begin GROUP S3601_AcTvDisCh "VBU0706/Task_10ms/Subsystem/VCU /PMM/PMM_Ctrl/PMM/PwrMod_Ctrl/AcTvDisCh" /begin REF_CHARACTERISTIC PMM_stActvDisCh_SY /end REF_CHARACTERISTIC /end GROUP
/begin GROUP S3601_SelfRoutine "VBU0706/Task_10ms/Subsystem/VCU /PMM/PMM_Ctrl/PMM/PwrMod_Ctrl/SelfRoutine" /begin REF_CHARACTERISTIC PMM_tiSmplT_SY /end REF_CHARACTERISTIC /end GROUP
/begin GROUP S3711_nMotr2vVeh "VBU0706/Task_10ms/Subsystem/VCU /SPD/SPD/SignalProcessing_10ms/VehSpdNorm/nMotr2vVeh" /begin REF_CHARACTERISTIC SYS_facRPM2KPH_SY /end REF_CHARACTERISTIC /end GROUP
/begin GROUP S4087_Subsystem "VBU0706/Task_10ms/Subsystem/VCU /VehINP/VehINP_Logic/GearShift/Gear1/Subsystem" /begin REF_CHARACTERISTIC SPD_stMovDirBwrd_SY SPD_stMovDirFwrd_SY /end REF_CHARACTERISTIC /end GROUP
/begin GROUP S4249_BPD_BrakeSwitchSelect "VBU0706/Task_10ms/Subsystem/VCU /VehINP/VehINP_Logic/VehINP_BPD/BPD_BrakeSwitch/BPD_BrakeSwitchSelect" /begin REF_CHARACTERISTIC BPD_stBrkPedPrsNoActv_C /end REF_CHARACTERISTIC /end GROUP
/begin GROUP S756_Equal_to_HIGH1 "VBU0706/Function-Call Subsystem/Subsystem1/CTD/Subsystem/Subsystem4/Stuck_Open_Diagnostic/MNC_Stuck_Open/MNC_Stuck_Open_With_VehicleSpeed/Equal_to_HIGH1" /begin REF_CHARACTERISTIC HIGH /end REF_CHARACTERISTIC /end GROUP
/begin GROUP S757_Equal_to_HIGH1 "VBU0706/Function-Call Subsystem/Subsystem1/CTD/Subsystem/Subsystem4/Stuck_Open_Diagnostic/MNC_Stuck_Open/MNC_Stuck_Open_Without_VehicleSpeed/Equal_to_HIGH1" /begin REF_CHARACTERISTIC HIGH /end REF_CHARACTERISTIC /end GROUP
/begin GROUP S780_Equal_to_HIGH1 "VBU0706/Function-Call Subsystem/Subsystem1/CTD/Subsystem/Subsystem4/Stuck_Open_Diagnostic/MPC_Stuck_Open/MPC_Stuck_Open_Without_VehicleSpeed/Equal_to_HIGH1" /begin REF_CHARACTERISTIC HIGH /end REF_CHARACTERISTIC /end GROUP
/begin GROUP S1966_NVM_ReadWrite_Check "VBU0706/Function-Call Subsystem/Subsystem1/SOH/Subsystem4/Subsystem1/Calculate_Capacity/Calculate_CellCapacity/Caculate_CellCapacity_LifeTimeQ/NVM_ReadWrite_Check" /begin REF_CHARACTERISTIC NVM_EEPROM_CRC_CHECK_FAULT /end REF_CHARACTERISTIC /end GROUP
/begin GROUP S2040_NVM_ReadWrite_Check "VBU0706/Function-Call Subsystem/Subsystem1/SOH/Subsystem4/Subsystem1/Calculate_Resistance/BasicCellResistance_Calculation_Check/ResistanceCalc_Check/NVM_ReadWrite_Check" /begin REF_CHARACTERISTIC NVM_EEPROM_CRC_CHECK_FAULT /end REF_CHARACTERISTIC /end GROUP
/begin GROUP S3607_Wakeup "VBU0706/Task_10ms/Subsystem/VCU /PMM/PMM_Ctrl/PMM/LvWakeUp_Ctrl/LvWakeUp_State_Calc/Wakeup" /begin REF_CHARACTERISTIC PMM_tiSmplT_SY /end REF_CHARACTERISTIC /end GROUP
/begin GROUP S3656_HVClReqSrc "VBU0706/Task_10ms/Subsystem/VCU /PMM/PMM_Ctrl/PMM/PwrMod_Ctrl/PwrMod_PowerUp/HVClReqSrc" /begin REF_CHARACTERISTIC PMM_tiSmplT_SY /end REF_CHARACTERISTIC /end GROUP
/begin GROUP S3656_VehStsJudgement "VBU0706/Task_10ms/Subsystem/VCU /PMM/PMM_Ctrl/PMM/PwrMod_Ctrl/PwrMod_PowerUp/VehStsJudgement" /begin REF_CHARACTERISTIC PMM_stHVCntctStClosed_SY /end REF_CHARACTERISTIC /end GROUP
/begin GROUP S3656_stateflowcondition "VBU0706/Task_10ms/Subsystem/VCU /PMM/PMM_Ctrl/PMM/PwrMod_Ctrl/PwrMod_PowerUp/stateflowcondition" /begin REF_CHARACTERISTIC PMM_tiSmplT_SY /end REF_CHARACTERISTIC /end GROUP
/begin GROUP S3658_PwrUpRoutine "VBU0706/Task_10ms/Subsystem/VCU /PMM/PMM_Ctrl/PMM/PwrMod_Ctrl/Routine/PwrUpRoutine" /begin REF_CHARACTERISTIC PMM_stHVRlyConn_SY PMM_tiSmplT_SY /end REF_CHARACTERISTIC /end GROUP
/begin GROUP S736_Determine_Accumulated_Cooling "VBU0706/Function-Call Subsystem/Subsystem1/CTD/Subsystem/Subsystem4/PrechrgProcessMonitoring/Precharge_Thermal_Management/Determine_Precharge_JouleHeat/Determine_Accumulated_RemainingHeat/Determine_Accumulated_Cooling" /begin REF_CHARACTERISTIC CcCTD_MinHeatDissipation_J /end REF_CHARACTERISTIC /end GROUP
/begin GROUP S3610_VCUActSrc "VBU0706/Task_10ms/Subsystem/VCU /PMM/PMM_Ctrl/PMM/LvWakeUp_Ctrl/LvWakeUp_State_Calc/LVWSrc/VCUActSrc" /begin REF_CHARACTERISTIC PMM_tiSmplT_SY /end REF_CHARACTERISTIC /end GROUP
/begin GROUP S3610_VCUWakeUp "VBU0706/Task_10ms/Subsystem/VCU /PMM/PMM_Ctrl/PMM/LvWakeUp_Ctrl/LvWakeUp_State_Calc/LVWSrc/VCUWakeUp" /begin REF_CHARACTERISTIC PMM_tiSmplT_SY /end REF_CHARACTERISTIC /end GROUP
/end MODULE
/end PROJECT
