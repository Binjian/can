/******************************************************************************
* ASAP2 file: VBU0706.a2l
* Code generation for model "VBU0706".
* Model version : 1.751
* Simulink Coder version : 9.0 (R2018b) 24-May-2018
* C source code generated on : Wed Aug 11 20:51:01 2021
* Target selection: ez_ert_rtw.tlc
* Embedded hardware selection: Infineon->TriCore
* Code generation objectives: Unspecified
* Validation result: Not run
* (add additional file header information here)
******************************************************************************/
/* Version 1.31 */
ASAP2_VERSION 1 31
/begin PROJECT ProjectName "Project Comment Goes Here"
/begin HEADER "Header Comments go here" /end HEADER
/begin MODULE ModuleName "Module Comment Goes Here"
/begin MOD_PAR "MOD PAR Comment Goes Here" /end MOD_PAR
/begin IF_DATA ASAP1B_CCP
 /begin SOURCE "List 1 Rate 10 ms" 0 0 DISPLAY_IDENTIFIER "DAQ1"
  /begin QP_BLOB 0 LENGTH 10 CAN_ID_FIXED 0x631 RASTER 0 REDUCTION_ALLOWED FIRST_PID 0 /end QP_BLOB
 /end SOURCE
 /begin SOURCE "List 2 Rate 20 ms" 0 0 DISPLAY_IDENTIFIER "DAQ2"
  /begin QP_BLOB 1 LENGTH 16 CAN_ID_FIXED 0x631 RASTER 1 REDUCTION_ALLOWED FIRST_PID 10 /end QP_BLOB
 /end SOURCE
 /begin SOURCE "List 3 Rate 50 ms" 0 0 DISPLAY_IDENTIFIER "DAQ3"
  /begin QP_BLOB 2 LENGTH 20 CAN_ID_FIXED 0x631 RASTER 2 REDUCTION_ALLOWED FIRST_PID 26 /end QP_BLOB
 /end SOURCE
 /begin SOURCE "List 4 Rate 200 ms" 0 0 DISPLAY_IDENTIFIER "DAQ4"
  /begin QP_BLOB 3 LENGTH 20 CAN_ID_FIXED 0x631 RASTER 3 REDUCTION_ALLOWED FIRST_PID 46 /end QP_BLOB
 /end SOURCE
 /begin RASTER "FGND_1" "FGND_1" 0 3 10 /end RASTER
 /begin RASTER "FGND_2" "FGND_2" 1 3 20 /end RASTER
 /begin RASTER "FGND_5" "FGND_5" 2 3 50 /end RASTER
 /begin RASTER "FGND_20" "FGND_20" 3 3 200 /end RASTER
 /* /begin SEED_KEY */ /* DLL for CAL */ /* Uncomment and supply a value "SecurityCAL.dll" */ /* DLL for DAQ */ /* Uncomment and supply a value "SecurityDAQ.dll" */ /* DLL for PGM */ /* Uncomment and supply a value "SecurityPGM.dll" */ /* /end SEED_KEY */
 /begin TP_BLOB /* CCP version */ 0x201 /* Blob version */ 0x204 /* CAN msg ID - send */ 0x630 /* CAN msg ID - recv */ 0x631 /* Station address */ 0x1 /* byte order */ 2 BAUDRATE 500000 SAMPLE_RATE 1 SAMPLE_POINT 80 BTL_CYCLES 19 SJW 4 SYNC_EDGE SINGLE DAQ_MODE BURST CONSISTENCY ODT ADDRESS_EXTENSION DAQ /begin CHECKSUM_PARAM 0x0000 0xFFFFFFFF /* Limit */ /end CHECKSUM_PARAM
  /begin DEFINED_PAGES /* Memory page num */ 1 /* Page Name */ "working page" /* address ext. */ 0x00 /* base address */ 0x70000000 /* page length */ 0x11143 RAM /* memory page in RAM */ RAM_INIT_BY_ECU /* memory page is initialised by ECU start-up */ /end DEFINED_PAGES
  OPTIONAL_CMD 0x5 /* TEST */ OPTIONAL_CMD 0x8 /* START_STOP_ALL */ /* OPTIONAL_CMD 0xC */ /* SET_S_STATUS */ /* OPTIONAL_CMD 0xD */ /* GET_S_STATUS */ OPTIONAL_CMD 0xF /* SHORT_UP */ OPTIONAL_CMD 0x23 /* DNLOAD_6 */ /end TP_BLOB
/end IF_DATA
/begin MOD_PAR "MOD PAR Comment Goes Here" ECU_CALIBRATION_OFFSET 0x00000000
 /begin MEMORY_SEGMENT CAL "" DATA FLASH INTERN /* Address */ 0x70000000 /* Size */ 0x11143 /* Offset */ -1 -1 -1 -1 -1 /end MEMORY_SEGMENT
 /begin MEMORY_SEGMENT MeasRAM "" VARIABLES RAM INTERN /* Address */ 0x70011144 /* Size */ 0xEDF /* Offset */ -1 -1 -1 -1 -1 /end MEMORY_SEGMENT
/end MOD_PAR
/begin MOD_COMMON "Mod Common Comment Here" ALIGNMENT_WORD 1 ALIGNMENT_LONG 1 ALIGNMENT_FLOAT32_IEEE 1 ALIGNMENT_FLOAT64_IEEE 1 BYTE_ORDER MSB_LAST /end MOD_COMMON
/begin RECORD_LAYOUT Scalar_BOOLEAN FNC_VALUES 1 UBYTE COLUMN_DIR DIRECT /end RECORD_LAYOUT
/begin RECORD_LAYOUT Scalar_UBYTE FNC_VALUES 1 UBYTE COLUMN_DIR DIRECT /end RECORD_LAYOUT
/begin RECORD_LAYOUT Scalar_BYTE FNC_VALUES 1 SBYTE COLUMN_DIR DIRECT /end RECORD_LAYOUT
/begin RECORD_LAYOUT Scalar_UWORD FNC_VALUES 1 UWORD COLUMN_DIR DIRECT /end RECORD_LAYOUT
/begin RECORD_LAYOUT Scalar_ULONG FNC_VALUES 1 ULONG COLUMN_DIR DIRECT /end RECORD_LAYOUT
/begin RECORD_LAYOUT Scalar_LONG FNC_VALUES 1 SLONG COLUMN_DIR DIRECT /end RECORD_LAYOUT
/begin RECORD_LAYOUT Scalar_FLOAT32_IEEE FNC_VALUES 1 FLOAT32_IEEE COLUMN_DIR DIRECT /end RECORD_LAYOUT
/begin RECORD_LAYOUT Lookup1D_BOOLEAN FNC_VALUES 1 UBYTE COLUMN_DIR DIRECT /end RECORD_LAYOUT
/begin RECORD_LAYOUT Lookup1D_X_BOOLEAN AXIS_PTS_X 1 UBYTE INDEX_INCR DIRECT /end RECORD_LAYOUT
/begin RECORD_LAYOUT Lookup1D_BYTE FNC_VALUES 1 SBYTE COLUMN_DIR DIRECT /end RECORD_LAYOUT
/begin CHARACTERISTIC BCV_facHVADC "" VALUE 0x7000027c Scalar_FLOAT32_IEEE 0 VBU0706_CM_single_cnt 0.0 1000.0 /end CHARACTERISTIC
/begin CHARACTERISTIC BCV_facPEURCurrent "" VALUE 0x70000280 Scalar_FLOAT32_IEEE 0 VBU0706_CM_single -3.4E+38 3.4E+38 /end CHARACTERISTIC
/begin CHARACTERISTIC CcBMM_CurrentStableThreshold_A "" VALUE 0x70000370 Scalar_FLOAT32_IEEE 0 VBU0706_CM_single_cnt -3.4028234663852886E+38 3.4028234663852886E+38 /end CHARACTERISTIC
/begin CHARACTERISTIC CcBMM_HALKL30BMUVoltageLow_V "" VALUE 0x70000374 Scalar_FLOAT32_IEEE 0 VBU0706_CM_single_cnt -3.4028234663852886E+38 3.4028234663852886E+38 /end CHARACTERISTIC
/begin CHARACTERISTIC CcBMM_MaxInitializeTime_ms "" VALUE 0x70000378 Scalar_FLOAT32_IEEE 0 VBU0706_CM_single_cnt -3.4028234663852886E+38 3.4028234663852886E+38 /end CHARACTERISTIC
/begin CHARACTERISTIC CcISO_DrvISODecThr_kohm "" VALUE 0x70000560 Scalar_FLOAT32_IEEE 0 VBU0706_CM_single_kohm -3.4028234663852886E+38 3.4028234663852886E+38 /end CHARACTERISTIC
/begin CHARACTERISTIC CcISO_DrvISODecThr_pct "" VALUE 0x70000564 Scalar_FLOAT32_IEEE 0 VBU0706_CM_single_pct -3.4028234663852886E+38 3.4028234663852886E+38 /end CHARACTERISTIC
/begin CHARACTERISTIC CcISO_DrvISOLowThr40_kohm "" VALUE 0x70000568 Scalar_FLOAT32_IEEE 0 VBU0706_CM_single_kohm -3.4028234663852886E+38 3.4028234663852886E+38 /end CHARACTERISTIC
/begin CHARACTERISTIC CcISO_DrvISOLowThr_kohm "" VALUE 0x7000056c Scalar_FLOAT32_IEEE 0 VBU0706_CM_single_kohm -3.4028234663852886E+38 3.4028234663852886E+38 /end CHARACTERISTIC
/begin CHARACTERISTIC CcISO_FccISODecThr_kohm "" VALUE 0x70000570 Scalar_FLOAT32_IEEE 0 VBU0706_CM_single_kohm -3.4028234663852886E+38 3.4028234663852886E+38 /end CHARACTERISTIC
/begin CHARACTERISTIC CcISO_FccISODecThr_pct "" VALUE 0x70000574 Scalar_FLOAT32_IEEE 0 VBU0706_CM_single_pct -3.4028234663852886E+38 3.4028234663852886E+38 /end CHARACTERISTIC
/begin CHARACTERISTIC CcISO_FccISOLowThr40_kohm "" VALUE 0x70000578 Scalar_FLOAT32_IEEE 0 VBU0706_CM_single_kohm -3.4028234663852886E+38 3.4028234663852886E+38 /end CHARACTERISTIC
/begin CHARACTERISTIC CcISO_FccISOLowThr_kohm "" VALUE 0x7000057c Scalar_FLOAT32_IEEE 0 VBU0706_CM_single_kohm -3.4028234663852886E+38 3.4028234663852886E+38 /end CHARACTERISTIC
/begin CHARACTERISTIC CcISO_PackISODecThr_kohm "" VALUE 0x70000588 Scalar_FLOAT32_IEEE 0 VBU0706_CM_single_kohm -3.4028234663852886E+38 3.4028234663852886E+38 /end CHARACTERISTIC
/begin CHARACTERISTIC CcISO_PackISODecThr_pct "" VALUE 0x7000058c Scalar_FLOAT32_IEEE 0 VBU0706_CM_single_pct -3.4028234663852886E+38 3.4028234663852886E+38 /end CHARACTERISTIC
/begin CHARACTERISTIC CcISO_PackISOLowThr_kohm "" VALUE 0x70000590 Scalar_FLOAT32_IEEE 0 VBU0706_CM_single_kohm -3.4028234663852886E+38 3.4028234663852886E+38 /end CHARACTERISTIC
/begin CHARACTERISTIC CcSYS_BatteryChargeCurrentMax_A "" VALUE 0x70000898 Scalar_FLOAT32_IEEE 0 VBU0706_CM_single_single -3.4028234663852886E+38 3.4028234663852886E+38 /end CHARACTERISTIC
/begin CHARACTERISTIC CcSYS_NoChargeHighTemp_C "" VALUE 0x700008b0 Scalar_FLOAT32_IEEE 0 VBU0706_CM_single_cnt -3.4028234663852886E+38 3.4028234663852886E+38 /end CHARACTERISTIC
/begin CHARACTERISTIC CcSYS_NominalCellCapacity_Ah "" VALUE 0x700008b4 Scalar_FLOAT32_IEEE 0 VBU0706_CM_single_cnt -3.4028234663852886E+38 3.4028234663852886E+38 /end CHARACTERISTIC
/begin CHARACTERISTIC CcVCT_BatteryRatedVoltage_V "" VALUE 0x70000988 Scalar_FLOAT32_IEEE 0 VBU0706_CM_single_V -3.4028234663852886E+38 3.4028234663852886E+38 /end CHARACTERISTIC
/begin CHARACTERISTIC CcVCT_NominalCellCapacity_Ah "" VALUE 0x70000990 Scalar_FLOAT32_IEEE 0 VBU0706_CM_single_Ah -3.4028234663852886E+38 3.4028234663852886E+38 /end CHARACTERISTIC
/begin CHARACTERISTIC DCH_GBCurrGain_fac "" VALUE 0x700009d8 Scalar_FLOAT32_IEEE 0 VBU0706_CM_single -3.4E+38 3.4E+38 /end CHARACTERISTIC
/begin CHARACTERISTIC DCH_cBCPNrmCapOvrdVal_C "" VALUE 0x700009dc Scalar_FLOAT32_IEEE 0 VBU0706_CM_single_cnt -3.4028234663852886E+38 3.4028234663852886E+38 /end CHARACTERISTIC
/begin CHARACTERISTIC DCH_cBRMBattRatedCapOvrdVal_C "" VALUE 0x700009e0 Scalar_FLOAT32_IEEE 0 VBU0706_CM_single_cnt -3.4028234663852886E+38 3.4028234663852886E+38 /end CHARACTERISTIC
/begin CHARACTERISTIC DCH_iBCPMaxChCurrOvrdVal_C "" VALUE 0x700009f8 Scalar_FLOAT32_IEEE 0 VBU0706_CM_single_cnt -3.4028234663852886E+38 3.4028234663852886E+38 /end CHARACTERISTIC
/begin CHARACTERISTIC DCH_iBCSChCurrMeasureOvrdVal_C "" VALUE 0x700009fc Scalar_FLOAT32_IEEE 0 VBU0706_CM_single_cnt -3.4028234663852886E+38 3.4028234663852886E+38 /end CHARACTERISTIC
/begin CHARACTERISTIC DCH_numBCSMaxCellVltgNumOvrdVal_C "" VALUE 0x70000a28 Scalar_FLOAT32_IEEE 0 VBU0706_CM_single_cnt -3.4028234663852886E+38 3.4028234663852886E+38 /end CHARACTERISTIC
/begin CHARACTERISTIC DCH_pctBCPSocOvrdVal_C "" VALUE 0x70000a40 Scalar_FLOAT32_IEEE 0 VBU0706_CM_single_cnt -3.4028234663852886E+38 3.4028234663852886E+38 /end CHARACTERISTIC
/begin CHARACTERISTIC DCH_pctBCSCurrSocOvrdVal_C "" VALUE 0x70000a44 Scalar_FLOAT32_IEEE 0 VBU0706_CM_single_cnt -3.4028234663852886E+38 3.4028234663852886E+38 /end CHARACTERISTIC
/begin CHARACTERISTIC DCH_tBCPMaxPermitTempOvrdVal_C "" VALUE 0x70000a50 Scalar_FLOAT32_IEEE 0 VBU0706_CM_single_cnt -3.4028234663852886E+38 3.4028234663852886E+38 /end CHARACTERISTIC
/begin CHARACTERISTIC DCH_tiBCSChNeedTOvrdVal_C "" VALUE 0x70000a94 Scalar_FLOAT32_IEEE 0 VBU0706_CM_single_cnt -3.4028234663852886E+38 3.4028234663852886E+38 /end CHARACTERISTIC
/begin CHARACTERISTIC DCH_uBCPBattVltgOvrdVal_C "" VALUE 0x70000b14 Scalar_FLOAT32_IEEE 0 VBU0706_CM_single_cnt -3.4028234663852886E+38 3.4028234663852886E+38 /end CHARACTERISTIC
/begin CHARACTERISTIC DCH_uBCPMaxCellVltgForChOvrdVal_C "" VALUE 0x70000b18 Scalar_FLOAT32_IEEE 0 VBU0706_CM_single_cnt -3.4028234663852886E+38 3.4028234663852886E+38 /end CHARACTERISTIC
/begin CHARACTERISTIC DCH_uBCPMaxVltgForChOvrdVal_C "" VALUE 0x70000b1c Scalar_FLOAT32_IEEE 0 VBU0706_CM_single_cnt -3.4028234663852886E+38 3.4028234663852886E+38 /end CHARACTERISTIC
/begin CHARACTERISTIC DCH_uBCSChVltgMeasureOvrdVal_C "" VALUE 0x70000b20 Scalar_FLOAT32_IEEE 0 VBU0706_CM_single_cnt -3.4028234663852886E+38 3.4028234663852886E+38 /end CHARACTERISTIC
/begin CHARACTERISTIC DCH_uBCSMaxCellVltgOvrdVal_C "" VALUE 0x70000b24 Scalar_FLOAT32_IEEE 0 VBU0706_CM_single_cnt -3.4028234663852886E+38 3.4028234663852886E+38 /end CHARACTERISTIC
/begin CHARACTERISTIC DCH_uBRMBattRatedVltgOvrdVal_C "" VALUE 0x70000b28 Scalar_FLOAT32_IEEE 0 VBU0706_CM_single_cnt -3.4028234663852886E+38 3.4028234663852886E+38 /end CHARACTERISTIC
/begin CHARACTERISTIC FCC_pctVCRVCUMaxChrgSOCSet "" VALUE 0x70000d48 Scalar_FLOAT32_IEEE 0 VBU0706_CM_single_cnt -3.4028234663852886E+38 3.4028234663852886E+38 /end CHARACTERISTIC
/begin CHARACTERISTIC ONE_HUNDRED_PERCENT "" VALUE 0x70000e98 Scalar_FLOAT32_IEEE 0 VBU0706_CM_single_cnt 0.0 255.0 /end CHARACTERISTIC
/begin CHARACTERISTIC PermitVoltageOvrdVal_C "" VALUE 0x70000f94 Scalar_FLOAT32_IEEE 0 VBU0706_CM_single_cnt -3.4028234663852886E+38 3.4028234663852886E+38 /end CHARACTERISTIC
/begin CHARACTERISTIC SOC_pctMaxSOCSet_C "" VALUE 0x70000f98 Scalar_FLOAT32_IEEE 0 VBU0706_CM_single_cnt 0.0 100.0 /end CHARACTERISTIC
/begin CHARACTERISTIC TEMP_OVEROvrdVal_C "" VALUE 0x70001000 Scalar_FLOAT32_IEEE 0 VBU0706_CM_single_cnt -3.4028234663852886E+38 3.4028234663852886E+38 /end CHARACTERISTIC
/begin CHARACTERISTIC WATS_PER_KILOWAT "" VALUE 0x700013b4 Scalar_FLOAT32_IEEE 0 VBU0706_CM_single_cnt -3.4028234663852886E+38 3.4028234663852886E+38 /end CHARACTERISTIC
/begin CHARACTERISTIC CcBMM_AbnormalEventFlagLockTime_ms "" VALUE 0x7000036c Scalar_ULONG 0 VBU0706_CM_uint32_cnt 0.0 4.294967295E+9 /end CHARACTERISTIC
/begin CHARACTERISTIC CcISO_IsolationSeverseLimited_Kohm "" VALUE 0x70000580 Scalar_ULONG 0 VBU0706_CM_uint32_kohm 0.0 4.294967295E+9 /end CHARACTERISTIC
/begin CHARACTERISTIC CcISO_IsolationWarningLimited_Kohm "" VALUE 0x70000584 Scalar_ULONG 0 VBU0706_CM_uint32_kohm 0.0 4.294967295E+9 /end CHARACTERISTIC
/begin CHARACTERISTIC BCV_BATTERY_OVER_CURRENT_FAULT "" VALUE 0x70000000 Scalar_UWORD 0 VBU0706_CM_uint16_cnt 0.0 330.0 /end CHARACTERISTIC
/begin CHARACTERISTIC BCV_BATTERY_OVER_VOLTAGE_FAULT "" VALUE 0x70000002 Scalar_UWORD 0 VBU0706_CM_uint16_cnt 0.0 330.0 /end CHARACTERISTIC
/begin CHARACTERISTIC BCV_BATTERY_OVER_VOLTAGE_WARNING_FAULT "" VALUE 0x70000004 Scalar_UWORD 0 VBU0706_CM_uint16_cnt 0.0 330.0 /end CHARACTERISTIC
/begin CHARACTERISTIC CTD_MAIN_NEGATIVE_CONTACTOR_WELD_FAULT "" VALUE 0x70000008 Scalar_UWORD 0 VBU0706_CM_uint16_cnt 0.0 330.0 /end CHARACTERISTIC
/begin CHARACTERISTIC CTD_MAIN_POSITIVE_CONTACTOR_WELD_FAULT "" VALUE 0x7000000a Scalar_UWORD 0 VBU0706_CM_uint16_cnt 0.0 330.0 /end CHARACTERISTIC
/begin CHARACTERISTIC CTD_PARKING_MAIN_NEGATIVE_CONTACTOR_STUCK_OPEN_FAULT "" VALUE 0x7000000c Scalar_UWORD 0 VBU0706_CM_uint16_cnt 0.0 330.0 /end CHARACTERISTIC
/begin CHARACTERISTIC CTD_PARKING_MAIN_POSITIVE_CONTACTOR_STUCK_OPEN_FAULT "" VALUE 0x7000000e Scalar_UWORD 0 VBU0706_CM_uint16_cnt 0.0 330.0 /end CHARACTERISTIC
/begin CHARACTERISTIC CTD_PRECHARGE_ENERGY_HIGH_FAULT "" VALUE 0x70000010 Scalar_UWORD 0 VBU0706_CM_uint16_cnt 0.0 330.0 /end CHARACTERISTIC
/begin CHARACTERISTIC CTD_PRECHARGE_RELAY_STUCK_OPEN_FAULT "" VALUE 0x70000012 Scalar_UWORD 0 VBU0706_CM_uint16_cnt 0.0 330.0 /end CHARACTERISTIC
/begin CHARACTERISTIC CTD_PRECHARGE_RESISTANCE_BLOWN_FAULT "" VALUE 0x70000014 Scalar_UWORD 0 VBU0706_CM_uint16_cnt 0.0 330.0 /end CHARACTERISTIC
/begin CHARACTERISTIC CTD_PRECHARG_TIMEOUT_FAULT "" VALUE 0x70000016 Scalar_UWORD 0 VBU0706_CM_uint16_cnt 0.0 330.0 /end CHARACTERISTIC
/begin CHARACTERISTIC CTM_CELL_OVER_TEMP_FAULT "" VALUE 0x70000018 Scalar_UWORD 0 VBU0706_CM_uint16_cnt 0.0 330.0 /end CHARACTERISTIC
/begin CHARACTERISTIC CVT_CELL_OVER_VOLTAGE_FAULT "" VALUE 0x7000001e Scalar_UWORD 0 VBU0706_CM_uint16_cnt 0.0 330.0 /end CHARACTERISTIC
/begin CHARACTERISTIC CVT_CELL_UNDER_VOLTAGE_FAULT "" VALUE 0x70000020 Scalar_UWORD 0 VBU0706_CM_uint16_cnt 0.0 330.0 /end CHARACTERISTIC
/begin CHARACTERISTIC CcBMM_CurrentStableDelayTime_ms "" VALUE 0x70000032 Scalar_UWORD 0 VBU0706_CM_uint16_cnt 0.0 65535.0 /end CHARACTERISTIC
/begin CHARACTERISTIC CcBMM_DeepSleepUploadTime_s "" VALUE 0x70000034 Scalar_UWORD 0 VBU0706_CM_uint16_cnt 0.0 65535.0 /end CHARACTERISTIC
/begin CHARACTERISTIC CcBMM_PeriodicalUploadTime_s "" VALUE 0x70000038 Scalar_UWORD 0 VBU0706_CM_uint16_cnt 0.0 65535.0 /end CHARACTERISTIC
/begin CHARACTERISTIC CcISO_BDMOutputDelayTime_ms "" VALUE 0x70000090 Scalar_UWORD 0 VBU0706_CM_uint16_ms 0.0 65535.0 /end CHARACTERISTIC
/begin CHARACTERISTIC CcISO_FaultReverseConfirmTime_ms "" VALUE 0x70000094 Scalar_UWORD 0 VBU0706_CM_uint16_ms 0.0 65535.0 /end CHARACTERISTIC
/begin CHARACTERISTIC CcSYS_CellVoltageMaxLimit_mV "" VALUE 0x700000ec Scalar_UWORD 0 VBU0706_CM_uint16_mV 0.0 65535.0 /end CHARACTERISTIC
/begin CHARACTERISTIC CcWRT_BatteryCapacityCycleORV_n "" VALUE 0x700000fc Scalar_UWORD 0 VBU0706_CM_uint16_cnt 0.0 65535.0 /end CHARACTERISTIC
/begin CHARACTERISTIC FCC_CHARGE_CURRENT_OVER_FAULT "" VALUE 0x700000fe Scalar_UWORD 0 VBU0706_CM_uint16_cnt 0.0 330.0 /end CHARACTERISTIC
/begin CHARACTERISTIC MILISECONDS_PER_SECOND "" VALUE 0x70000108 Scalar_UWORD 0 VBU0706_CM_uint16_cnt 0.0 65535.0 /end CHARACTERISTIC
/begin CHARACTERISTIC MILIVOLTAGES_PER_VOLTAGE "" VALUE 0x7000010a Scalar_UWORD 0 VBU0706_CM_uint16_cnt 0.0 65535.0 /end CHARACTERISTIC
/begin CHARACTERISTIC SAMPLE_TIME_TASK_A "" VALUE 0x7000010e Scalar_UWORD 0 VBU0706_CM_uint16_cnt 0.0 65535.0 /end CHARACTERISTIC
/begin CHARACTERISTIC SAMPLE_TIME_TASK_B "" VALUE 0x70000110 Scalar_UWORD 0 VBU0706_CM_uint16_cnt 0.0 65535.0 /end CHARACTERISTIC
/begin CHARACTERISTIC SOF_CHARGE_OVER_POWER_FAULT "" VALUE 0x7000011c Scalar_UWORD 0 VBU0706_CM_uint16_cnt 0.0 330.0 /end CHARACTERISTIC
/begin CHARACTERISTIC ACV_OV "" VALUE 0x7001071e Scalar_BOOLEAN 0 VBU0706_CM_boolean 0 1 /end CHARACTERISTIC
/begin CHARACTERISTIC APO_flgBCLTxEnaOvrdVal_C "" VALUE 0x70010748 Scalar_BOOLEAN 0 VBU0706_CM_boolean_cnt 0.0 1.0 /end CHARACTERISTIC
/begin CHARACTERISTIC APO_flgBCLTxEnaOvrd_C "" VALUE 0x70010749 Scalar_BOOLEAN 0 VBU0706_CM_boolean_cnt 0.0 1.0 /end CHARACTERISTIC
/begin CHARACTERISTIC APO_flgBCPTxEnaOvrdVal_C "" VALUE 0x7001074a Scalar_BOOLEAN 0 VBU0706_CM_boolean_cnt 0.0 1.0 /end CHARACTERISTIC
/begin CHARACTERISTIC APO_flgBCPTxEnaOvrd_C "" VALUE 0x7001074b Scalar_BOOLEAN 0 VBU0706_CM_boolean_cnt 0.0 1.0 /end CHARACTERISTIC
/begin CHARACTERISTIC APO_flgBCSTxEnaOvrdVal_C "" VALUE 0x7001074c Scalar_BOOLEAN 0 VBU0706_CM_boolean_cnt 0.0 1.0 /end CHARACTERISTIC
/begin CHARACTERISTIC APO_flgBCSTxEnaOvrd_C "" VALUE 0x7001074d Scalar_BOOLEAN 0 VBU0706_CM_boolean_cnt 0.0 1.0 /end CHARACTERISTIC
/begin CHARACTERISTIC APO_flgBEMTxEnaOvrdVal_C "" VALUE 0x7001074e Scalar_BOOLEAN 0 VBU0706_CM_boolean_cnt 0.0 1.0 /end CHARACTERISTIC
/begin CHARACTERISTIC APO_flgBEMTxEnaOvrd_C "" VALUE 0x7001074f Scalar_BOOLEAN 0 VBU0706_CM_boolean_cnt 0.0 1.0 /end CHARACTERISTIC
/begin CHARACTERISTIC APO_flgBHMTxEnaOvrdVal_C "" VALUE 0x70010750 Scalar_BOOLEAN 0 VBU0706_CM_boolean_cnt 0.0 1.0 /end CHARACTERISTIC
/begin CHARACTERISTIC APO_flgBHMTxEnaOvrd_C "" VALUE 0x70010751 Scalar_BOOLEAN 0 VBU0706_CM_boolean_cnt 0.0 1.0 /end CHARACTERISTIC
/begin CHARACTERISTIC APO_flgBRMTxEnaOvrdVal_C "" VALUE 0x7001075e Scalar_BOOLEAN 0 VBU0706_CM_boolean_cnt 0.0 1.0 /end CHARACTERISTIC
/begin CHARACTERISTIC APO_flgBRMTxEnaOvrd_C "" VALUE 0x7001075f Scalar_BOOLEAN 0 VBU0706_CM_boolean_cnt 0.0 1.0 /end CHARACTERISTIC
/begin CHARACTERISTIC APO_flgBROTxEnaOvrdVal_C "" VALUE 0x70010760 Scalar_BOOLEAN 0 VBU0706_CM_boolean_cnt 0.0 1.0 /end CHARACTERISTIC
/begin CHARACTERISTIC APO_flgBROTxEnaOvrd_C "" VALUE 0x70010761 Scalar_BOOLEAN 0 VBU0706_CM_boolean_cnt 0.0 1.0 /end CHARACTERISTIC
/begin CHARACTERISTIC APO_flgBSDTxEnaOvrdVal_C "" VALUE 0x70010762 Scalar_BOOLEAN 0 VBU0706_CM_boolean_cnt 0.0 1.0 /end CHARACTERISTIC
/begin CHARACTERISTIC APO_flgBSDTxEnaOvrd_C "" VALUE 0x70010763 Scalar_BOOLEAN 0 VBU0706_CM_boolean_cnt 0.0 1.0 /end CHARACTERISTIC
/begin CHARACTERISTIC APO_flgBSMTxEnaOvrdVal_C "" VALUE 0x70010764 Scalar_BOOLEAN 0 VBU0706_CM_boolean_cnt 0.0 1.0 /end CHARACTERISTIC
/begin CHARACTERISTIC APO_flgBSMTxEnaOvrd_C "" VALUE 0x70010765 Scalar_BOOLEAN 0 VBU0706_CM_boolean_cnt 0.0 1.0 /end CHARACTERISTIC
/begin CHARACTERISTIC APO_flgBSTTxEnaOvrdVal_C "" VALUE 0x70010766 Scalar_BOOLEAN 0 VBU0706_CM_boolean_cnt 0.0 1.0 /end CHARACTERISTIC
/begin CHARACTERISTIC APO_flgBSTTxEnaOvrd_C "" VALUE 0x70010767 Scalar_BOOLEAN 0 VBU0706_CM_boolean_cnt 0.0 1.0 /end CHARACTERISTIC
/begin CHARACTERISTIC BATTERY_ISOLATION_STATEOvrd_C "" VALUE 0x7001078b Scalar_BOOLEAN 0 VBU0706_CM_boolean_cnt 0.0 1.0 /end CHARACTERISTIC
/begin CHARACTERISTIC BATTERY_OUTPUT_CONNECTOR_STATEOvrd_C "" VALUE 0x7001078d Scalar_BOOLEAN 0 VBU0706_CM_boolean_cnt 0.0 1.0 /end CHARACTERISTIC
/begin CHARACTERISTIC CELL_VOLTAGE_OVER_UNDEROvrd_C "" VALUE 0x700107c1 Scalar_BOOLEAN 0 VBU0706_CM_boolean_cnt 0.0 1.0 /end CHARACTERISTIC
/begin CHARACTERISTIC CHARGER_MESSAGE_OT_00Ovrd_C "" VALUE 0x700107d6 Scalar_BOOLEAN 0 VBU0706_CM_boolean_cnt 0.0 1.0 /end CHARACTERISTIC
/begin CHARACTERISTIC CHARGER_MESSAGE_OT_AAOvrd_C "" VALUE 0x700107d8 Scalar_BOOLEAN 0 VBU0706_CM_boolean_cnt 0.0 1.0 /end CHARACTERISTIC
/begin CHARACTERISTIC CHARGER_MESSAGE_OT_READYOvrd_C "" VALUE 0x700107da Scalar_BOOLEAN 0 VBU0706_CM_boolean_cnt 0.0 1.0 /end CHARACTERISTIC
/begin CHARACTERISTIC CHARGER_MESSAGE_OT_STATEOvrd_C "" VALUE 0x700107dc Scalar_BOOLEAN 0 VBU0706_CM_boolean_cnt 0.0 1.0 /end CHARACTERISTIC
/begin CHARACTERISTIC CHARGER_MESSAGE_OT_STATISTICSOvrd_C "" VALUE 0x700107de Scalar_BOOLEAN 0 VBU0706_CM_boolean_cnt 0.0 1.0 /end CHARACTERISTIC
/begin CHARACTERISTIC CHARGER_MESSAGE_OT_STOPOvrd_C "" VALUE 0x700107e0 Scalar_BOOLEAN 0 VBU0706_CM_boolean_cnt 0.0 1.0 /end CHARACTERISTIC
/begin CHARACTERISTIC CHARGER_MESSAGE_OT_SYNCHRONOUSOvrd_C "" VALUE 0x700107e2 Scalar_BOOLEAN 0 VBU0706_CM_boolean_cnt 0.0 1.0 /end CHARACTERISTIC
/begin CHARACTERISTIC CHARGING_MODEOvrd_C "" VALUE 0x700107e4 Scalar_BOOLEAN 0 VBU0706_CM_boolean_cnt 0.0 1.0 /end CHARACTERISTIC
/begin CHARACTERISTIC CHARGING_PERMITOvrd_C "" VALUE 0x700107e6 Scalar_BOOLEAN 0 VBU0706_CM_boolean_cnt 0.0 1.0 /end CHARACTERISTIC
/begin CHARACTERISTIC CURRENT_OVER_UNDEROvrd_C "" VALUE 0x70010804 Scalar_BOOLEAN 0 VBU0706_CM_boolean_cnt 0.0 1.0 /end CHARACTERISTIC
/begin CHARACTERISTIC CURRENT_REQUIREMENTOvrd_C "" VALUE 0x70010806 Scalar_BOOLEAN 0 VBU0706_CM_boolean_cnt 0.0 1.0 /end CHARACTERISTIC
/begin CHARACTERISTIC CbBMM_AbnormalEventDetectedORF_flg "" VALUE 0x7001082c Scalar_BOOLEAN 0 VBU0706_CM_boolean_cnt 0.0 1.0 /end CHARACTERISTIC
/begin CHARACTERISTIC CbBMM_AbnormalEventDetectedORV_flg "" VALUE 0x7001082d Scalar_BOOLEAN 0 VBU0706_CM_boolean_cnt 0.0 1.0 /end CHARACTERISTIC
/begin CHARACTERISTIC CbBMM_AbnormalPowerOffOverride_flg "" VALUE 0x7001082e Scalar_BOOLEAN 0 VBU0706_CM_boolean_cnt 0.0 1.0 /end CHARACTERISTIC
/begin CHARACTERISTIC CbBMM_AbnormalResetOverride_flg "" VALUE 0x7001082f Scalar_BOOLEAN 0 VBU0706_CM_boolean_cnt 0.0 1.0 /end CHARACTERISTIC
/begin CHARACTERISTIC CbBMM_flgNVMReadCheckEnable_C "" VALUE 0x70010832 Scalar_BOOLEAN 0 VBU0706_CM_boolean_cnt 0.0 1.0 /end CHARACTERISTIC
/begin CHARACTERISTIC CbISO_IsolationSevere_flg "" VALUE 0x70010868 Scalar_BOOLEAN 0 VBU0706_CM_boolean_flg 0.0 1.0 /end CHARACTERISTIC
/begin CHARACTERISTIC CbISO_IsolationWarning_flg "" VALUE 0x70010869 Scalar_BOOLEAN 0 VBU0706_CM_boolean_flg 0.0 1.0 /end CHARACTERISTIC
/begin CHARACTERISTIC CbRTC_ActualTimeInit_flg "" VALUE 0x7001086b Scalar_BOOLEAN 0 VBU0706_CM_boolean_cnt 0.0 1.0 /end CHARACTERISTIC
/begin CHARACTERISTIC CbSYS_flgAbnormalResetRecoverEnable "" VALUE 0x70010880 Scalar_BOOLEAN 0 VBU0706_CM_boolean_cnt 0.0 1.0 /end CHARACTERISTIC
/begin CHARACTERISTIC CbWRT_BatteryCapacityCycleORF_flg "" VALUE 0x700108e8 Scalar_BOOLEAN 0 VBU0706_CM_boolean_cnt 0.0 1.0 /end CHARACTERISTIC
/begin CHARACTERISTIC DCH_cBCPNrmCapOvrd_C "" VALUE 0x7001099e Scalar_BOOLEAN 0 VBU0706_CM_boolean_cnt 0.0 1.0 /end CHARACTERISTIC
/begin CHARACTERISTIC DCH_cBRMBattRatedCapOvrd_C "" VALUE 0x7001099f Scalar_BOOLEAN 0 VBU0706_CM_boolean_cnt 0.0 1.0 /end CHARACTERISTIC
/begin CHARACTERISTIC DCH_iBCPMaxChCurrOvrd_C "" VALUE 0x70010a06 Scalar_BOOLEAN 0 VBU0706_CM_boolean_cnt 0.0 1.0 /end CHARACTERISTIC
/begin CHARACTERISTIC DCH_iBCSChCurrMeasureOvrd_C "" VALUE 0x70010a07 Scalar_BOOLEAN 0 VBU0706_CM_boolean_cnt 0.0 1.0 /end CHARACTERISTIC
/begin CHARACTERISTIC DCH_numBCSMaxCellVltgNumOvrd_C "" VALUE 0x70010a08 Scalar_BOOLEAN 0 VBU0706_CM_boolean_cnt 0.0 1.0 /end CHARACTERISTIC
/begin CHARACTERISTIC DCH_numBRMBattTypOvrd_C "" VALUE 0x70010a0a Scalar_BOOLEAN 0 VBU0706_CM_boolean_cnt 0.0 1.0 /end CHARACTERISTIC
/begin CHARACTERISTIC DCH_pctBCPSocOvrd_C "" VALUE 0x70010a0b Scalar_BOOLEAN 0 VBU0706_CM_boolean_cnt 0.0 1.0 /end CHARACTERISTIC
/begin CHARACTERISTIC DCH_pctBCSCurrSocOvrd_C "" VALUE 0x70010a0c Scalar_BOOLEAN 0 VBU0706_CM_boolean_cnt 0.0 1.0 /end CHARACTERISTIC
/begin CHARACTERISTIC DCH_tBCPMaxPermitTempOvrd_C "" VALUE 0x70010a66 Scalar_BOOLEAN 0 VBU0706_CM_boolean_cnt 0.0 1.0 /end CHARACTERISTIC
/begin CHARACTERISTIC DCH_tiBCSChNeedTOvrd_C "" VALUE 0x70010a67 Scalar_BOOLEAN 0 VBU0706_CM_boolean_cnt 0.0 1.0 /end CHARACTERISTIC
/begin CHARACTERISTIC DCH_uBCPBattVltgOvrd_C "" VALUE 0x70010a68 Scalar_BOOLEAN 0 VBU0706_CM_boolean_cnt 0.0 1.0 /end CHARACTERISTIC
/begin CHARACTERISTIC DCH_uBCPMaxCellVltgForChOvrd_C "" VALUE 0x70010a69 Scalar_BOOLEAN 0 VBU0706_CM_boolean_cnt 0.0 1.0 /end CHARACTERISTIC
/begin CHARACTERISTIC DCH_uBCPMaxVltgForChOvrd_C "" VALUE 0x70010a6a Scalar_BOOLEAN 0 VBU0706_CM_boolean_cnt 0.0 1.0 /end CHARACTERISTIC
/begin CHARACTERISTIC DCH_uBCSChVltgMeasureOvrd_C "" VALUE 0x70010a6b Scalar_BOOLEAN 0 VBU0706_CM_boolean_cnt 0.0 1.0 /end CHARACTERISTIC
/begin CHARACTERISTIC DCH_uBCSMaxCellVltgOvrd_C "" VALUE 0x70010a6c Scalar_BOOLEAN 0 VBU0706_CM_boolean_cnt 0.0 1.0 /end CHARACTERISTIC
/begin CHARACTERISTIC DCH_uBRMBattRatedVltgOvrd_C "" VALUE 0x70010a6d Scalar_BOOLEAN 0 VBU0706_CM_boolean_cnt 0.0 1.0 /end CHARACTERISTIC
/begin CHARACTERISTIC GATEWAY_STOP_ERROR_REASON_OCOvrd_C "" VALUE 0x70010aa4 Scalar_BOOLEAN 0 VBU0706_CM_boolean_cnt 0.0 1.0 /end CHARACTERISTIC
/begin CHARACTERISTIC GATEWAY_STOP_ERROR_REASON_VOLTOvrd_C "" VALUE 0x70010aa6 Scalar_BOOLEAN 0 VBU0706_CM_boolean_cnt 0.0 1.0 /end CHARACTERISTIC
/begin CHARACTERISTIC GATEWAY_STOP_FAULT_REASON_1Ovrd_C "" VALUE 0x70010aa8 Scalar_BOOLEAN 0 VBU0706_CM_boolean_cnt 0.0 1.0 /end CHARACTERISTIC
/begin CHARACTERISTIC GATEWAY_STOP_FAULT_REASON_2Ovrd_C "" VALUE 0x70010aaa Scalar_BOOLEAN 0 VBU0706_CM_boolean_cnt 0.0 1.0 /end CHARACTERISTIC
/begin CHARACTERISTIC GATEWAY_STOP_FAULT_REASON_3Ovrd_C "" VALUE 0x70010aac Scalar_BOOLEAN 0 VBU0706_CM_boolean_cnt 0.0 1.0 /end CHARACTERISTIC
/begin CHARACTERISTIC GATEWAY_STOP_FAULT_REASON_BMSOTOvrd_C "" VALUE 0x70010aae Scalar_BOOLEAN 0 VBU0706_CM_boolean_cnt 0.0 1.0 /end CHARACTERISTIC
/begin CHARACTERISTIC GATEWAY_STOP_FAULT_REASON_CELLOTOvrd_C "" VALUE 0x70010ab0 Scalar_BOOLEAN 0 VBU0706_CM_boolean_cnt 0.0 1.0 /end CHARACTERISTIC
/begin CHARACTERISTIC GATEWAY_STOP_FAULT_REASON_CONNOTOvrd_C "" VALUE 0x70010ab2 Scalar_BOOLEAN 0 VBU0706_CM_boolean_cnt 0.0 1.0 /end CHARACTERISTIC
/begin CHARACTERISTIC GATEWAY_STOP_FAULT_REASON_CONNOvrd_C "" VALUE 0x70010ab4 Scalar_BOOLEAN 0 VBU0706_CM_boolean_cnt 0.0 1.0 /end CHARACTERISTIC
/begin CHARACTERISTIC GATEWAY_STOP_FAULT_REASON_ISOOvrd_C "" VALUE 0x70010ab6 Scalar_BOOLEAN 0 VBU0706_CM_boolean_cnt 0.0 1.0 /end CHARACTERISTIC
/begin CHARACTERISTIC GATEWAY_STOP_REASON_CELLVOLTOvrd_C "" VALUE 0x70010ab8 Scalar_BOOLEAN 0 VBU0706_CM_boolean_cnt 0.0 1.0 /end CHARACTERISTIC
/begin CHARACTERISTIC GATEWAY_STOP_REASON_SOCOvrd_C "" VALUE 0x70010aba Scalar_BOOLEAN 0 VBU0706_CM_boolean_cnt 0.0 1.0 /end CHARACTERISTIC
/begin CHARACTERISTIC GATEWAY_STOP_REASON_STATIONOvrd_C "" VALUE 0x70010abc Scalar_BOOLEAN 0 VBU0706_CM_boolean_cnt 0.0 1.0 /end CHARACTERISTIC
/begin CHARACTERISTIC GATEWAY_STOP_REASON_TOTALVOLTOvrd_C "" VALUE 0x70010abe Scalar_BOOLEAN 0 VBU0706_CM_boolean_cnt 0.0 1.0 /end CHARACTERISTIC
/begin CHARACTERISTIC MAXIMUM_CELL_TEMPOvrd_C "" VALUE 0x70010b16 Scalar_BOOLEAN 0 VBU0706_CM_boolean_cnt 0.0 1.0 /end CHARACTERISTIC
/begin CHARACTERISTIC MAXIMUM_CELL_TEMP_BSDOvrd_C "" VALUE 0x70010b18 Scalar_BOOLEAN 0 VBU0706_CM_boolean_cnt 0.0 1.0 /end CHARACTERISTIC
/begin CHARACTERISTIC MAXIMUM_CELL_VOLTAGE_BSDOvrd_C "" VALUE 0x70010b1a Scalar_BOOLEAN 0 VBU0706_CM_boolean_cnt 0.0 1.0 /end CHARACTERISTIC
/begin CHARACTERISTIC MAXIMUM_CELL_VOLTAGE_NUMBER_BSMOvrd_C "" VALUE 0x70010b1c Scalar_BOOLEAN 0 VBU0706_CM_boolean_cnt 0.0 1.0 /end CHARACTERISTIC
/begin CHARACTERISTIC MAXIMUM_TEMP_NUMBEROvrd_C "" VALUE 0x70010b1e Scalar_BOOLEAN 0 VBU0706_CM_boolean_cnt 0.0 1.0 /end CHARACTERISTIC
/begin CHARACTERISTIC MINIMUM_CELL_TEMPOvrd_C "" VALUE 0x70010b24 Scalar_BOOLEAN 0 VBU0706_CM_boolean_cnt 0.0 1.0 /end CHARACTERISTIC
/begin CHARACTERISTIC MINIMUM_CELL_TEMP_BSDOvrd_C "" VALUE 0x70010b26 Scalar_BOOLEAN 0 VBU0706_CM_boolean_cnt 0.0 1.0 /end CHARACTERISTIC
/begin CHARACTERISTIC MINIMUM_CELL_VOLTAGE_BSDOvrd_C "" VALUE 0x70010b28 Scalar_BOOLEAN 0 VBU0706_CM_boolean_cnt 0.0 1.0 /end CHARACTERISTIC
/begin CHARACTERISTIC MINIMUM_TEMP_NUMBEROvrd_C "" VALUE 0x70010b2a Scalar_BOOLEAN 0 VBU0706_CM_boolean_cnt 0.0 1.0 /end CHARACTERISTIC
/begin CHARACTERISTIC PTCRLY_OV "" VALUE 0x70010b75 Scalar_BOOLEAN 0 VBU0706_CM_boolean 0 1 /end CHARACTERISTIC
/begin CHARACTERISTIC PermitVoltageOvrd_C "" VALUE 0x70010b76 Scalar_BOOLEAN 0 VBU0706_CM_boolean_cnt 0.0 1.0 /end CHARACTERISTIC
/begin CHARACTERISTIC READY_CHARGING_GATEWAYOvrd_C "" VALUE 0x70010b78 Scalar_BOOLEAN 0 VBU0706_CM_boolean_cnt 0.0 1.0 /end CHARACTERISTIC
/begin CHARACTERISTIC SOC_OVER_UNDEROvrd_C "" VALUE 0x70010b7e Scalar_BOOLEAN 0 VBU0706_CM_boolean_cnt 0.0 1.0 /end CHARACTERISTIC
/begin CHARACTERISTIC SOC_STOPOvrd_C "" VALUE 0x70010b80 Scalar_BOOLEAN 0 VBU0706_CM_boolean_cnt 0.0 1.0 /end CHARACTERISTIC
/begin CHARACTERISTIC SleepEnable "" VALUE 0x70010b96 Scalar_BOOLEAN 0 VBU0706_CM_boolean 0 1 /end CHARACTERISTIC
/begin CHARACTERISTIC TEMP_OVEROvrd_C "" VALUE 0x70010b97 Scalar_BOOLEAN 0 VBU0706_CM_boolean_cnt 0.0 1.0 /end CHARACTERISTIC
/begin CHARACTERISTIC VCT_CHARGE_STATE_CHARGING "" VALUE 0x70010bcf Scalar_BOOLEAN 0 VBU0706_CM_boolean_cnt 0.0 1.0 /end CHARACTERISTIC
/begin CHARACTERISTIC VCT_CHARGE_STATE_CHARGING_FAULT "" VALUE 0x70010bd0 Scalar_BOOLEAN 0 VBU0706_CM_boolean_cnt 0.0 1.0 /end CHARACTERISTIC
/begin CHARACTERISTIC VCT_CHARGE_STATE_NOT_CHARGING "" VALUE 0x70010bd2 Scalar_BOOLEAN 0 VBU0706_CM_boolean_cnt 0.0 1.0 /end CHARACTERISTIC
/begin CHARACTERISTIC VOLTAGE_REQUIREMENTOvrd_C "" VALUE 0x70010bdd Scalar_BOOLEAN 0 VBU0706_CM_boolean_cnt 0.0 1.0 /end CHARACTERISTIC
/begin CHARACTERISTIC CcISO_IsolationSevereFaultFIC_n "" VALUE 0x7001094b Scalar_BYTE 0 VBU0706_CM_int8_n -128.0 127.0 /end CHARACTERISTIC
/begin CHARACTERISTIC CcISO_IsolationSevereFaultPIC_n "" VALUE 0x7001094c Scalar_BYTE 0 VBU0706_CM_int8_n -128.0 127.0 /end CHARACTERISTIC
/begin CHARACTERISTIC CcISO_IsolationWarningFaultFIC_n "" VALUE 0x7001094d Scalar_BYTE 0 VBU0706_CM_int8_n -128.0 127.0 /end CHARACTERISTIC
/begin CHARACTERISTIC CcISO_IsolationWarningFaultPIC_n "" VALUE 0x7001094e Scalar_BYTE 0 VBU0706_CM_int8_n -128.0 127.0 /end CHARACTERISTIC
/begin CHARACTERISTIC BATTERY_ISOLATION_STATEOvrdVal_C "" VALUE 0x7001078a Scalar_UBYTE 0 VBU0706_CM_uint8_cnt 0.0 255.0 /end CHARACTERISTIC
/begin CHARACTERISTIC BATTERY_OUTPUT_CONNECTOR_STATEOvrdVal_C "" VALUE 0x7001078c Scalar_UBYTE 0 VBU0706_CM_uint8_cnt 0.0 255.0 /end CHARACTERISTIC
/begin CHARACTERISTIC BMM_BMU_POWEROFF_NORMAL "" VALUE 0x70010794 Scalar_UBYTE 0 VBU0706_CM_uint8_cnt 0.0 255.0 /end CHARACTERISTIC
/begin CHARACTERISTIC BMM_BMU_RESET_NONE "" VALUE 0x70010795 Scalar_UBYTE 0 VBU0706_CM_uint8_cnt 0.0 255.0 /end CHARACTERISTIC
/begin CHARACTERISTIC BMM_STATE_AFTER_RUN "" VALUE 0x70010797 Scalar_UBYTE 0 VBU0706_CM_uint8_cnt 0.0 255.0 /end CHARACTERISTIC
/begin CHARACTERISTIC BMM_STATE_DRIVE_MODE "" VALUE 0x70010798 Scalar_UBYTE 0 VBU0706_CM_uint8_cnt 0.0 255.0 /end CHARACTERISTIC
/begin CHARACTERISTIC BMM_STATE_FAST_CHARGE "" VALUE 0x70010799 Scalar_UBYTE 0 VBU0706_CM_uint8_cnt 0.0 255.0 /end CHARACTERISTIC
/begin CHARACTERISTIC BMM_STATE_IDLE "" VALUE 0x7001079a Scalar_UBYTE 0 VBU0706_CM_uint8_cnt 0.0 255.0 /end CHARACTERISTIC
/begin CHARACTERISTIC BMM_STATE_INITIALIZATION "" VALUE 0x7001079b Scalar_UBYTE 0 VBU0706_CM_uint8_cnt 0.0 255.0 /end CHARACTERISTIC
/begin CHARACTERISTIC BMM_STATE_ONBOARD_CHARGE "" VALUE 0x7001079c Scalar_UBYTE 0 VBU0706_CM_uint8_cnt 0.0 255.0 /end CHARACTERISTIC
/begin CHARACTERISTIC BMM_STATE_RTC "" VALUE 0x7001079e Scalar_UBYTE 0 VBU0706_CM_uint8_cnt 0.0 255.0 /end CHARACTERISTIC
/begin CHARACTERISTIC BMM_STATE_SHUT_DOWN "" VALUE 0x7001079f Scalar_UBYTE 0 VBU0706_CM_uint8_cnt 0.0 255.0 /end CHARACTERISTIC
/begin CHARACTERISTIC CELL_VOLTAGE_OVER_UNDEROvrdVal_C "" VALUE 0x700107c0 Scalar_UBYTE 0 VBU0706_CM_uint8_cnt 0.0 255.0 /end CHARACTERISTIC
/begin CHARACTERISTIC CHARGER_MESSAGE_OT_00OvrdVal_C "" VALUE 0x700107d5 Scalar_UBYTE 0 VBU0706_CM_uint8_cnt 0.0 255.0 /end CHARACTERISTIC
/begin CHARACTERISTIC CHARGER_MESSAGE_OT_AAOvrdVal_C "" VALUE 0x700107d7 Scalar_UBYTE 0 VBU0706_CM_uint8_cnt 0.0 255.0 /end CHARACTERISTIC
/begin CHARACTERISTIC CHARGER_MESSAGE_OT_READYOvrdVal_C "" VALUE 0x700107d9 Scalar_UBYTE 0 VBU0706_CM_uint8_cnt 0.0 255.0 /end CHARACTERISTIC
/begin CHARACTERISTIC CHARGER_MESSAGE_OT_STATEOvrdVal_C "" VALUE 0x700107db Scalar_UBYTE 0 VBU0706_CM_uint8_cnt 0.0 255.0 /end CHARACTERISTIC
/begin CHARACTERISTIC CHARGER_MESSAGE_OT_STATISTICSOvrdVal_C "" VALUE 0x700107dd Scalar_UBYTE 0 VBU0706_CM_uint8_cnt 0.0 255.0 /end CHARACTERISTIC
/begin CHARACTERISTIC CHARGER_MESSAGE_OT_STOPOvrdVal_C "" VALUE 0x700107df Scalar_UBYTE 0 VBU0706_CM_uint8_cnt 0.0 255.0 /end CHARACTERISTIC
/begin CHARACTERISTIC CHARGER_MESSAGE_OT_SYNCHRONOUSOvrdVal_C "" VALUE 0x700107e1 Scalar_UBYTE 0 VBU0706_CM_uint8_cnt 0.0 255.0 /end CHARACTERISTIC
/begin CHARACTERISTIC CHARGING_MODEOvrdVal_C "" VALUE 0x700107e3 Scalar_UBYTE 0 VBU0706_CM_uint8_cnt 0.0 255.0 /end CHARACTERISTIC
/begin CHARACTERISTIC CHARGING_PERMITOvrdVal_C "" VALUE 0x700107e5 Scalar_UBYTE 0 VBU0706_CM_uint8_cnt 0.0 255.0 /end CHARACTERISTIC
/begin CHARACTERISTIC CTD_MAIN_CONTACTOR_STATUS_CLOSED "" VALUE 0x700107e7 Scalar_UBYTE 0 VBU0706_CM_uint8_cnt 0.0 255.0 /end CHARACTERISTIC
/begin CHARACTERISTIC CTD_MAIN_CONTACTOR_STATUS_OPENED "" VALUE 0x700107e8 Scalar_UBYTE 0 VBU0706_CM_uint8_cnt 0.0 255.0 /end CHARACTERISTIC
/begin CHARACTERISTIC CURRENT_OVER_UNDEROvrdVal_C "" VALUE 0x70010803 Scalar_UBYTE 0 VBU0706_CM_uint8_cnt 0.0 255.0 /end CHARACTERISTIC
/begin CHARACTERISTIC CURRENT_REQUIREMENTOvrdVal_C "" VALUE 0x70010805 Scalar_UBYTE 0 VBU0706_CM_uint8_cnt 0.0 255.0 /end CHARACTERISTIC
/begin CHARACTERISTIC CYCLE_WAKEUP_STATE_PERIODICAL_UPLOAD "" VALUE 0x7001080a Scalar_UBYTE 0 VBU0706_CM_uint8_cnt 0.0 255.0 /end CHARACTERISTIC
/begin CHARACTERISTIC CcISO_AllowableIsolationWarningTimes_n "" VALUE 0x7001094a Scalar_UBYTE 0 VBU0706_CM_uint8_n 0.0 255.0 /end CHARACTERISTIC
/begin CHARACTERISTIC CeVCT_BMSBatteryType_enum "" VALUE 0x70010974 Scalar_UBYTE 0 VBU0706_CM_uint8_enum 0.0 255.0 /end CHARACTERISTIC
/begin CHARACTERISTIC DCH_numBRMBattTypOvrdVal_C "" VALUE 0x70010a09 Scalar_UBYTE 0 VBU0706_CM_uint8_cnt 0.0 255.0 /end CHARACTERISTIC
/begin CHARACTERISTIC ENUM_J1939TP_CTS "" VALUE 0x70010a8b Scalar_UBYTE 0 VBU0706_CM_uint8 0 255 /end CHARACTERISTIC
/begin CHARACTERISTIC ENUM_J1939TP_Conn_Abort "" VALUE 0x70010a8c Scalar_UBYTE 0 VBU0706_CM_uint8 0.0 255.0 /end CHARACTERISTIC
/begin CHARACTERISTIC ENUM_J1939TP_EndOfMsgACK "" VALUE 0x70010a8d Scalar_UBYTE 0 VBU0706_CM_uint8 0.0 255.0 /end CHARACTERISTIC
/begin CHARACTERISTIC FCC_STATE_CHARGE_FAULT "" VALUE 0x70010a98 Scalar_UBYTE 0 VBU0706_CM_uint8_cnt 0.0 255.0 /end CHARACTERISTIC
/begin CHARACTERISTIC FCC_STATE_CHARGE_FULL "" VALUE 0x70010a99 Scalar_UBYTE 0 VBU0706_CM_uint8_cnt 0.0 255.0 /end CHARACTERISTIC
/begin CHARACTERISTIC FCC_STATE_CHARGING "" VALUE 0x70010a9b Scalar_UBYTE 0 VBU0706_CM_uint8_cnt 0.0 255.0 /end CHARACTERISTIC
/begin CHARACTERISTIC GATEWAY_STOP_ERROR_REASON_OCOvrdVal_C "" VALUE 0x70010aa3 Scalar_UBYTE 0 VBU0706_CM_uint8_cnt 0.0 255.0 /end CHARACTERISTIC
/begin CHARACTERISTIC GATEWAY_STOP_ERROR_REASON_VOLTOvrdVal_C "" VALUE 0x70010aa5 Scalar_UBYTE 0 VBU0706_CM_uint8_cnt 0.0 255.0 /end CHARACTERISTIC
/begin CHARACTERISTIC GATEWAY_STOP_FAULT_REASON_1OvrdVal_C "" VALUE 0x70010aa7 Scalar_UBYTE 0 VBU0706_CM_uint8_cnt 0.0 255.0 /end CHARACTERISTIC
/begin CHARACTERISTIC GATEWAY_STOP_FAULT_REASON_2OvrdVal_C "" VALUE 0x70010aa9 Scalar_UBYTE 0 VBU0706_CM_uint8_cnt 0.0 255.0 /end CHARACTERISTIC
/begin CHARACTERISTIC GATEWAY_STOP_FAULT_REASON_3OvrdVal_C "" VALUE 0x70010aab Scalar_UBYTE 0 VBU0706_CM_uint8_cnt 0.0 255.0 /end CHARACTERISTIC
/begin CHARACTERISTIC GATEWAY_STOP_FAULT_REASON_BMSOTOvrdVal_C "" VALUE 0x70010aad Scalar_UBYTE 0 VBU0706_CM_uint8_cnt 0.0 255.0 /end CHARACTERISTIC
/begin CHARACTERISTIC GATEWAY_STOP_FAULT_REASON_CELLOTOvrdVal_C "" VALUE 0x70010aaf Scalar_UBYTE 0 VBU0706_CM_uint8_cnt 0.0 255.0 /end CHARACTERISTIC
/begin CHARACTERISTIC GATEWAY_STOP_FAULT_REASON_CONNOTOvrdVal_C "" VALUE 0x70010ab1 Scalar_UBYTE 0 VBU0706_CM_uint8_cnt 0.0 255.0 /end CHARACTERISTIC
/begin CHARACTERISTIC GATEWAY_STOP_FAULT_REASON_CONNOvrdVal_C "" VALUE 0x70010ab3 Scalar_UBYTE 0 VBU0706_CM_uint8_cnt 0.0 255.0 /end CHARACTERISTIC
/begin CHARACTERISTIC GATEWAY_STOP_FAULT_REASON_ISOOvrdVal_C "" VALUE 0x70010ab5 Scalar_UBYTE 0 VBU0706_CM_uint8_cnt 0.0 255.0 /end CHARACTERISTIC
/begin CHARACTERISTIC GATEWAY_STOP_REASON_CELLVOLTOvrdVal_C "" VALUE 0x70010ab7 Scalar_UBYTE 0 VBU0706_CM_uint8_cnt 0.0 255.0 /end CHARACTERISTIC
/begin CHARACTERISTIC GATEWAY_STOP_REASON_SOCOvrdVal_C "" VALUE 0x70010ab9 Scalar_UBYTE 0 VBU0706_CM_uint8_cnt 0.0 255.0 /end CHARACTERISTIC
/begin CHARACTERISTIC GATEWAY_STOP_REASON_STATIONOvrdVal_C "" VALUE 0x70010abb Scalar_UBYTE 0 VBU0706_CM_uint8_cnt 0.0 255.0 /end CHARACTERISTIC
/begin CHARACTERISTIC GATEWAY_STOP_REASON_TOTALVOLTOvrdVal_C "" VALUE 0x70010abd Scalar_UBYTE 0 VBU0706_CM_uint8_cnt 0.0 255.0 /end CHARACTERISTIC
/begin CHARACTERISTIC ISO_ISOLATION_SEVERE_FAULT "" VALUE 0x70010b0a Scalar_UBYTE 0 VBU0706_CM_uint8_n 0.0 255.0 /end CHARACTERISTIC
/begin CHARACTERISTIC ISO_ISOLATION_WARNING_FAULT "" VALUE 0x70010b0b Scalar_UBYTE 0 VBU0706_CM_uint8_n 0.0 255.0 /end CHARACTERISTIC
/begin CHARACTERISTIC MAXIMUM_CELL_TEMPOvrdVal_C "" VALUE 0x70010b15 Scalar_UBYTE 0 VBU0706_CM_uint8_cnt 0.0 255.0 /end CHARACTERISTIC
/begin CHARACTERISTIC MAXIMUM_CELL_TEMP_BSDOvrdVal_C "" VALUE 0x70010b17 Scalar_UBYTE 0 VBU0706_CM_uint8_cnt 0.0 255.0 /end CHARACTERISTIC
/begin CHARACTERISTIC MAXIMUM_CELL_VOLTAGE_BSDOvrdVal_C "" VALUE 0x70010b19 Scalar_UBYTE 0 VBU0706_CM_uint8_cnt 0.0 255.0 /end CHARACTERISTIC
/begin CHARACTERISTIC MAXIMUM_CELL_VOLTAGE_NUMBER_BSMOvrdVal_C "" VALUE 0x70010b1b Scalar_UBYTE 0 VBU0706_CM_uint8_cnt 0.0 255.0 /end CHARACTERISTIC
/begin CHARACTERISTIC MAXIMUM_TEMP_NUMBEROvrdVal_C "" VALUE 0x70010b1d Scalar_UBYTE 0 VBU0706_CM_uint8_cnt 0.0 255.0 /end CHARACTERISTIC
/begin CHARACTERISTIC MINIMUM_CELL_TEMPOvrdVal_C "" VALUE 0x70010b23 Scalar_UBYTE 0 VBU0706_CM_uint8_cnt 0.0 255.0 /end CHARACTERISTIC
/begin CHARACTERISTIC MINIMUM_CELL_TEMP_BSDOvrdVal_C "" VALUE 0x70010b25 Scalar_UBYTE 0 VBU0706_CM_uint8_cnt 0.0 255.0 /end CHARACTERISTIC
/begin CHARACTERISTIC MINIMUM_CELL_VOLTAGE_BSDOvrdVal_C "" VALUE 0x70010b27 Scalar_UBYTE 0 VBU0706_CM_uint8_cnt 0.0 255.0 /end CHARACTERISTIC
/begin CHARACTERISTIC MINIMUM_TEMP_NUMBEROvrdVal_C "" VALUE 0x70010b29 Scalar_UBYTE 0 VBU0706_CM_uint8_cnt 0.0 255.0 /end CHARACTERISTIC
/begin CHARACTERISTIC NUMBER_OF_PARALLEL_CELLS_PER_MODULE "" VALUE 0x70010b2f Scalar_UBYTE 0 VBU0706_CM_uint8_cnt 0.0 255.0 /end CHARACTERISTIC
/begin CHARACTERISTIC NUMBER_OF_PARALLEL_MODULES "" VALUE 0x70010b30 Scalar_UBYTE 0 VBU0706_CM_uint8_cnt 0.0 255.0 /end CHARACTERISTIC
/begin CHARACTERISTIC READY_CHARGING_GATEWAYOvrdVal_C "" VALUE 0x70010b77 Scalar_UBYTE 0 VBU0706_CM_uint8_cnt 0.0 255.0 /end CHARACTERISTIC
/begin CHARACTERISTIC SOC_OVER_UNDEROvrdVal_C "" VALUE 0x70010b7d Scalar_UBYTE 0 VBU0706_CM_uint8_cnt 0.0 255.0 /end CHARACTERISTIC
/begin CHARACTERISTIC SOC_STOPOvrdVal_C "" VALUE 0x70010b7f Scalar_UBYTE 0 VBU0706_CM_uint8_cnt 0.0 255.0 /end CHARACTERISTIC
/begin CHARACTERISTIC VCT_CHARGE_STATE_CHARGING_FULL "" VALUE 0x70010bd1 Scalar_UBYTE 0 VBU0706_CM_uint8_cnt 0.0 255.0 /end CHARACTERISTIC
/begin CHARACTERISTIC VOLTAGE_REQUIREMENTOvrdVal_C "" VALUE 0x70010bdc Scalar_UBYTE 0 VBU0706_CM_uint8_cnt 0.0 255.0 /end CHARACTERISTIC
/begin MEASUREMENT WRT_numOpenContactorWithLoadTimes1 "" ULONG VBU0706_CM_uint32 0 0 0 4294967295 ECU_ADDRESS 0x70011c3a /end MEASUREMENT
/begin MEASUREMENT WRT_numOpenContactorWithLoadTimes2 "" ULONG VBU0706_CM_uint32 0 0 0 4294967295 ECU_ADDRESS 0x70011c3e /end MEASUREMENT
/begin MEASUREMENT TP_PGN "" ULONG VBU0706_CM_uint32 0 0 0 4294967295 ECU_ADDRESS 0x7001197e /end MEASUREMENT
/begin MEASUREMENT CellTemp1 "" FLOAT32_IEEE VBU0706_CM_single 0 0 -3.4E+38 3.4E+38 ECU_ADDRESS 0x700114f6 /end MEASUREMENT
/begin MEASUREMENT BCV_uHALBatteryVoltageRaw "" FLOAT32_IEEE VBU0706_CM_single 0 0 -3.4E+38 3.4E+38 ECU_ADDRESS 0x70011462 /end MEASUREMENT
/begin MEASUREMENT BCV_uHALVx2VoltageRaw "" FLOAT32_IEEE VBU0706_CM_single 0 0 -3.4E+38 3.4E+38 ECU_ADDRESS 0x7001146e /end MEASUREMENT
/begin MEASUREMENT BCV_uHALBusNegativeVoltageRaw "" FLOAT32_IEEE VBU0706_CM_single 0 0 -3.4E+38 3.4E+38 ECU_ADDRESS 0x70011466 /end MEASUREMENT
/begin MEASUREMENT BCV_uHALFuseVoltageRaw "" FLOAT32_IEEE VBU0706_CM_single 0 0 -3.4E+38 3.4E+38 ECU_ADDRESS 0x7001146a /end MEASUREMENT
/begin MEASUREMENT WRT_numBatteryCapacityCycle "" FLOAT32_IEEE VBU0706_CM_single 0 0 -3.4E+38 3.4E+38 ECU_ADDRESS 0x70011c36 /end MEASUREMENT
/begin MEASUREMENT WRT_AhOverallDischarged "" FLOAT32_IEEE VBU0706_CM_single 0 0 -3.4E+38 3.4E+38 ECU_ADDRESS 0x70011c2e /end MEASUREMENT
/begin MEASUREMENT WRT_AhOverallFastcharged "" FLOAT32_IEEE VBU0706_CM_single 0 0 -3.4E+38 3.4E+38 ECU_ADDRESS 0x70011c32 /end MEASUREMENT
/begin MEASUREMENT OP_fLsWaterPumpOut1 "" FLOAT32_IEEE VBU0706_CM_single 0 0 -3.4E+38 3.4E+38 ECU_ADDRESS 0x7001176a /end MEASUREMENT
/begin MEASUREMENT OP_pctLsWaterPumpOut1 "" FLOAT32_IEEE VBU0706_CM_single 0 0 -3.4E+38 3.4E+38 ECU_ADDRESS 0x70011782 /end MEASUREMENT
/begin MEASUREMENT MsgRxData_HCU_Message_1_RelayStatus "" UBYTE VBU0706_CM_uint8 0 0 0 255 ARRAY_SIZE 8 ECU_ADDRESS 0x70011f55 /end MEASUREMENT
/begin MEASUREMENT MsgRxFlg_HCU_Message_1_RelayStatus "" UBYTE VBU0706_CM_boolean 0 0 0 1 ECU_ADDRESS 0x70011e80 /end MEASUREMENT
/begin MEASUREMENT CTS_flgCmdHeatContactor "" UBYTE VBU0706_CM_boolean 0 0 0.0 1.0 ECU_ADDRESS 0x70011d48 /end MEASUREMENT
/begin MEASUREMENT CTC_flgHALHeatContactor "" UBYTE VBU0706_CM_boolean 0 0 0.0 1.0 ECU_ADDRESS 0x70011d28 /end MEASUREMENT
/begin MEASUREMENT NVM_flgNVMValid "" UBYTE VBU0706_CM_boolean 0 0 0 1 ECU_ADDRESS 0x70011e84 /end MEASUREMENT
/begin MEASUREMENT BMM_flgDefaultState "" UBYTE VBU0706_CM_boolean 0 0 0.0 1.0 ECU_ADDRESS 0x70011d08 /end MEASUREMENT
/begin MEASUREMENT BMM_flgBatteryAbnormalAlarm2 "" UBYTE VBU0706_CM_boolean 0 0 0 1 ECU_ADDRESS 0x70011d06 /end MEASUREMENT
/begin MEASUREMENT BMM_flgBatteryAbnormalAlarm3 "" UBYTE VBU0706_CM_boolean 0 0 0 1 ECU_ADDRESS 0x70011d07 /end MEASUREMENT
/begin MEASUREMENT BMM_flgBatteryAbnormalAlarm1 "" UBYTE VBU0706_CM_boolean 0 0 0 1 ECU_ADDRESS 0x70011d05 /end MEASUREMENT
/begin MEASUREMENT BMM_flgBMUAbnormalReset "" UBYTE VBU0706_CM_boolean 0 0 0 1 ECU_ADDRESS 0x70011d04 /end MEASUREMENT
/begin MEASUREMENT BMM_flg12VBatteryVoltageAbnormal "" UBYTE VBU0706_CM_boolean 0 0 0 1 ECU_ADDRESS 0x70011d02 /end MEASUREMENT
/begin MEASUREMENT BMM_flgBMUAbnormalPowerOff "" UBYTE VBU0706_CM_boolean 0 0 0.0 1.0 ECU_ADDRESS 0x70011d03 /end MEASUREMENT
/begin MEASUREMENT FCHG_BRMRevFlag "" UBYTE VBU0706_CM_boolean 0 0 0 1 ECU_ADDRESS 0x70011def /end MEASUREMENT
/begin MEASUREMENT FCHG_BCSRevFlag "" UBYTE VBU0706_CM_boolean 0 0 0 1 ECU_ADDRESS 0x70011dee /end MEASUREMENT
/begin MEASUREMENT FCHG_BCPRevFlag "" UBYTE VBU0706_CM_boolean 0 0 0 1 ECU_ADDRESS 0x70011ded /end MEASUREMENT
/begin MEASUREMENT EcSOC_BatteryDisplaySoc_pct "" FLOAT32_IEEE VBU0706_CM_single 0 0 -3.4E+38 3.4E+38 ECU_ADDRESS 0x70012048 /end MEASUREMENT
/begin MEASUREMENT EcSOC_BatterySoc_pct "" FLOAT32_IEEE VBU0706_CM_single 0 0 -3.4E+38 3.4E+38 ECU_ADDRESS 0x7001204c /end MEASUREMENT
/begin MEASUREMENT EcSOH_AhChargeStart "" FLOAT32_IEEE VBU0706_CM_single 0 0 -3.4E+38 3.4E+38 ECU_ADDRESS 0x70012068 /end MEASUREMENT
/begin MEASUREMENT EcSOH_AhDischargeStart "" FLOAT32_IEEE VBU0706_CM_single 0 0 -3.4E+38 3.4E+38 ECU_ADDRESS 0x7001206c /end MEASUREMENT
/begin MEASUREMENT EcSOH_tisLifeTimeOperateTime "" FLOAT32_IEEE VBU0706_CM_single 0 0 -3.4E+38 3.4E+38 ECU_ADDRESS 0x70012070 /end MEASUREMENT
/begin MEASUREMENT LcBMM_timsInitializeTimer "" FLOAT32_IEEE VBU0706_CM_single 0 0 -3.4E+38 3.4E+38 ECU_ADDRESS 0x700116e6 /end MEASUREMENT
/begin MEASUREMENT LcBMM_timsShutdownTimer "" FLOAT32_IEEE VBU0706_CM_single 0 0 -3.4E+38 3.4E+38 ECU_ADDRESS 0x700116ea /end MEASUREMENT
/begin MEASUREMENT EcSOC_LoadDefaultSOCCnt_n "" ULONG VBU0706_CM_uint32 0 0 0 4294967295 ECU_ADDRESS 0x70012060 /end MEASUREMENT
/begin MEASUREMENT EcSOC_CellSocMaxOverrunCounter_n "" ULONG VBU0706_CM_uint32 0 0 0 4294967295 ECU_ADDRESS 0x70012050 /end MEASUREMENT
/begin MEASUREMENT EcSOC_CellSocMinOverrunCounter_n "" ULONG VBU0706_CM_uint32 0 0 0 4294967295 ECU_ADDRESS 0x70012054 /end MEASUREMENT
/begin MEASUREMENT EcSOC_LastCorrectionTime_s "" ULONG VBU0706_CM_uint32 0 0 0 4294967295 ECU_ADDRESS 0x70012058 /end MEASUREMENT
/begin MEASUREMENT EcSOC_ShortTimeLastCorrectionTime_s "" ULONG VBU0706_CM_uint32 0 0 0 4294967295 ECU_ADDRESS 0x70012064 /end MEASUREMENT
/begin MEASUREMENT EcSOC_LastShutdownTime_s "" ULONG VBU0706_CM_uint32 0 0 0 4294967295 ECU_ADDRESS 0x7001205c /end MEASUREMENT
/begin COMPU_METHOD VBU0706_CM_single_cnt "Q = V" RAT_FUNC "%8.6" "cnt" COEFFS 0 1 0 0 0 1 /end COMPU_METHOD
/begin COMPU_METHOD VBU0706_CM_uint16_cnt "Q = V" RAT_FUNC "%5.0" "cnt" COEFFS 0 1 0 0 0 1 /end COMPU_METHOD
/begin COMPU_METHOD VBU0706_CM_single_pct "Q = V" RAT_FUNC "%8.6" "pct" COEFFS 0 1 0 0 0 1 /end COMPU_METHOD
/begin COMPU_METHOD VBU0706_CM_single_V "Q = V" RAT_FUNC "%8.6" "V" COEFFS 0 1 0 0 0 1 /end COMPU_METHOD
/begin COMPU_METHOD VBU0706_CM_uint8 "Q = V" RAT_FUNC "%3.0" "" COEFFS 0 1 0 0 0 1 /end COMPU_METHOD
/begin COMPU_METHOD VBU0706_CM_single "Q = V" RAT_FUNC "%8.6" "" COEFFS 0 1 0 0 0 1 /end COMPU_METHOD
/begin COMPU_METHOD VBU0706_CM_single_kohm "Q = V" RAT_FUNC "%8.6" "kohm" COEFFS 0 1 0 0 0 1 /end COMPU_METHOD
/begin COMPU_METHOD VBU0706_CM_single_single "Q = V" RAT_FUNC "%8.6" "single" COEFFS 0 1 0 0 0 1 /end COMPU_METHOD
/begin COMPU_METHOD VBU0706_CM_single_Ah "Q = V" RAT_FUNC "%8.6" "Ah" COEFFS 0 1 0 0 0 1 /end COMPU_METHOD
/begin COMPU_METHOD VBU0706_CM_uint32_cnt "Q = V" RAT_FUNC "%10.0" "cnt" COEFFS 0 1 0 0 0 1 /end COMPU_METHOD
/begin COMPU_METHOD VBU0706_CM_uint32_kohm "Q = V" RAT_FUNC "%10.0" "kohm" COEFFS 0 1 0 0 0 1 /end COMPU_METHOD
/begin COMPU_METHOD VBU0706_CM_uint16_mV "Q = V" RAT_FUNC "%5.0" "mV" COEFFS 0 1 0 0 0 1 /end COMPU_METHOD
/begin COMPU_METHOD VBU0706_CM_uint16_ms "Q = V" RAT_FUNC "%5.0" "ms" COEFFS 0 1 0 0 0 1 /end COMPU_METHOD
/begin COMPU_METHOD VBU0706_CM_boolean_flg "Q = V" RAT_FUNC "%1.0" "flg" COEFFS 0 1 0 0 0 1 /end COMPU_METHOD
/begin COMPU_METHOD VBU0706_CM_boolean "Q = V" RAT_FUNC "%1.0" "" COEFFS 0 1 0 0 0 1 /end COMPU_METHOD
/begin COMPU_METHOD VBU0706_CM_boolean_cnt "Q = V" RAT_FUNC "%1.0" "cnt" COEFFS 0 1 0 0 0 1 /end COMPU_METHOD
/begin COMPU_METHOD VBU0706_CM_int8_n "Q = V" RAT_FUNC "%3.0" "n" COEFFS 0 1 0 0 0 1 /end COMPU_METHOD
/begin COMPU_METHOD VBU0706_CM_uint8_cnt "Q = V" RAT_FUNC "%3.0" "cnt" COEFFS 0 1 0 0 0 1 /end COMPU_METHOD
/begin COMPU_METHOD VBU0706_CM_uint8_n "Q = V" RAT_FUNC "%3.0" "n" COEFFS 0 1 0 0 0 1 /end COMPU_METHOD
/begin COMPU_METHOD VBU0706_CM_uint8_enum "Q = V" RAT_FUNC "%3.0" "enum" COEFFS 0 1 0 0 0 1 /end COMPU_METHOD
/begin COMPU_METHOD VBU0706_CM_uint32 "Q = V" RAT_FUNC "%10.0" "" COEFFS 0 1 0 0 0 1 /end COMPU_METHOD
/begin GROUP VBU0706 "VBU0706" /* Root */ ROOT /begin SUB_GROUP Root_Function_Call_Subsystem Root_Task_10ms /end SUB_GROUP
 /begin REF_MEASUREMENT EcSOC_BatteryDisplaySoc_pct EcSOC_BatterySoc_pct EcSOC_CellSocMaxOverrunCounter_n EcSOC_CellSocMinOverrunCounter_n EcSOC_LastCorrectionTime_s EcSOC_LastShutdownTime_s EcSOC_LoadDefaultSOCCnt_n EcSOC_ShortTimeLastCorrectionTime_s EcSOH_AhChargeStart EcSOH_AhDischargeStart EcSOH_tisLifeTimeOperateTime /end REF_MEASUREMENT
/end GROUP
/begin GROUP Root_Function_Call_Subsystem "VBU0706/Function-Call Subsystem" /begin SUB_GROUP S2_Subsystem S2_Subsystem1 /end SUB_GROUP /end GROUP
/begin GROUP Root_Task_10ms "VBU0706/Task_10ms" /begin SUB_GROUP S5_J1939 S5_Subsystem /end SUB_GROUP /end GROUP
/begin GROUP S2_Subsystem "VBU0706/Function-Call Subsystem/Subsystem" /begin SUB_GROUP S11_CHGCAN S11_PrivateCAN /end SUB_GROUP /end GROUP
/begin GROUP S2_Subsystem1 "VBU0706/Function-Call Subsystem/Subsystem1"
 /begin SUB_GROUP S12_BCV S12_BMM S12_CBL S12_CSD_ S12_CTC S12_CTD S12_CTM S12_CTS S12_CVT S12_DSM S12_FCC_ S12_ISO S12_NVM_ S12_OCV S12_RTC S12_SOC S12_SOE S12_SOF S12_SOH S12_Subsystem S12_THM S12_VCT S12_WRT /end SUB_GROUP
/end GROUP
/begin GROUP S5_J1939 "VBU0706/Task_10ms/J1939" /begin SUB_GROUP S2295_FCHG /end SUB_GROUP /end GROUP
/begin GROUP S5_Subsystem "VBU0706/Task_10ms/Subsystem" /begin SUB_GROUP S2296_HALIn S2296_HALOut S2296_VCU_ /end SUB_GROUP /end GROUP
/begin GROUP S11_CHGCAN "VBU0706/Function-Call Subsystem/Subsystem/CHGCAN" /begin SUB_GROUP S15_CanMsgUnpack /end SUB_GROUP /end GROUP
/begin GROUP S11_PrivateCAN "VBU0706/Function-Call Subsystem/Subsystem/PrivateCAN" /begin SUB_GROUP S16_CanMsgReceive1 S16_CanMsgUnpack1 /end SUB_GROUP /end GROUP
/begin GROUP S12_BCV "VBU0706/Function-Call Subsystem/Subsystem1/BCV" /begin SUB_GROUP S288_BCV /end SUB_GROUP /begin REF_CHARACTERISTIC BCV_facPEURCurrent /end REF_CHARACTERISTIC /end GROUP
/begin GROUP S12_BMM "VBU0706/Function-Call Subsystem/Subsystem1/BMM" /begin SUB_GROUP S289_BMM /end SUB_GROUP /end GROUP
/begin GROUP S12_CBL "VBU0706/Function-Call Subsystem/Subsystem1/CBL" /begin SUB_GROUP S291_Subsystem8 /end SUB_GROUP /end GROUP
/begin GROUP S12_CSD_ "VBU0706/Function-Call Subsystem/Subsystem1/CSD " /begin SUB_GROUP S293_Subsystem /end SUB_GROUP /end GROUP
/begin GROUP S12_CTC "VBU0706/Function-Call Subsystem/Subsystem1/CTC" /begin SUB_GROUP S294_Subsystem1 /end SUB_GROUP /end GROUP
/begin GROUP S12_CTD "VBU0706/Function-Call Subsystem/Subsystem1/CTD" /begin SUB_GROUP S295_Subsystem /end SUB_GROUP /end GROUP
/begin GROUP S12_CTM "VBU0706/Function-Call Subsystem/Subsystem1/CTM" /begin SUB_GROUP S296_CTM /end SUB_GROUP /end GROUP
/begin GROUP S12_CTS "VBU0706/Function-Call Subsystem/Subsystem1/CTS" /begin SUB_GROUP S297_CTS /end SUB_GROUP /end GROUP
/begin GROUP S12_CVT "VBU0706/Function-Call Subsystem/Subsystem1/CVT" /begin SUB_GROUP S298_CVT /end SUB_GROUP /end GROUP
/begin GROUP S12_DSM "VBU0706/Function-Call Subsystem/Subsystem1/DSM" /begin SUB_GROUP S300_Subsystem10 /end SUB_GROUP /end GROUP
/begin GROUP S12_FCC_ "VBU0706/Function-Call Subsystem/Subsystem1/FCC " /begin SUB_GROUP S301_DCH_Overall S301_FCC S301_Subsystem S301_Subsystem1 /end SUB_GROUP /end GROUP
/begin GROUP S12_ISO "VBU0706/Function-Call Subsystem/Subsystem1/ISO"
 /begin SUB_GROUP S302_Determine_FaultDetection_Check S302_Determine_IsoLowItems S302_ISOSourceDiag /end SUB_GROUP
 /begin REF_CHARACTERISTIC BMM_STATE_FAST_CHARGE BMM_STATE_ONBOARD_CHARGE CTD_MAIN_CONTACTOR_STATUS_CLOSED CTD_MAIN_CONTACTOR_STATUS_OPENED /end REF_CHARACTERISTIC
/end GROUP
/begin GROUP S12_NVM_ "VBU0706/Function-Call Subsystem/Subsystem1/NVM " /begin SUB_GROUP S303_Subsystem3 /end SUB_GROUP /end GROUP
/begin GROUP S12_OCV "VBU0706/Function-Call Subsystem/Subsystem1/OCV" /begin SUB_GROUP S304_OCV /end SUB_GROUP /end GROUP
/begin GROUP S12_RTC "VBU0706/Function-Call Subsystem/Subsystem1/RTC" /begin SUB_GROUP S305_RTC /end SUB_GROUP /end GROUP
/begin GROUP S12_SOC "VBU0706/Function-Call Subsystem/Subsystem1/SOC" /begin SUB_GROUP S306_Subsystem5 /end SUB_GROUP /end GROUP
/begin GROUP S12_SOE "VBU0706/Function-Call Subsystem/Subsystem1/SOE" /begin SUB_GROUP S307_Subsystem2 /end SUB_GROUP /end GROUP
/begin GROUP S12_SOF "VBU0706/Function-Call Subsystem/Subsystem1/SOF" /begin SUB_GROUP S308_Subsystem6 /end SUB_GROUP /end GROUP
/begin GROUP S12_SOH "VBU0706/Function-Call Subsystem/Subsystem1/SOH" /begin SUB_GROUP S309_Subsystem4 /end SUB_GROUP /end GROUP
/begin GROUP S12_Subsystem "VBU0706/Function-Call Subsystem/Subsystem1/Subsystem" /begin SUB_GROUP S310_FaultDealTemp /end SUB_GROUP /end GROUP
/begin GROUP S12_THM "VBU0706/Function-Call Subsystem/Subsystem1/THM" /begin SUB_GROUP S311_Subsystem /end SUB_GROUP /end GROUP
/begin GROUP S12_VCT "VBU0706/Function-Call Subsystem/Subsystem1/VCT" /begin SUB_GROUP S312_Subsystem /end SUB_GROUP /end GROUP
/begin GROUP S12_WRT "VBU0706/Function-Call Subsystem/Subsystem1/WRT" /begin SUB_GROUP S313_Subsystem9 /end SUB_GROUP /end GROUP
/begin GROUP S2295_FCHG "VBU0706/Task_10ms/J1939/FCHG"
 /begin SUB_GROUP S2304_BCP S2304_BCS S2304_BCS_DATA S2304_BRM S2304_TP_CM_RX /end SUB_GROUP
/end GROUP
/begin GROUP S2296_HALIn "VBU0706/Task_10ms/Subsystem/HALIn" /begin SUB_GROUP S2334_HW S2334_LIN S2334_PTCAN /end SUB_GROUP /end GROUP
/begin GROUP S2296_HALOut "VBU0706/Task_10ms/Subsystem/HALOut" /begin SUB_GROUP S2335_HWOut S2335_PT_PrivateCAN /end SUB_GROUP /end GROUP
/begin GROUP S2296_VCU_ "VBU0706/Task_10ms/Subsystem/VCU "
 /begin SUB_GROUP S2336_APO2HAL S2336_DSPL S2336_EDIS S2336_PMM S2336_SPD S2336_THM S2336_TQC S2336_TQD S2336_TQO S2336_VTQA S2336_VehINP /end SUB_GROUP
/end GROUP
/begin GROUP S15_CanMsgUnpack "VBU0706/Function-Call Subsystem/Subsystem/CHGCAN/CanMsgUnpack" /begin SUB_GROUP S18_MsgRxData_Unpack10 /end SUB_GROUP /end GROUP
/begin GROUP S16_CanMsgReceive1 "VBU0706/Function-Call Subsystem/Subsystem/PrivateCAN/CanMsgReceive1"
 /begin REF_MEASUREMENT MsgRxData_HCU_Message_1_RelayStatus MsgRxFlg_HCU_Message_1_RelayStatus /end REF_MEASUREMENT
/end GROUP
/begin GROUP S16_CanMsgUnpack1 "VBU0706/Function-Call Subsystem/Subsystem/PrivateCAN/CanMsgUnpack1"
 /begin SUB_GROUP S51_MsgRxData_Unpack1 S51_MsgRxData_Unpack10 S51_MsgRxData_Unpack11 S51_MsgRxData_Unpack12 S51_MsgRxData_Unpack13 S51_MsgRxData_Unpack14 S51_MsgRxData_Unpack15 S51_MsgRxData_Unpack16 S51_MsgRxData_Unpack17 S51_MsgRxData_Unpack18 S51_MsgRxData_Unpack19 S51_MsgRxData_Unpack2 S51_MsgRxData_Unpack20 S51_MsgRxData_Unpack21 S51_MsgRxData_Unpack22 S51_MsgRxData_Unpack23 S51_MsgRxData_Unpack24 S51_MsgRxData_Unpack25 S51_MsgRxData_Unpack26 S51_MsgRxData_Unpack27 S51_MsgRxData_Unpack28 S51_MsgRxData_Unpack29 S51_MsgRxData_Unpack3 S51_MsgRxData_Unpack30 S51_MsgRxData_Unpack31 S51_MsgRxData_Unpack32 S51_MsgRxData_Unpack33 S51_MsgRxData_Unpack34 S51_MsgRxData_Unpack35 S51_MsgRxData_Unpack36 S51_MsgRxData_Unpack37 S51_MsgRxData_Unpack38 S51_MsgRxData_Unpack39 S51_MsgRxData_Unpack4 S51_MsgRxData_Unpack40 S51_MsgRxData_Unpack41 S51_MsgRxData_Unpack42 S51_MsgRxData_Unpack43 S51_MsgRxData_Unpack44 S51_MsgRxData_Unpack45 S51_MsgRxData_Unpack46 S51_MsgRxData_Unpack47 S51_MsgRxData_Unpack48 S51_MsgRxData_Unpack49 S51_MsgRxData_Unpack5 S51_MsgRxData_Unpack50 S51_MsgRxData_Unpack51 S51_MsgRxData_Unpack52 S51_MsgRxData_Unpack53 S51_MsgRxData_Unpack54 S51_MsgRxData_Unpack55 S51_MsgRxData_Unpack56 S51_MsgRxData_Unpack57 S51_MsgRxData_Unpack58 S51_MsgRxData_Unpack59 S51_MsgRxData_Unpack6 S51_MsgRxData_Unpack60 S51_MsgRxData_Unpack61 S51_MsgRxData_Unpack62 S51_MsgRxData_Unpack63 S51_MsgRxData_Unpack64 S51_MsgRxData_Unpack65 S51_MsgRxData_Unpack66 S51_MsgRxData_Unpack67 S51_MsgRxData_Unpack68 S51_MsgRxData_Unpack69 S51_MsgRxData_Unpack7 S51_MsgRxData_Unpack70 S51_MsgRxData_Unpack71 S51_MsgRxData_Unpack72 S51_MsgRxData_Unpack73 S51_MsgRxData_Unpack74 S51_MsgRxData_Unpack75 S51_MsgRxData_Unpack76 S51_MsgRxData_Unpack77 S51_MsgRxData_Unpack78 S51_MsgRxData_Unpack8 S51_MsgRxData_Unpack9 /end SUB_GROUP
/end GROUP
/begin GROUP S288_BCV "VBU0706/Function-Call Subsystem/Subsystem1/BCV/BCV" /begin SUB_GROUP S314_Subsystem /end SUB_GROUP /end GROUP
/begin GROUP S289_BMM "VBU0706/Function-Call Subsystem/Subsystem1/BMM/BMM"
 /begin SUB_GROUP S512_BMU_PowerOff_Check S512_BMU_Reset_Check S512_BMU_State_Management S512_DetermineAbnormalEventFlag S512_DetermineCycleUpload S512_Determine_Hold_Afterrun S512_Determine_Wakeup_Mode S512_Subsystem /end SUB_GROUP
 /begin REF_CHARACTERISTIC CbBMM_flgNVMReadCheckEnable_C /end REF_CHARACTERISTIC
/end GROUP
/begin GROUP S291_Subsystem8 "VBU0706/Function-Call Subsystem/Subsystem1/CBL/Subsystem8" /begin SUB_GROUP S562_Subsystem /end SUB_GROUP /end GROUP
/begin GROUP S293_Subsystem "VBU0706/Function-Call Subsystem/Subsystem1/CSD /Subsystem" /begin REF_MEASUREMENT CellTemp1 /end REF_MEASUREMENT /end GROUP
/begin GROUP S294_Subsystem1 "VBU0706/Function-Call Subsystem/Subsystem1/CTC/Subsystem1" /begin SUB_GROUP S631_Subsystem /end SUB_GROUP /end GROUP
/begin GROUP S295_Subsystem "VBU0706/Function-Call Subsystem/Subsystem1/CTD/Subsystem" /begin SUB_GROUP S648_Subsystem4 /end SUB_GROUP /end GROUP
/begin GROUP S296_CTM "VBU0706/Function-Call Subsystem/Subsystem1/CTM/CTM" /begin SUB_GROUP S816_Subsystem /end SUB_GROUP /end GROUP
/begin GROUP S297_CTS "VBU0706/Function-Call Subsystem/Subsystem1/CTS/CTS" /begin SUB_GROUP S894_Subsystem /end SUB_GROUP /end GROUP
/begin GROUP S298_CVT "VBU0706/Function-Call Subsystem/Subsystem1/CVT/CVT" /begin SUB_GROUP S924_Subsystem /end SUB_GROUP /end GROUP
/begin GROUP S300_Subsystem10 "VBU0706/Function-Call Subsystem/Subsystem1/DSM/Subsystem10" /begin SUB_GROUP S998_Subsystem /end SUB_GROUP /end GROUP
/begin GROUP S301_DCH_Overall "VBU0706/Function-Call Subsystem/Subsystem1/FCC /DCH_Overall"
 /begin SUB_GROUP S1030_DCH_DCChargeCtrlOverall S1030_DCH_J1939InputProcess S1030_DCH_J1939OutputSignalProcess /end SUB_GROUP
/end GROUP
/begin GROUP S301_FCC "VBU0706/Function-Call Subsystem/Subsystem1/FCC /FCC" /begin SUB_GROUP S1031_Subsystem /end SUB_GROUP /end GROUP
/begin GROUP S301_Subsystem "VBU0706/Function-Call Subsystem/Subsystem1/FCC /Subsystem"
 /begin SUB_GROUP S1032_FCC_CHARGE_MODE1 S1032_Subsystem1 S1032_Subsystem3 S1032_Subsystem4 S1032_Subsystem5 /end SUB_GROUP
 /begin REF_CHARACTERISTIC CcSYS_BatteryChargeCurrentMax_A CcSYS_CellVoltageMaxLimit_mV CcSYS_NoChargeHighTemp_C CcVCT_BatteryRatedVoltage_V CcVCT_NominalCellCapacity_Ah CeVCT_BMSBatteryType_enum MILIVOLTAGES_PER_VOLTAGE /end REF_CHARACTERISTIC
/end GROUP
/begin GROUP S301_Subsystem1 "VBU0706/Function-Call Subsystem/Subsystem1/FCC /Subsystem1"
 /begin SUB_GROUP S1033_BCL S1033_BCP S1033_BCS S1033_BEM S1033_BHM S1033_BRM S1033_BRO S1033_BSD S1033_BSM S1033_BST_ S1033_J1939TxEna /end SUB_GROUP
/end GROUP
/begin GROUP S302_Determine_FaultDetection_Check "VBU0706/Function-Call Subsystem/Subsystem1/ISO/Determine_FaultDetection_Check"
 /begin SUB_GROUP S1393_DetermineIsolationSevereTestFail S1393_DetermineIsolationWarningTestFail S1393_Status_Process /end SUB_GROUP
 /begin REF_CHARACTERISTIC CbISO_IsolationSevere_flg CbISO_IsolationWarning_flg CcISO_FaultReverseConfirmTime_ms CcISO_IsolationSevereFaultFIC_n CcISO_IsolationSevereFaultPIC_n CcISO_IsolationWarningFaultFIC_n CcISO_IsolationWarningFaultPIC_n ISO_ISOLATION_SEVERE_FAULT ISO_ISOLATION_WARNING_FAULT SAMPLE_TIME_TASK_B /end REF_CHARACTERISTIC
/end GROUP
/begin GROUP S302_Determine_IsoLowItems "VBU0706/Function-Call Subsystem/Subsystem1/ISO/Determine_IsoLowItems"
 /begin SUB_GROUP S1394_ISO_DCCharging_Dec S1394_ISO_Normal_Dec S1394_ISO_Pack_Dec /end SUB_GROUP
/end GROUP
/begin GROUP S302_ISOSourceDiag "VBU0706/Function-Call Subsystem/Subsystem1/ISO/ISOSourceDiag" /begin REF_CHARACTERISTIC CcISO_BDMOutputDelayTime_ms SAMPLE_TIME_TASK_B /end REF_CHARACTERISTIC /end GROUP
/begin GROUP S303_Subsystem3 "VBU0706/Function-Call Subsystem/Subsystem1/NVM /Subsystem3" /begin SUB_GROUP S1434_Read_NVM_Data /end SUB_GROUP /end GROUP
/begin GROUP S304_OCV "VBU0706/Function-Call Subsystem/Subsystem1/OCV/OCV" /begin SUB_GROUP S1454_Subsystem /end SUB_GROUP /end GROUP
/begin GROUP S305_RTC "VBU0706/Function-Call Subsystem/Subsystem1/RTC/RTC"
 /begin SUB_GROUP S1463_Calculate_Actual_Time S1463_Calculate_RelativeActual_Time S1463_Determine_VCU_ActualTime S1463_Reset_TimeInit_flg /end SUB_GROUP
/end GROUP
/begin GROUP S306_Subsystem5 "VBU0706/Function-Call Subsystem/Subsystem1/SOC/Subsystem5" /begin SUB_GROUP S1490_Subsystem /end SUB_GROUP /end GROUP
/begin GROUP S307_Subsystem2 "VBU0706/Function-Call Subsystem/Subsystem1/SOE/Subsystem2" /begin SUB_GROUP S1668_Subsystem /end SUB_GROUP /end GROUP
/begin GROUP S308_Subsystem6 "VBU0706/Function-Call Subsystem/Subsystem1/SOF/Subsystem6" /begin SUB_GROUP S1720_Subsystem /end SUB_GROUP /end GROUP
/begin GROUP S309_Subsystem4 "VBU0706/Function-Call Subsystem/Subsystem1/SOH/Subsystem4" /begin SUB_GROUP S1953_Subsystem1 /end SUB_GROUP /end GROUP
/begin GROUP S310_FaultDealTemp "VBU0706/Function-Call Subsystem/Subsystem1/Subsystem/FaultDealTemp"
 /begin REF_CHARACTERISTIC BCV_BATTERY_OVER_CURRENT_FAULT BCV_BATTERY_OVER_VOLTAGE_FAULT BCV_BATTERY_OVER_VOLTAGE_WARNING_FAULT CTD_MAIN_NEGATIVE_CONTACTOR_WELD_FAULT CTD_MAIN_POSITIVE_CONTACTOR_WELD_FAULT CTD_PARKING_MAIN_NEGATIVE_CONTACTOR_STUCK_OPEN_FAULT CTD_PARKING_MAIN_POSITIVE_CONTACTOR_STUCK_OPEN_FAULT CTD_PRECHARGE_ENERGY_HIGH_FAULT CTD_PRECHARGE_RELAY_STUCK_OPEN_FAULT CTD_PRECHARGE_RESISTANCE_BLOWN_FAULT CTD_PRECHARG_TIMEOUT_FAULT CTM_CELL_OVER_TEMP_FAULT CVT_CELL_OVER_VOLTAGE_FAULT CVT_CELL_UNDER_VOLTAGE_FAULT FCC_CHARGE_CURRENT_OVER_FAULT SOF_CHARGE_OVER_POWER_FAULT /end REF_CHARACTERISTIC
/end GROUP
/begin GROUP S311_Subsystem "VBU0706/Function-Call Subsystem/Subsystem1/THM/Subsystem" /begin SUB_GROUP S2084_Subsystem /end SUB_GROUP /end GROUP
/begin GROUP S312_Subsystem "VBU0706/Function-Call Subsystem/Subsystem1/VCT/Subsystem" /begin SUB_GROUP S2158_Subsystem /end SUB_GROUP /end GROUP
/begin GROUP S313_Subsystem9 "VBU0706/Function-Call Subsystem/Subsystem1/WRT/Subsystem9" /begin SUB_GROUP S2293_Subsystem /end SUB_GROUP /end GROUP
/begin GROUP S2304_BCP "VBU0706/Task_10ms/J1939/FCHG/BCP" /begin SUB_GROUP S2312_EdgeBi /end SUB_GROUP
 /begin REF_CHARACTERISTIC ENUM_J1939TP_CTS ENUM_J1939TP_Conn_Abort ENUM_J1939TP_EndOfMsgACK /end REF_CHARACTERISTIC
/end GROUP
/begin GROUP S2304_BCS "VBU0706/Task_10ms/J1939/FCHG/BCS" /begin SUB_GROUP S2314_EdgeBi /end SUB_GROUP
 /begin REF_CHARACTERISTIC ENUM_J1939TP_CTS ENUM_J1939TP_Conn_Abort ENUM_J1939TP_EndOfMsgACK /end REF_CHARACTERISTIC
/end GROUP
/begin GROUP S2304_BCS_DATA "VBU0706/Task_10ms/J1939/FCHG/BCS_DATA" /begin REF_CHARACTERISTIC DCH_GBCurrGain_fac /end REF_CHARACTERISTIC /end GROUP
/begin GROUP S2304_BRM "VBU0706/Task_10ms/J1939/FCHG/BRM" /begin SUB_GROUP S2316_EdgeBi /end SUB_GROUP
 /begin REF_CHARACTERISTIC ENUM_J1939TP_CTS ENUM_J1939TP_Conn_Abort ENUM_J1939TP_EndOfMsgACK /end REF_CHARACTERISTIC
/end GROUP
/begin GROUP S2304_TP_CM_RX "VBU0706/Task_10ms/J1939/FCHG/TP_CM_RX" /begin SUB_GROUP S2320_TP_CM_RX /end SUB_GROUP /end GROUP
/begin GROUP S2334_HW "VBU0706/Task_10ms/Subsystem/HALIn/HW" /begin SUB_GROUP S2337_Subsystem S2337_Subsystem1 S2337_Subsystem2 /end SUB_GROUP /end GROUP
/begin GROUP S2334_LIN "VBU0706/Task_10ms/Subsystem/HALIn/LIN" /begin SUB_GROUP S2338_MsgRxData_Unpack1 /end SUB_GROUP /end GROUP
/begin GROUP S2334_PTCAN "VBU0706/Task_10ms/Subsystem/HALIn/PTCAN" /begin SUB_GROUP S2339_Subsystem /end SUB_GROUP /end GROUP
/begin GROUP S2335_HWOut "VBU0706/Task_10ms/Subsystem/HALOut/HWOut" /begin REF_CHARACTERISTIC ACV_OV PTCRLY_OV SleepEnable /end REF_CHARACTERISTIC /begin REF_MEASUREMENT OP_fLsWaterPumpOut1 OP_pctLsWaterPumpOut1 /end REF_MEASUREMENT /end GROUP
/begin GROUP S2335_PT_PrivateCAN "VBU0706/Task_10ms/Subsystem/HALOut/PT_PrivateCAN" /begin REF_CHARACTERISTIC SAMPLE_TIME_TASK_B /end REF_CHARACTERISTIC /end GROUP
/begin GROUP S2336_APO2HAL "VBU0706/Task_10ms/Subsystem/VCU /APO2HAL" /begin SUB_GROUP S3227_PTCAN1Transmit S3227_Subsystem2 /end SUB_GROUP /end GROUP
/begin GROUP S2336_DSPL "VBU0706/Task_10ms/Subsystem/VCU /DSPL" /begin SUB_GROUP S3228_DSPL /end SUB_GROUP /end GROUP
/begin GROUP S2336_EDIS "VBU0706/Task_10ms/Subsystem/VCU /EDIS" /begin SUB_GROUP S3229_EDIS_Ctrl /end SUB_GROUP /end GROUP
/begin GROUP S2336_PMM "VBU0706/Task_10ms/Subsystem/VCU /PMM" /begin SUB_GROUP S3230_PMM_Ctrl /end SUB_GROUP /end GROUP
/begin GROUP S2336_SPD "VBU0706/Task_10ms/Subsystem/VCU /SPD" /begin SUB_GROUP S3231_SPD /end SUB_GROUP /end GROUP
/begin GROUP S2336_THM "VBU0706/Task_10ms/Subsystem/VCU /THM" /begin SUB_GROUP S3232_THM S3232_THMINP S3232_THMOUT /end SUB_GROUP /end GROUP
/begin GROUP S2336_TQC "VBU0706/Task_10ms/Subsystem/VCU /TQC" /begin SUB_GROUP S3233_TQC /end SUB_GROUP /end GROUP
/begin GROUP S2336_TQD "VBU0706/Task_10ms/Subsystem/VCU /TQD" /begin SUB_GROUP S3234_TrqDem /end SUB_GROUP /end GROUP
/begin GROUP S2336_TQO "VBU0706/Task_10ms/Subsystem/VCU /TQO" /begin SUB_GROUP S3235_TQOAll /end SUB_GROUP /end GROUP
/begin GROUP S2336_VTQA "VBU0706/Task_10ms/Subsystem/VCU /VTQA" /begin SUB_GROUP S3237_Subsystem /end SUB_GROUP /end GROUP
/begin GROUP S2336_VehINP "VBU0706/Task_10ms/Subsystem/VCU /VehINP" /begin SUB_GROUP S3238_VehINP_Logic /end SUB_GROUP /end GROUP
/begin GROUP S18_MsgRxData_Unpack10 "VBU0706/Function-Call Subsystem/Subsystem/CHGCAN/CanMsgUnpack/MsgRxData_Unpack10" /begin SUB_GROUP S21_CanRxData_Unpack /end SUB_GROUP /end GROUP
/begin GROUP S51_MsgRxData_Unpack1 "VBU0706/Function-Call Subsystem/Subsystem/PrivateCAN/CanMsgUnpack1/MsgRxData_Unpack1" /begin SUB_GROUP S54_CanRxData_Unpack /end SUB_GROUP /end GROUP
/begin GROUP S51_MsgRxData_Unpack10 "VBU0706/Function-Call Subsystem/Subsystem/PrivateCAN/CanMsgUnpack1/MsgRxData_Unpack10" /begin SUB_GROUP S55_CanRxData_Unpack /end SUB_GROUP /end GROUP
/begin GROUP S51_MsgRxData_Unpack11 "VBU0706/Function-Call Subsystem/Subsystem/PrivateCAN/CanMsgUnpack1/MsgRxData_Unpack11" /begin SUB_GROUP S56_CanRxData_Unpack /end SUB_GROUP /end GROUP
/begin GROUP S51_MsgRxData_Unpack12 "VBU0706/Function-Call Subsystem/Subsystem/PrivateCAN/CanMsgUnpack1/MsgRxData_Unpack12" /begin SUB_GROUP S57_CanRxData_Unpack /end SUB_GROUP /end GROUP
/begin GROUP S51_MsgRxData_Unpack13 "VBU0706/Function-Call Subsystem/Subsystem/PrivateCAN/CanMsgUnpack1/MsgRxData_Unpack13" /begin SUB_GROUP S58_CanRxData_Unpack /end SUB_GROUP /end GROUP
/begin GROUP S51_MsgRxData_Unpack14 "VBU0706/Function-Call Subsystem/Subsystem/PrivateCAN/CanMsgUnpack1/MsgRxData_Unpack14" /begin SUB_GROUP S59_CanRxData_Unpack /end SUB_GROUP /end GROUP
/begin GROUP S51_MsgRxData_Unpack15 "VBU0706/Function-Call Subsystem/Subsystem/PrivateCAN/CanMsgUnpack1/MsgRxData_Unpack15" /begin SUB_GROUP S60_CanRxData_Unpack /end SUB_GROUP /end GROUP
/begin GROUP S51_MsgRxData_Unpack16 "VBU0706/Function-Call Subsystem/Subsystem/PrivateCAN/CanMsgUnpack1/MsgRxData_Unpack16" /begin SUB_GROUP S61_CanRxData_Unpack /end SUB_GROUP /end GROUP
/begin GROUP S51_MsgRxData_Unpack17 "VBU0706/Function-Call Subsystem/Subsystem/PrivateCAN/CanMsgUnpack1/MsgRxData_Unpack17" /begin SUB_GROUP S62_CanRxData_Unpack /end SUB_GROUP /end GROUP
/begin GROUP S51_MsgRxData_Unpack18 "VBU0706/Function-Call Subsystem/Subsystem/PrivateCAN/CanMsgUnpack1/MsgRxData_Unpack18" /begin SUB_GROUP S63_CanRxData_Unpack /end SUB_GROUP /end GROUP
/begin GROUP S51_MsgRxData_Unpack19 "VBU0706/Function-Call Subsystem/Subsystem/PrivateCAN/CanMsgUnpack1/MsgRxData_Unpack19" /begin SUB_GROUP S64_CanRxData_Unpack /end SUB_GROUP /end GROUP
/begin GROUP S51_MsgRxData_Unpack2 "VBU0706/Function-Call Subsystem/Subsystem/PrivateCAN/CanMsgUnpack1/MsgRxData_Unpack2" /begin SUB_GROUP S65_CanRxData_Unpack /end SUB_GROUP /end GROUP
/begin GROUP S51_MsgRxData_Unpack20 "VBU0706/Function-Call Subsystem/Subsystem/PrivateCAN/CanMsgUnpack1/MsgRxData_Unpack20" /begin SUB_GROUP S66_CanRxData_Unpack /end SUB_GROUP /end GROUP
/begin GROUP S51_MsgRxData_Unpack21 "VBU0706/Function-Call Subsystem/Subsystem/PrivateCAN/CanMsgUnpack1/MsgRxData_Unpack21" /begin SUB_GROUP S67_CanRxData_Unpack /end SUB_GROUP /end GROUP
/begin GROUP S51_MsgRxData_Unpack22 "VBU0706/Function-Call Subsystem/Subsystem/PrivateCAN/CanMsgUnpack1/MsgRxData_Unpack22" /begin SUB_GROUP S68_CanRxData_Unpack /end SUB_GROUP /end GROUP
/begin GROUP S51_MsgRxData_Unpack23 "VBU0706/Function-Call Subsystem/Subsystem/PrivateCAN/CanMsgUnpack1/MsgRxData_Unpack23" /begin SUB_GROUP S69_CanRxData_Unpack /end SUB_GROUP /end GROUP
/begin GROUP S51_MsgRxData_Unpack24 "VBU0706/Function-Call Subsystem/Subsystem/PrivateCAN/CanMsgUnpack1/MsgRxData_Unpack24" /begin SUB_GROUP S70_CanRxData_Unpack /end SUB_GROUP /end GROUP
/begin GROUP S51_MsgRxData_Unpack25 "VBU0706/Function-Call Subsystem/Subsystem/PrivateCAN/CanMsgUnpack1/MsgRxData_Unpack25" /begin SUB_GROUP S71_CanRxData_Unpack /end SUB_GROUP /end GROUP
/begin GROUP S51_MsgRxData_Unpack26 "VBU0706/Function-Call Subsystem/Subsystem/PrivateCAN/CanMsgUnpack1/MsgRxData_Unpack26" /begin SUB_GROUP S72_CanRxData_Unpack /end SUB_GROUP /end GROUP
/begin GROUP S51_MsgRxData_Unpack27 "VBU0706/Function-Call Subsystem/Subsystem/PrivateCAN/CanMsgUnpack1/MsgRxData_Unpack27" /begin SUB_GROUP S73_CanRxData_Unpack /end SUB_GROUP /end GROUP
/begin GROUP S51_MsgRxData_Unpack28 "VBU0706/Function-Call Subsystem/Subsystem/PrivateCAN/CanMsgUnpack1/MsgRxData_Unpack28" /begin SUB_GROUP S74_CanRxData_Unpack /end SUB_GROUP /end GROUP
/begin GROUP S51_MsgRxData_Unpack29 "VBU0706/Function-Call Subsystem/Subsystem/PrivateCAN/CanMsgUnpack1/MsgRxData_Unpack29" /begin SUB_GROUP S75_CanRxData_Unpack /end SUB_GROUP /end GROUP
/begin GROUP S51_MsgRxData_Unpack3 "VBU0706/Function-Call Subsystem/Subsystem/PrivateCAN/CanMsgUnpack1/MsgRxData_Unpack3" /begin SUB_GROUP S76_CanRxData_Unpack /end SUB_GROUP /end GROUP
/begin GROUP S51_MsgRxData_Unpack30 "VBU0706/Function-Call Subsystem/Subsystem/PrivateCAN/CanMsgUnpack1/MsgRxData_Unpack30" /begin SUB_GROUP S77_CanRxData_Unpack /end SUB_GROUP /end GROUP
/begin GROUP S51_MsgRxData_Unpack31 "VBU0706/Function-Call Subsystem/Subsystem/PrivateCAN/CanMsgUnpack1/MsgRxData_Unpack31" /begin SUB_GROUP S78_CanRxData_Unpack /end SUB_GROUP /end GROUP
/begin GROUP S51_MsgRxData_Unpack32 "VBU0706/Function-Call Subsystem/Subsystem/PrivateCAN/CanMsgUnpack1/MsgRxData_Unpack32" /begin SUB_GROUP S79_CanRxData_Unpack /end SUB_GROUP /end GROUP
/begin GROUP S51_MsgRxData_Unpack33 "VBU0706/Function-Call Subsystem/Subsystem/PrivateCAN/CanMsgUnpack1/MsgRxData_Unpack33" /begin SUB_GROUP S80_CanRxData_Unpack /end SUB_GROUP /end GROUP
/begin GROUP S51_MsgRxData_Unpack34 "VBU0706/Function-Call Subsystem/Subsystem/PrivateCAN/CanMsgUnpack1/MsgRxData_Unpack34" /begin SUB_GROUP S81_CanRxData_Unpack /end SUB_GROUP /end GROUP
/begin GROUP S51_MsgRxData_Unpack35 "VBU0706/Function-Call Subsystem/Subsystem/PrivateCAN/CanMsgUnpack1/MsgRxData_Unpack35" /begin SUB_GROUP S82_CanRxData_Unpack /end SUB_GROUP /end GROUP
/begin GROUP S51_MsgRxData_Unpack36 "VBU0706/Function-Call Subsystem/Subsystem/PrivateCAN/CanMsgUnpack1/MsgRxData_Unpack36" /begin SUB_GROUP S83_CanRxData_Unpack /end SUB_GROUP /end GROUP
/begin GROUP S51_MsgRxData_Unpack37 "VBU0706/Function-Call Subsystem/Subsystem/PrivateCAN/CanMsgUnpack1/MsgRxData_Unpack37" /begin SUB_GROUP S84_CanRxData_Unpack /end SUB_GROUP /end GROUP
/begin GROUP S51_MsgRxData_Unpack38 "VBU0706/Function-Call Subsystem/Subsystem/PrivateCAN/CanMsgUnpack1/MsgRxData_Unpack38" /begin SUB_GROUP S85_CanRxData_Unpack /end SUB_GROUP /end GROUP
/begin GROUP S51_MsgRxData_Unpack39 "VBU0706/Function-Call Subsystem/Subsystem/PrivateCAN/CanMsgUnpack1/MsgRxData_Unpack39" /begin SUB_GROUP S86_CanRxData_Unpack /end SUB_GROUP /end GROUP
/begin GROUP S51_MsgRxData_Unpack4 "VBU0706/Function-Call Subsystem/Subsystem/PrivateCAN/CanMsgUnpack1/MsgRxData_Unpack4" /begin SUB_GROUP S87_CanRxData_Unpack /end SUB_GROUP /end GROUP
/begin GROUP S51_MsgRxData_Unpack40 "VBU0706/Function-Call Subsystem/Subsystem/PrivateCAN/CanMsgUnpack1/MsgRxData_Unpack40" /begin SUB_GROUP S88_CanRxData_Unpack /end SUB_GROUP /end GROUP
/begin GROUP S51_MsgRxData_Unpack41 "VBU0706/Function-Call Subsystem/Subsystem/PrivateCAN/CanMsgUnpack1/MsgRxData_Unpack41" /begin SUB_GROUP S89_CanRxData_Unpack /end SUB_GROUP /end GROUP
/begin GROUP S51_MsgRxData_Unpack42 "VBU0706/Function-Call Subsystem/Subsystem/PrivateCAN/CanMsgUnpack1/MsgRxData_Unpack42" /begin SUB_GROUP S90_CanRxData_Unpack /end SUB_GROUP /end GROUP
/begin GROUP S51_MsgRxData_Unpack43 "VBU0706/Function-Call Subsystem/Subsystem/PrivateCAN/CanMsgUnpack1/MsgRxData_Unpack43" /begin SUB_GROUP S91_CanRxData_Unpack /end SUB_GROUP /end GROUP
/begin GROUP S51_MsgRxData_Unpack44 "VBU0706/Function-Call Subsystem/Subsystem/PrivateCAN/CanMsgUnpack1/MsgRxData_Unpack44" /begin SUB_GROUP S92_CanRxData_Unpack /end SUB_GROUP /end GROUP
/begin GROUP S51_MsgRxData_Unpack45 "VBU0706/Function-Call Subsystem/Subsystem/PrivateCAN/CanMsgUnpack1/MsgRxData_Unpack45" /begin SUB_GROUP S93_CanRxData_Unpack /end SUB_GROUP /end GROUP
/begin GROUP S51_MsgRxData_Unpack46 "VBU0706/Function-Call Subsystem/Subsystem/PrivateCAN/CanMsgUnpack1/MsgRxData_Unpack46" /begin SUB_GROUP S94_CanRxData_Unpack /end SUB_GROUP /end GROUP
/begin GROUP S51_MsgRxData_Unpack47 "VBU0706/Function-Call Subsystem/Subsystem/PrivateCAN/CanMsgUnpack1/MsgRxData_Unpack47" /begin SUB_GROUP S95_CanRxData_Unpack /end SUB_GROUP /end GROUP
/begin GROUP S51_MsgRxData_Unpack48 "VBU0706/Function-Call Subsystem/Subsystem/PrivateCAN/CanMsgUnpack1/MsgRxData_Unpack48" /begin SUB_GROUP S96_CanRxData_Unpack /end SUB_GROUP /end GROUP
/begin GROUP S51_MsgRxData_Unpack49 "VBU0706/Function-Call Subsystem/Subsystem/PrivateCAN/CanMsgUnpack1/MsgRxData_Unpack49" /begin SUB_GROUP S97_CanRxData_Unpack /end SUB_GROUP /end GROUP
/begin GROUP S51_MsgRxData_Unpack5 "VBU0706/Function-Call Subsystem/Subsystem/PrivateCAN/CanMsgUnpack1/MsgRxData_Unpack5" /begin SUB_GROUP S98_CanRxData_Unpack /end SUB_GROUP /end GROUP
/begin GROUP S51_MsgRxData_Unpack50 "VBU0706/Function-Call Subsystem/Subsystem/PrivateCAN/CanMsgUnpack1/MsgRxData_Unpack50" /begin SUB_GROUP S99_CanRxData_Unpack /end SUB_GROUP /end GROUP
/begin GROUP S51_MsgRxData_Unpack51 "VBU0706/Function-Call Subsystem/Subsystem/PrivateCAN/CanMsgUnpack1/MsgRxData_Unpack51" /begin SUB_GROUP S100_CanRxData_Unpack /end SUB_GROUP /end GROUP
/begin GROUP S51_MsgRxData_Unpack52 "VBU0706/Function-Call Subsystem/Subsystem/PrivateCAN/CanMsgUnpack1/MsgRxData_Unpack52" /begin SUB_GROUP S101_CanRxData_Unpack /end SUB_GROUP /end GROUP
/begin GROUP S51_MsgRxData_Unpack53 "VBU0706/Function-Call Subsystem/Subsystem/PrivateCAN/CanMsgUnpack1/MsgRxData_Unpack53" /begin SUB_GROUP S102_CanRxData_Unpack /end SUB_GROUP /end GROUP
/begin GROUP S51_MsgRxData_Unpack54 "VBU0706/Function-Call Subsystem/Subsystem/PrivateCAN/CanMsgUnpack1/MsgRxData_Unpack54" /begin SUB_GROUP S103_CanRxData_Unpack /end SUB_GROUP /end GROUP
/begin GROUP S51_MsgRxData_Unpack55 "VBU0706/Function-Call Subsystem/Subsystem/PrivateCAN/CanMsgUnpack1/MsgRxData_Unpack55" /begin SUB_GROUP S104_CanRxData_Unpack /end SUB_GROUP /end GROUP
/begin GROUP S51_MsgRxData_Unpack56 "VBU0706/Function-Call Subsystem/Subsystem/PrivateCAN/CanMsgUnpack1/MsgRxData_Unpack56" /begin SUB_GROUP S105_CanRxData_Unpack /end SUB_GROUP /end GROUP
/begin GROUP S51_MsgRxData_Unpack57 "VBU0706/Function-Call Subsystem/Subsystem/PrivateCAN/CanMsgUnpack1/MsgRxData_Unpack57" /begin SUB_GROUP S106_CanRxData_Unpack /end SUB_GROUP /end GROUP
/begin GROUP S51_MsgRxData_Unpack58 "VBU0706/Function-Call Subsystem/Subsystem/PrivateCAN/CanMsgUnpack1/MsgRxData_Unpack58" /begin SUB_GROUP S107_CanRxData_Unpack /end SUB_GROUP /end GROUP
/begin GROUP S51_MsgRxData_Unpack59 "VBU0706/Function-Call Subsystem/Subsystem/PrivateCAN/CanMsgUnpack1/MsgRxData_Unpack59" /begin SUB_GROUP S108_CanRxData_Unpack /end SUB_GROUP /end GROUP
/begin GROUP S51_MsgRxData_Unpack6 "VBU0706/Function-Call Subsystem/Subsystem/PrivateCAN/CanMsgUnpack1/MsgRxData_Unpack6" /begin SUB_GROUP S109_CanRxData_Unpack /end SUB_GROUP /end GROUP
/begin GROUP S51_MsgRxData_Unpack60 "VBU0706/Function-Call Subsystem/Subsystem/PrivateCAN/CanMsgUnpack1/MsgRxData_Unpack60" /begin SUB_GROUP S110_CanRxData_Unpack /end SUB_GROUP /end GROUP
/begin GROUP S51_MsgRxData_Unpack61 "VBU0706/Function-Call Subsystem/Subsystem/PrivateCAN/CanMsgUnpack1/MsgRxData_Unpack61" /begin SUB_GROUP S111_CanRxData_Unpack /end SUB_GROUP /end GROUP
/begin GROUP S51_MsgRxData_Unpack62 "VBU0706/Function-Call Subsystem/Subsystem/PrivateCAN/CanMsgUnpack1/MsgRxData_Unpack62" /begin SUB_GROUP S112_CanRxData_Unpack /end SUB_GROUP /end GROUP
/begin GROUP S51_MsgRxData_Unpack63 "VBU0706/Function-Call Subsystem/Subsystem/PrivateCAN/CanMsgUnpack1/MsgRxData_Unpack63" /begin SUB_GROUP S113_CanRxData_Unpack /end SUB_GROUP /end GROUP
/begin GROUP S51_MsgRxData_Unpack64 "VBU0706/Function-Call Subsystem/Subsystem/PrivateCAN/CanMsgUnpack1/MsgRxData_Unpack64" /begin SUB_GROUP S114_CanRxData_Unpack /end SUB_GROUP /end GROUP
/begin GROUP S51_MsgRxData_Unpack65 "VBU0706/Function-Call Subsystem/Subsystem/PrivateCAN/CanMsgUnpack1/MsgRxData_Unpack65" /begin SUB_GROUP S115_CanRxData_Unpack /end SUB_GROUP /end GROUP
/begin GROUP S51_MsgRxData_Unpack66 "VBU0706/Function-Call Subsystem/Subsystem/PrivateCAN/CanMsgUnpack1/MsgRxData_Unpack66" /begin SUB_GROUP S116_CanRxData_Unpack /end SUB_GROUP /end GROUP
/begin GROUP S51_MsgRxData_Unpack67 "VBU0706/Function-Call Subsystem/Subsystem/PrivateCAN/CanMsgUnpack1/MsgRxData_Unpack67" /begin SUB_GROUP S117_CanRxData_Unpack /end SUB_GROUP /end GROUP
/begin GROUP S51_MsgRxData_Unpack68 "VBU0706/Function-Call Subsystem/Subsystem/PrivateCAN/CanMsgUnpack1/MsgRxData_Unpack68" /begin SUB_GROUP S118_CanRxData_Unpack /end SUB_GROUP /end GROUP
/begin GROUP S51_MsgRxData_Unpack69 "VBU0706/Function-Call Subsystem/Subsystem/PrivateCAN/CanMsgUnpack1/MsgRxData_Unpack69" /begin SUB_GROUP S119_CanRxData_Unpack /end SUB_GROUP /end GROUP
/begin GROUP S51_MsgRxData_Unpack7 "VBU0706/Function-Call Subsystem/Subsystem/PrivateCAN/CanMsgUnpack1/MsgRxData_Unpack7" /begin SUB_GROUP S120_CanRxData_Unpack /end SUB_GROUP /end GROUP
/begin GROUP S51_MsgRxData_Unpack70 "VBU0706/Function-Call Subsystem/Subsystem/PrivateCAN/CanMsgUnpack1/MsgRxData_Unpack70" /begin SUB_GROUP S121_CanRxData_Unpack /end SUB_GROUP /end GROUP
/begin GROUP S51_MsgRxData_Unpack71 "VBU0706/Function-Call Subsystem/Subsystem/PrivateCAN/CanMsgUnpack1/MsgRxData_Unpack71" /begin SUB_GROUP S122_CanRxData_Unpack /end SUB_GROUP /end GROUP
/begin GROUP S51_MsgRxData_Unpack72 "VBU0706/Function-Call Subsystem/Subsystem/PrivateCAN/CanMsgUnpack1/MsgRxData_Unpack72" /begin SUB_GROUP S123_CanRxData_Unpack /end SUB_GROUP /end GROUP
/begin GROUP S51_MsgRxData_Unpack73 "VBU0706/Function-Call Subsystem/Subsystem/PrivateCAN/CanMsgUnpack1/MsgRxData_Unpack73" /begin SUB_GROUP S124_CanRxData_Unpack /end SUB_GROUP /end GROUP
/begin GROUP S51_MsgRxData_Unpack74 "VBU0706/Function-Call Subsystem/Subsystem/PrivateCAN/CanMsgUnpack1/MsgRxData_Unpack74" /begin SUB_GROUP S125_CanRxData_Unpack /end SUB_GROUP /end GROUP
/begin GROUP S51_MsgRxData_Unpack75 "VBU0706/Function-Call Subsystem/Subsystem/PrivateCAN/CanMsgUnpack1/MsgRxData_Unpack75" /begin SUB_GROUP S126_CanRxData_Unpack /end SUB_GROUP /end GROUP
/begin GROUP S51_MsgRxData_Unpack76 "VBU0706/Function-Call Subsystem/Subsystem/PrivateCAN/CanMsgUnpack1/MsgRxData_Unpack76" /begin SUB_GROUP S127_CanRxData_Unpack /end SUB_GROUP /end GROUP
/begin GROUP S51_MsgRxData_Unpack77 "VBU0706/Function-Call Subsystem/Subsystem/PrivateCAN/CanMsgUnpack1/MsgRxData_Unpack77" /begin SUB_GROUP S128_CanRxData_Unpack /end SUB_GROUP /end GROUP
/begin GROUP S51_MsgRxData_Unpack78 "VBU0706/Function-Call Subsystem/Subsystem/PrivateCAN/CanMsgUnpack1/MsgRxData_Unpack78" /begin SUB_GROUP S129_CanRxData_Unpack /end SUB_GROUP /end GROUP
/begin GROUP S51_MsgRxData_Unpack8 "VBU0706/Function-Call Subsystem/Subsystem/PrivateCAN/CanMsgUnpack1/MsgRxData_Unpack8" /begin SUB_GROUP S130_CanRxData_Unpack /end SUB_GROUP /end GROUP
/begin GROUP S51_MsgRxData_Unpack9 "VBU0706/Function-Call Subsystem/Subsystem/PrivateCAN/CanMsgUnpack1/MsgRxData_Unpack9" /begin SUB_GROUP S131_CanRxData_Unpack /end SUB_GROUP /end GROUP
/begin GROUP S314_Subsystem "VBU0706/Function-Call Subsystem/Subsystem1/BCV/BCV/Subsystem"
 /begin SUB_GROUP S315_Calculate_BatteryCurrent S315_Calculate_BatteryVoltage S315_Calculate_Lifetime_Data S315_Diagnose_BCV_Communication_Fault S315_Diagnose_BCV_Data_Fault S315_Interface_Switch S315_Interface_Switch1 S315_Interface_Switch2 S315_Interface_Switch3 S315_Interface_Switch4 S315_Interface_Switch5 S315_Interface_Switch6 S315_Interface_Switch7 S315_Interface_Switch8 S315_Interface_Switch9 S315_Monitor_BCV_Performance S315_Unpackage_LEM_Msg /end SUB_GROUP
 /begin REF_CHARACTERISTIC BCV_facHVADC /end REF_CHARACTERISTIC
 /begin REF_MEASUREMENT BCV_uHALBatteryVoltageRaw BCV_uHALBusNegativeVoltageRaw BCV_uHALFuseVoltageRaw BCV_uHALVx2VoltageRaw /end REF_MEASUREMENT
/end GROUP
/begin GROUP S512_BMU_PowerOff_Check "VBU0706/Function-Call Subsystem/Subsystem1/BMM/BMM/BMU_PowerOff_Check"
 /begin REF_CHARACTERISTIC BMM_BMU_POWEROFF_NORMAL CbBMM_AbnormalPowerOffOverride_flg CcBMM_HALKL30BMUVoltageLow_V /end REF_CHARACTERISTIC
 /begin REF_MEASUREMENT BMM_flg12VBatteryVoltageAbnormal BMM_flgBMUAbnormalPowerOff /end REF_MEASUREMENT
/end GROUP
/begin GROUP S512_BMU_Reset_Check "VBU0706/Function-Call Subsystem/Subsystem1/BMM/BMM/BMU_Reset_Check" /begin REF_CHARACTERISTIC BMM_BMU_RESET_NONE CbBMM_AbnormalResetOverride_flg /end REF_CHARACTERISTIC /begin REF_MEASUREMENT BMM_flgBMUAbnormalReset /end REF_MEASUREMENT /end GROUP
/begin GROUP S512_BMU_State_Management "VBU0706/Function-Call Subsystem/Subsystem1/BMM/BMM/BMU_State_Management"
 /begin REF_CHARACTERISTIC BMM_STATE_AFTER_RUN BMM_STATE_DRIVE_MODE BMM_STATE_FAST_CHARGE BMM_STATE_IDLE BMM_STATE_INITIALIZATION BMM_STATE_SHUT_DOWN CcBMM_MaxInitializeTime_ms SAMPLE_TIME_TASK_B /end REF_CHARACTERISTIC
 /begin REF_MEASUREMENT LcBMM_timsInitializeTimer LcBMM_timsShutdownTimer /end REF_MEASUREMENT
/end GROUP
/begin GROUP S512_DetermineAbnormalEventFlag "VBU0706/Function-Call Subsystem/Subsystem1/BMM/BMM/DetermineAbnormalEventFlag" /begin SUB_GROUP S516_DetermineSOCJump /end SUB_GROUP
 /begin REF_CHARACTERISTIC BMM_STATE_SHUT_DOWN CbBMM_AbnormalEventDetectedORF_flg CbBMM_AbnormalEventDetectedORV_flg CcBMM_AbnormalEventFlagLockTime_ms CcBMM_CurrentStableDelayTime_ms CcBMM_CurrentStableThreshold_A SAMPLE_TIME_TASK_B /end REF_CHARACTERISTIC
 /begin REF_MEASUREMENT BMM_flgBatteryAbnormalAlarm1 BMM_flgBatteryAbnormalAlarm2 BMM_flgBatteryAbnormalAlarm3 /end REF_MEASUREMENT
/end GROUP
/begin GROUP S512_DetermineCycleUpload "VBU0706/Function-Call Subsystem/Subsystem1/BMM/BMM/DetermineCycleUpload" /begin SUB_GROUP S517_CycleWakeupStateMachine S517_GetValueInNVM /end SUB_GROUP
 /begin REF_CHARACTERISTIC BMM_STATE_AFTER_RUN BMM_STATE_RTC CYCLE_WAKEUP_STATE_PERIODICAL_UPLOAD CcBMM_DeepSleepUploadTime_s CcBMM_PeriodicalUploadTime_s /end REF_CHARACTERISTIC
 /begin REF_MEASUREMENT BMM_flgDefaultState /end REF_MEASUREMENT
/end GROUP
/begin GROUP S512_Determine_Hold_Afterrun "VBU0706/Function-Call Subsystem/Subsystem1/BMM/BMM/Determine_Hold_Afterrun" /begin SUB_GROUP S518_Determine_HoldAfterrun_Condition /end SUB_GROUP /begin REF_CHARACTERISTIC BMM_STATE_AFTER_RUN /end REF_CHARACTERISTIC /end GROUP
/begin GROUP S512_Determine_Wakeup_Mode "VBU0706/Function-Call Subsystem/Subsystem1/BMM/BMM/Determine_Wakeup_Mode"
 /begin SUB_GROUP S519_Determine_Wakeup_Bywire S519_Wakeup_Fast_Charge S519_Wakeup_Ignition_On /end SUB_GROUP
/end GROUP
/begin GROUP S512_Subsystem "VBU0706/Function-Call Subsystem/Subsystem1/BMM/BMM/Subsystem" /begin SUB_GROUP S520_EEPROM_BlockStoreEnable /end SUB_GROUP /end GROUP
/begin GROUP S562_Subsystem "VBU0706/Function-Call Subsystem/Subsystem1/CBL/Subsystem8/Subsystem"
 /begin SUB_GROUP S563_Balance_EnableCondition S563_Determine_BoardTemAvailableCheck S563_Determine_CSCCellBalanceRequest S563_Override /end SUB_GROUP
/end GROUP
/begin GROUP S631_Subsystem "VBU0706/Function-Call Subsystem/Subsystem1/CTC/Subsystem1/Subsystem"
 /begin SUB_GROUP S632_ControlPrechargeRelay S632_ControlResetRelays S632_ControlmainNegativeRelay S632_ControlmainPositiveRelay S632_DetermineRelayCommandStatus S632_Determine_Openings_Number /end SUB_GROUP
 /begin REF_MEASUREMENT CTC_flgHALHeatContactor /end REF_MEASUREMENT
/end GROUP
/begin GROUP S648_Subsystem4 "VBU0706/Function-Call Subsystem/Subsystem1/CTD/Subsystem/Subsystem4"
 /begin SUB_GROUP S649_Determine_MainContactor_Status S649_DiagnoseRelayWeld S649_LV_Battery_Voltage S649_Lockout_Precharge_Process S649_MainFuseDiagnostic S649_Precharge_Resistance_Diagnostic S649_PrechrgProcessMonitoring S649_Stuck_Open_Diagnostic S649_Subsystem S649_Subsystem1 S649_Subsystem2 S649_Subsystem3 /end SUB_GROUP
/end GROUP
/begin GROUP S816_Subsystem "VBU0706/Function-Call Subsystem/Subsystem1/CTM/CTM/Subsystem"
 /begin SUB_GROUP S817_BoardTemp_ValidCheck S817_CellTemp_ValidCheck S817_Determine_CellTemp S817_Determine_CellTemp_OverDeviationFaults S817_Determine_CellTemp_OverUnderFaults S817_Determine_Thermal_Runaway /end SUB_GROUP
/end GROUP
/begin GROUP S894_Subsystem "VBU0706/Function-Call Subsystem/Subsystem1/CTS/CTS/Subsystem"
 /begin SUB_GROUP S895_Contactors_Timing_Control S895_DeterminePrechargeConditions S895_Determine_Contactor_Request S895_Determine_Emergency_Open S895_Determine_Precharge_Times /end SUB_GROUP
 /begin REF_MEASUREMENT CTS_flgCmdHeatContactor /end REF_MEASUREMENT
/end GROUP
/begin GROUP S924_Subsystem "VBU0706/Function-Call Subsystem/Subsystem1/CVT/CVT/Subsystem"
 /begin SUB_GROUP S925_CellVoltage_ValidCheck S925_Determine_CellVoltage_ExtremeData S925_Determine_CellVoltage_OverUnderFaults /end SUB_GROUP
/end GROUP
/begin GROUP S998_Subsystem "VBU0706/Function-Call Subsystem/Subsystem1/DSM/Subsystem10/Subsystem"
 /begin SUB_GROUP S999_Clear_Fault_Data S999_Determine_Abnormal_In_PeriodicalUpload S999_Determine_CSC_Inhibit S999_Determine_Drive_Cycle S999_Determine_Fault_Category S999_Determine_MIL_Request S999_Determine_No_Charge S999_Determine_No_Restart /end SUB_GROUP
/end GROUP
/begin GROUP S1030_DCH_DCChargeCtrlOverall "VBU0706/Function-Call Subsystem/Subsystem1/FCC /DCH_Overall/DCH_DCChargeCtrlOverall"
 /begin SUB_GROUP S1034_DCH_BMSChgrReq S1034_DCH_DCChargeCtrlStateflow S1034_DCH_Diagnose S1034_DCH_EepromStore S1034_DSPLLight /end SUB_GROUP
/end GROUP
/begin GROUP S1030_DCH_J1939InputProcess "VBU0706/Function-Call Subsystem/Subsystem1/FCC /DCH_Overall/DCH_J1939InputProcess" /begin SUB_GROUP S1035_DCH_J1939ReceiveProcess /end SUB_GROUP /end GROUP
/begin GROUP S1030_DCH_J1939OutputSignalProcess "VBU0706/Function-Call Subsystem/Subsystem1/FCC /DCH_Overall/DCH_J1939OutputSignalProcess"
 /begin SUB_GROUP S1036_DCH_J1939OutputProcessBCL S1036_DCH_J1939OutputProcessBCP S1036_DCH_J1939OutputProcessBCS S1036_DCH_J1939OutputProcessBEM S1036_DCH_J1939OutputProcessBRO S1036_DCH_J1939OutputProcessBSD S1036_DCH_J1939OutputProcessBSM S1036_DCH_J1939OutputProcessBST /end SUB_GROUP
/end GROUP
/begin GROUP S1031_Subsystem "VBU0706/Function-Call Subsystem/Subsystem1/FCC /FCC/Subsystem"
 /begin SUB_GROUP S1157_Calculate_Fastcharge_Time S1157_Determine_Fastcharge_Request S1157_Fastcharge_Conditions_Check S1157_Fastcharge_State_Management S1157_Fastcharge_Violation_Diagnostic S1157_MapingSOC /end SUB_GROUP
 /begin REF_CHARACTERISTIC FCC_pctVCRVCUMaxChrgSOCSet /end REF_CHARACTERISTIC
/end GROUP
/begin GROUP S1032_FCC_CHARGE_MODE1 "VBU0706/Function-Call Subsystem/Subsystem1/FCC /Subsystem/FCC_CHARGE_MODE1" /begin REF_CHARACTERISTIC BMM_STATE_FAST_CHARGE /end REF_CHARACTERISTIC /end GROUP
/begin GROUP S1032_Subsystem1 "VBU0706/Function-Call Subsystem/Subsystem1/FCC /Subsystem/Subsystem1"
 /begin REF_CHARACTERISTIC FCC_STATE_CHARGE_FAULT FCC_STATE_CHARGE_FULL FCC_STATE_CHARGING VCT_CHARGE_STATE_CHARGING VCT_CHARGE_STATE_CHARGING_FAULT VCT_CHARGE_STATE_CHARGING_FULL VCT_CHARGE_STATE_NOT_CHARGING /end REF_CHARACTERISTIC
/end GROUP
/begin GROUP S1032_Subsystem3 "VBU0706/Function-Call Subsystem/Subsystem1/FCC /Subsystem/Subsystem3"
 /begin SUB_GROUP S1279_CONTACTOR_STATUS_CLOSED1 S1279_CONTACTOR_STATUS_CLOSED2 S1279_CONTACTOR_STATUS_CLOSED3 S1279_CONTACTOR_STATUS_CLOSED4 S1279_CONTACTOR_STATUS_OPENED2 /end SUB_GROUP
/end GROUP
/begin GROUP S1032_Subsystem4 "VBU0706/Function-Call Subsystem/Subsystem1/FCC /Subsystem/Subsystem4"
 /begin REF_CHARACTERISTIC CcVCT_BatteryRatedVoltage_V CcVCT_NominalCellCapacity_Ah NUMBER_OF_PARALLEL_CELLS_PER_MODULE NUMBER_OF_PARALLEL_MODULES WATS_PER_KILOWAT /end REF_CHARACTERISTIC
/end GROUP
/begin GROUP S1032_Subsystem5 "VBU0706/Function-Call Subsystem/Subsystem1/FCC /Subsystem/Subsystem5" /begin REF_CHARACTERISTIC CcSYS_CellVoltageMaxLimit_mV MILIVOLTAGES_PER_VOLTAGE /end REF_CHARACTERISTIC /end GROUP
/begin GROUP S1033_BCL "VBU0706/Function-Call Subsystem/Subsystem1/FCC /Subsystem1/BCL"
 /begin REF_CHARACTERISTIC CHARGING_MODEOvrdVal_C CHARGING_MODEOvrd_C CURRENT_REQUIREMENTOvrdVal_C CURRENT_REQUIREMENTOvrd_C VOLTAGE_REQUIREMENTOvrdVal_C VOLTAGE_REQUIREMENTOvrd_C /end REF_CHARACTERISTIC
/end GROUP
/begin GROUP S1033_BCP "VBU0706/Function-Call Subsystem/Subsystem1/FCC /Subsystem1/BCP"
 /begin REF_CHARACTERISTIC DCH_cBCPNrmCapOvrdVal_C DCH_cBCPNrmCapOvrd_C DCH_iBCPMaxChCurrOvrdVal_C DCH_iBCPMaxChCurrOvrd_C DCH_pctBCPSocOvrdVal_C DCH_pctBCPSocOvrd_C DCH_tBCPMaxPermitTempOvrdVal_C DCH_tBCPMaxPermitTempOvrd_C DCH_uBCPBattVltgOvrdVal_C DCH_uBCPBattVltgOvrd_C DCH_uBCPMaxCellVltgForChOvrdVal_C DCH_uBCPMaxCellVltgForChOvrd_C DCH_uBCPMaxVltgForChOvrdVal_C DCH_uBCPMaxVltgForChOvrd_C /end REF_CHARACTERISTIC
/end GROUP
/begin GROUP S1033_BCS "VBU0706/Function-Call Subsystem/Subsystem1/FCC /Subsystem1/BCS"
 /begin REF_CHARACTERISTIC DCH_iBCSChCurrMeasureOvrdVal_C DCH_iBCSChCurrMeasureOvrd_C DCH_numBCSMaxCellVltgNumOvrdVal_C DCH_numBCSMaxCellVltgNumOvrd_C DCH_pctBCSCurrSocOvrdVal_C DCH_pctBCSCurrSocOvrd_C DCH_tiBCSChNeedTOvrdVal_C DCH_tiBCSChNeedTOvrd_C DCH_uBCSChVltgMeasureOvrdVal_C DCH_uBCSChVltgMeasureOvrd_C DCH_uBCSMaxCellVltgOvrdVal_C DCH_uBCSMaxCellVltgOvrd_C /end REF_CHARACTERISTIC
/end GROUP
/begin GROUP S1033_BEM "VBU0706/Function-Call Subsystem/Subsystem1/FCC /Subsystem1/BEM"
 /begin REF_CHARACTERISTIC CHARGER_MESSAGE_OT_00OvrdVal_C CHARGER_MESSAGE_OT_00Ovrd_C CHARGER_MESSAGE_OT_AAOvrdVal_C CHARGER_MESSAGE_OT_AAOvrd_C CHARGER_MESSAGE_OT_READYOvrdVal_C CHARGER_MESSAGE_OT_READYOvrd_C CHARGER_MESSAGE_OT_STATEOvrdVal_C CHARGER_MESSAGE_OT_STATEOvrd_C CHARGER_MESSAGE_OT_STATISTICSOvrdVal_C CHARGER_MESSAGE_OT_STATISTICSOvrd_C CHARGER_MESSAGE_OT_STOPOvrdVal_C CHARGER_MESSAGE_OT_STOPOvrd_C CHARGER_MESSAGE_OT_SYNCHRONOUSOvrdVal_C CHARGER_MESSAGE_OT_SYNCHRONOUSOvrd_C /end REF_CHARACTERISTIC
/end GROUP
/begin GROUP S1033_BHM "VBU0706/Function-Call Subsystem/Subsystem1/FCC /Subsystem1/BHM" /begin REF_CHARACTERISTIC PermitVoltageOvrdVal_C PermitVoltageOvrd_C /end REF_CHARACTERISTIC /end GROUP
/begin GROUP S1033_BRM "VBU0706/Function-Call Subsystem/Subsystem1/FCC /Subsystem1/BRM"
 /begin REF_CHARACTERISTIC DCH_cBRMBattRatedCapOvrdVal_C DCH_cBRMBattRatedCapOvrd_C DCH_numBRMBattTypOvrdVal_C DCH_numBRMBattTypOvrd_C DCH_uBRMBattRatedVltgOvrdVal_C DCH_uBRMBattRatedVltgOvrd_C /end REF_CHARACTERISTIC
/end GROUP
/begin GROUP S1033_BRO "VBU0706/Function-Call Subsystem/Subsystem1/FCC /Subsystem1/BRO"
 /begin REF_CHARACTERISTIC READY_CHARGING_GATEWAYOvrdVal_C READY_CHARGING_GATEWAYOvrd_C /end REF_CHARACTERISTIC
/end GROUP
/begin GROUP S1033_BSD "VBU0706/Function-Call Subsystem/Subsystem1/FCC /Subsystem1/BSD"
 /begin REF_CHARACTERISTIC MAXIMUM_CELL_TEMP_BSDOvrdVal_C MAXIMUM_CELL_TEMP_BSDOvrd_C MAXIMUM_CELL_VOLTAGE_BSDOvrdVal_C MAXIMUM_CELL_VOLTAGE_BSDOvrd_C MINIMUM_CELL_TEMP_BSDOvrdVal_C MINIMUM_CELL_TEMP_BSDOvrd_C MINIMUM_CELL_VOLTAGE_BSDOvrdVal_C MINIMUM_CELL_VOLTAGE_BSDOvrd_C SOC_STOPOvrdVal_C SOC_STOPOvrd_C /end REF_CHARACTERISTIC
/end GROUP
/begin GROUP S1033_BSM "VBU0706/Function-Call Subsystem/Subsystem1/FCC /Subsystem1/BSM"
 /begin REF_CHARACTERISTIC BATTERY_ISOLATION_STATEOvrdVal_C BATTERY_ISOLATION_STATEOvrd_C BATTERY_OUTPUT_CONNECTOR_STATEOvrdVal_C BATTERY_OUTPUT_CONNECTOR_STATEOvrd_C CELL_VOLTAGE_OVER_UNDEROvrdVal_C CELL_VOLTAGE_OVER_UNDEROvrd_C CHARGING_PERMITOvrdVal_C CHARGING_PERMITOvrd_C CURRENT_OVER_UNDEROvrdVal_C CURRENT_OVER_UNDEROvrd_C MAXIMUM_CELL_TEMPOvrdVal_C MAXIMUM_CELL_TEMPOvrd_C MAXIMUM_CELL_VOLTAGE_NUMBER_BSMOvrdVal_C MAXIMUM_CELL_VOLTAGE_NUMBER_BSMOvrd_C MAXIMUM_TEMP_NUMBEROvrdVal_C MAXIMUM_TEMP_NUMBEROvrd_C MINIMUM_CELL_TEMPOvrdVal_C MINIMUM_CELL_TEMPOvrd_C MINIMUM_TEMP_NUMBEROvrdVal_C MINIMUM_TEMP_NUMBEROvrd_C SOC_OVER_UNDEROvrdVal_C SOC_OVER_UNDEROvrd_C TEMP_OVEROvrdVal_C TEMP_OVEROvrd_C /end REF_CHARACTERISTIC
/end GROUP
/begin GROUP S1033_BST_ "VBU0706/Function-Call Subsystem/Subsystem1/FCC /Subsystem1/BST "
 /begin REF_CHARACTERISTIC GATEWAY_STOP_ERROR_REASON_OCOvrdVal_C GATEWAY_STOP_ERROR_REASON_OCOvrd_C GATEWAY_STOP_ERROR_REASON_VOLTOvrdVal_C GATEWAY_STOP_ERROR_REASON_VOLTOvrd_C GATEWAY_STOP_FAULT_REASON_1OvrdVal_C GATEWAY_STOP_FAULT_REASON_1Ovrd_C GATEWAY_STOP_FAULT_REASON_2OvrdVal_C GATEWAY_STOP_FAULT_REASON_2Ovrd_C GATEWAY_STOP_FAULT_REASON_3OvrdVal_C GATEWAY_STOP_FAULT_REASON_3Ovrd_C GATEWAY_STOP_FAULT_REASON_BMSOTOvrdVal_C GATEWAY_STOP_FAULT_REASON_BMSOTOvrd_C GATEWAY_STOP_FAULT_REASON_CELLOTOvrdVal_C GATEWAY_STOP_FAULT_REASON_CELLOTOvrd_C GATEWAY_STOP_FAULT_REASON_CONNOTOvrdVal_C GATEWAY_STOP_FAULT_REASON_CONNOTOvrd_C GATEWAY_STOP_FAULT_REASON_CONNOvrdVal_C GATEWAY_STOP_FAULT_REASON_CONNOvrd_C GATEWAY_STOP_FAULT_REASON_ISOOvrdVal_C GATEWAY_STOP_FAULT_REASON_ISOOvrd_C GATEWAY_STOP_REASON_CELLVOLTOvrdVal_C GATEWAY_STOP_REASON_CELLVOLTOvrd_C GATEWAY_STOP_REASON_SOCOvrdVal_C GATEWAY_STOP_REASON_SOCOvrd_C GATEWAY_STOP_REASON_STATIONOvrdVal_C GATEWAY_STOP_REASON_STATIONOvrd_C GATEWAY_STOP_REASON_TOTALVOLTOvrdVal_C GATEWAY_STOP_REASON_TOTALVOLTOvrd_C /end REF_CHARACTERISTIC
/end GROUP
/begin GROUP S1033_J1939TxEna "VBU0706/Function-Call Subsystem/Subsystem1/FCC /Subsystem1/J1939TxEna"
 /begin REF_CHARACTERISTIC APO_flgBCLTxEnaOvrdVal_C APO_flgBCLTxEnaOvrd_C APO_flgBCPTxEnaOvrdVal_C APO_flgBCPTxEnaOvrd_C APO_flgBCSTxEnaOvrdVal_C APO_flgBCSTxEnaOvrd_C APO_flgBEMTxEnaOvrdVal_C APO_flgBEMTxEnaOvrd_C APO_flgBHMTxEnaOvrdVal_C APO_flgBHMTxEnaOvrd_C APO_flgBRMTxEnaOvrdVal_C APO_flgBRMTxEnaOvrd_C APO_flgBROTxEnaOvrdVal_C APO_flgBROTxEnaOvrd_C APO_flgBSDTxEnaOvrdVal_C APO_flgBSDTxEnaOvrd_C APO_flgBSMTxEnaOvrdVal_C APO_flgBSMTxEnaOvrd_C APO_flgBSTTxEnaOvrdVal_C APO_flgBSTTxEnaOvrd_C /end REF_CHARACTERISTIC
/end GROUP
/begin GROUP S1393_DetermineIsolationSevereTestFail "VBU0706/Function-Call Subsystem/Subsystem1/ISO/Determine_FaultDetection_Check/DetermineIsolationSevereTestFail"
 /begin REF_CHARACTERISTIC CcISO_AllowableIsolationWarningTimes_n CcISO_IsolationSeverseLimited_Kohm /end REF_CHARACTERISTIC
/end GROUP
/begin GROUP S1393_DetermineIsolationWarningTestFail "VBU0706/Function-Call Subsystem/Subsystem1/ISO/Determine_FaultDetection_Check/DetermineIsolationWarningTestFail"
 /begin REF_CHARACTERISTIC CcISO_AllowableIsolationWarningTimes_n CcISO_IsolationWarningLimited_Kohm /end REF_CHARACTERISTIC
/end GROUP
/begin GROUP S1393_Status_Process "VBU0706/Function-Call Subsystem/Subsystem1/ISO/Determine_FaultDetection_Check/Status_Process"
 /begin SUB_GROUP S1403_Determine_EVMandStatus S1403_Determine_IsolationLevel /end SUB_GROUP
/end GROUP
/begin GROUP S1394_ISO_DCCharging_Dec "VBU0706/Function-Call Subsystem/Subsystem1/ISO/Determine_IsoLowItems/ISO_DCCharging_Dec"
 /begin REF_CHARACTERISTIC CcISO_FccISODecThr_kohm CcISO_FccISODecThr_pct CcISO_FccISOLowThr40_kohm CcISO_FccISOLowThr_kohm ONE_HUNDRED_PERCENT /end REF_CHARACTERISTIC
/end GROUP
/begin GROUP S1394_ISO_Normal_Dec "VBU0706/Function-Call Subsystem/Subsystem1/ISO/Determine_IsoLowItems/ISO_Normal_Dec"
 /begin REF_CHARACTERISTIC CcISO_DrvISODecThr_kohm CcISO_DrvISODecThr_pct CcISO_DrvISOLowThr40_kohm CcISO_DrvISOLowThr_kohm ONE_HUNDRED_PERCENT /end REF_CHARACTERISTIC
/end GROUP
/begin GROUP S1394_ISO_Pack_Dec "VBU0706/Function-Call Subsystem/Subsystem1/ISO/Determine_IsoLowItems/ISO_Pack_Dec"
 /begin REF_CHARACTERISTIC CcISO_PackISODecThr_kohm CcISO_PackISODecThr_pct CcISO_PackISOLowThr_kohm ONE_HUNDRED_PERCENT /end REF_CHARACTERISTIC
/end GROUP
/begin GROUP S1434_Read_NVM_Data "VBU0706/Function-Call Subsystem/Subsystem1/NVM /Subsystem3/Read_NVM_Data" /begin SUB_GROUP S1436_Check_First_Run S1436_Check_NVM_Read /end SUB_GROUP /begin REF_MEASUREMENT NVM_flgNVMValid /end REF_MEASUREMENT /end GROUP
/begin GROUP S1454_Subsystem "VBU0706/Function-Call Subsystem/Subsystem1/OCV/OCV/Subsystem"
 /begin SUB_GROUP S1455_Determine_Criteria S1455_Determine_Relax_ElapsedTime S1455_Determine_Relax_MinTime S1455_OCV_Valid_Check /end SUB_GROUP
/end GROUP
/begin GROUP S1463_Calculate_Actual_Time "VBU0706/Function-Call Subsystem/Subsystem1/RTC/RTC/Calculate_Actual_Time" /begin SUB_GROUP S1464_Initialize_Actual_Time /end SUB_GROUP /begin REF_CHARACTERISTIC CbSYS_flgAbnormalResetRecoverEnable /end REF_CHARACTERISTIC /end GROUP
/begin GROUP S1463_Calculate_RelativeActual_Time "VBU0706/Function-Call Subsystem/Subsystem1/RTC/RTC/Calculate_RelativeActual_Time" /begin REF_CHARACTERISTIC MILISECONDS_PER_SECOND SAMPLE_TIME_TASK_A /end REF_CHARACTERISTIC /end GROUP
/begin GROUP S1463_Determine_VCU_ActualTime "VBU0706/Function-Call Subsystem/Subsystem1/RTC/RTC/Determine_VCU_ActualTime" /begin SUB_GROUP S1466_Calculate_Time_Deviation /end SUB_GROUP /begin REF_CHARACTERISTIC BMM_STATE_INITIALIZATION CbRTC_ActualTimeInit_flg /end REF_CHARACTERISTIC /end GROUP
/begin GROUP S1463_Reset_TimeInit_flg "VBU0706/Function-Call Subsystem/Subsystem1/RTC/RTC/Reset_TimeInit_flg" /begin REF_CHARACTERISTIC CbRTC_ActualTimeInit_flg /end REF_CHARACTERISTIC /end GROUP
/begin GROUP S1490_Subsystem "VBU0706/Function-Call Subsystem/Subsystem1/SOC/Subsystem5/Subsystem"
 /begin SUB_GROUP S1491_Battery_SoC_Diagnostic S1491_Determine_AhIntegral_SoC S1491_Determine_Battery_SOC S1491_Determine_CellData_Validation S1491_Determine_Cell_SOC S1491_Determine_Correction_Condition S1491_Determine_Display_SOC S1491_Determine_FastChargeCorrection_Soc S1491_Determine_Initial_SoC S1491_Determine_Initialization_Condition S1491_Determine_OcvSoc S1491_Determine_ShortTimeCorrection_Condition S1491_Ocv_ShortTimeCorrection S1491_Soc_Data_Storage /end SUB_GROUP
 /begin REF_CHARACTERISTIC SOC_pctMaxSOCSet_C /end REF_CHARACTERISTIC
/end GROUP
/begin GROUP S1668_Subsystem "VBU0706/Function-Call Subsystem/Subsystem1/SOE/Subsystem2/Subsystem"
 /begin SUB_GROUP S1669_Calculate_History_Average_Current S1669_Calculate_Pack_Remaining_Energy S1669_Calculate_Pack_Remaining_Energy_SOC S1669_Rate_Limit_and_Output S1669_Rate_Limit_and_Output_SOC /end SUB_GROUP
/end GROUP
/begin GROUP S1720_Subsystem "VBU0706/Function-Call Subsystem/Subsystem1/SOF/Subsystem6/Subsystem"
 /begin SUB_GROUP S1721_Calculate_ActualPower S1721_Calculate_PowerLimit S1721_Count_LowTempOverCurrent S1721_Determine_Currentlimit_Target S1721_Rate_CurrentLimit S1721_Rate_PowerLimit S1721_SOF_Diagnostic /end SUB_GROUP
/end GROUP
/begin GROUP S1953_Subsystem1 "VBU0706/Function-Call Subsystem/Subsystem1/SOH/Subsystem4/Subsystem1"
 /begin SUB_GROUP S1954_Calculate_Capacity S1954_Calculate_Resistance S1954_Monitor_SOH S1954_SOH_Diagnositic S1954_Subsystem /end SUB_GROUP
/end GROUP
/begin GROUP S2084_Subsystem "VBU0706/Function-Call Subsystem/Subsystem1/THM/Subsystem/Subsystem"
 /begin SUB_GROUP S2085_Calculate_PipeTemperature S2085_Charge_Mode_Temp_Request S2085_Cooling_Request_Respond_Check S2085_Diagnose_InletCoolingHighTemperture_Fault S2085_Diagnose_InletCoolingLowTemperture_Fault S2085_Diagnose_InletOutletTempDelta_Fault S2085_Diagnose_OutletCoolingHighTemperture_Fault S2085_Diagnose_OutletCoolingLowTemperture_Fault S2085_Thermal_System_Damage_Judgement S2085_Valid_Condition_Determination /end SUB_GROUP
/end GROUP
/begin GROUP S2158_Subsystem "VBU0706/Function-Call Subsystem/Subsystem1/VCT/Subsystem/Subsystem"
 /begin SUB_GROUP S2159_Determine_BMS_VCU_267 S2159_Determine_BMS_VCU_268 S2159_Determine_BMS_VCU_269 S2159_Determine_BMS_VCU_26A S2159_Determine_BMS_VCU_271 S2159_Determine_BMS_VCU_272 S2159_Determine_BMS_VCU_34 S2159_Determine_BMS_VCU_373 S2159_Determine_BMS_VCU_AC /end SUB_GROUP
/end GROUP
/begin GROUP S2293_Subsystem "VBU0706/Function-Call Subsystem/Subsystem1/WRT/Subsystem9/Subsystem"
 /begin REF_CHARACTERISTIC CbWRT_BatteryCapacityCycleORF_flg CcSYS_NominalCellCapacity_Ah CcWRT_BatteryCapacityCycleORV_n /end REF_CHARACTERISTIC
 /begin REF_MEASUREMENT WRT_AhOverallDischarged WRT_AhOverallFastcharged WRT_numBatteryCapacityCycle WRT_numOpenContactorWithLoadTimes1 WRT_numOpenContactorWithLoadTimes2 /end REF_MEASUREMENT
/end GROUP
/begin GROUP S2312_EdgeBi "VBU0706/Task_10ms/J1939/FCHG/BCP/EdgeBi" /begin REF_MEASUREMENT FCHG_BCPRevFlag /end REF_MEASUREMENT /end GROUP
/begin GROUP S2314_EdgeBi "VBU0706/Task_10ms/J1939/FCHG/BCS/EdgeBi" /begin REF_MEASUREMENT FCHG_BCSRevFlag /end REF_MEASUREMENT /end GROUP
/begin GROUP S2316_EdgeBi "VBU0706/Task_10ms/J1939/FCHG/BRM/EdgeBi" /begin REF_MEASUREMENT FCHG_BRMRevFlag /end REF_MEASUREMENT /end GROUP
/begin GROUP S2320_TP_CM_RX "VBU0706/Task_10ms/J1939/FCHG/TP_CM_RX/TP_CM RX" /begin SUB_GROUP S2330_CANRX_Active /end SUB_GROUP /begin REF_MEASUREMENT TP_PGN /end REF_MEASUREMENT /end GROUP
/begin GROUP S315_Monitor_BCV_Performance "VBU0706/Function-Call Subsystem/Subsystem1/BCV/BCV/Subsystem/Monitor_BCV_Performance" /begin REF_CHARACTERISTIC SAMPLE_TIME_TASK_B /end REF_CHARACTERISTIC /end GROUP
/begin GROUP S516_DetermineSOCJump "VBU0706/Function-Call Subsystem/Subsystem1/BMM/BMM/DetermineAbnormalEventFlag/DetermineSOCJump" /begin REF_CHARACTERISTIC SAMPLE_TIME_TASK_B /end REF_CHARACTERISTIC /end GROUP
/begin GROUP S517_CycleWakeupStateMachine "VBU0706/Function-Call Subsystem/Subsystem1/BMM/BMM/DetermineCycleUpload/CycleWakeupStateMachine" /begin REF_CHARACTERISTIC CYCLE_WAKEUP_STATE_PERIODICAL_UPLOAD /end REF_CHARACTERISTIC /end GROUP
/begin GROUP S518_Determine_HoldAfterrun_Condition "VBU0706/Function-Call Subsystem/Subsystem1/BMM/BMM/Determine_Hold_Afterrun/Determine_HoldAfterrun_Condition" /begin REF_CHARACTERISTIC BMM_STATE_INITIALIZATION BMM_STATE_RTC /end REF_CHARACTERISTIC /end GROUP
/begin GROUP S632_ControlPrechargeRelay "VBU0706/Function-Call Subsystem/Subsystem1/CTC/Subsystem1/Subsystem/ControlPrechargeRelay" /begin REF_CHARACTERISTIC CTD_MAIN_CONTACTOR_STATUS_CLOSED /end REF_CHARACTERISTIC /end GROUP
/begin GROUP S632_ControlResetRelays "VBU0706/Function-Call Subsystem/Subsystem1/CTC/Subsystem1/Subsystem/ControlResetRelays"
 /begin REF_CHARACTERISTIC CTD_MAIN_CONTACTOR_STATUS_CLOSED CTD_MAIN_CONTACTOR_STATUS_OPENED /end REF_CHARACTERISTIC
/end GROUP
/begin GROUP S632_ControlmainNegativeRelay "VBU0706/Function-Call Subsystem/Subsystem1/CTC/Subsystem1/Subsystem/ControlmainNegativeRelay" /begin REF_CHARACTERISTIC CTD_MAIN_CONTACTOR_STATUS_CLOSED /end REF_CHARACTERISTIC /end GROUP
/begin GROUP S632_ControlmainPositiveRelay "VBU0706/Function-Call Subsystem/Subsystem1/CTC/Subsystem1/Subsystem/ControlmainPositiveRelay" /begin REF_CHARACTERISTIC CTD_MAIN_CONTACTOR_STATUS_CLOSED /end REF_CHARACTERISTIC /end GROUP
/begin GROUP S649_Determine_MainContactor_Status "VBU0706/Function-Call Subsystem/Subsystem1/CTD/Subsystem/Subsystem4/Determine_MainContactor_Status"
 /begin REF_CHARACTERISTIC CTD_MAIN_CONTACTOR_STATUS_CLOSED CTD_MAIN_CONTACTOR_STATUS_OPENED /end REF_CHARACTERISTIC
/end GROUP
/begin GROUP S649_Precharge_Resistance_Diagnostic "VBU0706/Function-Call Subsystem/Subsystem1/CTD/Subsystem/Subsystem4/Precharge_Resistance_Diagnostic" /begin REF_CHARACTERISTIC CTD_PRECHARGE_RESISTANCE_BLOWN_FAULT /end REF_CHARACTERISTIC /end GROUP
/begin GROUP S649_Subsystem "VBU0706/Function-Call Subsystem/Subsystem1/CTD/Subsystem/Subsystem4/Subsystem"
 /begin REF_CHARACTERISTIC CTD_MAIN_CONTACTOR_STATUS_CLOSED CTD_MAIN_CONTACTOR_STATUS_OPENED /end REF_CHARACTERISTIC
/end GROUP
/begin GROUP S649_Subsystem1 "VBU0706/Function-Call Subsystem/Subsystem1/CTD/Subsystem/Subsystem4/Subsystem1" /begin REF_CHARACTERISTIC CTD_MAIN_CONTACTOR_STATUS_CLOSED /end REF_CHARACTERISTIC /end GROUP
/begin GROUP S649_Subsystem2 "VBU0706/Function-Call Subsystem/Subsystem1/CTD/Subsystem/Subsystem4/Subsystem2" /begin REF_CHARACTERISTIC CTD_MAIN_CONTACTOR_STATUS_CLOSED /end REF_CHARACTERISTIC /end GROUP
/begin GROUP S649_Subsystem3 "VBU0706/Function-Call Subsystem/Subsystem1/CTD/Subsystem/Subsystem4/Subsystem3" /begin REF_CHARACTERISTIC CTD_MAIN_CONTACTOR_STATUS_CLOSED /end REF_CHARACTERISTIC /end GROUP
/begin GROUP S817_Determine_CellTemp_OverUnderFaults "VBU0706/Function-Call Subsystem/Subsystem1/CTM/CTM/Subsystem/Determine_CellTemp_OverUnderFaults" /begin REF_CHARACTERISTIC CTM_CELL_OVER_TEMP_FAULT /end REF_CHARACTERISTIC /end GROUP
/begin GROUP S895_Contactors_Timing_Control "VBU0706/Function-Call Subsystem/Subsystem1/CTS/CTS/Subsystem/Contactors_Timing_Control"
 /begin REF_CHARACTERISTIC CTD_MAIN_CONTACTOR_STATUS_CLOSED CTD_MAIN_CONTACTOR_STATUS_OPENED SAMPLE_TIME_TASK_B /end REF_CHARACTERISTIC
/end GROUP
/begin GROUP S895_Determine_Precharge_Times "VBU0706/Function-Call Subsystem/Subsystem1/CTS/CTS/Subsystem/Determine_Precharge_Times" /begin REF_CHARACTERISTIC SAMPLE_TIME_TASK_B /end REF_CHARACTERISTIC /end GROUP
/begin GROUP S925_Determine_CellVoltage_OverUnderFaults "VBU0706/Function-Call Subsystem/Subsystem1/CVT/CVT/Subsystem/Determine_CellVoltage_OverUnderFaults"
 /begin REF_CHARACTERISTIC BMM_STATE_INITIALIZATION BMM_STATE_ONBOARD_CHARGE CVT_CELL_OVER_VOLTAGE_FAULT CVT_CELL_UNDER_VOLTAGE_FAULT MILISECONDS_PER_SECOND /end REF_CHARACTERISTIC
/end GROUP
/begin GROUP S999_Determine_CSC_Inhibit "VBU0706/Function-Call Subsystem/Subsystem1/DSM/Subsystem10/Subsystem/Determine_CSC_Inhibit" /begin REF_CHARACTERISTIC BMM_STATE_AFTER_RUN /end REF_CHARACTERISTIC /end GROUP
/begin GROUP S999_Determine_Drive_Cycle "VBU0706/Function-Call Subsystem/Subsystem1/DSM/Subsystem10/Subsystem/Determine_Drive_Cycle"
 /begin REF_CHARACTERISTIC BMM_STATE_FAST_CHARGE BMM_STATE_ONBOARD_CHARGE SAMPLE_TIME_TASK_A /end REF_CHARACTERISTIC
/end GROUP
/begin GROUP S999_Determine_No_Restart "VBU0706/Function-Call Subsystem/Subsystem1/DSM/Subsystem10/Subsystem/Determine_No_Restart" /begin REF_CHARACTERISTIC BMM_STATE_AFTER_RUN /end REF_CHARACTERISTIC /end GROUP
/begin GROUP S1036_DCH_J1939OutputProcessBCP "VBU0706/Function-Call Subsystem/Subsystem1/FCC /DCH_Overall/DCH_J1939OutputSignalProcess/DCH_J1939OutputProcessBCP"
 /begin REF_CHARACTERISTIC DCH_cBCPNrmCapOvrdVal_C DCH_iBCPMaxChCurrOvrdVal_C DCH_pctBCPSocOvrdVal_C DCH_tBCPMaxPermitTempOvrdVal_C DCH_uBCPBattVltgOvrdVal_C DCH_uBCPMaxCellVltgForChOvrdVal_C DCH_uBCPMaxVltgForChOvrdVal_C /end REF_CHARACTERISTIC
/end GROUP
/begin GROUP S1036_DCH_J1939OutputProcessBCS "VBU0706/Function-Call Subsystem/Subsystem1/FCC /DCH_Overall/DCH_J1939OutputSignalProcess/DCH_J1939OutputProcessBCS"
 /begin REF_CHARACTERISTIC DCH_iBCSChCurrMeasureOvrdVal_C DCH_numBCSMaxCellVltgNumOvrdVal_C DCH_pctBCSCurrSocOvrdVal_C DCH_tiBCSChNeedTOvrdVal_C DCH_uBCSChVltgMeasureOvrdVal_C DCH_uBCSMaxCellVltgOvrdVal_C /end REF_CHARACTERISTIC
/end GROUP
/begin GROUP S1157_Fastcharge_State_Management "VBU0706/Function-Call Subsystem/Subsystem1/FCC /FCC/Subsystem/Fastcharge_State_Management"
 /begin REF_CHARACTERISTIC BMM_STATE_FAST_CHARGE FCC_STATE_CHARGE_FAULT FCC_STATE_CHARGE_FULL FCC_STATE_CHARGING /end REF_CHARACTERISTIC
/end GROUP
/begin GROUP S1157_Fastcharge_Violation_Diagnostic "VBU0706/Function-Call Subsystem/Subsystem1/FCC /FCC/Subsystem/Fastcharge_Violation_Diagnostic" /begin REF_CHARACTERISTIC BMM_STATE_FAST_CHARGE FCC_CHARGE_CURRENT_OVER_FAULT /end REF_CHARACTERISTIC /end GROUP
/begin GROUP S1157_MapingSOC "VBU0706/Function-Call Subsystem/Subsystem1/FCC /FCC/Subsystem/MapingSOC" /begin REF_CHARACTERISTIC ONE_HUNDRED_PERCENT /end REF_CHARACTERISTIC /end GROUP
/begin GROUP S1279_CONTACTOR_STATUS_CLOSED1 "VBU0706/Function-Call Subsystem/Subsystem1/FCC /Subsystem/Subsystem3/CONTACTOR_STATUS_CLOSED1" /begin REF_CHARACTERISTIC CTD_MAIN_CONTACTOR_STATUS_CLOSED /end REF_CHARACTERISTIC /end GROUP
/begin GROUP S1279_CONTACTOR_STATUS_CLOSED2 "VBU0706/Function-Call Subsystem/Subsystem1/FCC /Subsystem/Subsystem3/CONTACTOR_STATUS_CLOSED2" /begin REF_CHARACTERISTIC CTD_MAIN_CONTACTOR_STATUS_CLOSED /end REF_CHARACTERISTIC /end GROUP
/begin GROUP S1279_CONTACTOR_STATUS_CLOSED3 "VBU0706/Function-Call Subsystem/Subsystem1/FCC /Subsystem/Subsystem3/CONTACTOR_STATUS_CLOSED3" /begin REF_CHARACTERISTIC CTD_MAIN_CONTACTOR_STATUS_CLOSED /end REF_CHARACTERISTIC /end GROUP
/begin GROUP S1279_CONTACTOR_STATUS_CLOSED4 "VBU0706/Function-Call Subsystem/Subsystem1/FCC /Subsystem/Subsystem3/CONTACTOR_STATUS_CLOSED4" /begin REF_CHARACTERISTIC CTD_MAIN_CONTACTOR_STATUS_CLOSED /end REF_CHARACTERISTIC /end GROUP
/begin GROUP S1279_CONTACTOR_STATUS_OPENED2 "VBU0706/Function-Call Subsystem/Subsystem1/FCC /Subsystem/Subsystem3/CONTACTOR_STATUS_OPENED2" /begin REF_CHARACTERISTIC CTD_MAIN_CONTACTOR_STATUS_OPENED /end REF_CHARACTERISTIC /end GROUP
/begin GROUP S1403_Determine_IsolationLevel "VBU0706/Function-Call Subsystem/Subsystem1/ISO/Determine_FaultDetection_Check/Status_Process/Determine_IsolationLevel" /begin REF_CHARACTERISTIC SAMPLE_TIME_TASK_B /end REF_CHARACTERISTIC /end GROUP
/begin GROUP S1491_Determine_Battery_SOC "VBU0706/Function-Call Subsystem/Subsystem1/SOC/Subsystem5/Subsystem/Determine_Battery_SOC" /begin REF_CHARACTERISTIC ONE_HUNDRED_PERCENT /end REF_CHARACTERISTIC /end GROUP
/begin GROUP S1491_Determine_Display_SOC "VBU0706/Function-Call Subsystem/Subsystem1/SOC/Subsystem5/Subsystem/Determine_Display_SOC" /begin REF_CHARACTERISTIC ONE_HUNDRED_PERCENT /end REF_CHARACTERISTIC /end GROUP
/begin GROUP S1669_Calculate_Pack_Remaining_Energy_SOC "VBU0706/Function-Call Subsystem/Subsystem1/SOE/Subsystem2/Subsystem/Calculate_Pack_Remaining_Energy_SOC"
 /begin REF_CHARACTERISTIC CcSYS_NominalCellCapacity_Ah ONE_HUNDRED_PERCENT WATS_PER_KILOWAT /end REF_CHARACTERISTIC
/end GROUP
/begin GROUP S1669_Rate_Limit_and_Output "VBU0706/Function-Call Subsystem/Subsystem1/SOE/Subsystem2/Subsystem/Rate_Limit_and_Output" /begin REF_CHARACTERISTIC MILISECONDS_PER_SECOND /end REF_CHARACTERISTIC /end GROUP
/begin GROUP S1669_Rate_Limit_and_Output_SOC "VBU0706/Function-Call Subsystem/Subsystem1/SOE/Subsystem2/Subsystem/Rate_Limit_and_Output_SOC" /begin REF_CHARACTERISTIC MILISECONDS_PER_SECOND /end REF_CHARACTERISTIC /end GROUP
/begin GROUP S1721_Calculate_ActualPower "VBU0706/Function-Call Subsystem/Subsystem1/SOF/Subsystem6/Subsystem/Calculate_ActualPower" /begin REF_CHARACTERISTIC FCC_STATE_CHARGING WATS_PER_KILOWAT /end REF_CHARACTERISTIC /end GROUP
/begin GROUP S1721_Calculate_PowerLimit "VBU0706/Function-Call Subsystem/Subsystem1/SOF/Subsystem6/Subsystem/Calculate_PowerLimit" /begin REF_CHARACTERISTIC WATS_PER_KILOWAT /end REF_CHARACTERISTIC /end GROUP
/begin GROUP S1721_Count_LowTempOverCurrent "VBU0706/Function-Call Subsystem/Subsystem1/SOF/Subsystem6/Subsystem/Count_LowTempOverCurrent" /begin REF_CHARACTERISTIC MILISECONDS_PER_SECOND /end REF_CHARACTERISTIC /end GROUP
/begin GROUP S1721_Rate_CurrentLimit "VBU0706/Function-Call Subsystem/Subsystem1/SOF/Subsystem6/Subsystem/Rate_CurrentLimit" /begin REF_CHARACTERISTIC MILISECONDS_PER_SECOND /end REF_CHARACTERISTIC /end GROUP
/begin GROUP S1721_Rate_PowerLimit "VBU0706/Function-Call Subsystem/Subsystem1/SOF/Subsystem6/Subsystem/Rate_PowerLimit" /begin REF_CHARACTERISTIC MILISECONDS_PER_SECOND /end REF_CHARACTERISTIC /end GROUP
/begin GROUP S1721_SOF_Diagnostic "VBU0706/Function-Call Subsystem/Subsystem1/SOF/Subsystem6/Subsystem/SOF_Diagnostic" /begin REF_CHARACTERISTIC MILISECONDS_PER_SECOND SOF_CHARGE_OVER_POWER_FAULT /end REF_CHARACTERISTIC /end GROUP
/begin GROUP S1954_Subsystem "VBU0706/Function-Call Subsystem/Subsystem1/SOH/Subsystem4/Subsystem1/Subsystem"
 /begin REF_CHARACTERISTIC FCC_STATE_CHARGE_FAULT FCC_STATE_CHARGE_FULL FCC_STATE_CHARGING VCT_CHARGE_STATE_CHARGING VCT_CHARGE_STATE_CHARGING_FAULT VCT_CHARGE_STATE_CHARGING_FULL VCT_CHARGE_STATE_NOT_CHARGING /end REF_CHARACTERISTIC
/end GROUP
/begin GROUP S2085_Charge_Mode_Temp_Request "VBU0706/Function-Call Subsystem/Subsystem1/THM/Subsystem/Subsystem/Charge_Mode_Temp_Request" /begin REF_CHARACTERISTIC BMM_STATE_FAST_CHARGE BMM_STATE_ONBOARD_CHARGE /end REF_CHARACTERISTIC /end GROUP
/begin GROUP S2085_Cooling_Request_Respond_Check "VBU0706/Function-Call Subsystem/Subsystem1/THM/Subsystem/Subsystem/Cooling_Request_Respond_Check" /begin REF_CHARACTERISTIC MILISECONDS_PER_SECOND /end REF_CHARACTERISTIC /end GROUP
/begin GROUP S2085_Thermal_System_Damage_Judgement "VBU0706/Function-Call Subsystem/Subsystem1/THM/Subsystem/Subsystem/Thermal_System_Damage_Judgement" /begin REF_CHARACTERISTIC MILISECONDS_PER_SECOND /end REF_CHARACTERISTIC /end GROUP
/begin GROUP S2085_Valid_Condition_Determination "VBU0706/Function-Call Subsystem/Subsystem1/THM/Subsystem/Subsystem/Valid_Condition_Determination" /begin REF_CHARACTERISTIC BMM_STATE_FAST_CHARGE BMM_STATE_ONBOARD_CHARGE /end REF_CHARACTERISTIC /end GROUP
/begin GROUP S2159_Determine_BMS_VCU_272 "VBU0706/Function-Call Subsystem/Subsystem1/VCT/Subsystem/Subsystem/Determine_BMS_VCU_272" /begin REF_CHARACTERISTIC SAMPLE_TIME_TASK_B /end REF_CHARACTERISTIC /end GROUP
/begin GROUP S316_Correct_BatteryCurrent "VBU0706/Function-Call Subsystem/Subsystem1/BCV/BCV/Subsystem/Calculate_BatteryCurrent/Correct_BatteryCurrent" /begin REF_CHARACTERISTIC SAMPLE_TIME_TASK_B /end REF_CHARACTERISTIC /end GROUP
/begin GROUP S317_Check_BatteryVoltage_Valid "VBU0706/Function-Call Subsystem/Subsystem1/BCV/BCV/Subsystem/Calculate_BatteryVoltage/Check_BatteryVoltage_Valid" /begin REF_CHARACTERISTIC SAMPLE_TIME_TASK_B /end REF_CHARACTERISTIC /end GROUP
/begin GROUP S317_Check_BusNegativeVoltage_Valid "VBU0706/Function-Call Subsystem/Subsystem1/BCV/BCV/Subsystem/Calculate_BatteryVoltage/Check_BusNegativeVoltage_Valid" /begin REF_CHARACTERISTIC SAMPLE_TIME_TASK_B /end REF_CHARACTERISTIC /end GROUP
/begin GROUP S317_Check_BusVoltage_Valid "VBU0706/Function-Call Subsystem/Subsystem1/BCV/BCV/Subsystem/Calculate_BatteryVoltage/Check_BusVoltage_Valid" /begin REF_CHARACTERISTIC SAMPLE_TIME_TASK_B /end REF_CHARACTERISTIC /end GROUP
/begin GROUP S317_Check_FuseVoltage_Valid "VBU0706/Function-Call Subsystem/Subsystem1/BCV/BCV/Subsystem/Calculate_BatteryVoltage/Check_FuseVoltage_Valid" /begin REF_CHARACTERISTIC SAMPLE_TIME_TASK_B /end REF_CHARACTERISTIC /end GROUP
/begin GROUP S317_Check_PrechargeVoltage_Valid "VBU0706/Function-Call Subsystem/Subsystem1/BCV/BCV/Subsystem/Calculate_BatteryVoltage/Check_PrechargeVoltage_Valid" /begin REF_CHARACTERISTIC SAMPLE_TIME_TASK_B /end REF_CHARACTERISTIC /end GROUP
/begin GROUP S317_Check_Vx1Voltage_Valid "VBU0706/Function-Call Subsystem/Subsystem1/BCV/BCV/Subsystem/Calculate_BatteryVoltage/Check_Vx1Voltage_Valid" /begin REF_CHARACTERISTIC SAMPLE_TIME_TASK_B /end REF_CHARACTERISTIC /end GROUP
/begin GROUP S317_Check_Vx2Voltage_Valid "VBU0706/Function-Call Subsystem/Subsystem1/BCV/BCV/Subsystem/Calculate_BatteryVoltage/Check_Vx2Voltage_Valid" /begin REF_CHARACTERISTIC SAMPLE_TIME_TASK_B /end REF_CHARACTERISTIC /end GROUP
/begin GROUP S318_Calculate_FuseProtect_Counter "VBU0706/Function-Call Subsystem/Subsystem1/BCV/BCV/Subsystem/Calculate_Lifetime_Data/Calculate_FuseProtect_Counter" /begin REF_CHARACTERISTIC SAMPLE_TIME_TASK_B /end REF_CHARACTERISTIC /end GROUP
/begin GROUP S318_Calculate_LifeTimeCoulomb "VBU0706/Function-Call Subsystem/Subsystem1/BCV/BCV/Subsystem/Calculate_Lifetime_Data/Calculate_LifeTimeCoulomb" /begin REF_CHARACTERISTIC MILISECONDS_PER_SECOND SAMPLE_TIME_TASK_B /end REF_CHARACTERISTIC /end GROUP
/begin GROUP S320_Diagnose_VoltageCurrent_Fault "VBU0706/Function-Call Subsystem/Subsystem1/BCV/BCV/Subsystem/Diagnose_BCV_Data_Fault/Diagnose_VoltageCurrent_Fault"
 /begin REF_CHARACTERISTIC BCV_BATTERY_OVER_CURRENT_FAULT BCV_BATTERY_OVER_VOLTAGE_FAULT BCV_BATTERY_OVER_VOLTAGE_WARNING_FAULT SAMPLE_TIME_TASK_B /end REF_CHARACTERISTIC
/end GROUP
/begin GROUP S331_Diagnose_BDM_FastChargeContactorOverCurrentAlarm "VBU0706/Function-Call Subsystem/Subsystem1/BCV/BCV/Subsystem/Monitor_BCV_Performance/Diagnose_BDM_FastChargeContactorOverCurrentAlarm" /begin REF_CHARACTERISTIC SAMPLE_TIME_TASK_B /end REF_CHARACTERISTIC /end GROUP
/begin GROUP S564_DetermineSOCBalance_EnableCondition "VBU0706/Function-Call Subsystem/Subsystem1/CBL/Subsystem8/Subsystem/Balance_EnableCondition/DetermineSOCBalance_EnableCondition" /begin REF_CHARACTERISTIC MILISECONDS_PER_SECOND /end REF_CHARACTERISTIC /end GROUP
/begin GROUP S564_DetermineVoltaageBalance_EnableCondition "VBU0706/Function-Call Subsystem/Subsystem1/CBL/Subsystem8/Subsystem/Balance_EnableCondition/DetermineVoltaageBalance_EnableCondition" /begin REF_CHARACTERISTIC MILISECONDS_PER_SECOND /end REF_CHARACTERISTIC /end GROUP
/begin GROUP S651_DetermineRatioPEUtoBat "VBU0706/Function-Call Subsystem/Subsystem1/CTD/Subsystem/Subsystem4/DiagnoseRelayWeld/DetermineRatioPEUtoBat" /begin REF_CHARACTERISTIC ONE_HUNDRED_PERCENT /end REF_CHARACTERISTIC /end GROUP
/begin GROUP S651_MNC_Weld_Check "VBU0706/Function-Call Subsystem/Subsystem1/CTD/Subsystem/Subsystem4/DiagnoseRelayWeld/MNC_Weld_Check" /begin REF_CHARACTERISTIC CTD_MAIN_NEGATIVE_CONTACTOR_WELD_FAULT ONE_HUNDRED_PERCENT /end REF_CHARACTERISTIC /end GROUP
/begin GROUP S651_MPC_Weld_Check "VBU0706/Function-Call Subsystem/Subsystem1/CTD/Subsystem/Subsystem4/DiagnoseRelayWeld/MPC_Weld_Check" /begin REF_CHARACTERISTIC CTD_MAIN_POSITIVE_CONTACTOR_WELD_FAULT /end REF_CHARACTERISTIC /end GROUP
/begin GROUP S655_CONTACTOR_STATUS_CLOSED1 "VBU0706/Function-Call Subsystem/Subsystem1/CTD/Subsystem/Subsystem4/Precharge_Resistance_Diagnostic/CONTACTOR_STATUS_CLOSED1" /begin REF_CHARACTERISTIC CTD_MAIN_CONTACTOR_STATUS_CLOSED /end REF_CHARACTERISTIC /end GROUP
/begin GROUP S655_CONTACTOR_STATUS_OPENED1 "VBU0706/Function-Call Subsystem/Subsystem1/CTD/Subsystem/Subsystem4/Precharge_Resistance_Diagnostic/CONTACTOR_STATUS_OPENED1" /begin REF_CHARACTERISTIC CTD_MAIN_CONTACTOR_STATUS_OPENED /end REF_CHARACTERISTIC /end GROUP
/begin GROUP S656_Determine_Precharge_Timer "VBU0706/Function-Call Subsystem/Subsystem1/CTD/Subsystem/Subsystem4/PrechrgProcessMonitoring/Determine_Precharge_Timer" /begin REF_CHARACTERISTIC SAMPLE_TIME_TASK_B /end REF_CHARACTERISTIC /end GROUP
/begin GROUP S656_Determine_Ratio_BusVBatV "VBU0706/Function-Call Subsystem/Subsystem1/CTD/Subsystem/Subsystem4/PrechrgProcessMonitoring/Determine_Ratio_BusVBatV" /begin REF_CHARACTERISTIC ONE_HUNDRED_PERCENT /end REF_CHARACTERISTIC /end GROUP
/begin GROUP S656_Precharge_Timeout_Diagnostic "VBU0706/Function-Call Subsystem/Subsystem1/CTD/Subsystem/Subsystem4/PrechrgProcessMonitoring/Precharge_Timeout_Diagnostic" /begin REF_CHARACTERISTIC CTD_PRECHARG_TIMEOUT_FAULT /end REF_CHARACTERISTIC /end GROUP
/begin GROUP S657_MPR_Stuck_Open "VBU0706/Function-Call Subsystem/Subsystem1/CTD/Subsystem/Subsystem4/Stuck_Open_Diagnostic/MPR_Stuck_Open" /begin REF_CHARACTERISTIC CTD_PRECHARGE_RELAY_STUCK_OPEN_FAULT /end REF_CHARACTERISTIC /end GROUP
/begin GROUP S657_StuckOpenAssistantConditons "VBU0706/Function-Call Subsystem/Subsystem1/CTD/Subsystem/Subsystem4/Stuck_Open_Diagnostic/StuckOpenAssistantConditons" /begin REF_CHARACTERISTIC SAMPLE_TIME_TASK_B /end REF_CHARACTERISTIC /end GROUP
/begin GROUP S897_Energy_Protection_Check "VBU0706/Function-Call Subsystem/Subsystem1/CTS/CTS/Subsystem/DeterminePrechargeConditions/Energy_Protection_Check" /begin REF_CHARACTERISTIC BMM_STATE_DRIVE_MODE /end REF_CHARACTERISTIC /end GROUP
/begin GROUP S897_SoC_Initialization_Check "VBU0706/Function-Call Subsystem/Subsystem1/CTS/CTS/Subsystem/DeterminePrechargeConditions/SoC_Initialization_Check" /begin REF_CHARACTERISTIC MILISECONDS_PER_SECOND SAMPLE_TIME_TASK_B /end REF_CHARACTERISTIC /end GROUP
/begin GROUP S898_Close_Comamnd "VBU0706/Function-Call Subsystem/Subsystem1/CTS/CTS/Subsystem/Determine_Contactor_Request/Close_Comamnd"
 /begin REF_CHARACTERISTIC BMM_STATE_DRIVE_MODE BMM_STATE_FAST_CHARGE BMM_STATE_ONBOARD_CHARGE SAMPLE_TIME_TASK_B /end REF_CHARACTERISTIC
/end GROUP
/begin GROUP S898_Open_Comamnd "VBU0706/Function-Call Subsystem/Subsystem1/CTS/CTS/Subsystem/Determine_Contactor_Request/Open_Comamnd" /begin REF_CHARACTERISTIC BMM_STATE_FAST_CHARGE /end REF_CHARACTERISTIC /end GROUP
/begin GROUP S1158_Calculate_FastChargeBaseRemainTime "VBU0706/Function-Call Subsystem/Subsystem1/FCC /FCC/Subsystem/Calculate_Fastcharge_Time/Calculate_FastChargeBaseRemainTime" /begin REF_CHARACTERISTIC ONE_HUNDRED_PERCENT /end REF_CHARACTERISTIC /end GROUP
/begin GROUP S1158_EightyPercentCustomSOC_CaculateChargeTime "VBU0706/Function-Call Subsystem/Subsystem1/FCC /FCC/Subsystem/Calculate_Fastcharge_Time/EightyPercentCustomSOC_CaculateChargeTime" /begin REF_CHARACTERISTIC ONE_HUNDRED_PERCENT /end REF_CHARACTERISTIC /end GROUP
/begin GROUP S1158_EightyPercentCustomSOC_EnableInvalidChargeTimeFlag "VBU0706/Function-Call Subsystem/Subsystem1/FCC /FCC/Subsystem/Calculate_Fastcharge_Time/EightyPercentCustomSOC_EnableInvalidChargeTimeFlag" /begin REF_CHARACTERISTIC BMM_STATE_FAST_CHARGE /end REF_CHARACTERISTIC /end GROUP
/begin GROUP S1158_EightyPercentCustomSOC_UpdateChargeTimeFlag "VBU0706/Function-Call Subsystem/Subsystem1/FCC /FCC/Subsystem/Calculate_Fastcharge_Time/EightyPercentCustomSOC_UpdateChargeTimeFlag" /begin REF_CHARACTERISTIC BMM_STATE_FAST_CHARGE MILISECONDS_PER_SECOND /end REF_CHARACTERISTIC /end GROUP
/begin GROUP S1158_SendInvalidTime_flg "VBU0706/Function-Call Subsystem/Subsystem1/FCC /FCC/Subsystem/Calculate_Fastcharge_Time/SendInvalidTime_flg" /begin REF_CHARACTERISTIC BMM_STATE_FAST_CHARGE /end REF_CHARACTERISTIC /end GROUP
/begin GROUP S1158_UpdateTimeTrigger "VBU0706/Function-Call Subsystem/Subsystem1/FCC /FCC/Subsystem/Calculate_Fastcharge_Time/UpdateTimeTrigger" /begin REF_CHARACTERISTIC BMM_STATE_FAST_CHARGE MILISECONDS_PER_SECOND /end REF_CHARACTERISTIC /end GROUP
/begin GROUP S1159_Charge_Request_Protection "VBU0706/Function-Call Subsystem/Subsystem1/FCC /FCC/Subsystem/Determine_Fastcharge_Request/Charge_Request_Protection" /begin REF_CHARACTERISTIC CcSYS_CellVoltageMaxLimit_mV MILISECONDS_PER_SECOND /end REF_CHARACTERISTIC /end GROUP
/begin GROUP S1159_Determine_Base_ChargeRequest "VBU0706/Function-Call Subsystem/Subsystem1/FCC /FCC/Subsystem/Determine_Fastcharge_Request/Determine_Base_ChargeRequest" /begin REF_CHARACTERISTIC FCC_STATE_CHARGING /end REF_CHARACTERISTIC /end GROUP
/begin GROUP S1159_Determine_DiagnosedAndLimitedChargeRequestCurrent "VBU0706/Function-Call Subsystem/Subsystem1/FCC /FCC/Subsystem/Determine_Fastcharge_Request/Determine_DiagnosedAndLimitedChargeRequestCurrent" /begin REF_CHARACTERISTIC WATS_PER_KILOWAT /end REF_CHARACTERISTIC /end GROUP
/begin GROUP S1456_Determine_OCV_Criteria "VBU0706/Function-Call Subsystem/Subsystem1/OCV/OCV/Subsystem/Determine_Criteria/Determine_OCV_Criteria" /begin REF_CHARACTERISTIC CTD_MAIN_CONTACTOR_STATUS_OPENED /end REF_CHARACTERISTIC /end GROUP
/begin GROUP S1456_Determine_QOCV_Criteria "VBU0706/Function-Call Subsystem/Subsystem1/OCV/OCV/Subsystem/Determine_Criteria/Determine_QOCV_Criteria" /begin REF_CHARACTERISTIC CTD_MAIN_CONTACTOR_STATUS_CLOSED /end REF_CHARACTERISTIC /end GROUP
/begin GROUP S1493_Determine_AhIntegral_Capacity "VBU0706/Function-Call Subsystem/Subsystem1/SOC/Subsystem5/Subsystem/Determine_AhIntegral_SoC/Determine_AhIntegral_Capacity" /begin REF_CHARACTERISTIC MILISECONDS_PER_SECOND /end REF_CHARACTERISTIC /end GROUP
/begin GROUP S1493_Determine_AhIntegral_SOC "VBU0706/Function-Call Subsystem/Subsystem1/SOC/Subsystem5/Subsystem/Determine_AhIntegral_SoC/Determine_AhIntegral_SOC" /begin REF_CHARACTERISTIC ONE_HUNDRED_PERCENT /end REF_CHARACTERISTIC /end GROUP
/begin GROUP S1498_Determine_BatterySOC_ChangeRate "VBU0706/Function-Call Subsystem/Subsystem1/SOC/Subsystem5/Subsystem/Determine_Display_SOC/Determine_BatterySOC_ChangeRate" /begin REF_CHARACTERISTIC MILISECONDS_PER_SECOND ONE_HUNDRED_PERCENT /end REF_CHARACTERISTIC /end GROUP
/begin GROUP S1498_DisplaySOC_Driving_Calculation "VBU0706/Function-Call Subsystem/Subsystem1/SOC/Subsystem5/Subsystem/Determine_Display_SOC/DisplaySOC_Driving_Calculation" /begin REF_CHARACTERISTIC BMM_STATE_FAST_CHARGE /end REF_CHARACTERISTIC /end GROUP
/begin GROUP S1499_Determine_InternalResistanceCausedDevCellVoltage "VBU0706/Function-Call Subsystem/Subsystem1/SOC/Subsystem5/Subsystem/Determine_FastChargeCorrection_Soc/Determine_InternalResistanceCausedDevCellVoltage" /begin REF_CHARACTERISTIC BMM_STATE_FAST_CHARGE /end REF_CHARACTERISTIC /end GROUP
/begin GROUP S1499_FastCharge_PreCorrection "VBU0706/Function-Call Subsystem/Subsystem1/SOC/Subsystem5/Subsystem/Determine_FastChargeCorrection_Soc/FastCharge_PreCorrection" /begin REF_CHARACTERISTIC BMM_STATE_FAST_CHARGE /end REF_CHARACTERISTIC /end GROUP
/begin GROUP S1499_FastCharge_TopofChargeCorrection "VBU0706/Function-Call Subsystem/Subsystem1/SOC/Subsystem5/Subsystem/Determine_FastChargeCorrection_Soc/FastCharge_TopofChargeCorrection" /begin REF_CHARACTERISTIC BMM_STATE_FAST_CHARGE /end REF_CHARACTERISTIC /end GROUP
/begin GROUP S1670_Determine_History_Current_Data "VBU0706/Function-Call Subsystem/Subsystem1/SOE/Subsystem2/Subsystem/Calculate_History_Average_Current/Determine_History_Current_Data" /begin REF_CHARACTERISTIC MILISECONDS_PER_SECOND /end REF_CHARACTERISTIC /end GROUP
/begin GROUP S1670_Time_Counter "VBU0706/Function-Call Subsystem/Subsystem1/SOE/Subsystem2/Subsystem/Calculate_History_Average_Current/Time_Counter" /begin REF_CHARACTERISTIC MILISECONDS_PER_SECOND NUMBER_OF_PARALLEL_MODULES /end REF_CHARACTERISTIC /end GROUP
/begin GROUP S1671_Charge_and_Idle_Mode "VBU0706/Function-Call Subsystem/Subsystem1/SOE/Subsystem2/Subsystem/Calculate_Pack_Remaining_Energy/Charge_and_Idle_Mode" /begin REF_CHARACTERISTIC CcSYS_NominalCellCapacity_Ah ONE_HUNDRED_PERCENT /end REF_CHARACTERISTIC /end GROUP
/begin GROUP S1671_Discharge_Mode "VBU0706/Function-Call Subsystem/Subsystem1/SOE/Subsystem2/Subsystem/Calculate_Pack_Remaining_Energy/Discharge_Mode" /begin REF_CHARACTERISTIC ONE_HUNDRED_PERCENT /end REF_CHARACTERISTIC /end GROUP
/begin GROUP S1723_Calculate_Pack_OCV "VBU0706/Function-Call Subsystem/Subsystem1/SOF/Subsystem6/Subsystem/Calculate_PowerLimit/Calculate_Pack_OCV" /begin REF_CHARACTERISTIC NUMBER_OF_PARALLEL_MODULES /end REF_CHARACTERISTIC /end GROUP
/begin GROUP S1726_FCC_CHARGE_MODE1 "VBU0706/Function-Call Subsystem/Subsystem1/SOF/Subsystem6/Subsystem/Rate_CurrentLimit/FCC_CHARGE_MODE1" /begin REF_CHARACTERISTIC BMM_STATE_FAST_CHARGE /end REF_CHARACTERISTIC /end GROUP
/begin GROUP S1955_Calculate_MinCellCapacity274_SlowCharge "VBU0706/Function-Call Subsystem/Subsystem1/SOH/Subsystem4/Subsystem1/Calculate_Capacity/Calculate_MinCellCapacity274_SlowCharge" /begin REF_CHARACTERISTIC CcSYS_NominalCellCapacity_Ah ONE_HUNDRED_PERCENT /end REF_CHARACTERISTIC /end GROUP
/begin GROUP S1956_Compute_Resistance_Request "VBU0706/Function-Call Subsystem/Subsystem1/SOH/Subsystem4/Subsystem1/Calculate_Resistance/Compute_Resistance_Request" /begin REF_CHARACTERISTIC CcSYS_NominalCellCapacity_Ah /end REF_CHARACTERISTIC /end GROUP
/begin GROUP S2166_CONTACTOR_STATUS_CLOSED1 "VBU0706/Function-Call Subsystem/Subsystem1/VCT/Subsystem/Subsystem/Determine_BMS_VCU_34/CONTACTOR_STATUS_CLOSED1" /begin REF_CHARACTERISTIC CTD_MAIN_CONTACTOR_STATUS_CLOSED /end REF_CHARACTERISTIC /end GROUP
/begin GROUP S2166_CONTACTOR_STATUS_CLOSED2 "VBU0706/Function-Call Subsystem/Subsystem1/VCT/Subsystem/Subsystem/Determine_BMS_VCU_34/CONTACTOR_STATUS_CLOSED2" /begin REF_CHARACTERISTIC CTD_MAIN_CONTACTOR_STATUS_CLOSED /end REF_CHARACTERISTIC /end GROUP
/begin GROUP S2166_CONTACTOR_STATUS_CLOSED3 "VBU0706/Function-Call Subsystem/Subsystem1/VCT/Subsystem/Subsystem/Determine_BMS_VCU_34/CONTACTOR_STATUS_CLOSED3" /begin REF_CHARACTERISTIC CTD_MAIN_CONTACTOR_STATUS_CLOSED /end REF_CHARACTERISTIC /end GROUP
/begin GROUP S2166_CONTACTOR_STATUS_CLOSED4 "VBU0706/Function-Call Subsystem/Subsystem1/VCT/Subsystem/Subsystem/Determine_BMS_VCU_34/CONTACTOR_STATUS_CLOSED4" /begin REF_CHARACTERISTIC CTD_MAIN_CONTACTOR_STATUS_CLOSED /end REF_CHARACTERISTIC /end GROUP
/begin GROUP S2166_CONTACTOR_STATUS_OPENED2 "VBU0706/Function-Call Subsystem/Subsystem1/VCT/Subsystem/Subsystem/Determine_BMS_VCU_34/CONTACTOR_STATUS_OPENED2" /begin REF_CHARACTERISTIC CTD_MAIN_CONTACTOR_STATUS_OPENED /end REF_CHARACTERISTIC /end GROUP
/begin GROUP S2168_FCC_CHARGE_MODE1 "VBU0706/Function-Call Subsystem/Subsystem1/VCT/Subsystem/Subsystem/Determine_BMS_VCU_AC/FCC_CHARGE_MODE1" /begin REF_CHARACTERISTIC BMM_STATE_FAST_CHARGE /end REF_CHARACTERISTIC /end GROUP
/begin GROUP S467_Diagnose_BdmVoltageCurrent_Fault "VBU0706/Function-Call Subsystem/Subsystem1/BCV/BCV/Subsystem/Monitor_BCV_Performance/Diagnose_BDM_BCV_Data_Fault/Diagnose_BdmVoltageCurrent_Fault"
 /begin REF_CHARACTERISTIC BCV_BATTERY_OVER_CURRENT_FAULT BCV_BATTERY_OVER_VOLTAGE_FAULT /end REF_CHARACTERISTIC
/end GROUP
/begin GROUP S663_CONTACTOR_STATUS_OPENED1 "VBU0706/Function-Call Subsystem/Subsystem1/CTD/Subsystem/Subsystem4/DiagnoseRelayWeld/MNC_Weld_Check/CONTACTOR_STATUS_OPENED1" /begin REF_CHARACTERISTIC CTD_MAIN_CONTACTOR_STATUS_OPENED /end REF_CHARACTERISTIC /end GROUP
/begin GROUP S664_CONTACTOR_STATUS_OPENED "VBU0706/Function-Call Subsystem/Subsystem1/CTD/Subsystem/Subsystem4/DiagnoseRelayWeld/MPC_Weld_Check/CONTACTOR_STATUS_OPENED" /begin REF_CHARACTERISTIC CTD_MAIN_CONTACTOR_STATUS_OPENED /end REF_CHARACTERISTIC /end GROUP
/begin GROUP S664_CONTACTOR_STATUS_OPENED1 "VBU0706/Function-Call Subsystem/Subsystem1/CTD/Subsystem/Subsystem4/DiagnoseRelayWeld/MPC_Weld_Check/CONTACTOR_STATUS_OPENED1" /begin REF_CHARACTERISTIC CTD_MAIN_CONTACTOR_STATUS_OPENED /end REF_CHARACTERISTIC /end GROUP
/begin GROUP S730_Determine_Precharge_JouleHeat "VBU0706/Function-Call Subsystem/Subsystem1/CTD/Subsystem/Subsystem4/PrechrgProcessMonitoring/Precharge_Thermal_Management/Determine_Precharge_JouleHeat" /begin REF_CHARACTERISTIC MILISECONDS_PER_SECOND SAMPLE_TIME_TASK_B /end REF_CHARACTERISTIC /end GROUP
/begin GROUP S730_Perform_OverEnergy_Diagnostic "VBU0706/Function-Call Subsystem/Subsystem1/CTD/Subsystem/Subsystem4/PrechrgProcessMonitoring/Precharge_Thermal_Management/Perform_OverEnergy_Diagnostic" /begin REF_CHARACTERISTIC CTD_PRECHARGE_ENERGY_HIGH_FAULT /end REF_CHARACTERISTIC /end GROUP
/begin GROUP S752_MNC_Stuck_Open_Without_VehicleSpeed "VBU0706/Function-Call Subsystem/Subsystem1/CTD/Subsystem/Subsystem4/Stuck_Open_Diagnostic/MNC_Stuck_Open/MNC_Stuck_Open_Without_VehicleSpeed" /begin REF_CHARACTERISTIC CTD_PARKING_MAIN_NEGATIVE_CONTACTOR_STUCK_OPEN_FAULT /end REF_CHARACTERISTIC /end GROUP
/begin GROUP S753_MPC_Stuck_Open_Within_VehicleSpeed "VBU0706/Function-Call Subsystem/Subsystem1/CTD/Subsystem/Subsystem4/Stuck_Open_Diagnostic/MPC_Stuck_Open/MPC_Stuck_Open_Within_VehicleSpeed" /begin REF_CHARACTERISTIC CTD_PARKING_MAIN_POSITIVE_CONTACTOR_STUCK_OPEN_FAULT /end REF_CHARACTERISTIC /end GROUP
/begin GROUP S754_CONTACTOR_STATUS_CLOSED1 "VBU0706/Function-Call Subsystem/Subsystem1/CTD/Subsystem/Subsystem4/Stuck_Open_Diagnostic/MPR_Stuck_Open/CONTACTOR_STATUS_CLOSED1" /begin REF_CHARACTERISTIC CTD_MAIN_CONTACTOR_STATUS_CLOSED /end REF_CHARACTERISTIC /end GROUP
/begin GROUP S869_CellTemp_ChangeRate_Calculate "VBU0706/Function-Call Subsystem/Subsystem1/CTM/CTM/Subsystem/Determine_Thermal_Runaway/DetermineTempRiseRate/CellTemp_ChangeRate_Calculate" /begin REF_CHARACTERISTIC MILISECONDS_PER_SECOND /end REF_CHARACTERISTIC /end GROUP
/begin GROUP S1214_Decrease_ChargeCurrentRequest "VBU0706/Function-Call Subsystem/Subsystem1/FCC /FCC/Subsystem/Determine_Fastcharge_Request/Charge_Request_Protection/Decrease_ChargeCurrentRequest" /begin REF_CHARACTERISTIC FCC_STATE_CHARGING MILISECONDS_PER_SECOND /end REF_CHARACTERISTIC /end GROUP
/begin GROUP S1214_Override_Voltage_Request "VBU0706/Function-Call Subsystem/Subsystem1/FCC /FCC/Subsystem/Determine_Fastcharge_Request/Charge_Request_Protection/Override_Voltage_Request" /begin REF_CHARACTERISTIC CcSYS_CellVoltageMaxLimit_mV MILIVOLTAGES_PER_VOLTAGE /end REF_CHARACTERISTIC /end GROUP
/begin GROUP S1215_Determine_ComputeResistanceCondition "VBU0706/Function-Call Subsystem/Subsystem1/FCC /FCC/Subsystem/Determine_Fastcharge_Request/DetermineComputeResistancePulseCurrent/Determine_ComputeResistanceCondition" /begin REF_CHARACTERISTIC FCC_STATE_CHARGING /end REF_CHARACTERISTIC /end GROUP
/begin GROUP S1215_Determine_ComputeResistancePulseRequest "VBU0706/Function-Call Subsystem/Subsystem1/FCC /FCC/Subsystem/Determine_Fastcharge_Request/DetermineComputeResistancePulseCurrent/Determine_ComputeResistancePulseRequest" /begin REF_CHARACTERISTIC WATS_PER_KILOWAT /end REF_CHARACTERISTIC /end GROUP
/begin GROUP S1216_Request_At_Charging "VBU0706/Function-Call Subsystem/Subsystem1/FCC /FCC/Subsystem/Determine_Fastcharge_Request/Determine_Base_ChargeRequest/Request_At_Charging"
 /begin REF_CHARACTERISTIC CcSYS_CellVoltageMaxLimit_mV MILIVOLTAGES_PER_VOLTAGE WATS_PER_KILOWAT /end REF_CHARACTERISTIC
/end GROUP
/begin GROUP S1216_Request_At_NoCharging "VBU0706/Function-Call Subsystem/Subsystem1/FCC /FCC/Subsystem/Determine_Fastcharge_Request/Determine_Base_ChargeRequest/Request_At_NoCharging"
 /begin REF_CHARACTERISTIC CcSYS_CellVoltageMaxLimit_mV MILIVOLTAGES_PER_VOLTAGE WATS_PER_KILOWAT /end REF_CHARACTERISTIC
/end GROUP
/begin GROUP S1248_Cell_Temp_Protection "VBU0706/Function-Call Subsystem/Subsystem1/FCC /FCC/Subsystem/Fastcharge_Conditions_Check/Condition_Categorize/Cell_Temp_Protection" /begin REF_CHARACTERISTIC MILISECONDS_PER_SECOND /end REF_CHARACTERISTIC /end GROUP
/begin GROUP S1248_Voltage_Protection "VBU0706/Function-Call Subsystem/Subsystem1/FCC /FCC/Subsystem/Fastcharge_Conditions_Check/Condition_Categorize/Voltage_Protection"
 /begin REF_CHARACTERISTIC CcSYS_CellVoltageMaxLimit_mV MILISECONDS_PER_SECOND MILIVOLTAGES_PER_VOLTAGE /end REF_CHARACTERISTIC
/end GROUP
/begin GROUP S1518_Determine_Cell_Balanced_Capacity "VBU0706/Function-Call Subsystem/Subsystem1/SOC/Subsystem5/Subsystem/Determine_AhIntegral_SoC/Determine_AhIntegral_Capacity/Determine_Cell_Balanced_Capacity" /begin REF_CHARACTERISTIC MILISECONDS_PER_SECOND ONE_HUNDRED_PERCENT /end REF_CHARACTERISTIC /end GROUP
/begin GROUP S1520_CONTACTOR_STATUS_OPENED1 "VBU0706/Function-Call Subsystem/Subsystem1/SOC/Subsystem5/Subsystem/Determine_AhIntegral_SoC/Determine_Module_Current/CONTACTOR_STATUS_OPENED1" /begin REF_CHARACTERISTIC CTD_MAIN_CONTACTOR_STATUS_OPENED /end REF_CHARACTERISTIC /end GROUP
/begin GROUP S1554_Determine_SOC_RateLimit "VBU0706/Function-Call Subsystem/Subsystem1/SOC/Subsystem5/Subsystem/Determine_Display_SOC/DisplaySOC_Driving_Calculation/Determine_SOC_RateLimit" /begin REF_CHARACTERISTIC BMM_STATE_DRIVE_MODE /end REF_CHARACTERISTIC /end GROUP
/begin GROUP S1578_FastCharge_DynamicCorrection_Enable "VBU0706/Function-Call Subsystem/Subsystem1/SOC/Subsystem5/Subsystem/Determine_FastChargeCorrection_Soc/FastCharge_DynamicCorrection/FastCharge_DynamicCorrection_Enable" /begin REF_CHARACTERISTIC CcSYS_NominalCellCapacity_Ah /end REF_CHARACTERISTIC /end GROUP
/begin GROUP S1615_Battery_SOC_Calculation "VBU0706/Function-Call Subsystem/Subsystem1/SOC/Subsystem5/Subsystem/Determine_Initial_SoC/CellSOC_Startup_AbnormalReset/Battery_SOC_Calculation" /begin REF_CHARACTERISTIC ONE_HUNDRED_PERCENT /end REF_CHARACTERISTIC /end GROUP
/begin GROUP S1617_Battery_SOC_Calculation "VBU0706/Function-Call Subsystem/Subsystem1/SOC/Subsystem5/Subsystem/Determine_Initial_SoC/CellSOC_Startup_Normal/Battery SOC Calculation" /begin REF_CHARACTERISTIC ONE_HUNDRED_PERCENT /end REF_CHARACTERISTIC /end GROUP
/begin GROUP S1682_Calculate_Energy_Retention_Factor "VBU0706/Function-Call Subsystem/Subsystem1/SOE/Subsystem2/Subsystem/Calculate_Pack_Remaining_Energy/Discharge_Mode/Calculate_Energy_Retention_Factor" /begin REF_CHARACTERISTIC ONE_HUNDRED_PERCENT /end REF_CHARACTERISTIC /end GROUP
/begin GROUP S1682_Calculate_Remaining_Energy "VBU0706/Function-Call Subsystem/Subsystem1/SOE/Subsystem2/Subsystem/Calculate_Pack_Remaining_Energy/Discharge_Mode/Calculate_Remaining_Energy" /begin REF_CHARACTERISTIC CcSYS_NominalCellCapacity_Ah ONE_HUNDRED_PERCENT /end REF_CHARACTERISTIC /end GROUP
/begin GROUP S1682_Predict_SOC_End "VBU0706/Function-Call Subsystem/Subsystem1/SOE/Subsystem2/Subsystem/Calculate_Pack_Remaining_Energy/Discharge_Mode/Predict_SOC_End" /begin REF_CHARACTERISTIC ONE_HUNDRED_PERCENT /end REF_CHARACTERISTIC /end GROUP
/begin GROUP S1729_Calculate_Locked_SOC "VBU0706/Function-Call Subsystem/Subsystem1/SOF/Subsystem6/Subsystem/Calculate_PowerLimit/Calculate_Pack_OCV/Calculate_Locked_SOC" /begin REF_CHARACTERISTIC ONE_HUNDRED_PERCENT /end REF_CHARACTERISTIC /end GROUP
/begin GROUP S1729_Rate_Limiter "VBU0706/Function-Call Subsystem/Subsystem1/SOF/Subsystem6/Subsystem/Calculate_PowerLimit/Calculate_Pack_OCV/Rate_Limiter" /begin REF_CHARACTERISTIC MILISECONDS_PER_SECOND /end REF_CHARACTERISTIC /end GROUP
/begin GROUP S1731_Calculate_Locked_SOC "VBU0706/Function-Call Subsystem/Subsystem1/SOF/Subsystem6/Subsystem/Calculate_PowerLimit/Determine_SOCP_PowerLimit/Calculate_Locked_SOC" /begin REF_CHARACTERISTIC ONE_HUNDRED_PERCENT /end REF_CHARACTERISTIC /end GROUP
/begin GROUP S1761_Calculate_CurrentLimit_Base "VBU0706/Function-Call Subsystem/Subsystem1/SOF/Subsystem6/Subsystem/Determine_Currentlimit_Target/Calculate_CurrentLimit_Target/Calculate_CurrentLimit_Base" /begin REF_CHARACTERISTIC MILISECONDS_PER_SECOND /end REF_CHARACTERISTIC /end GROUP
/begin GROUP S1961_CellCapacity_Limit "VBU0706/Function-Call Subsystem/Subsystem1/SOH/Subsystem4/Subsystem1/Calculate_Capacity/Calculate_CellCapacity/CellCapacity_Limit" /begin REF_CHARACTERISTIC CcSYS_NominalCellCapacity_Ah /end REF_CHARACTERISTIC /end GROUP
/begin GROUP S1961_Determine_PackSoh "VBU0706/Function-Call Subsystem/Subsystem1/SOH/Subsystem4/Subsystem1/Calculate_Capacity/Calculate_CellCapacity/Determine_PackSoh" /begin REF_CHARACTERISTIC CcSYS_NominalCellCapacity_Ah ONE_HUNDRED_PERCENT /end REF_CHARACTERISTIC /end GROUP
/begin GROUP S1962_Caculate_CellCapacity "VBU0706/Function-Call Subsystem/Subsystem1/SOH/Subsystem4/Subsystem1/Calculate_Capacity/Calculate_CellCapacity_SlowCharge/Caculate_CellCapacity" /begin REF_CHARACTERISTIC ONE_HUNDRED_PERCENT /end REF_CHARACTERISTIC /end GROUP
/begin GROUP S1964_Determine_SlowCharge "VBU0706/Function-Call Subsystem/Subsystem1/SOH/Subsystem4/Subsystem1/Calculate_Capacity/Determine_CalculateCellCapacity_Condition/Determine_SlowCharge" /begin REF_CHARACTERISTIC VCT_CHARGE_STATE_CHARGING /end REF_CHARACTERISTIC /end GROUP
/begin GROUP S1964_Determine_SlowChargeEnd "VBU0706/Function-Call Subsystem/Subsystem1/SOH/Subsystem4/Subsystem1/Calculate_Capacity/Determine_CalculateCellCapacity_Condition/Determine_SlowChargeEnd" /begin REF_CHARACTERISTIC VCT_CHARGE_STATE_CHARGING /end REF_CHARACTERISTIC /end GROUP
/begin GROUP S1964_Determine_SlowChargeStart "VBU0706/Function-Call Subsystem/Subsystem1/SOH/Subsystem4/Subsystem1/Calculate_Capacity/Determine_CalculateCellCapacity_Condition/Determine_SlowChargeStart" /begin REF_CHARACTERISTIC VCT_CHARGE_STATE_CHARGING /end REF_CHARACTERISTIC /end GROUP
/begin GROUP S2030_ResistanceCalc_Check "VBU0706/Function-Call Subsystem/Subsystem1/SOH/Subsystem4/Subsystem1/Calculate_Resistance/BasicCellResistance_Calculation_Check/ResistanceCalc_Check" /begin REF_CHARACTERISTIC VCT_CHARGE_STATE_CHARGING /end REF_CHARACTERISTIC /end GROUP
/begin GROUP S2032_CONTACTOR_STATUS_CLOSED "VBU0706/Function-Call Subsystem/Subsystem1/SOH/Subsystem4/Subsystem1/Calculate_Resistance/Calculate_ModuleCurrent/CONTACTOR_STATUS_CLOSED" /begin REF_CHARACTERISTIC CTD_MAIN_CONTACTOR_STATUS_CLOSED /end REF_CHARACTERISTIC /end GROUP
/begin GROUP S2096_Determine_InletTemp_Validation "VBU0706/Function-Call Subsystem/Subsystem1/THM/Subsystem/Subsystem/Calculate_PipeTemperature/Determine_CoolantSensorTemp_Validation/Determine_InletTemp_Validation" /begin REF_CHARACTERISTIC MILISECONDS_PER_SECOND /end REF_CHARACTERISTIC /end GROUP
/begin GROUP S2096_Determine_OutletTemp_Validation "VBU0706/Function-Call Subsystem/Subsystem1/THM/Subsystem/Subsystem/Calculate_PipeTemperature/Determine_CoolantSensorTemp_Validation/Determine_OutletTemp_Validation" /begin REF_CHARACTERISTIC MILISECONDS_PER_SECOND /end REF_CHARACTERISTIC /end GROUP
/begin GROUP S336_Calculate_Current_ZeroDruft "VBU0706/Function-Call Subsystem/Subsystem1/BCV/BCV/Subsystem/Calculate_BatteryCurrent/Correct_BatteryCurrent/Calculate_BatteryCurrent_ZeroDrift/Calculate_Current_ZeroDruft" /begin REF_CHARACTERISTIC SAMPLE_TIME_TASK_B /end REF_CHARACTERISTIC /end GROUP
/begin GROUP S756_CONTACTOR_STATUS_CLOSED1 "VBU0706/Function-Call Subsystem/Subsystem1/CTD/Subsystem/Subsystem4/Stuck_Open_Diagnostic/MNC_Stuck_Open/MNC_Stuck_Open_With_VehicleSpeed/CONTACTOR_STATUS_CLOSED1" /begin REF_CHARACTERISTIC CTD_MAIN_CONTACTOR_STATUS_CLOSED /end REF_CHARACTERISTIC /end GROUP
/begin GROUP S757_CONTACTOR_STATUS_CLOSED1 "VBU0706/Function-Call Subsystem/Subsystem1/CTD/Subsystem/Subsystem4/Stuck_Open_Diagnostic/MNC_Stuck_Open/MNC_Stuck_Open_Without_VehicleSpeed/CONTACTOR_STATUS_CLOSED1" /begin REF_CHARACTERISTIC CTD_MAIN_CONTACTOR_STATUS_CLOSED /end REF_CHARACTERISTIC /end GROUP
/begin GROUP S779_CONTACTOR_STATUS_CLOSED1 "VBU0706/Function-Call Subsystem/Subsystem1/CTD/Subsystem/Subsystem4/Stuck_Open_Diagnostic/MPC_Stuck_Open/MPC_Stuck_Open_Within_VehicleSpeed/CONTACTOR_STATUS_CLOSED1" /begin REF_CHARACTERISTIC CTD_MAIN_CONTACTOR_STATUS_CLOSED /end REF_CHARACTERISTIC /end GROUP
/begin GROUP S780_CONTACTOR_STATUS_CLOSED1 "VBU0706/Function-Call Subsystem/Subsystem1/CTD/Subsystem/Subsystem4/Stuck_Open_Diagnostic/MPC_Stuck_Open/MPC_Stuck_Open_Without_VehicleSpeed/CONTACTOR_STATUS_CLOSED1" /begin REF_CHARACTERISTIC CTD_MAIN_CONTACTOR_STATUS_CLOSED /end REF_CHARACTERISTIC /end GROUP
/begin GROUP S1257_FullCharge_criteria1 "VBU0706/Function-Call Subsystem/Subsystem1/FCC /FCC/Subsystem/Fastcharge_Conditions_Check/Condition_Categorize/Full_Charge_Determination/FullCharge_criteria1" /begin REF_CHARACTERISTIC MILISECONDS_PER_SECOND /end REF_CHARACTERISTIC /end GROUP
/begin GROUP S1257_FullCharge_criteria2 "VBU0706/Function-Call Subsystem/Subsystem1/FCC /FCC/Subsystem/Fastcharge_Conditions_Check/Condition_Categorize/Full_Charge_Determination/FullCharge_criteria2"
 /begin REF_CHARACTERISTIC MILISECONDS_PER_SECOND MILIVOLTAGES_PER_VOLTAGE NUMBER_OF_PARALLEL_CELLS_PER_MODULE NUMBER_OF_PARALLEL_MODULES /end REF_CHARACTERISTIC
/end GROUP
/begin GROUP S1257_FullCharge_criteria4 "VBU0706/Function-Call Subsystem/Subsystem1/FCC /FCC/Subsystem/Fastcharge_Conditions_Check/Condition_Categorize/Full_Charge_Determination/FullCharge_criteria4" /begin REF_CHARACTERISTIC MILISECONDS_PER_SECOND /end REF_CHARACTERISTIC /end GROUP
/begin GROUP S1588_Determine_CurrentStable_Condition "VBU0706/Function-Call Subsystem/Subsystem1/SOC/Subsystem5/Subsystem/Determine_FastChargeCorrection_Soc/FastCharge_DynamicCorrection/FastCharge_DynamicCorrection_Enable/Determine_CurrentStable_Condition" /begin REF_CHARACTERISTIC ONE_HUNDRED_PERCENT /end REF_CHARACTERISTIC /end GROUP
/begin GROUP S1765_FastChrgOneThirdRateCurrentLimitCheck "VBU0706/Function-Call Subsystem/Subsystem1/SOF/Subsystem6/Subsystem/Determine_Currentlimit_Target/Calculate_CurrentLimit_Target/CurrentLimit_FastCharge_Check/FastChrgOneThirdRateCurrentLimitCheck" /begin REF_CHARACTERISTIC MILISECONDS_PER_SECOND /end REF_CHARACTERISTIC /end GROUP
/begin GROUP S1766_Determine_StopCharge_Condition "VBU0706/Function-Call Subsystem/Subsystem1/SOF/Subsystem6/Subsystem/Determine_Currentlimit_Target/Calculate_CurrentLimit_Target/CurrentLimit_Fault_Correct/Determine_StopCharge_Condition" /begin REF_CHARACTERISTIC MILISECONDS_PER_SECOND /end REF_CHARACTERISTIC /end GROUP
/begin GROUP S1768_ClvLookUp1 "VBU0706/Function-Call Subsystem/Subsystem1/SOF/Subsystem6/Subsystem/Determine_Currentlimit_Target/Calculate_CurrentLimit_Target/FastChrgCurr1/ClvLookUp1" /begin REF_CHARACTERISTIC FCC_STATE_CHARGING /end REF_CHARACTERISTIC /end GROUP
/begin GROUP S1768_ClvLookUp2 "VBU0706/Function-Call Subsystem/Subsystem1/SOF/Subsystem6/Subsystem/Determine_Currentlimit_Target/Calculate_CurrentLimit_Target/FastChrgCurr1/ClvLookUp2" /begin REF_CHARACTERISTIC FCC_STATE_CHARGING /end REF_CHARACTERISTIC /end GROUP
/begin GROUP S1966_Caculate_WeightingLifeTimeCharge "VBU0706/Function-Call Subsystem/Subsystem1/SOH/Subsystem4/Subsystem1/Calculate_Capacity/Calculate_CellCapacity/Caculate_CellCapacity_LifeTimeQ/Caculate_WeightingLifeTimeCharge" /begin REF_CHARACTERISTIC ONE_HUNDRED_PERCENT /end REF_CHARACTERISTIC /end GROUP
/begin GROUP S1967_LimittedByNVMvalue "VBU0706/Function-Call Subsystem/Subsystem1/SOH/Subsystem4/Subsystem1/Calculate_Capacity/Calculate_CellCapacity/CellCapacity_Limit/LimittedByNVMvalue" /begin REF_CHARACTERISTIC CcSYS_NominalCellCapacity_Ah ONE_HUNDRED_PERCENT /end REF_CHARACTERISTIC /end GROUP
/begin GROUP S2000_Determine_AhIntegral_Q "VBU0706/Function-Call Subsystem/Subsystem1/SOH/Subsystem4/Subsystem1/Calculate_Capacity/Calculate_CellCapacity_SlowCharge/Determine_AhIntegral_DeltaQ/Determine_AhIntegral_Q" /begin REF_CHARACTERISTIC MILISECONDS_PER_SECOND /end REF_CHARACTERISTIC /end GROUP
/begin GROUP S2000_Determine_Module_Current "VBU0706/Function-Call Subsystem/Subsystem1/SOH/Subsystem4/Subsystem1/Calculate_Capacity/Calculate_CellCapacity_SlowCharge/Determine_AhIntegral_DeltaQ/Determine_Module_Current" /begin REF_CHARACTERISTIC NUMBER_OF_PARALLEL_MODULES /end REF_CHARACTERISTIC /end GROUP
/begin GROUP S2022_OBC_CHARGE_MODE1 "VBU0706/Function-Call Subsystem/Subsystem1/SOH/Subsystem4/Subsystem1/Calculate_Capacity/Determine_CalculateCellCapacity_Condition/Determine_SlowCharge/OBC_CHARGE_MODE1" /begin REF_CHARACTERISTIC BMM_STATE_ONBOARD_CHARGE /end REF_CHARACTERISTIC /end GROUP
/begin GROUP S2055_Determine_FCCPulseCurrent_Condition "VBU0706/Function-Call Subsystem/Subsystem1/SOH/Subsystem4/Subsystem1/Calculate_Resistance/Determine_Condition_Calculate_Pulse_Average_CurrentVoltage/Determine_Condition/Determine_FCCPulseCurrent_Condition" /begin REF_CHARACTERISTIC NUMBER_OF_PARALLEL_MODULES ONE_HUNDRED_PERCENT /end REF_CHARACTERISTIC /end GROUP
/begin GROUP S2097_Determinate_InletTempValidationDelay "VBU0706/Function-Call Subsystem/Subsystem1/THM/Subsystem/Subsystem/Calculate_PipeTemperature/Determine_CoolantSensorTemp_Validation/Determine_InletTemp_Validation/Determinate_InletTempValidationDelay" /begin REF_CHARACTERISTIC MILISECONDS_PER_SECOND /end REF_CHARACTERISTIC /end GROUP
/begin GROUP S2098_Determinate_OutletTempValidationDelay "VBU0706/Function-Call Subsystem/Subsystem1/THM/Subsystem/Subsystem/Calculate_PipeTemperature/Determine_CoolantSensorTemp_Validation/Determine_OutletTemp_Validation/Determinate_OutletTempValidationDelay" /begin REF_CHARACTERISTIC MILISECONDS_PER_SECOND /end REF_CHARACTERISTIC /end GROUP
/begin GROUP S338_Enabled_Subsystem "VBU0706/Function-Call Subsystem/Subsystem1/BCV/BCV/Subsystem/Calculate_BatteryCurrent/Correct_BatteryCurrent/Calculate_BatteryCurrent_ZeroDrift/Calculate_Current_ZeroDruft/Enabled_Subsystem" /begin REF_CHARACTERISTIC SAMPLE_TIME_TASK_B /end REF_CHARACTERISTIC /end GROUP
/begin GROUP S736_Determine_Accumulated_Cooling "VBU0706/Function-Call Subsystem/Subsystem1/CTD/Subsystem/Subsystem4/PrechrgProcessMonitoring/Precharge_Thermal_Management/Determine_Precharge_JouleHeat/Determine_Accumulated_RemainingHeat/Determine_Accumulated_Cooling" /begin REF_CHARACTERISTIC MILISECONDS_PER_SECOND SAMPLE_TIME_TASK_B /end REF_CHARACTERISTIC /end GROUP
/begin GROUP S1769_Calculate_Locked_SOC "VBU0706/Function-Call Subsystem/Subsystem1/SOF/Subsystem6/Subsystem/Determine_Currentlimit_Target/Calculate_CurrentLimit_Target/Calculate_CurrentLimit_Base/Calculate_ContinuousChargeCurrent/Calculate_Locked_SOC" /begin REF_CHARACTERISTIC ONE_HUNDRED_PERCENT /end REF_CHARACTERISTIC /end GROUP
/begin GROUP S1769_Calculate_Locked_SOC1 "VBU0706/Function-Call Subsystem/Subsystem1/SOF/Subsystem6/Subsystem/Determine_Currentlimit_Target/Calculate_CurrentLimit_Target/Calculate_CurrentLimit_Base/Calculate_ContinuousChargeCurrent/Calculate_Locked_SOC1" /begin REF_CHARACTERISTIC ONE_HUNDRED_PERCENT /end REF_CHARACTERISTIC /end GROUP
/begin GROUP S1769_Calculate_Locked_SOC2 "VBU0706/Function-Call Subsystem/Subsystem1/SOF/Subsystem6/Subsystem/Determine_Currentlimit_Target/Calculate_CurrentLimit_Target/Calculate_CurrentLimit_Base/Calculate_ContinuousChargeCurrent/Calculate_Locked_SOC2" /begin REF_CHARACTERISTIC ONE_HUNDRED_PERCENT /end REF_CHARACTERISTIC /end GROUP
/begin GROUP S1770_Calculate_Locked_SOC "VBU0706/Function-Call Subsystem/Subsystem1/SOF/Subsystem6/Subsystem/Determine_Currentlimit_Target/Calculate_CurrentLimit_Target/Calculate_CurrentLimit_Base/Calculate_ContinuousDischargeCurrent/Calculate_Locked_SOC" /begin REF_CHARACTERISTIC ONE_HUNDRED_PERCENT /end REF_CHARACTERISTIC /end GROUP
/begin GROUP S1770_Calculate_Locked_SOC1 "VBU0706/Function-Call Subsystem/Subsystem1/SOF/Subsystem6/Subsystem/Determine_Currentlimit_Target/Calculate_CurrentLimit_Target/Calculate_CurrentLimit_Base/Calculate_ContinuousDischargeCurrent/Calculate_Locked_SOC1" /begin REF_CHARACTERISTIC ONE_HUNDRED_PERCENT /end REF_CHARACTERISTIC /end GROUP
/begin GROUP S1771_Calculate_Locked_SOC "VBU0706/Function-Call Subsystem/Subsystem1/SOF/Subsystem6/Subsystem/Determine_Currentlimit_Target/Calculate_CurrentLimit_Target/Calculate_CurrentLimit_Base/Calculate_ShortPulseChargeCurrent/Calculate_Locked_SOC" /begin REF_CHARACTERISTIC ONE_HUNDRED_PERCENT /end REF_CHARACTERISTIC /end GROUP
/begin GROUP S1771_Calculate_Locked_SOC1 "VBU0706/Function-Call Subsystem/Subsystem1/SOF/Subsystem6/Subsystem/Determine_Currentlimit_Target/Calculate_CurrentLimit_Target/Calculate_CurrentLimit_Base/Calculate_ShortPulseChargeCurrent/Calculate_Locked_SOC1" /begin REF_CHARACTERISTIC ONE_HUNDRED_PERCENT /end REF_CHARACTERISTIC /end GROUP
/begin GROUP S1772_Calculate_Locked_SOC "VBU0706/Function-Call Subsystem/Subsystem1/SOF/Subsystem6/Subsystem/Determine_Currentlimit_Target/Calculate_CurrentLimit_Target/Calculate_CurrentLimit_Base/Calculate_ShortPulseDischargeCurrent/Calculate_Locked_SOC" /begin REF_CHARACTERISTIC ONE_HUNDRED_PERCENT /end REF_CHARACTERISTIC /end GROUP
/begin GROUP S1772_Calculate_Locked_SOC1 "VBU0706/Function-Call Subsystem/Subsystem1/SOF/Subsystem6/Subsystem/Determine_Currentlimit_Target/Calculate_CurrentLimit_Target/Calculate_CurrentLimit_Base/Calculate_ShortPulseDischargeCurrent/Calculate_Locked_SOC1" /begin REF_CHARACTERISTIC ONE_HUNDRED_PERCENT /end REF_CHARACTERISTIC /end GROUP
/begin GROUP S1835_FCC_CHARGE_MODE1 "VBU0706/Function-Call Subsystem/Subsystem1/SOF/Subsystem6/Subsystem/Determine_Currentlimit_Target/Calculate_CurrentLimit_Target/CurrentLimit_FastCharge_Check/FastChrgOneThirdRateCurrentLimitCheck/FCC_CHARGE_MODE1" /begin REF_CHARACTERISTIC BMM_STATE_FAST_CHARGE /end REF_CHARACTERISTIC /end GROUP
/begin GROUP S1836_FCC_CHARGE_MODE1 "VBU0706/Function-Call Subsystem/Subsystem1/SOF/Subsystem6/Subsystem/Determine_Currentlimit_Target/Calculate_CurrentLimit_Target/CurrentLimit_FastCharge_Check/SegmentChargeCheck/FCC_CHARGE_MODE1" /begin REF_CHARACTERISTIC BMM_STATE_FAST_CHARGE /end REF_CHARACTERISTIC /end GROUP
/begin GROUP S1871_Calculate_CurrentLimit "VBU0706/Function-Call Subsystem/Subsystem1/SOF/Subsystem6/Subsystem/Determine_Currentlimit_Target/Calculate_CurrentLimit_Target/CurrentLimit_Voltage_Correct/Correct_CurrentLimit/Calculate_CurrentLimit"
 /begin REF_CHARACTERISTIC BMM_STATE_FAST_CHARGE MILISECONDS_PER_SECOND MILIVOLTAGES_PER_VOLTAGE /end REF_CHARACTERISTIC
/end GROUP
/begin GROUP S2006_Determine_Cell_Balanced_Capacity "VBU0706/Function-Call Subsystem/Subsystem1/SOH/Subsystem4/Subsystem1/Calculate_Capacity/Calculate_CellCapacity_SlowCharge/Determine_AhIntegral_DeltaQ/Determine_AhIntegral_Q/Determine_Cell_Balanced_Capacity" /begin REF_CHARACTERISTIC MILISECONDS_PER_SECOND ONE_HUNDRED_PERCENT /end REF_CHARACTERISTIC /end GROUP
/begin GROUP S2007_CONTACTOR_STATUS_OPENED1 "VBU0706/Function-Call Subsystem/Subsystem1/SOH/Subsystem4/Subsystem1/Calculate_Capacity/Calculate_CellCapacity_SlowCharge/Determine_AhIntegral_DeltaQ/Determine_Module_Current/CONTACTOR_STATUS_OPENED1" /begin REF_CHARACTERISTIC CTD_MAIN_CONTACTOR_STATUS_OPENED /end REF_CHARACTERISTIC /end GROUP
/begin GROUP S2011_CONTACTOR_STATUS_OPENED1 "VBU0706/Function-Call Subsystem/Subsystem1/SOH/Subsystem4/Subsystem1/Calculate_Capacity/Calculate_CellCapacity_SlowCharge/Determine_Soc/Determine_Module_Current/CONTACTOR_STATUS_OPENED1" /begin REF_CHARACTERISTIC CTD_MAIN_CONTACTOR_STATUS_OPENED /end REF_CHARACTERISTIC /end GROUP
/begin GROUP S344_Calculate_Current_Sum "VBU0706/Function-Call Subsystem/Subsystem1/BCV/BCV/Subsystem/Calculate_BatteryCurrent/Correct_BatteryCurrent/Calculate_BatteryCurrent_ZeroDrift/Calculate_ExtremeData/Enabled_Subsystem/Calculate_Current_Sum" /begin REF_CHARACTERISTIC SAMPLE_TIME_TASK_B /end REF_CHARACTERISTIC /end GROUP
/begin GROUP S1816_Calculate_ChargeCurrentLimitBuffer_Use "VBU0706/Function-Call Subsystem/Subsystem1/SOF/Subsystem6/Subsystem/Determine_Currentlimit_Target/Calculate_CurrentLimit_Target/Calculate_Dynamic_CurrentLimit/Calculate_Dynamic_ChargeCurrentLimit/Calculate_ChargeCurrentLimit_Buff/Calculate_ChargeCurrentLimitBuffer_Use" /begin REF_CHARACTERISTIC MILISECONDS_PER_SECOND /end REF_CHARACTERISTIC /end GROUP
/begin GROUP S1824_Calculate_DischargeCurrentLimitBuffer_Use "VBU0706/Function-Call Subsystem/Subsystem1/SOF/Subsystem6/Subsystem/Determine_Currentlimit_Target/Calculate_CurrentLimit_Target/Calculate_Dynamic_CurrentLimit/Calculate_Dynamic_DischargeCurrentLimit/Calculate_DischargeCurrentLimit_Buff/Calculate_DischargeCurrentLimitBuffer_Use" /begin REF_CHARACTERISTIC MILISECONDS_PER_SECOND /end REF_CHARACTERISTIC /end GROUP
/begin GROUP S1825_Rate_Limiter "VBU0706/Function-Call Subsystem/Subsystem1/SOF/Subsystem6/Subsystem/Determine_Currentlimit_Target/Calculate_CurrentLimit_Target/Calculate_Dynamic_CurrentLimit/Calculate_Dynamic_DischargeCurrentLimit/Calculate_Dynamic_DischargeCurrentLimit/Rate_Limiter" /begin REF_CHARACTERISTIC MILISECONDS_PER_SECOND /end REF_CHARACTERISTIC /end GROUP
/begin GROUP S1873_BatteryVoltageAveCalculate "VBU0706/Function-Call Subsystem/Subsystem1/SOF/Subsystem6/Subsystem/Determine_Currentlimit_Target/Calculate_CurrentLimit_Target/CurrentLimit_Voltage_Correct/Correct_CurrentLimit/Calculate_CurrentLimit/BatteryVoltageAveCalculate" /begin REF_CHARACTERISTIC MILIVOLTAGES_PER_VOLTAGE /end REF_CHARACTERISTIC /end GROUP
/begin GROUP S1873_Rate_Limiter1 "VBU0706/Function-Call Subsystem/Subsystem1/SOF/Subsystem6/Subsystem/Determine_Currentlimit_Target/Calculate_CurrentLimit_Target/CurrentLimit_Voltage_Correct/Correct_CurrentLimit/Calculate_CurrentLimit/Rate_Limiter1" /begin REF_CHARACTERISTIC MILISECONDS_PER_SECOND /end REF_CHARACTERISTIC /end GROUP
/begin GROUP S1876_Calculate_DCIR_Validation "VBU0706/Function-Call Subsystem/Subsystem1/SOF/Subsystem6/Subsystem/Determine_Currentlimit_Target/Calculate_CurrentLimit_Target/CurrentLimit_Voltage_Correct/Correct_CurrentLimit/Calculate_CurrentLimit/Calculate_Cell_Discharge_DCIR/Calculate_DCIR_Validation" /begin REF_CHARACTERISTIC ONE_HUNDRED_PERCENT /end REF_CHARACTERISTIC /end GROUP
/include "EEPROM.a2l"
/include "LegionOS.a2l"
/include "Tlf35584.a2l"
/include "VersionInfo.a2l"
/include "uds_basic.a2l"
/end MODULE
/end PROJECT
/* (add any file trailer comments here) */ /* EOF VBU0706.a2l */
