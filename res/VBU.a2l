ASAP2_VERSION 1 31
/begin PROJECT ProjectName "Project Comment Goes Here"
/begin HEADER "Header Comments go here" /end HEADER
/begin MODULE ModuleName "Module Comment Goes Here"
/begin MOD_COMMON "Mod Common Comment Here" ALIGNMENT_WORD 1 ALIGNMENT_LONG 1 ALIGNMENT_FLOAT32_IEEE 1 ALIGNMENT_FLOAT64_IEEE 1 BYTE_ORDER MSB_LAST /end MOD_COMMON
/begin RECORD_LAYOUT Scalar_BOOLEAN FNC_VALUES 1 UBYTE COLUMN_DIR DIRECT /end RECORD_LAYOUT
/begin RECORD_LAYOUT Scalar_UBYTE FNC_VALUES 1 UBYTE COLUMN_DIR DIRECT /end RECORD_LAYOUT
/begin RECORD_LAYOUT Scalar_UWORD FNC_VALUES 1 UWORD COLUMN_DIR DIRECT /end RECORD_LAYOUT
/begin RECORD_LAYOUT Scalar_SWORD FNC_VALUES 1 SWORD COLUMN_DIR DIRECT /end RECORD_LAYOUT
/begin RECORD_LAYOUT Scalar_ULONG FNC_VALUES 1 ULONG COLUMN_DIR DIRECT /end RECORD_LAYOUT
/begin RECORD_LAYOUT Scalar_FLOAT32_IEEE FNC_VALUES 1 FLOAT32_IEEE COLUMN_DIR DIRECT /end RECORD_LAYOUT
/begin RECORD_LAYOUT Lookup1D_FLOAT32_IEEE FNC_VALUES 1 FLOAT32_IEEE COLUMN_DIR DIRECT /end RECORD_LAYOUT
/begin RECORD_LAYOUT Lookup1D_X_FLOAT32_IEEE AXIS_PTS_X 1 FLOAT32_IEEE INDEX_INCR DIRECT /end RECORD_LAYOUT
/begin RECORD_LAYOUT Lookup2D_UBYTE FNC_VALUES 1 UBYTE COLUMN_DIR DIRECT /end RECORD_LAYOUT
/begin RECORD_LAYOUT Lookup2D_X_UBYTE AXIS_PTS_X 1 UBYTE INDEX_INCR DIRECT /end RECORD_LAYOUT
/begin RECORD_LAYOUT Lookup2D_BYTE FNC_VALUES 1 SBYTE COLUMN_DIR DIRECT /end RECORD_LAYOUT
/begin RECORD_LAYOUT Lookup2D_X_BYTE AXIS_PTS_X 1 SBYTE INDEX_INCR DIRECT /end RECORD_LAYOUT
/begin RECORD_LAYOUT Lookup2D_X_UWORD AXIS_PTS_X 1 UWORD INDEX_INCR DIRECT /end RECORD_LAYOUT
/begin RECORD_LAYOUT Lookup2D_FLOAT32_IEEE FNC_VALUES 1 FLOAT32_IEEE COLUMN_DIR DIRECT /end RECORD_LAYOUT
/begin RECORD_LAYOUT Lookup2D_X_FLOAT32_IEEE AXIS_PTS_X 1 FLOAT32_IEEE INDEX_INCR DIRECT /end RECORD_LAYOUT
/begin AXIS_PTS CaTHM_PackSohMapX_pct "" 0x7000189a NO_INPUT_QUANTITY Lookup1D_X_FLOAT32_IEEE 0 VBU0706_CM_single_cnt 5 0.0 100.0 /end AXIS_PTS
/begin AXIS_PTS CaTHM_CellTempMaxMapX_C "" 0x70001a5e CTM_tCellTempMax Lookup2D_X_FLOAT32_IEEE 0 VBU0706_CM_single_cnt 6 -40.0 80.0 /end AXIS_PTS
/begin AXIS_PTS CaTHM_CellSocMaxMapY_pct "" 0x7000184a SOC_pctCellSocMax Lookup2D_X_FLOAT32_IEEE 0 VBU0706_CM_single_cnt 5 0.0 100.0 /end AXIS_PTS
/begin CHARACTERISTIC CaFCC_VCRVCUAuxPowerFactorVoltageTempMapZ_nbr "" MAP 0x70002984 Lookup2D_FLOAT32_IEEE 0 VBU0706_CM_single_cnt -3.4028234663852886E+38 3.4028234663852886E+38
 /begin AXIS_DESCR COM_AXIS CVT_mvCellVoltageMin VBU0706_CM_uint16_cnt 3 0.0 65535.0 AXIS_PTS_REF CaFCC_VCRVCUAuxPowerFactorVoltageTempMapY_mV /end AXIS_DESCR
 /begin AXIS_DESCR COM_AXIS CTM_tCellTempMin VBU0706_CM_single_cnt 4 -3.4028234663852886E+38 3.4028234663852886E+38 AXIS_PTS_REF CaFCC_VCRVCUAuxPowerFactorVoltageTempMapX_C /end AXIS_DESCR
/end CHARACTERISTIC
/begin AXIS_PTS CaFCC_VCRVCUAuxPowerFactorVoltageTempMapX_C "" 0x700015f6 CTM_tCellTempMin Lookup2D_X_FLOAT32_IEEE 0 VBU0706_CM_single_cnt 4 -3.4028234663852886E+38 3.4028234663852886E+38 /end AXIS_PTS
/begin AXIS_PTS CaFCC_VCRVCUAuxPowerFactorVoltageTempMapY_mV "" 0x700013d0 CVT_mvCellVoltageMin Lookup2D_X_UWORD 0 VBU0706_CM_uint16_cnt 3 0.0 65535.0 /end AXIS_PTS
/begin CHARACTERISTIC CaSOC_BatteryDisplaySocDischargeDecRateY_n "" CURVE 0x7000176e Lookup1D_FLOAT32_IEEE 0 VBU0706_CM_single_cnt -3.4028234663852886E+38 3.4028234663852886E+38
 /begin AXIS_DESCR COM_AXIS SOC_pctBatterySoc VBU0706_CM_single_cnt 5 -3.4028234663852886E+38 3.4028234663852886E+38 AXIS_PTS_REF CaSOC_BatteryDisplaySocDischargeDecRateX_pct /end AXIS_DESCR
/end CHARACTERISTIC
/begin AXIS_PTS CaSOC_BatteryDisplaySocDischargeDecRateX_pct "" 0x7000175a SOC_pctBatterySoc Lookup1D_X_FLOAT32_IEEE 0 VBU0706_CM_single_cnt 5 -3.4028234663852886E+38 3.4028234663852886E+38 /end AXIS_PTS
/begin CHARACTERISTIC CaSOC_BatteryDisplaySocDischargeIncRateY_n "" CURVE 0x70001796 Lookup1D_FLOAT32_IEEE 0 VBU0706_CM_single_cnt -3.4028234663852886E+38 3.4028234663852886E+38
 /begin AXIS_DESCR COM_AXIS SOC_pctBatterySoc VBU0706_CM_single_cnt 5 -3.4028234663852886E+38 3.4028234663852886E+38 AXIS_PTS_REF CaSOC_BatteryDisplaySocDischargeIncRateX_pct /end AXIS_DESCR
/end CHARACTERISTIC
/begin AXIS_PTS CaSOC_BatteryDisplaySocDischargeIncRateX_pct "" 0x70001782 SOC_pctBatterySoc Lookup1D_X_FLOAT32_IEEE 0 VBU0706_CM_single_cnt 5 -3.4028234663852886E+38 3.4028234663852886E+38 /end AXIS_PTS
/begin CHARACTERISTIC CaSOC_SOCDisChargeIncOffsetY_n "" CURVE 0x70001a2e Lookup1D_FLOAT32_IEEE 0 VBU0706_CM_single_cnt -3.4028234663852886E+38 3.4028234663852886E+38
 /begin AXIS_DESCR COM_AXIS SOC_pctBatterySoc VBU0706_CM_single_cnt 6 -3.4028234663852886E+38 3.4028234663852886E+38 AXIS_PTS_REF CaSOC_SOCDisChargeIncOffsetX_pct /end AXIS_DESCR
/end CHARACTERISTIC
/begin AXIS_PTS CaSOC_SOCDisChargeIncOffsetX_pct "" 0x70001a16 SOC_pctBatterySoc Lookup1D_X_FLOAT32_IEEE 0 VBU0706_CM_single_cnt 6 -3.4028234663852886E+38 3.4028234663852886E+38 /end AXIS_PTS
/begin CHARACTERISTIC CaSOC_SOCDisChargeDecOffsetY_n "" CURVE 0x700019fe Lookup1D_FLOAT32_IEEE 0 VBU0706_CM_single_cnt -3.4028234663852886E+38 3.4028234663852886E+38
 /begin AXIS_DESCR COM_AXIS SOC_pctBatterySoc VBU0706_CM_single_cnt 6 -3.4028234663852886E+38 3.4028234663852886E+38 AXIS_PTS_REF CaSOC_SOCDisChargeDecOffsetX_pct /end AXIS_DESCR
/end CHARACTERISTIC
/begin AXIS_PTS CaSOC_SOCDisChargeDecOffsetX_pct "" 0x700019e6 SOC_pctBatterySoc Lookup1D_X_FLOAT32_IEEE 0 VBU0706_CM_single_cnt 6 -3.4028234663852886E+38 3.4028234663852886E+38 /end AXIS_PTS
/begin CHARACTERISTIC CaSOE_SocOcvMapZ_mV "" MAP 0x7000526c Lookup2D_FLOAT32_IEEE 0 VBU0706_CM_single_cnt 2500.0 3800.0
 /begin AXIS_DESCR COM_AXIS NO_INPUT_QUANTITY VBU0706_CM_single_cnt 11 0.0 100.0 AXIS_PTS_REF CaSOE_SocOcvMapY_pct /end AXIS_DESCR
 /begin AXIS_DESCR COM_AXIS CTM_tCellTempAve VBU0706_CM_single_cnt 9 -40.0 80.0 AXIS_PTS_REF CaSOE_SocOcvMapX_C /end AXIS_DESCR
/end CHARACTERISTIC
/begin AXIS_PTS CaSOE_SocOcvMapX_C "" 0x7000211a CTM_tCellTempAve Lookup2D_X_FLOAT32_IEEE 0 VBU0706_CM_single_cnt 9 -40.0 80.0 /end AXIS_PTS
/begin AXIS_PTS CaSOE_SocOcvMapY_pct "" 0x70002612 NO_INPUT_QUANTITY Lookup2D_X_FLOAT32_IEEE 0 VBU0706_CM_single_cnt 11 0.0 100.0 /end AXIS_PTS
/begin CHARACTERISTIC CaSOE_SocResistanceLongMapZ_mohm "" MAP 0x700053f8 Lookup2D_FLOAT32_IEEE 0 VBU0706_CM_single_cnt -3.4028234663852886E+38 3.4028234663852886E+38
 /begin AXIS_DESCR COM_AXIS NO_INPUT_QUANTITY VBU0706_CM_single_cnt 11 -3.4028234663852886E+38 3.4028234663852886E+38 AXIS_PTS_REF CaSOE_SocResistanceLongMapY_pct /end AXIS_DESCR
 /begin AXIS_DESCR COM_AXIS CTM_tCellTempAve VBU0706_CM_single_cnt 9 -3.4028234663852886E+38 3.4028234663852886E+38 AXIS_PTS_REF CaSOE_SocResistanceLongMapX_C /end AXIS_DESCR
/end CHARACTERISTIC
/begin AXIS_PTS CaSOE_SocResistanceLongMapX_C "" 0x7000213e CTM_tCellTempAve Lookup2D_X_FLOAT32_IEEE 0 VBU0706_CM_single_cnt 9 -3.4028234663852886E+38 3.4028234663852886E+38 /end AXIS_PTS
/begin AXIS_PTS CaSOE_SocResistanceLongMapY_pct "" 0x7000263e NO_INPUT_QUANTITY Lookup2D_X_FLOAT32_IEEE 0 VBU0706_CM_single_cnt 11 -3.4028234663852886E+38 3.4028234663852886E+38 /end AXIS_PTS
/begin CHARACTERISTIC CaSOH_CellCapacity_Ah "" CURVE 0x70002f04 Lookup1D_FLOAT32_IEEE 0 VBU0706_CM_single_cnt -3.4028234663852886E+38 3.4028234663852886E+38
 /begin AXIS_DESCR COM_AXIS NO_INPUT_QUANTITY VBU0706_CM_single_cnt 13 -3.4028234663852886E+38 3.4028234663852886E+38 AXIS_PTS_REF CaSOH_LifeTimeDischarge_Ah /end AXIS_DESCR
/end CHARACTERISTIC
/begin AXIS_PTS CaSOH_LifeTimeDischarge_Ah "" 0x70002f6c NO_INPUT_QUANTITY Lookup1D_X_FLOAT32_IEEE 0 VBU0706_CM_single_cnt 13 -3.4028234663852886E+38 3.4028234663852886E+38 /end AXIS_PTS
/begin CHARACTERISTIC CaSOH_LifeTimeDischargeLookUp_Ah "" CURVE 0x70002f38 Lookup1D_FLOAT32_IEEE 0 VBU0706_CM_single_cnt -3.4028234663852886E+38 3.4028234663852886E+38
 /begin AXIS_DESCR COM_AXIS NO_INPUT_QUANTITY VBU0706_CM_single_cnt 13 -3.4028234663852886E+38 3.4028234663852886E+38 AXIS_PTS_REF CaSOH_CellCapacityLookUp_Ah /end AXIS_DESCR
/end CHARACTERISTIC
/begin AXIS_PTS CaSOH_CellCapacityLookUp_Ah "" 0x70002ed0 NO_INPUT_QUANTITY Lookup1D_X_FLOAT32_IEEE 0 VBU0706_CM_single_cnt 13 -3.4028234663852886E+38 3.4028234663852886E+38 /end AXIS_PTS
/begin CHARACTERISTIC CaTHM_ObcSohFactorMapY_n "" CURVE 0x70001886 Lookup1D_FLOAT32_IEEE 0 VBU0706_CM_single_cnt 0.0 1.0
 /begin AXIS_DESCR COM_AXIS NO_INPUT_QUANTITY VBU0706_CM_single_cnt 5 0.0 100.0 AXIS_PTS_REF CaTHM_PackSohMapX_pct /end AXIS_DESCR
/end CHARACTERISTIC
/begin CHARACTERISTIC CaTHM_ObcHighSocRequestTempMapZ_C "" MAP 0x70004798 Lookup2D_FLOAT32_IEEE 0 VBU0706_CM_single_cnt -40.0 80.0
 /begin AXIS_DESCR COM_AXIS SOC_pctCellSocMax VBU0706_CM_single_cnt 5 0.0 100.0 AXIS_PTS_REF CaTHM_CellSocMaxMapY_pct /end AXIS_DESCR
 /begin AXIS_DESCR COM_AXIS CTM_tCellTempMax VBU0706_CM_single_cnt 6 -40.0 80.0 AXIS_PTS_REF CaTHM_CellTempMaxMapX_C /end AXIS_DESCR
/end CHARACTERISTIC
/begin CHARACTERISTIC DSPL_numRngCalcDch_CUR_v "" CURVE 0x70001524 Lookup1D_FLOAT32_IEEE 0 VBU0706_CM_single_cnt 0.0 1.0E+10
 /begin AXIS_DESCR COM_AXIS NO_INPUT_QUANTITY VBU0706_CM_single_A 3 -1000.0 1000.0 AXIS_PTS_REF DSPL_iBattDch_CUR_x /end AXIS_DESCR
/end CHARACTERISTIC
/begin AXIS_PTS DSPL_iBattDch_CUR_x "" 0x70001518 NO_INPUT_QUANTITY Lookup1D_X_FLOAT32_IEEE 0 VBU0706_CM_single_A 3 -1000.0 1000.0 /end AXIS_PTS
/begin CHARACTERISTIC EDIS_pwrChrgCurrntOverDelta_CUR_v "" CURVE 0x700014ce Lookup1D_FLOAT32_IEEE 0 VBU0706_CM_single_cnt -3.4028234663852886E+38 3.4028234663852886E+38
 /begin AXIS_DESCR COM_AXIS NO_INPUT_QUANTITY VBU0706_CM_single_cnt 2 -3.4028234663852886E+38 3.4028234663852886E+38 AXIS_PTS_REF EDIS_iChrgCurrntOverDelta_CUR_x /end AXIS_DESCR
/end CHARACTERISTIC
/begin AXIS_PTS EDIS_iChrgCurrntOverDelta_CUR_x "" 0x700014be NO_INPUT_QUANTITY Lookup1D_X_FLOAT32_IEEE 0 VBU0706_CM_single_cnt 2 -3.4028234663852886E+38 3.4028234663852886E+38 /end AXIS_PTS
/begin CHARACTERISTIC EDIS_facChrgCurrLimBaseSoc_CUR_v "" CURVE 0x700014b6 Lookup1D_FLOAT32_IEEE 0 VBU0706_CM_single_cnt -3.4028234663852886E+38 3.4028234663852886E+38
 /begin AXIS_DESCR COM_AXIS NO_INPUT_QUANTITY VBU0706_CM_single_cnt 2 -3.4028234663852886E+38 3.4028234663852886E+38 AXIS_PTS_REF EDIS_pctBattSocChrgCurrLim_CUR_x /end AXIS_DESCR
/end CHARACTERISTIC
/begin AXIS_PTS EDIS_pctBattSocChrgCurrLim_CUR_x "" 0x700014c6 NO_INPUT_QUANTITY Lookup1D_X_FLOAT32_IEEE 0 VBU0706_CM_single_cnt 2 -3.4028234663852886E+38 3.4028234663852886E+38 /end AXIS_PTS
/begin CHARACTERISTIC EDIS_facUpGradPwr_MAP_v "" MAP 0x7000a2e4 Lookup2D_FLOAT32_IEEE 0 VBU0706_CM_single_cnt -3.4028234663852886E+38 3.4028234663852886E+38
 /begin AXIS_DESCR COM_AXIS TQO_trqRMotr VBU0706_CM_single_cnt 13 -3.4028234663852886E+38 3.4028234663852886E+38 AXIS_PTS_REF EDIS_facUpGradPwr_MAP_y /end AXIS_DESCR
 /begin AXIS_DESCR COM_AXIS SPD_vVehSpd VBU0706_CM_single_cnt 17 -3.4028234663852886E+38 3.4028234663852886E+38 AXIS_PTS_REF EDIS_facUpGradPwr_MAP_x /end AXIS_DESCR
/end CHARACTERISTIC
/begin AXIS_PTS EDIS_facUpGradPwr_MAP_x "" 0x70003708 SPD_vVehSpd Lookup2D_X_FLOAT32_IEEE 0 VBU0706_CM_single_cnt 17 -3.4028234663852886E+38 3.4028234663852886E+38 /end AXIS_PTS
/begin AXIS_PTS EDIS_facUpGradPwr_MAP_y "" 0x70002fa0 TQO_trqRMotr Lookup2D_X_FLOAT32_IEEE 0 VBU0706_CM_single_cnt 13 -3.4028234663852886E+38 3.4028234663852886E+38 /end AXIS_PTS
/begin CHARACTERISTIC EDIS_facChPwrKd_CUR_v "" CURVE 0x7000235e Lookup1D_FLOAT32_IEEE 0 VBU0706_CM_single_cnt -3.4028234663852886E+38 3.4028234663852886E+38
 /begin AXIS_DESCR COM_AXIS NO_INPUT_QUANTITY VBU0706_CM_single_cnt 10 -3.4028234663852886E+38 3.4028234663852886E+38 AXIS_PTS_REF EDIS_facChPwrKd_CUR_x /end AXIS_DESCR
/end CHARACTERISTIC
/begin AXIS_PTS EDIS_facChPwrKd_CUR_x "" 0x70002386 NO_INPUT_QUANTITY Lookup1D_X_FLOAT32_IEEE 0 VBU0706_CM_single_cnt 10 -3.4028234663852886E+38 3.4028234663852886E+38 /end AXIS_PTS
/begin CHARACTERISTIC EDIS_facChPwrBaseDiffKp_CUR_v "" CURVE 0x70003ef8 Lookup1D_FLOAT32_IEEE 0 VBU0706_CM_single_cnt -3.4028234663852886E+38 3.4028234663852886E+38
 /begin AXIS_DESCR COM_AXIS EDIS_pwrRgnDelta VBU0706_CM_single_cnt 21 -3.4028234663852886E+38 3.4028234663852886E+38 AXIS_PTS_REF EDIS_pwrChPwrBaseDiffKp_CUR_x /end AXIS_DESCR
/end CHARACTERISTIC
/begin AXIS_PTS EDIS_pwrChPwrBaseDiffKp_CUR_x "" 0x70003ff4 EDIS_pwrRgnDelta Lookup1D_X_FLOAT32_IEEE 0 VBU0706_CM_single_cnt 21 -3.4028234663852886E+38 3.4028234663852886E+38 /end AXIS_PTS
/begin CHARACTERISTIC EDIS_facChPwrKi_MAP_v "" MAP 0x700058e4 Lookup2D_FLOAT32_IEEE 0 VBU0706_CM_single_cnt -3.4028234663852886E+38 3.4028234663852886E+38
 /begin AXIS_DESCR COM_AXIS EDIS_pwrChLimDynRaw VBU0706_CM_single_cnt 10 -3.4028234663852886E+38 3.4028234663852886E+38 AXIS_PTS_REF EDIS_facChPwrKi_MAP_y /end AXIS_DESCR
 /begin AXIS_DESCR COM_AXIS EDIS_pwrRgnDelta VBU0706_CM_single_cnt 11 -3.4028234663852886E+38 3.4028234663852886E+38 AXIS_PTS_REF EDIS_facChPwrKi_MAP_x /end AXIS_DESCR
/end CHARACTERISTIC
/begin AXIS_PTS EDIS_facChPwrKi_MAP_x "" 0x70002772 EDIS_pwrRgnDelta Lookup2D_X_FLOAT32_IEEE 0 VBU0706_CM_single_cnt 11 -3.4028234663852886E+38 3.4028234663852886E+38 /end AXIS_PTS
/begin AXIS_PTS EDIS_facChPwrKi_MAP_y "" 0x700023ae EDIS_pwrChLimDynRaw Lookup2D_X_FLOAT32_IEEE 0 VBU0706_CM_single_cnt 10 -3.4028234663852886E+38 3.4028234663852886E+38 /end AXIS_PTS
/begin CHARACTERISTIC EDIS_facDisChPwrBaseDiffKp_CUR_v "" CURVE 0x70003fa0 Lookup1D_FLOAT32_IEEE 0 VBU0706_CM_single_cnt -3.4028234663852886E+38 3.4028234663852886E+38
 /begin AXIS_DESCR COM_AXIS EDIS_pwrDchaDelta VBU0706_CM_single_cnt 21 -3.4028234663852886E+38 3.4028234663852886E+38 AXIS_PTS_REF EDIS_pwrDisChPwrBaseDiffKp_CUR_x /end AXIS_DESCR
/end CHARACTERISTIC
/begin AXIS_PTS EDIS_pwrDisChPwrBaseDiffKp_CUR_x "" 0x7000409c EDIS_pwrDchaDelta Lookup1D_X_FLOAT32_IEEE 0 VBU0706_CM_single_cnt 21 -3.4028234663852886E+38 3.4028234663852886E+38 /end AXIS_PTS
/begin CHARACTERISTIC EDIS_facDisChPwrKi_MAP_v "" MAP 0x70005a9c Lookup2D_FLOAT32_IEEE 0 VBU0706_CM_single_cnt -3.4028234663852886E+38 3.4028234663852886E+38
 /begin AXIS_DESCR COM_AXIS EDIS_pwrDisChLimDynST VBU0706_CM_single_cnt 10 -3.4028234663852886E+38 3.4028234663852886E+38 AXIS_PTS_REF EDIS_facDisChPwrKi_MAP_y /end AXIS_DESCR
 /begin AXIS_DESCR COM_AXIS EDIS_pwrDchaDelta VBU0706_CM_single_cnt 11 -3.4028234663852886E+38 3.4028234663852886E+38 AXIS_PTS_REF EDIS_facDisChPwrKi_MAP_x /end AXIS_DESCR
/end CHARACTERISTIC
/begin AXIS_PTS EDIS_facDisChPwrKi_MAP_x "" 0x7000279e EDIS_pwrDchaDelta Lookup2D_X_FLOAT32_IEEE 0 VBU0706_CM_single_cnt 11 -3.4028234663852886E+38 3.4028234663852886E+38 /end AXIS_PTS
/begin AXIS_PTS EDIS_facDisChPwrKi_MAP_y "" 0x700023d6 EDIS_pwrDisChLimDynST Lookup2D_X_FLOAT32_IEEE 0 VBU0706_CM_single_cnt 10 -3.4028234663852886E+38 3.4028234663852886E+38 /end AXIS_PTS
/begin CHARACTERISTIC BCU_flgABSActvOvrdVal_C "" VALUE 0x70000224 Scalar_FLOAT32_IEEE 0 VBU0706_CM_single_cnt 0.0 1.0 /end CHARACTERISTIC
/begin CHARACTERISTIC BCU_flgABSFailOvrdVal_C "" VALUE 0x70000228 Scalar_FLOAT32_IEEE 0 VBU0706_CM_single_cnt 0.0 1.0 /end CHARACTERISTIC
/begin CHARACTERISTIC BCU_flgFlgABSActvOvrd_C "" VALUE 0x7000022c Scalar_FLOAT32_IEEE 0 VBU0706_CM_single_cnt 0.0 1.0 /end CHARACTERISTIC
/begin CHARACTERISTIC BCU_flgFlgABSFailOvrd_C "" VALUE 0x70000230 Scalar_FLOAT32_IEEE 0 VBU0706_CM_single_cnt 0.0 1.0 /end CHARACTERISTIC
/begin CHARACTERISTIC BCU_flgStWhlFLOvrd_C "" VALUE 0x70000234 Scalar_FLOAT32_IEEE 0 VBU0706_CM_single_cnt 0.0 1.0 /end CHARACTERISTIC
/begin CHARACTERISTIC BCU_flgStWhlFROvrd_C "" VALUE 0x70000238 Scalar_FLOAT32_IEEE 0 VBU0706_CM_single_cnt 0.0 1.0 /end CHARACTERISTIC
/begin CHARACTERISTIC BCU_flgStWhlRLOvrd_C "" VALUE 0x7000023c Scalar_FLOAT32_IEEE 0 VBU0706_CM_single_cnt 0.0 1.0 /end CHARACTERISTIC
/begin CHARACTERISTIC BCU_flgStWhlRROvrd_C "" VALUE 0x70000240 Scalar_FLOAT32_IEEE 0 VBU0706_CM_single_cnt 0.0 1.0 /end CHARACTERISTIC
/begin CHARACTERISTIC BCU_flgVVehicleSpeedOvrd_C "" VALUE 0x70000244 Scalar_FLOAT32_IEEE 0 VBU0706_CM_single_cnt 0.0 1.0 /end CHARACTERISTIC
/begin CHARACTERISTIC BCU_flgVWhlFLOvrd_C "" VALUE 0x70000248 Scalar_FLOAT32_IEEE 0 VBU0706_CM_single_cnt 0.0 1.0 /end CHARACTERISTIC
/begin CHARACTERISTIC BCU_flgVWhlFROvrd_C "" VALUE 0x7000024c Scalar_FLOAT32_IEEE 0 VBU0706_CM_single_cnt 0.0 1.0 /end CHARACTERISTIC
/begin CHARACTERISTIC BCU_flgVWhlRLOvrd_C "" VALUE 0x70000250 Scalar_FLOAT32_IEEE 0 VBU0706_CM_single_cnt 0.0 1.0 /end CHARACTERISTIC
/begin CHARACTERISTIC BCU_flgVWhlRROvrd_C "" VALUE 0x70000254 Scalar_FLOAT32_IEEE 0 VBU0706_CM_single_cnt 0.0 1.0 /end CHARACTERISTIC
/begin CHARACTERISTIC BCU_stWhlFLOvrdVal_C "" VALUE 0x70000258 Scalar_FLOAT32_IEEE 0 VBU0706_CM_single_cnt 0.0 255.0 /end CHARACTERISTIC
/begin CHARACTERISTIC BCU_stWhlFROvrdVal_C "" VALUE 0x7000025c Scalar_FLOAT32_IEEE 0 VBU0706_CM_single_cnt 0.0 255.0 /end CHARACTERISTIC
/begin CHARACTERISTIC BCU_stWhlRLOvrdVal_C "" VALUE 0x70000260 Scalar_FLOAT32_IEEE 0 VBU0706_CM_single_cnt 0.0 255.0 /end CHARACTERISTIC
/begin CHARACTERISTIC BCU_stWhlRROvrdVal_C "" VALUE 0x70000264 Scalar_FLOAT32_IEEE 0 VBU0706_CM_single_cnt 0.0 255.0 /end CHARACTERISTIC
/begin CHARACTERISTIC BCU_vVehicleSpeedOvrdVal_C "" VALUE 0x70000268 Scalar_FLOAT32_IEEE 0 VBU0706_CM_single_cnt -3.40282346638528E+38 3.40282346638528E+38 /end CHARACTERISTIC
/begin CHARACTERISTIC BCU_vWhlFLOvrdVal_C "" VALUE 0x7000026c Scalar_FLOAT32_IEEE 0 VBU0706_CM_single_cnt -3.40282346638528E+38 3.40282346638528E+38 /end CHARACTERISTIC
/begin CHARACTERISTIC BCU_vWhlFROvrdVal_C "" VALUE 0x70000270 Scalar_FLOAT32_IEEE 0 VBU0706_CM_single_cnt -3.40282346638528E+38 3.40282346638528E+38 /end CHARACTERISTIC
/begin CHARACTERISTIC BCU_vWhlRLOvrdVal_C "" VALUE 0x70000274 Scalar_FLOAT32_IEEE 0 VBU0706_CM_single_cnt -3.40282346638528E+38 3.40282346638528E+38 /end CHARACTERISTIC
/begin CHARACTERISTIC BCU_vWhlRROvrdVal_C "" VALUE 0x70000278 Scalar_FLOAT32_IEEE 0 VBU0706_CM_single_cnt -3.40282346638528E+38 3.40282346638528E+38 /end CHARACTERISTIC
/begin CHARACTERISTIC CDC_flgCreepOnOffOvrdVal_C "" VALUE 0x70000298 Scalar_FLOAT32_IEEE 0 VBU0706_CM_single_cnt 0.0 1.0 /end CHARACTERISTIC
/begin CHARACTERISTIC CDC_flgFlgCreepOnOffOvrd_C "" VALUE 0x7000029c Scalar_FLOAT32_IEEE 0 VBU0706_CM_single_cnt 0.0 1.0 /end CHARACTERISTIC
/begin CHARACTERISTIC CDC_flgStDrvModeOvrd_C "" VALUE 0x700002a0 Scalar_FLOAT32_IEEE 0 VBU0706_CM_single_cnt 0.0 1.0 /end CHARACTERISTIC
/begin CHARACTERISTIC CDC_flgStRgnModeOvrd_C "" VALUE 0x700002a4 Scalar_FLOAT32_IEEE 0 VBU0706_CM_single_cnt 0.0 1.0 /end CHARACTERISTIC
/begin CHARACTERISTIC CDC_stDrvModeOvrdVal_C "" VALUE 0x700002a8 Scalar_FLOAT32_IEEE 0 VBU0706_CM_single_cnt 0.0 255.0 /end CHARACTERISTIC
/begin CHARACTERISTIC CDC_stRgnModeOvrdVal_C "" VALUE 0x700002ac Scalar_FLOAT32_IEEE 0 VBU0706_CM_single_cnt 0.0 255.0 /end CHARACTERISTIC
/begin CHARACTERISTIC CaSOH_CellCapacityWrite_Ah "" VAL_BLK 0x70009978 Scalar_FLOAT32_IEEE 0 VBU0706_CM_single_cnt -3.4028234663852886E+38 3.4028234663852886E+38 NUMBER 198 /end CHARACTERISTIC
/begin CHARACTERISTIC CaSOH_InvalidCellCapacity_Ah "" VAL_BLK 0x70009c90 Scalar_FLOAT32_IEEE 0 VBU0706_CM_single_cnt -3.4028234663852886E+38 3.4028234663852886E+38 NUMBER 198 /end CHARACTERISTIC
/begin CHARACTERISTIC CaSOH_InvalidHistoryCurrentData_A "" VAL_BLK 0x70001836 Scalar_FLOAT32_IEEE 0 VBU0706_CM_single_cnt -3.4028234663852886E+38 3.4028234663852886E+38 NUMBER 5 /end CHARACTERISTIC
/begin CHARACTERISTIC CcFCC_ChargeCurrentDerateSocDelta_pct "" VALUE 0x700004dc Scalar_FLOAT32_IEEE 0 VBU0706_CM_single_cnt -3.4028234663852886E+38 3.4028234663852886E+38 /end CHARACTERISTIC
/begin CHARACTERISTIC CcFCC_ChargeCurrentDerateSoc_pct "" VALUE 0x700004e0 Scalar_FLOAT32_IEEE 0 VBU0706_CM_single_cnt -3.4028234663852886E+38 3.4028234663852886E+38 /end CHARACTERISTIC
/begin CHARACTERISTIC CcFCC_ChargeCurrentOvRValue_A "" VALUE 0x700004e4 Scalar_FLOAT32_IEEE 0 VBU0706_CM_single_cnt -3.4028234663852886E+38 3.4028234663852886E+38 /end CHARACTERISTIC
/begin CHARACTERISTIC CcFCC_ChargeCurrentOverDelay_s "" VALUE 0x700004e8 Scalar_FLOAT32_IEEE 0 VBU0706_CM_single_cnt -3.4028234663852886E+38 3.4028234663852886E+38 /end CHARACTERISTIC
/begin CHARACTERISTIC CcFCC_ChargeCurrentRequestDec_A "" VALUE 0x700004f4 Scalar_FLOAT32_IEEE 0 VBU0706_CM_single_cnt -3.4028234663852886E+38 3.4028234663852886E+38 /end CHARACTERISTIC
/begin CHARACTERISTIC CcFCC_ChargeVoltageDelta_V "" VALUE 0x7000050c Scalar_FLOAT32_IEEE 0 VBU0706_CM_single_cnt -3.4028234663852886E+38 3.4028234663852886E+38 /end CHARACTERISTIC
/begin CHARACTERISTIC CcFCC_ComputeResistanceTempMax_C "" VALUE 0x70000520 Scalar_FLOAT32_IEEE 0 VBU0706_CM_single_C -40.0 200.0 /end CHARACTERISTIC
/begin CHARACTERISTIC CcFCC_ComputeResistanceTempMin_C "" VALUE 0x70000524 Scalar_FLOAT32_IEEE 0 VBU0706_CM_single_C -40.0 200.0 /end CHARACTERISTIC
/begin CHARACTERISTIC CcSOC_BatteryDisplaySocChargeDecRate_n "" VALUE 0x700005a0 Scalar_FLOAT32_IEEE 0 VBU0706_CM_single_cnt -3.4028234663852886E+38 3.4028234663852886E+38 /end CHARACTERISTIC
/begin CHARACTERISTIC CcSOC_BatteryDisplaySocChargeIncRate_n "" VALUE 0x700005a4 Scalar_FLOAT32_IEEE 0 VBU0706_CM_single_cnt -3.4028234663852886E+38 3.4028234663852886E+38 /end CHARACTERISTIC
/begin CHARACTERISTIC CcSOC_CurrentWinAvePeriodTime_ms "" VALUE 0x70000618 Scalar_FLOAT32_IEEE 0 VBU0706_CM_single_cnt -3.4028234663852886E+38 3.4028234663852886E+38 /end CHARACTERISTIC
/begin CHARACTERISTIC CcSOC_FastChargeTOCDeltaVolSOC_pct "" VALUE 0x70000630 Scalar_FLOAT32_IEEE 0 VBU0706_CM_single_cnt -3.4028234663852886E+38 3.4028234663852886E+38 /end CHARACTERISTIC
/begin CHARACTERISTIC CcSOC_iAOcvShortTimeCurrentLimit "" VALUE 0x7000066c Scalar_FLOAT32_IEEE 0 VBU0706_CM_single_cnt -3.4028234663852886E+38 3.4028234663852886E+38 /end CHARACTERISTIC
/begin CHARACTERISTIC CcSOE_CellVoltageLowerLimit_mV "" VALUE 0x7000067c Scalar_FLOAT32_IEEE 0 VBU0706_CM_single_cnt -3.4028234663852886E+38 3.4028234663852886E+38 /end CHARACTERISTIC
/begin CHARACTERISTIC CcSOF_DischargeLowOCVStepSlope_V "" VALUE 0x70000720 Scalar_FLOAT32_IEEE 0 VBU0706_CM_single_cnt -3.4028234663852886E+38 3.4028234663852886E+38 /end CHARACTERISTIC
/begin CHARACTERISTIC CcSOF_LowVoltageChargeCurrentMax_A "" VALUE 0x700007a0 Scalar_FLOAT32_IEEE 0 VBU0706_CM_single_cnt -3.4028234663852886E+38 3.4028234663852886E+38 /end CHARACTERISTIC
/begin CHARACTERISTIC CcSOF_LowVoltageChargeCurrentSlopeDec_A "" VALUE 0x700007a4 Scalar_FLOAT32_IEEE 0 VBU0706_CM_single_cnt -3.4028234663852886E+38 3.4028234663852886E+38 /end CHARACTERISTIC
/begin CHARACTERISTIC CcSOF_LowVoltageChargeCurrentSlopeInc_A "" VALUE 0x700007a8 Scalar_FLOAT32_IEEE 0 VBU0706_CM_single_cnt -3.4028234663852886E+38 3.4028234663852886E+38 /end CHARACTERISTIC
/begin CHARACTERISTIC CcSOF_SocpDischargePowerMin_Kw "" VALUE 0x700007d8 Scalar_FLOAT32_IEEE 0 VBU0706_CM_single_cnt -3.4028234663852886E+38 3.4028234663852886E+38 /end CHARACTERISTIC
/begin CHARACTERISTIC CcSOF_SocpDischargePowerSlope_Kw "" VALUE 0x700007dc Scalar_FLOAT32_IEEE 0 VBU0706_CM_single_cnt -3.4028234663852886E+38 3.4028234663852886E+38 /end CHARACTERISTIC
/begin CHARACTERISTIC CcSOH_CellCapacityLowThershold_Ah "" VALUE 0x7000083c Scalar_FLOAT32_IEEE 0 VBU0706_CM_single_cnt -3.4028234663852886E+38 3.4028234663852886E+38 /end CHARACTERISTIC
/begin CHARACTERISTIC CcSOH_ComResisTempLowerLimit_C "" VALUE 0x7000084c Scalar_FLOAT32_IEEE 0 VBU0706_CM_single_cnt -3.4028234663852886E+38 3.4028234663852886E+38 /end CHARACTERISTIC
/begin CHARACTERISTIC CcSOH_ComResisTempUpperLimit_C "" VALUE 0x70000850 Scalar_FLOAT32_IEEE 0 VBU0706_CM_single_cnt -3.4028234663852886E+38 3.4028234663852886E+38 /end CHARACTERISTIC
/begin CHARACTERISTIC CcSOH_DeltaModuleCurrent_A "" VALUE 0x70000854 Scalar_FLOAT32_IEEE 0 VBU0706_CM_single_cnt -3.4028234663852886E+38 3.4028234663852886E+38 /end CHARACTERISTIC
/begin CHARACTERISTIC CcSOH_DeltaSocLowerLimit_pct "" VALUE 0x70000858 Scalar_FLOAT32_IEEE 0 VBU0706_CM_single_cnt -3.4028234663852886E+38 3.4028234663852886E+38 /end CHARACTERISTIC
/begin CHARACTERISTIC CcSOH_DeltaSocThreshold_pct "" VALUE 0x7000085c Scalar_FLOAT32_IEEE 0 VBU0706_CM_single_cnt -3.4028234663852886E+38 3.4028234663852886E+38 /end CHARACTERISTIC
/begin CHARACTERISTIC CcSOH_DeltaSocUpperLimit_pct "" VALUE 0x70000860 Scalar_FLOAT32_IEEE 0 VBU0706_CM_single_cnt -3.4028234663852886E+38 3.4028234663852886E+38 /end CHARACTERISTIC
/begin CHARACTERISTIC CcSOH_DeltaTemThreshold_C "" VALUE 0x70000864 Scalar_FLOAT32_IEEE 0 VBU0706_CM_single_cnt -3.4028234663852886E+38 3.4028234663852886E+38 /end CHARACTERISTIC
/begin CHARACTERISTIC CcSOH_LowTemThreshold_C "" VALUE 0x70000870 Scalar_FLOAT32_IEEE 0 VBU0706_CM_single_cnt -3.4028234663852886E+38 3.4028234663852886E+38 /end CHARACTERISTIC
/begin CHARACTERISTIC CcSOH_UdSocInvalidLowerLimit_pct "" VALUE 0x70000890 Scalar_FLOAT32_IEEE 0 VBU0706_CM_single_cnt -3.4028234663852886E+38 3.4028234663852886E+38 /end CHARACTERISTIC
/begin CHARACTERISTIC CcSOH_UdSocInvalidUpperLimit_pct "" VALUE 0x70000894 Scalar_FLOAT32_IEEE 0 VBU0706_CM_single_cnt -3.4028234663852886E+38 3.4028234663852886E+38 /end CHARACTERISTIC
/begin CHARACTERISTIC CcSYS_ResisCalFCCPulseCurrent_A "" VALUE 0x700008b8 Scalar_FLOAT32_IEEE 0 VBU0706_CM_single_cnt 0.0 1.0E+23 /end CHARACTERISTIC
/begin CHARACTERISTIC CcSYS_ResisCalPulseCurrentDurationTime_ms "" VALUE 0x700008bc Scalar_FLOAT32_IEEE 0 VBU0706_CM_single_cnt 0.0 1.0E+23 /end CHARACTERISTIC
/begin CHARACTERISTIC CcSYS_ResisCalRelaxationCurrent_A "" VALUE 0x700008c0 Scalar_FLOAT32_IEEE 0 VBU0706_CM_single_cnt -3.4028234663852886E+38 3.4028234663852886E+38 /end CHARACTERISTIC
/begin CHARACTERISTIC CcTHM_FccCellTempHighThreshold_C "" VALUE 0x700008dc Scalar_FLOAT32_IEEE 0 VBU0706_CM_single_cnt -3.4028234663852886E+38 3.4028234663852886E+38 /end CHARACTERISTIC
/begin CHARACTERISTIC CcTHM_FccChargeHysterSOC_pct "" VALUE 0x700008e0 Scalar_FLOAT32_IEEE 0 VBU0706_CM_single_cnt -3.4028234663852886E+38 3.4028234663852886E+38 /end CHARACTERISTIC
/begin CHARACTERISTIC CcTHM_FccChargeTempRequestHysterTemp_C "" VALUE 0x700008e4 Scalar_FLOAT32_IEEE 0 VBU0706_CM_single_cnt -3.4028234663852886E+38 3.4028234663852886E+38 /end CHARACTERISTIC
/begin CHARACTERISTIC CcTHM_FccSocHighThreshold_pct "" VALUE 0x700008ec Scalar_FLOAT32_IEEE 0 VBU0706_CM_single_cnt -3.4028234663852886E+38 3.4028234663852886E+38 /end CHARACTERISTIC
/begin CHARACTERISTIC CcTHM_ObcCellTempHighThreshold_C "" VALUE 0x70000900 Scalar_FLOAT32_IEEE 0 VBU0706_CM_single_cnt -3.4028234663852886E+38 3.4028234663852886E+38 /end CHARACTERISTIC
/begin CHARACTERISTIC CcTHM_ObcChargeHysterSOC_pct "" VALUE 0x70000904 Scalar_FLOAT32_IEEE 0 VBU0706_CM_single_cnt -3.4028234663852886E+38 3.4028234663852886E+38 /end CHARACTERISTIC
/begin CHARACTERISTIC CcTHM_ObcChargeTempRequestHysterTemp_C "" VALUE 0x70000908 Scalar_FLOAT32_IEEE 0 VBU0706_CM_single_cnt -3.4028234663852886E+38 3.4028234663852886E+38 /end CHARACTERISTIC
/begin CHARACTERISTIC CcTHM_ObcChargeTempRequestLowThreshold_C "" VALUE 0x7000090c Scalar_FLOAT32_IEEE 0 VBU0706_CM_single_cnt -3.4028234663852886E+38 3.4028234663852886E+38 /end CHARACTERISTIC
/begin CHARACTERISTIC CcTHM_ObcSocHighThreshold_pct "" VALUE 0x70000910 Scalar_FLOAT32_IEEE 0 VBU0706_CM_single_cnt -3.4028234663852886E+38 3.4028234663852886E+38 /end CHARACTERISTIC
/begin CHARACTERISTIC CcTHM_ObcSohTempLowThreshold_C "" VALUE 0x70000914 Scalar_FLOAT32_IEEE 0 VBU0706_CM_single_cnt -3.4028234663852886E+38 3.4028234663852886E+38 /end CHARACTERISTIC
/begin CHARACTERISTIC DCDC_flgIInputCurrOvrd_C "" VALUE 0x700009a8 Scalar_FLOAT32_IEEE 0 VBU0706_CM_single_cnt 0.0 1.0 /end CHARACTERISTIC
/begin CHARACTERISTIC DCDC_flgIOutputCurrOvrd_C "" VALUE 0x700009ac Scalar_FLOAT32_IEEE 0 VBU0706_CM_single_cnt 0.0 1.0 /end CHARACTERISTIC
/begin CHARACTERISTIC DCDC_flgStStatusOvrd_C "" VALUE 0x700009b0 Scalar_FLOAT32_IEEE 0 VBU0706_CM_single_cnt 0.0 1.0 /end CHARACTERISTIC
/begin CHARACTERISTIC DCDC_flgTTempOvrd_C "" VALUE 0x700009b4 Scalar_FLOAT32_IEEE 0 VBU0706_CM_single_cnt 0.0 1.0 /end CHARACTERISTIC
/begin CHARACTERISTIC DCDC_flgUInputVltgOvrd_C "" VALUE 0x700009b8 Scalar_FLOAT32_IEEE 0 VBU0706_CM_single_cnt 0.0 1.0 /end CHARACTERISTIC
/begin CHARACTERISTIC DCDC_flgUOutputVltgOvrd_C "" VALUE 0x700009bc Scalar_FLOAT32_IEEE 0 VBU0706_CM_single_cnt 0.0 1.0 /end CHARACTERISTIC
/begin CHARACTERISTIC DCDC_iInputCurrOvrdVal_C "" VALUE 0x700009c0 Scalar_FLOAT32_IEEE 0 VBU0706_CM_single_cnt -3.40282346638528E+38 3.40282346638528E+38 /end CHARACTERISTIC
/begin CHARACTERISTIC DCDC_iOutputCurrOvrdVal_C "" VALUE 0x700009c4 Scalar_FLOAT32_IEEE 0 VBU0706_CM_single_cnt -3.40282346638528E+38 3.40282346638528E+38 /end CHARACTERISTIC
/begin CHARACTERISTIC DCDC_stStatusOvrdVal_C "" VALUE 0x700009c8 Scalar_FLOAT32_IEEE 0 VBU0706_CM_single_cnt 0.0 255.0 /end CHARACTERISTIC
/begin CHARACTERISTIC DCDC_tTempOvrdVal_C "" VALUE 0x700009cc Scalar_FLOAT32_IEEE 0 VBU0706_CM_single_cnt -3.40282346638528E+38 3.40282346638528E+38 /end CHARACTERISTIC
/begin CHARACTERISTIC DCDC_uInputVltgOvrdVal_C "" VALUE 0x700009d0 Scalar_FLOAT32_IEEE 0 VBU0706_CM_single_cnt -3.40282346638528E+38 3.40282346638528E+38 /end CHARACTERISTIC
/begin CHARACTERISTIC DCDC_uOutputVltgOvrdVal_C "" VALUE 0x700009d4 Scalar_FLOAT32_IEEE 0 VBU0706_CM_single_cnt -3.40282346638528E+38 3.40282346638528E+38 /end CHARACTERISTIC
/begin CHARACTERISTIC DCH_iBMSZeroCrntDlyStopCh_C "" VALUE 0x70000a00 Scalar_FLOAT32_IEEE 0 VBU0706_CM_single_cnt -3.4028234663852886E+38 3.4028234663852886E+38 /end CHARACTERISTIC
/begin CHARACTERISTIC DCH_iCCSChgCrnt_C "" VALUE 0x70000a04 Scalar_FLOAT32_IEEE 0 VBU0706_CM_single_cnt -3.4028234663852886E+38 3.4028234663852886E+38 /end CHARACTERISTIC
/begin CHARACTERISTIC DCH_iOpenDCChRly_C "" VALUE 0x70000a18 Scalar_FLOAT32_IEEE 0 VBU0706_CM_single_cnt -3.4028234663852886E+38 3.4028234663852886E+38 /end CHARACTERISTIC
/begin CHARACTERISTIC DCH_tiCC2OffCnfrm_C "" VALUE 0x70000aac Scalar_FLOAT32_IEEE 0 VBU0706_CM_single_cnt -3.4028234663852886E+38 3.4028234663852886E+38 /end CHARACTERISTIC
/begin CHARACTERISTIC DCH_tiCSTTrigDly_C "" VALUE 0x70000ad0 Scalar_FLOAT32_IEEE 0 VBU0706_CM_single_cnt -3.4028234663852886E+38 3.4028234663852886E+38 /end CHARACTERISTIC
/begin CHARACTERISTIC DSPL_facChargeTemp1_C "" VALUE 0x70000b58 Scalar_FLOAT32_IEEE 0 VBU0706_CM_single_fac 0.0 1.0 /end CHARACTERISTIC
/begin CHARACTERISTIC DSPL_facChargeTemp2_C "" VALUE 0x70000b5c Scalar_FLOAT32_IEEE 0 VBU0706_CM_single_fac 0.0 1.0 /end CHARACTERISTIC
/begin CHARACTERISTIC DSPL_facChargeTemp3_C "" VALUE 0x70000b60 Scalar_FLOAT32_IEEE 0 VBU0706_CM_single_fac 0.0 1.0 /end CHARACTERISTIC
/begin CHARACTERISTIC DSPL_facChargeTemp4_C "" VALUE 0x70000b64 Scalar_FLOAT32_IEEE 0 VBU0706_CM_single_fac 0.0 1.0 /end CHARACTERISTIC
/begin CHARACTERISTIC DSPL_facChargeTemp5_C "" VALUE 0x70000b68 Scalar_FLOAT32_IEEE 0 VBU0706_CM_single_fac 0.0 1.0 /end CHARACTERISTIC
/begin CHARACTERISTIC DSPL_iRngCalcDch_C "" VALUE 0x70000b88 Scalar_FLOAT32_IEEE 0 VBU0706_CM_single_A -1000.0 1000.0 /end CHARACTERISTIC
/begin CHARACTERISTIC DSPL_kmDriveTempSpeedEnThreshold_C "" VALUE 0x70000b94 Scalar_FLOAT32_IEEE 0 VBU0706_CM_single_km 0.0 1.0E+11 /end CHARACTERISTIC
/begin CHARACTERISTIC DSPL_tDriveTempDefault_C "" VALUE 0x70000bd8 Scalar_FLOAT32_IEEE 0 VBU0706_CM_single_cnt 0.0 1.0E+17 /end CHARACTERISTIC
/begin CHARACTERISTIC DSPL_tRangeTempDefault_C "" VALUE 0x70000bdc Scalar_FLOAT32_IEEE 0 VBU0706_CM_single_cnt -40.0 120.0 /end CHARACTERISTIC
/begin CHARACTERISTIC DSPL_tiDriveTempMoveTime_C "" VALUE 0x70000bf4 Scalar_FLOAT32_IEEE 0 VBU0706_CM_single_s 0.0 1.0E+23 /end CHARACTERISTIC
/begin CHARACTERISTIC DSPL_tiDriveTempSpeedEnThreshold_C "" VALUE 0x70000bf8 Scalar_FLOAT32_IEEE 0 VBU0706_CM_single_s 0.0 1.0E+23 /end CHARACTERISTIC
/begin CHARACTERISTIC DSPL_tiDriveTempSpeedReset_C "" VALUE 0x70000bfc Scalar_FLOAT32_IEEE 0 VBU0706_CM_single_s 0.0 1.0E+23 /end CHARACTERISTIC
/begin CHARACTERISTIC DSPL_tiRemChrgLineDelay_C "" VALUE 0x70000c08 Scalar_FLOAT32_IEEE 0 VBU0706_CM_single_s 0.0 1.0E+23 /end CHARACTERISTIC
/begin CHARACTERISTIC DSPL_vDriveTempResetThreshold_C "" VALUE 0x70000c1c Scalar_FLOAT32_IEEE 0 VBU0706_CM_single_cnt 0.0 1000.0 /end CHARACTERISTIC
/begin CHARACTERISTIC DSPL_vDriveTempSpeedEnLe_C "" VALUE 0x70000c20 Scalar_FLOAT32_IEEE 0 VBU0706_CM_single_cnt 0.0 1000.0 /end CHARACTERISTIC
/begin CHARACTERISTIC DSPL_vDriveTempSpeedEnRi_C "" VALUE 0x70000c24 Scalar_FLOAT32_IEEE 0 VBU0706_CM_single_cnt 0.0 10000.0 /end CHARACTERISTIC
/begin CHARACTERISTIC EDIS_facStermDisChgRaw_C "" VALUE 0x70000c2c Scalar_FLOAT32_IEEE 0 VBU0706_CM_single_cnt -3.4028234663852886E+38 3.4028234663852886E+38 /end CHARACTERISTIC
/begin CHARACTERISTIC EDIS_kmVehOdometer_C "" VALUE 0x70000c34 Scalar_FLOAT32_IEEE 0 VBU0706_CM_single_cnt -3.4028234663852886E+38 3.4028234663852886E+38 /end CHARACTERISTIC
/begin CHARACTERISTIC EDIS_pctBmsSocOverrideHi1_C "" VALUE 0x70000c58 Scalar_FLOAT32_IEEE 0 VBU0706_CM_single_cnt -3.4028234663852886E+38 3.4028234663852886E+38 /end CHARACTERISTIC
/begin CHARACTERISTIC EDIS_pctBmsSocOverrideHi_C "" VALUE 0x70000c5c Scalar_FLOAT32_IEEE 0 VBU0706_CM_single_cnt -3.4028234663852886E+38 3.4028234663852886E+38 /end CHARACTERISTIC
/begin CHARACTERISTIC EDIS_pctBmsSocOverrideLo1_C "" VALUE 0x70000c60 Scalar_FLOAT32_IEEE 0 VBU0706_CM_single_cnt -3.4028234663852886E+38 3.4028234663852886E+38 /end CHARACTERISTIC
/begin CHARACTERISTIC EDIS_pctBmsSocOverrideLo_C "" VALUE 0x70000c64 Scalar_FLOAT32_IEEE 0 VBU0706_CM_single_cnt -3.4028234663852886E+38 3.4028234663852886E+38 /end CHARACTERISTIC
/begin CHARACTERISTIC EDIS_pwrACPowOverride_C "" VALUE 0x70000c70 Scalar_FLOAT32_IEEE 0 VBU0706_CM_single_cnt -3.4028234663852886E+38 3.4028234663852886E+38 /end CHARACTERISTIC
/begin CHARACTERISTIC EDIS_pwrACRated_C "" VALUE 0x70000c74 Scalar_FLOAT32_IEEE 0 VBU0706_CM_single_kW 0.0 1000.0 /end CHARACTERISTIC
/begin CHARACTERISTIC EDIS_pwrBattMaxPwrForInvaild_C "" VALUE 0x70000c78 Scalar_FLOAT32_IEEE 0 VBU0706_CM_single_cnt -3.4028234663852886E+38 3.4028234663852886E+38 /end CHARACTERISTIC
/begin CHARACTERISTIC EDIS_pwrBattMinPwrForInvaild_C "" VALUE 0x70000c7c Scalar_FLOAT32_IEEE 0 VBU0706_CM_single_cnt -3.4028234663852886E+38 3.4028234663852886E+38 /end CHARACTERISTIC
/begin CHARACTERISTIC EDIS_pwrDCDCPowOverride_C "" VALUE 0x70000c90 Scalar_FLOAT32_IEEE 0 VBU0706_CM_single_cnt -3.4028234663852886E+38 3.4028234663852886E+38 /end CHARACTERISTIC
/begin CHARACTERISTIC EDIS_pwrDcdcRated_C "" VALUE 0x70000c94 Scalar_FLOAT32_IEEE 0 VBU0706_CM_single_cnt 0.0 1000.0 /end CHARACTERISTIC
/begin CHARACTERISTIC EDIS_pwrDchaDeltaMin_C "" VALUE 0x70000c98 Scalar_FLOAT32_IEEE 0 VBU0706_CM_single_kW -1000.0 1000.0 /end CHARACTERISTIC
/begin CHARACTERISTIC EDIS_pwrDchaItermMin_C "" VALUE 0x70000c9c Scalar_FLOAT32_IEEE 0 VBU0706_CM_single_cnt -3.4028234663852886E+38 3.4028234663852886E+38 /end CHARACTERISTIC
/begin CHARACTERISTIC EDIS_pwrDchaPIDPowrLim_C "" VALUE 0x70000ca0 Scalar_FLOAT32_IEEE 0 VBU0706_CM_single_cnt -3.4028234663852886E+38 3.4028234663852886E+38 /end CHARACTERISTIC
/begin CHARACTERISTIC EDIS_pwrDecGradBmsSocLo_C "" VALUE 0x70000ca4 Scalar_FLOAT32_IEEE 0 VBU0706_CM_single_cnt -3.4028234663852886E+38 3.4028234663852886E+38 /end CHARACTERISTIC
/begin CHARACTERISTIC EDIS_pwrDrvPowLackHi_C "" VALUE 0x70000cbc Scalar_FLOAT32_IEEE 0 VBU0706_CM_single_cnt -3.4028234663852886E+38 3.4028234663852886E+38 /end CHARACTERISTIC
/begin CHARACTERISTIC EDIS_pwrDrvPowLackLo_C "" VALUE 0x70000cc0 Scalar_FLOAT32_IEEE 0 VBU0706_CM_single_cnt -3.4028234663852886E+38 3.4028234663852886E+38 /end CHARACTERISTIC
/begin CHARACTERISTIC EDIS_pwrHVHPowOverride_C "" VALUE 0x70000cc8 Scalar_FLOAT32_IEEE 0 VBU0706_CM_single_cnt -3.4028234663852886E+38 3.4028234663852886E+38 /end CHARACTERISTIC
/begin CHARACTERISTIC EDIS_pwrHVHRated_C "" VALUE 0x70000ccc Scalar_FLOAT32_IEEE 0 VBU0706_CM_single_cnt 0.0 1000.0 /end CHARACTERISTIC
/begin CHARACTERISTIC EDIS_pwrPTCPowOverride_C "" VALUE 0x70000ce4 Scalar_FLOAT32_IEEE 0 VBU0706_CM_single_cnt -3.4028234663852886E+38 3.4028234663852886E+38 /end CHARACTERISTIC
/begin CHARACTERISTIC EDIS_pwrPTCRated_C "" VALUE 0x70000ce8 Scalar_FLOAT32_IEEE 0 VBU0706_CM_single_kW 0.0 1000.0 /end CHARACTERISTIC
/begin CHARACTERISTIC EDIS_tiBattPowLackDelay_C "" VALUE 0x70000d00 Scalar_FLOAT32_IEEE 0 VBU0706_CM_single_cnt -3.4028234663852886E+38 3.4028234663852886E+38 /end CHARACTERISTIC
/begin CHARACTERISTIC EDIS_tiDrvPwrFilter_C "" VALUE 0x70000d04 Scalar_FLOAT32_IEEE 0 VBU0706_CM_single_cnt -3.4028234663852886E+38 3.4028234663852886E+38 /end CHARACTERISTIC
/begin CHARACTERISTIC EDIS_tiRgnPwrFilter_C "" VALUE 0x70000d0c Scalar_FLOAT32_IEEE 0 VBU0706_CM_single_cnt -3.4028234663852886E+38 3.4028234663852886E+38 /end CHARACTERISTIC
/begin CHARACTERISTIC EDIS_tiSmplT_SY "" VALUE 0x70000d10 Scalar_FLOAT32_IEEE 0 VBU0706_CM_single_s -3.4028234663852886E+38 3.4028234663852886E+38 /end CHARACTERISTIC
/begin CHARACTERISTIC EPB_flgStFaultLevelOvrd_C "" VALUE 0x70000d20 Scalar_FLOAT32_IEEE 0 VBU0706_CM_single_cnt 0.0 1.0 /end CHARACTERISTIC
/begin CHARACTERISTIC EPB_flgStStateOvrd_C "" VALUE 0x70000d24 Scalar_FLOAT32_IEEE 0 VBU0706_CM_single_cnt 0.0 1.0 /end CHARACTERISTIC
/begin CHARACTERISTIC EPB_flgStSwitchOvrd_C "" VALUE 0x70000d28 Scalar_FLOAT32_IEEE 0 VBU0706_CM_single_cnt 0.0 1.0 /end CHARACTERISTIC
/begin CHARACTERISTIC EPB_stFaultLevelOvrdVal_C "" VALUE 0x70000d2c Scalar_FLOAT32_IEEE 0 VBU0706_CM_single_cnt 0.0 255.0 /end CHARACTERISTIC
/begin CHARACTERISTIC EPB_stStateOvrdVal_C "" VALUE 0x70000d30 Scalar_FLOAT32_IEEE 0 VBU0706_CM_single_cnt 0.0 255.0 /end CHARACTERISTIC
/begin CHARACTERISTIC EPB_stSwitchOvrdVal_C "" VALUE 0x70000d34 Scalar_FLOAT32_IEEE 0 VBU0706_CM_single_cnt 0.0 255.0 /end CHARACTERISTIC
/begin CHARACTERISTIC EPS_flgStECUModeCntOvrd_C "" VALUE 0x70000d3c Scalar_FLOAT32_IEEE 0 VBU0706_CM_single_cnt 0.0 1.0 /end CHARACTERISTIC
/begin CHARACTERISTIC EPS_stECUModeCntOvrdVal_C "" VALUE 0x70000d40 Scalar_FLOAT32_IEEE 0 VBU0706_CM_single_cnt 0.0 255.0 /end CHARACTERISTIC
/begin CHARACTERISTIC IC_flgKmVehOdmeterOvrd_C "" VALUE 0x70000dbc Scalar_FLOAT32_IEEE 0 VBU0706_CM_single_cnt 0.0 1.0 /end CHARACTERISTIC
/begin CHARACTERISTIC IC_kmVehOdmeterOvrdVal_C "" VALUE 0x70000dc0 Scalar_FLOAT32_IEEE 0 VBU0706_CM_single_cnt -3.40282346638528E+38 3.40282346638528E+38 /end CHARACTERISTIC
/begin CHARACTERISTIC LVC_tiHvRlyClReq_C "" VALUE 0x70000e48 Scalar_FLOAT32_IEEE 0 VBU0706_CM_single_cnt -3.4028234663852886E+38 3.4028234663852886E+38 /end CHARACTERISTIC
/begin CHARACTERISTIC LVC_tiIBSStatusErrAndParked_C "" VALUE 0x70000e4c Scalar_FLOAT32_IEEE 0 VBU0706_CM_single_cnt -3.4028234663852886E+38 3.4028234663852886E+38 /end CHARACTERISTIC
/begin CHARACTERISTIC LVC_tiLvBattVolLow_C "" VALUE 0x70000e50 Scalar_FLOAT32_IEEE 0 VBU0706_CM_single_cnt -3.4028234663852886E+38 3.4028234663852886E+38 /end CHARACTERISTIC
/begin CHARACTERISTIC LVC_tiSample_SY "" VALUE 0x70000e54 Scalar_FLOAT32_IEEE 0 VBU0706_CM_single_cnt -3.4028234663852886E+38 3.4028234663852886E+38 /end CHARACTERISTIC
/begin CHARACTERISTIC LVC_uVolLowOnPark_C "" VALUE 0x70000e6c Scalar_FLOAT32_IEEE 0 VBU0706_CM_single_cnt -3.4028234663852886E+38 3.4028234663852886E+38 /end CHARACTERISTIC
/begin CHARACTERISTIC MILIAMPERES_PER_AMPERE "" VALUE 0x70000e74 Scalar_FLOAT32_IEEE 0 VBU0706_CM_single_cnt -3.4028234663852886E+38 3.4028234663852886E+38 /end CHARACTERISTIC
/begin CHARACTERISTIC PEUR_flgFlgIGBTOvrHeatOvrd_C "" VALUE 0x70000e9c Scalar_FLOAT32_IEEE 0 VBU0706_CM_single_cnt 0.0 1.0 /end CHARACTERISTIC
/begin CHARACTERISTIC PEUR_flgFlgMotrHillHldOvrd_C "" VALUE 0x70000ea0 Scalar_FLOAT32_IEEE 0 VBU0706_CM_single_cnt 0.0 1.0 /end CHARACTERISTIC
/begin CHARACTERISTIC PEUR_flgFlgMotrOvrHeatOvrd_C "" VALUE 0x70000ea4 Scalar_FLOAT32_IEEE 0 VBU0706_CM_single_cnt 0.0 1.0 /end CHARACTERISTIC
/begin CHARACTERISTIC PEUR_flgFlgMotrSpdVldOvrd_C "" VALUE 0x70000ea8 Scalar_FLOAT32_IEEE 0 VBU0706_CM_single_cnt 0.0 1.0 /end CHARACTERISTIC
/begin CHARACTERISTIC PEUR_flgICalcDCOvrd_C "" VALUE 0x70000eac Scalar_FLOAT32_IEEE 0 VBU0706_CM_single_cnt 0.0 1.0 /end CHARACTERISTIC
/begin CHARACTERISTIC PEUR_flgIGBTOvrHeatOvrdVal_C "" VALUE 0x70000eb0 Scalar_FLOAT32_IEEE 0 VBU0706_CM_single_cnt 0.0 1.0 /end CHARACTERISTIC
/begin CHARACTERISTIC PEUR_flgMotrHillHldOvrdVal_C "" VALUE 0x70000eb4 Scalar_FLOAT32_IEEE 0 VBU0706_CM_single_cnt 0.0 1.0 /end CHARACTERISTIC
/begin CHARACTERISTIC PEUR_flgMotrOvrHeatOvrdVal_C "" VALUE 0x70000eb8 Scalar_FLOAT32_IEEE 0 VBU0706_CM_single_cnt 0.0 1.0 /end CHARACTERISTIC
/begin CHARACTERISTIC PEUR_flgMotrSpdVldOvrdVal_C "" VALUE 0x70000ebc Scalar_FLOAT32_IEEE 0 VBU0706_CM_single_cnt 0.0 1.0 /end CHARACTERISTIC
/begin CHARACTERISTIC PEUR_flgNMotrOvrd_C "" VALUE 0x70000ec0 Scalar_FLOAT32_IEEE 0 VBU0706_CM_single_cnt 0.0 1.0 /end CHARACTERISTIC
/begin CHARACTERISTIC PEUR_flgStActvDisChOvrd_C "" VALUE 0x70000ec4 Scalar_FLOAT32_IEEE 0 VBU0706_CM_single_cnt 0.0 1.0 /end CHARACTERISTIC
/begin CHARACTERISTIC PEUR_flgStFaultOvrd_C "" VALUE 0x70000ec8 Scalar_FLOAT32_IEEE 0 VBU0706_CM_single_cnt 0.0 1.0 /end CHARACTERISTIC
/begin CHARACTERISTIC PEUR_flgStInvrOvrd_C "" VALUE 0x70000ecc Scalar_FLOAT32_IEEE 0 VBU0706_CM_single_cnt 0.0 1.0 /end CHARACTERISTIC
/begin CHARACTERISTIC PEUR_flgTMeasMaxPhUVWOvrd_C "" VALUE 0x70000ed0 Scalar_FLOAT32_IEEE 0 VBU0706_CM_single_cnt 0.0 1.0 /end CHARACTERISTIC
/begin CHARACTERISTIC PEUR_flgTMeasMaxStrOvrd_C "" VALUE 0x70000ed4 Scalar_FLOAT32_IEEE 0 VBU0706_CM_single_cnt 0.0 1.0 /end CHARACTERISTIC
/begin CHARACTERISTIC PEUR_flgTrqActOvrd_C "" VALUE 0x70000ed8 Scalar_FLOAT32_IEEE 0 VBU0706_CM_single_cnt 0.0 1.0 /end CHARACTERISTIC
/begin CHARACTERISTIC PEUR_flgTrqMaxLimitOvrd_C "" VALUE 0x70000edc Scalar_FLOAT32_IEEE 0 VBU0706_CM_single_cnt 0.0 1.0 /end CHARACTERISTIC
/begin CHARACTERISTIC PEUR_flgUDCRlyOutsideVltgOvrd_C "" VALUE 0x70000ee0 Scalar_FLOAT32_IEEE 0 VBU0706_CM_single_cnt 0.0 1.0 /end CHARACTERISTIC
/begin CHARACTERISTIC PEUR_flgUMeasDCOvrd_C "" VALUE 0x70000ee4 Scalar_FLOAT32_IEEE 0 VBU0706_CM_single_cnt 0.0 1.0 /end CHARACTERISTIC
/begin CHARACTERISTIC PEUR_iCalcDCOvrdVal_C "" VALUE 0x70000ee8 Scalar_FLOAT32_IEEE 0 VBU0706_CM_single_cnt -3.40282346638528E+38 3.40282346638528E+38 /end CHARACTERISTIC
/begin CHARACTERISTIC PEUR_nMotrOvrdVal_C "" VALUE 0x70000eec Scalar_FLOAT32_IEEE 0 VBU0706_CM_single_cnt -3.40282346638528E+38 3.40282346638528E+38 /end CHARACTERISTIC
/begin CHARACTERISTIC PEUR_stActvDisChOvrdVal_C "" VALUE 0x70000ef0 Scalar_FLOAT32_IEEE 0 VBU0706_CM_single_cnt 0.0 255.0 /end CHARACTERISTIC
/begin CHARACTERISTIC PEUR_stFaultOvrdVal_C "" VALUE 0x70000ef4 Scalar_FLOAT32_IEEE 0 VBU0706_CM_single_cnt 0.0 255.0 /end CHARACTERISTIC
/begin CHARACTERISTIC PEUR_stInvrOvrdVal_C "" VALUE 0x70000ef8 Scalar_FLOAT32_IEEE 0 VBU0706_CM_single_cnt 0.0 255.0 /end CHARACTERISTIC
/begin CHARACTERISTIC PEUR_tMeasMaxPhUVWOvrdVal_C "" VALUE 0x70000efc Scalar_FLOAT32_IEEE 0 VBU0706_CM_single_cnt -3.40282346638528E+38 3.40282346638528E+38 /end CHARACTERISTIC
/begin CHARACTERISTIC PEUR_tMeasMaxStrOvrdVal_C "" VALUE 0x70000f00 Scalar_FLOAT32_IEEE 0 VBU0706_CM_single_cnt -3.40282346638528E+38 3.40282346638528E+38 /end CHARACTERISTIC
/begin CHARACTERISTIC PEUR_trqActOvrdVal_C "" VALUE 0x70000f04 Scalar_FLOAT32_IEEE 0 VBU0706_CM_single_cnt -3.40282346638528E+38 3.40282346638528E+38 /end CHARACTERISTIC
/begin CHARACTERISTIC PEUR_trqMaxLimitOvrdVal_C "" VALUE 0x70000f08 Scalar_FLOAT32_IEEE 0 VBU0706_CM_single_cnt -3.40282346638528E+38 3.40282346638528E+38 /end CHARACTERISTIC
/begin CHARACTERISTIC PEUR_uDCRlyOutsideVltgOvrdVal_C "" VALUE 0x70000f0c Scalar_FLOAT32_IEEE 0 VBU0706_CM_single_cnt -3.40282346638528E+38 3.40282346638528E+38 /end CHARACTERISTIC
/begin CHARACTERISTIC PEUR_uMeasDCOvrdVal_C "" VALUE 0x70000f10 Scalar_FLOAT32_IEEE 0 VBU0706_CM_single_cnt -3.40282346638528E+38 3.40282346638528E+38 /end CHARACTERISTIC
/begin CHARACTERISTIC PMM_tiDlyPEUStandBy_C "" VALUE 0x70000f50 Scalar_FLOAT32_IEEE 0 VBU0706_CM_single_cnt -3.4028234663852886E+38 3.4028234663852886E+38 /end CHARACTERISTIC
/begin CHARACTERISTIC PMM_tiDlySWReset_C "" VALUE 0x70000f58 Scalar_FLOAT32_IEEE 0 VBU0706_CM_single_cnt -3.4028234663852886E+38 3.4028234663852886E+38 /end CHARACTERISTIC
/begin CHARACTERISTIC SYS_stShftPosDrv_SY "" VALUE 0x70000ff8 Scalar_FLOAT32_IEEE 0 VBU0706_CM_single_cnt -3.4028234663852886E+38 3.4028234663852886E+38 /end CHARACTERISTIC
/begin CHARACTERISTIC SYS_stShftPosRev_SY "" VALUE 0x70000ffc Scalar_FLOAT32_IEEE 0 VBU0706_CM_single_cnt -3.4028234663852886E+38 3.4028234663852886E+38 /end CHARACTERISTIC
/begin CHARACTERISTIC CcFCC_ComputeResistanceRelaxationTime_ms "" VALUE 0x7000051c Scalar_ULONG 0 VBU0706_CM_uint32_cnt 0.0 4.294967295E+9 /end CHARACTERISTIC
/begin CHARACTERISTIC CcSOC_FastChargePreCorrectionVolTime_ms "" VALUE 0x70000624 Scalar_ULONG 0 VBU0706_CM_uint32_cnt 0.0 4.294967295E+9 /end CHARACTERISTIC
/begin CHARACTERISTIC CcSOH_AfertSlowChargeEndTime_ms "" VALUE 0x7000082c Scalar_ULONG 0 VBU0706_CM_uint32_cnt 0.0 4.294967295E+9 /end CHARACTERISTIC
/begin CHARACTERISTIC CcSOH_AfertSlowChargeStartTime_ms "" VALUE 0x70000830 Scalar_ULONG 0 VBU0706_CM_uint32_cnt 0.0 4.294967295E+9 /end CHARACTERISTIC
/begin CHARACTERISTIC CcSOC_FastChargePreCorrectionVolThld_mV "" VALUE 0x700000a0 Scalar_SWORD 0 VBU0706_CM_int16_cnt -32768.0 32767.0 /end CHARACTERISTIC
/begin CHARACTERISTIC CcFCC_BatteryVoltageMaxLimitDebounceTime_s "" VALUE 0x70000078 Scalar_UWORD 0 VBU0706_CM_uint16_cnt 0.0 65535.0 /end CHARACTERISTIC
/begin CHARACTERISTIC CcFCC_CellVoltageMaxLimitDebounceTime_s "" VALUE 0x7000007a Scalar_UWORD 0 VBU0706_CM_uint16_cnt 0.0 65535.0 /end CHARACTERISTIC
/begin CHARACTERISTIC CcFCC_ComputeResistanceDelayTime_ms "" VALUE 0x7000007e Scalar_UWORD 0 VBU0706_CM_uint16_cnt 0.0 65535.0 /end CHARACTERISTIC
/begin CHARACTERISTIC CcFCC_ComputeResistanceEndVoltage_mV "" VALUE 0x70000080 Scalar_UWORD 0 VBU0706_CM_uint16_cnt 0.0 65535.0 /end CHARACTERISTIC
/begin CHARACTERISTIC CcFCC_ComputeResistanceStartVoltage_mV "" VALUE 0x70000082 Scalar_UWORD 0 VBU0706_CM_uint16_cnt 0.0 65535.0 /end CHARACTERISTIC
/begin CHARACTERISTIC CcFCC_HighTempDebounceTime_s "" VALUE 0x7000008c Scalar_UWORD 0 VBU0706_CM_uint16_cnt 0.0 65535.0 /end CHARACTERISTIC
/begin CHARACTERISTIC CcSOC_FastChargeTOCDeltaVolMax_mV "" VALUE 0x700000a2 Scalar_UWORD 0 VBU0706_CM_uint16_cnt 0.0 65535.0 /end CHARACTERISTIC
/begin CHARACTERISTIC CcSOF_LowVoltChgCurtSloDelay_ms "" VALUE 0x700000d0 Scalar_UWORD 0 VBU0706_CM_uint16_cnt 0.0 65535.0 /end CHARACTERISTIC
/begin CHARACTERISTIC CcSOF_LowVoltagePowerOnDelay_ms "" VALUE 0x700000d4 Scalar_UWORD 0 VBU0706_CM_uint16_cnt 0.0 65535.0 /end CHARACTERISTIC
/begin CHARACTERISTIC CcSOH_HistoryDataDimension_n "" VALUE 0x700000e8 Scalar_UWORD 0 VBU0706_CM_uint16_cnt 0.0 65535.0 /end CHARACTERISTIC
/begin CHARACTERISTIC CcSYS_CellBalanceDutyCycle_pct "" VALUE 0x700000ea Scalar_UWORD 0 VBU0706_CM_uint16_cnt 0.0 65535.0 /end CHARACTERISTIC
/begin CHARACTERISTIC CcTHM_CoolantTempOorDebounceTime_s "" VALUE 0x700000f6 Scalar_UWORD 0 VBU0706_CM_uint16_cnt 0.0 65535.0 /end CHARACTERISTIC
/begin CHARACTERISTIC CbFCC_BatteryVoltageMaxlimitEnable_flg "" VALUE 0x70010860 Scalar_BOOLEAN 0 VBU0706_CM_boolean_cnt 0.0 1.0 /end CHARACTERISTIC
/begin CHARACTERISTIC CbFCC_CellVoltageMaxlimitEnable_flg "" VALUE 0x70010861 Scalar_BOOLEAN 0 VBU0706_CM_boolean_cnt 0.0 1.0 /end CHARACTERISTIC
/begin CHARACTERISTIC CbFCC_ChargeCurrentOvR_flg "" VALUE 0x70010862 Scalar_BOOLEAN 0 VBU0706_CM_boolean_cnt 0.0 1.0 /end CHARACTERISTIC
/begin CHARACTERISTIC CbFCC_ComputeResistanceEnable_flg "" VALUE 0x70010865 Scalar_BOOLEAN 0 VBU0706_CM_boolean_cnt 0.0 1.0 /end CHARACTERISTIC
/begin CHARACTERISTIC CbFCC_NoChargeHighTempEnable_flg "" VALUE 0x70010866 Scalar_BOOLEAN 0 VBU0706_CM_boolean_cnt 0.0 1.0 /end CHARACTERISTIC
/begin CHARACTERISTIC CbFCC_NoChargeLowTempEnable_flg "" VALUE 0x70010867 Scalar_BOOLEAN 0 VBU0706_CM_boolean_cnt 0.0 1.0 /end CHARACTERISTIC
/begin CHARACTERISTIC CbSOC_DisplaySOCRateDynamicEnable_flg "" VALUE 0x70010871 Scalar_BOOLEAN 0 VBU0706_CM_boolean_cnt 0.0 1.0 /end CHARACTERISTIC
/begin CHARACTERISTIC CbSOH_EepromWriteCellCapacity_flg "" VALUE 0x7001087d Scalar_BOOLEAN 0 VBU0706_CM_boolean_cnt 0.0 1.0 /end CHARACTERISTIC
/begin CHARACTERISTIC CcFCC_ChargeCurrentOverEnable_flg "" VALUE 0x70010944 Scalar_BOOLEAN 0 VBU0706_CM_boolean_cnt 0.0 1.0 /end CHARACTERISTIC
/begin CHARACTERISTIC CcFCC_ChargeCurrentOverFuncEnable_flg "" VALUE 0x70010947 Scalar_BOOLEAN 0 VBU0706_CM_boolean_cnt 0.0 1.0 /end CHARACTERISTIC
/begin CHARACTERISTIC CcSOF_LowVoltageChargeLimitEnable_flg "" VALUE 0x7001095b Scalar_BOOLEAN 0 VBU0706_CM_boolean_cnt 0.0 1.0 /end CHARACTERISTIC
/begin CHARACTERISTIC CcTHM_CoolantSensorValidEnable_flg "" VALUE 0x70010962 Scalar_BOOLEAN 0 VBU0706_CM_boolean_cnt 0.0 1.0 /end CHARACTERISTIC
/begin CHARACTERISTIC DCH_flgAllowNGearCh_C "" VALUE 0x700109a0 Scalar_BOOLEAN 0 VBU0706_CM_boolean_cnt 0.0 1.0 /end CHARACTERISTIC
/begin CHARACTERISTIC EDIS_flgACPowOverride_C "" VALUE 0x70010a7d Scalar_BOOLEAN 0 VBU0706_CM_boolean_cnt 0.0 1.0 /end CHARACTERISTIC
/begin CHARACTERISTIC EDIS_flgDCDCPowOverride_C "" VALUE 0x70010a7f Scalar_BOOLEAN 0 VBU0706_CM_boolean_cnt 0.0 1.0 /end CHARACTERISTIC
/begin CHARACTERISTIC EDIS_flgHVHPowOverride_C "" VALUE 0x70010a82 Scalar_BOOLEAN 0 VBU0706_CM_boolean_cnt 0.0 1.0 /end CHARACTERISTIC
/begin CHARACTERISTIC EDIS_flgNoUsePowLackUpGrad_C "" VALUE 0x70010a83 Scalar_BOOLEAN 0 VBU0706_CM_boolean_cnt 0.0 1.0 /end CHARACTERISTIC
/begin CHARACTERISTIC EDIS_flgPTCPowOverride_C "" VALUE 0x70010a85 Scalar_BOOLEAN 0 VBU0706_CM_boolean_cnt 0.0 1.0 /end CHARACTERISTIC
/begin CHARACTERISTIC EDIS_flgUseAcsPwrReq_C "" VALUE 0x70010a86 Scalar_BOOLEAN 0 VBU0706_CM_boolean_cnt 0.0 1.0 /end CHARACTERISTIC
/begin CHARACTERISTIC EDIS_flgUseDynChPwrComfort_C "" VALUE 0x70010a87 Scalar_BOOLEAN 0 VBU0706_CM_boolean_cnt 0.0 1.0 /end CHARACTERISTIC
/begin CHARACTERISTIC PMM_flgAccDisblOvrdSwt_C "" VALUE 0x70010b3b Scalar_BOOLEAN 0 VBU0706_CM_boolean_cnt 0.0 1.0 /end CHARACTERISTIC
/begin CHARACTERISTIC PMM_flgAccDisblOvrdVal_C "" VALUE 0x70010b3c Scalar_BOOLEAN 0 VBU0706_CM_boolean_cnt 0.0 1.0 /end CHARACTERISTIC
/begin CHARACTERISTIC PMM_flgActvDisWihtHVRlyCldSwt_C "" VALUE 0x70010b3d Scalar_BOOLEAN 0 VBU0706_CM_boolean_cnt 0.0 1.0 /end CHARACTERISTIC
/begin CHARACTERISTIC PMM_flgActvDisWihtHVRlyCldVal_C "" VALUE 0x70010b3e Scalar_BOOLEAN 0 VBU0706_CM_boolean_cnt 0.0 1.0 /end CHARACTERISTIC
/begin CHARACTERISTIC PMM_flgHVRdyOvrdSwt_C "" VALUE 0x70010b43 Scalar_BOOLEAN 0 VBU0706_CM_boolean_cnt 0.0 1.0 /end CHARACTERISTIC
/begin CHARACTERISTIC PMM_flgHVRdyOvrdVal_C "" VALUE 0x70010b44 Scalar_BOOLEAN 0 VBU0706_CM_boolean_cnt 0.0 1.0 /end CHARACTERISTIC
/begin CHARACTERISTIC PMM_flgHVRlyReqOvrdSwt_C "" VALUE 0x70010b45 Scalar_BOOLEAN 0 VBU0706_CM_boolean_cnt 0.0 1.0 /end CHARACTERISTIC
/begin CHARACTERISTIC PMM_flgRMCUZrTrqReqOvrdSwt_C "" VALUE 0x70010b4a Scalar_BOOLEAN 0 VBU0706_CM_boolean_cnt 0.0 1.0 /end CHARACTERISTIC
/begin CHARACTERISTIC PMM_flgRMCUZrTrqReqOvrdVal_C "" VALUE 0x70010b4b Scalar_BOOLEAN 0 VBU0706_CM_boolean_cnt 0.0 1.0 /end CHARACTERISTIC
/begin CHARACTERISTIC PMM_flgVehRdyOvrdSwt_C "" VALUE 0x70010b50 Scalar_BOOLEAN 0 VBU0706_CM_boolean_cnt 0.0 1.0 /end CHARACTERISTIC
/begin CHARACTERISTIC PMM_flgWkupModOvrdSwt_C "" VALUE 0x70010b55 Scalar_BOOLEAN 0 VBU0706_CM_boolean_cnt 0.0 1.0 /end CHARACTERISTIC
/begin CHARACTERISTIC BATTERY_BOL_SOH "" VALUE 0x70010788 Scalar_UBYTE 0 VBU0706_CM_uint8_cnt 0.0 255.0 /end CHARACTERISTIC
/begin CHARACTERISTIC BATTERY_EOL_SOH "" VALUE 0x70010789 Scalar_UBYTE 0 VBU0706_CM_uint8_cnt 0.0 255.0 /end CHARACTERISTIC
/begin CHARACTERISTIC CaFCC_VCRVCUAuxPowerFactorVoltageTempMapDimension_n "" VAL_BLK 0x70010c09 Scalar_UBYTE 0 VBU0706_CM_uint8_cnt 0.0 255.0 NUMBER 2 /end CHARACTERISTIC
/begin CHARACTERISTIC CcSOE_MaxInterationNumber_n "" VALUE 0x70010954 Scalar_UBYTE 0 VBU0706_CM_uint8_cnt 0.0 255.0 /end CHARACTERISTIC
/begin CHARACTERISTIC DCH_stBEM00TOutMSK_SY "" VALUE 0x70010a12 Scalar_UBYTE 0 VBU0706_CM_uint8_cnt 0.0 255.0 /end CHARACTERISTIC
/begin CHARACTERISTIC DCH_stBEMAATOutMSK_SY "" VALUE 0x70010a13 Scalar_UBYTE 0 VBU0706_CM_uint8_cnt 0.0 255.0 /end CHARACTERISTIC
/begin CHARACTERISTIC DCH_stBEMChCapTOutMSK_SY "" VALUE 0x70010a14 Scalar_UBYTE 0 VBU0706_CM_uint8_cnt 0.0 255.0 /end CHARACTERISTIC
/begin CHARACTERISTIC DCH_stBEMChRdyTOutMSK_SY "" VALUE 0x70010a16 Scalar_UBYTE 0 VBU0706_CM_uint8_cnt 0.0 255.0 /end CHARACTERISTIC
/begin CHARACTERISTIC DCH_stBEMChStTOutMSK_SY "" VALUE 0x70010a18 Scalar_UBYTE 0 VBU0706_CM_uint8_cnt 0.0 255.0 /end CHARACTERISTIC
/begin CHARACTERISTIC DCH_stBEMChgrStopTOutMSK_SY "" VALUE 0x70010a1a Scalar_UBYTE 0 VBU0706_CM_uint8_cnt 0.0 255.0 /end CHARACTERISTIC
/begin CHARACTERISTIC DCH_stBEMStatsDataTOutMSK_SY "" VALUE 0x70010a1e Scalar_UBYTE 0 VBU0706_CM_uint8_cnt 0.0 255.0 /end CHARACTERISTIC
/begin CHARACTERISTIC DCH_stBMSChCmpt_SY "" VALUE 0x70010a20 Scalar_UBYTE 0 VBU0706_CM_uint8_cnt 0.0 255.0 /end CHARACTERISTIC
/begin CHARACTERISTIC DCH_stCDCStopCharging_SY "" VALUE 0x70010a28 Scalar_UBYTE 0 VBU0706_CM_uint8_cnt 0.0 255.0 /end CHARACTERISTIC
/begin CHARACTERISTIC DCH_stCurrDismatchErrMSK_SY "" VALUE 0x70010a34 Scalar_UBYTE 0 VBU0706_CM_uint8_cnt 0.0 255.0 /end CHARACTERISTIC
/begin CHARACTERISTIC DCH_stEnergNotTrnsmtFultMSK_SY "" VALUE 0x70010a36 Scalar_UBYTE 0 VBU0706_CM_uint8_cnt 0.0 255.0 /end CHARACTERISTIC
/begin CHARACTERISTIC DCH_stFaultStopMSK_SY "" VALUE 0x70010a37 Scalar_UBYTE 0 VBU0706_CM_uint8_cnt 0.0 255.0 /end CHARACTERISTIC
/begin CHARACTERISTIC DCH_stKeyRaw_SY "" VALUE 0x70010a3d Scalar_UBYTE 0 VBU0706_CM_uint8_cnt 0.0 255.0 /end CHARACTERISTIC
/begin CHARACTERISTIC DCH_stNGear_SY "" VALUE 0x70010a3f Scalar_UBYTE 0 VBU0706_CM_uint8_cnt 0.0 255.0 /end CHARACTERISTIC
/begin CHARACTERISTIC DCH_stOtherStaStpFultMSK_SY "" VALUE 0x70010a43 Scalar_UBYTE 0 VBU0706_CM_uint8_cnt 0.0 255.0 /end CHARACTERISTIC
/begin CHARACTERISTIC DCH_stPGear_SY "" VALUE 0x70010a44 Scalar_UBYTE 0 VBU0706_CM_uint8_cnt 0.0 255.0 /end CHARACTERISTIC
/begin CHARACTERISTIC DCH_stStaCntorFultMSK_SY "" VALUE 0x70010a48 Scalar_UBYTE 0 VBU0706_CM_uint8_cnt 0.0 255.0 /end CHARACTERISTIC
/begin CHARACTERISTIC DCH_stStaEmergStpFultMSK_SY "" VALUE 0x70010a49 Scalar_UBYTE 0 VBU0706_CM_uint8_cnt 0.0 255.0 /end CHARACTERISTIC
/begin CHARACTERISTIC DCH_stStaIntOverTempFultMSK_SY "" VALUE 0x70010a4a Scalar_UBYTE 0 VBU0706_CM_uint8_cnt 0.0 255.0 /end CHARACTERISTIC
/begin CHARACTERISTIC DCH_stStaOverTempFaultMSK_SY "" VALUE 0x70010a4b Scalar_UBYTE 0 VBU0706_CM_uint8_cnt 0.0 255.0 /end CHARACTERISTIC
/begin CHARACTERISTIC DCH_stStaStopCondReachMSK_SY "" VALUE 0x70010a4c Scalar_UBYTE 0 VBU0706_CM_uint8_cnt 0.0 255.0 /end CHARACTERISTIC
/begin CHARACTERISTIC DCH_stVehSoftwUpdate_SY "" VALUE 0x70010a61 Scalar_UBYTE 0 VBU0706_CM_uint8_cnt 0.0 255.0 /end CHARACTERISTIC
/begin CHARACTERISTIC DCH_stVoltAbnormalErrMSK_SY "" VALUE 0x70010a62 Scalar_UBYTE 0 VBU0706_CM_uint8_cnt 0.0 255.0 /end CHARACTERISTIC
/begin CHARACTERISTIC DSPL_stDCPortTempNoErr_C "" VALUE 0x70010a78 Scalar_UBYTE 0 VBU0706_CM_uint8_cnt 0.0 255.0 /end CHARACTERISTIC
/begin CHARACTERISTIC PMM_stDrvMode_SY "" VALUE 0x70010b5d Scalar_UBYTE 0 VBU0706_CM_uint8_cnt 0.0 255.0 /end CHARACTERISTIC
/begin CHARACTERISTIC PMM_stHVRlyReqOvrdVal_C "" VALUE 0x70010b67 Scalar_UBYTE 0 VBU0706_CM_uint8_cnt 0.0 15.0 /end CHARACTERISTIC
/begin CHARACTERISTIC PMM_stImmoPass_SY "" VALUE 0x70010b68 Scalar_UBYTE 0 VBU0706_CM_uint8_cnt 0.0 255.0 /end CHARACTERISTIC
/begin CHARACTERISTIC PMM_stNoReqMode_SY "" VALUE 0x70010b6c Scalar_UBYTE 0 VBU0706_CM_uint8_cnt 0.0 255.0 /end CHARACTERISTIC
/begin CHARACTERISTIC PMM_stPEUOpStandbyMod_SY "" VALUE 0x70010b6d Scalar_UBYTE 0 VBU0706_CM_uint8_cnt 0.0 255.0 /end CHARACTERISTIC
/begin CHARACTERISTIC PMM_stPEUOpTorMod_SY "" VALUE 0x70010b6e Scalar_UBYTE 0 VBU0706_CM_uint8_cnt 0.0 255.0 /end CHARACTERISTIC
/begin CHARACTERISTIC PMM_stPEUROpModOvrdSwt_C "" VALUE 0x70010b6f Scalar_UBYTE 0 VBU0706_CM_uint8_cnt 0.0 15.0 /end CHARACTERISTIC
/begin CHARACTERISTIC PMM_stPEUROpModOvrdVal_C "" VALUE 0x70010b70 Scalar_UBYTE 0 VBU0706_CM_uint8_cnt 0.0 15.0 /end CHARACTERISTIC
/begin CHARACTERISTIC PMM_stWkupModOvrdVal_C "" VALUE 0x70010b73 Scalar_UBYTE 0 VBU0706_CM_uint8_cnt 0.0 15.0 /end CHARACTERISTIC
/begin CHARACTERISTIC PMM_trqMaxPEUStandBy_C "" VALUE 0x70010b74 Scalar_UBYTE 0 VBU0706_CM_uint8_cnt 0.0 255.0 /end CHARACTERISTIC
/begin CHARACTERISTIC SOC_JUMP_ABNORMAL_POWER_OFF "" VALUE 0x70010b79 Scalar_UBYTE 0 VBU0706_CM_uint8_cnt 0.0 255.0 /end CHARACTERISTIC
/begin CHARACTERISTIC SOC_JUMP_ABNORMAL_RESET "" VALUE 0x70010b7a Scalar_UBYTE 0 VBU0706_CM_uint8_cnt 0.0 255.0 /end CHARACTERISTIC
/begin CHARACTERISTIC SOC_JUMP_NONE "" VALUE 0x70010b7b Scalar_UBYTE 0 VBU0706_CM_uint8_cnt 0.0 255.0 /end CHARACTERISTIC
/begin CHARACTERISTIC SOC_JUMP_OCV_CORRECTION "" VALUE 0x70010b7c Scalar_UBYTE 0 VBU0706_CM_uint8_cnt 0.0 255.0 /end CHARACTERISTIC
/begin CHARACTERISTIC SYS_stMCUDisChMalFunc_SY "" VALUE 0x70010b92 Scalar_UBYTE 0 VBU0706_CM_uint8_cnt 0.0 255.0 /end CHARACTERISTIC
/begin CHARACTERISTIC SYS_stShftPosNeutr_SY "" VALUE 0x70010b94 Scalar_UBYTE 0 VBU0706_CM_uint8_cnt 0.0 255.0 /end CHARACTERISTIC
/begin CHARACTERISTIC SYS_stShftPosPark_SY "" VALUE 0x70010b95 Scalar_UBYTE 0 VBU0706_CM_uint8_cnt 0.0 255.0 /end CHARACTERISTIC
/begin MEASUREMENT SOH_pctPackSoh "" FLOAT32_IEEE VBU0706_CM_single 0 0 -3.4E+38 3.4E+38 ECU_ADDRESS 0x700118fa /end MEASUREMENT
/begin MEASUREMENT LcSOC_iABatteryCurrentWinAve "" FLOAT32_IEEE VBU0706_CM_single_A 0 0 -3.4E+38 3.4E+38 ECU_ADDRESS 0x700116fe /end MEASUREMENT
/begin MEASUREMENT VCT_iABMSPackCrnt "" FLOAT32_IEEE VBU0706_CM_single 0 0 -3.4E+38 3.4E+38 ECU_ADDRESS 0x70011b6a /end MEASUREMENT
/begin MEASUREMENT VCT_uBMSPackVoltage "" FLOAT32_IEEE VBU0706_CM_single 0 0 -3.4E+38 3.4E+38 ECU_ADDRESS 0x70011bda /end MEASUREMENT
/begin MEASUREMENT VCT_pctBMSSOC "" FLOAT32_IEEE VBU0706_CM_single 0 0 -3.4E+38 3.4E+38 ECU_ADDRESS 0x70011b9e /end MEASUREMENT
/begin MEASUREMENT VCT_numBMSRollingCounter225 "" FLOAT32_IEEE VBU0706_CM_single 0 0 -3.4E+38 3.4E+38 ECU_ADDRESS 0x70011b8e /end MEASUREMENT
/begin MEASUREMENT VCT_pctBMSCustomerUsageSOC "" FLOAT32_IEEE VBU0706_CM_single 0 0 -3.4E+38 3.4E+38 ECU_ADDRESS 0x70011b96 /end MEASUREMENT
/begin MEASUREMENT VCT_tBMSTemperatureMax "" FLOAT32_IEEE VBU0706_CM_single 0 0 -3.4E+38 3.4E+38 ECU_ADDRESS 0x70011bbe /end MEASUREMENT
/begin MEASUREMENT VCT_tBMSTemperatureMin "" FLOAT32_IEEE VBU0706_CM_single 0 0 -3.4E+38 3.4E+38 ECU_ADDRESS 0x70011bc2 /end MEASUREMENT
/begin MEASUREMENT VCT_tBMSInletWaterTemp "" FLOAT32_IEEE VBU0706_CM_single 0 0 -3.4E+38 3.4E+38 ECU_ADDRESS 0x70011baa /end MEASUREMENT
/begin MEASUREMENT VCT_tBMSOutletWaterTemp "" FLOAT32_IEEE VBU0706_CM_single 0 0 -3.4E+38 3.4E+38 ECU_ADDRESS 0x70011bb6 /end MEASUREMENT
/begin MEASUREMENT VCT_tBMSTemperatureAverage "" FLOAT32_IEEE VBU0706_CM_single 0 0 -3.4E+38 3.4E+38 ECU_ADDRESS 0x70011bba /end MEASUREMENT
/begin MEASUREMENT VCT_tBMSCellTempStandardDeviation "" FLOAT32_IEEE VBU0706_CM_single 0 0 -3.4E+38 3.4E+38 ECU_ADDRESS 0x70011ba2 /end MEASUREMENT
/begin MEASUREMENT VCT_tBMSInletTempRequest "" FLOAT32_IEEE VBU0706_CM_single 0 0 -3.4E+38 3.4E+38 ECU_ADDRESS 0x70011ba6 /end MEASUREMENT
/begin MEASUREMENT VCT_numBMSRollingCounterAF "" FLOAT32_IEEE VBU0706_CM_single 0 0 -3.4E+38 3.4E+38 ECU_ADDRESS 0x70011b92 /end MEASUREMENT
/begin MEASUREMENT VCT_tBMSMaximumCellTemp "" FLOAT32_IEEE VBU0706_CM_single 0 0 -3.4E+38 3.4E+38 ECU_ADDRESS 0x70011bae /end MEASUREMENT
/begin MEASUREMENT VCT_tBMSMinimumCellTemp "" FLOAT32_IEEE VBU0706_CM_single 0 0 -3.4E+38 3.4E+38 ECU_ADDRESS 0x70011bb2 /end MEASUREMENT
/begin MEASUREMENT VCT_pctBMSDCChrgFinalSOC "" FLOAT32_IEEE VBU0706_CM_single 0 0 -3.4E+38 3.4E+38 ECU_ADDRESS 0x70011b9a /end MEASUREMENT
/begin MEASUREMENT VCT_kwBMSChgPowerLimitST "" FLOAT32_IEEE VBU0706_CM_single 0 0 -3.4E+38 3.4E+38 ECU_ADDRESS 0x70011b7a /end MEASUREMENT
/begin MEASUREMENT VCT_kwBMSChgPowerLimitLT "" FLOAT32_IEEE VBU0706_CM_single 0 0 -3.4E+38 3.4E+38 ECU_ADDRESS 0x70011b76 /end MEASUREMENT
/begin MEASUREMENT VCT_kwBMSChgPowerLimitDynamic "" FLOAT32_IEEE VBU0706_CM_single 0 0 -3.4E+38 3.4E+38 ECU_ADDRESS 0x70011b72 /end MEASUREMENT
/begin MEASUREMENT VCT_timinEstimatePercTime "" FLOAT32_IEEE VBU0706_CM_single 0 0 -3.4E+38 3.4E+38 ECU_ADDRESS 0x70011bca /end MEASUREMENT
/begin MEASUREMENT VCT_uBMSCellVoltageMax "" FLOAT32_IEEE VBU0706_CM_single 0 0 -3.4E+38 3.4E+38 ECU_ADDRESS 0x70011bd2 /end MEASUREMENT
/begin MEASUREMENT VCT_uBMSCellVoltageMin "" FLOAT32_IEEE VBU0706_CM_single 0 0 -3.4E+38 3.4E+38 ECU_ADDRESS 0x70011bd6 /end MEASUREMENT
/begin MEASUREMENT VCT_timinBMSEstimateChargingTime "" FLOAT32_IEEE VBU0706_CM_single 0 0 -3.4E+38 3.4E+38 ECU_ADDRESS 0x70011bc6 /end MEASUREMENT
/begin MEASUREMENT VCT_uBMSCellVoltageAve "" FLOAT32_IEEE VBU0706_CM_single 0 0 -3.4E+38 3.4E+38 ECU_ADDRESS 0x70011bce /end MEASUREMENT
/begin MEASUREMENT VCT_kwBMSDischgPowerLimitLT "" FLOAT32_IEEE VBU0706_CM_single 0 0 -3.4E+38 3.4E+38 ECU_ADDRESS 0x70011b82 /end MEASUREMENT
/begin MEASUREMENT VCT_kwBMSDischgPowerLimitST "" FLOAT32_IEEE VBU0706_CM_single 0 0 -3.4E+38 3.4E+38 ECU_ADDRESS 0x70011b86 /end MEASUREMENT
/begin MEASUREMENT VCT_kwBMSDischgPowerLimitDynamic "" FLOAT32_IEEE VBU0706_CM_single 0 0 -3.4E+38 3.4E+38 ECU_ADDRESS 0x70011b7e /end MEASUREMENT
/begin MEASUREMENT VCT_kohmBMSInsulationResistanceValue "" FLOAT32_IEEE VBU0706_CM_single 0 0 -3.4E+38 3.4E+38 ECU_ADDRESS 0x70011b6e /end MEASUREMENT
/begin MEASUREMENT VCT_kwhBMSPackEnergyAvailable "" FLOAT32_IEEE VBU0706_CM_single 0 0 -3.4E+38 3.4E+38 ECU_ADDRESS 0x70011b8a /end MEASUREMENT
/begin MEASUREMENT SOH_iABeforeStepAveCurrent "" FLOAT32_IEEE VBU0706_CM_single 0 0 -3.4E+38 3.4E+38 ECU_ADDRESS 0x700118f6 /end MEASUREMENT
/begin MEASUREMENT SOF_iAContinuousChargeCurrentLimitBase "" FLOAT32_IEEE VBU0706_CM_single 0 0 -3.4E+38 3.4E+38 ECU_ADDRESS 0x7001180e /end MEASUREMENT
/begin MEASUREMENT SOF_iAShortPulseChargeCurrentLimitBase "" FLOAT32_IEEE VBU0706_CM_single 0 0 -3.4E+38 3.4E+38 ECU_ADDRESS 0x70011862 /end MEASUREMENT
/begin MEASUREMENT SOF_iAContinuousDischargeCurrentLimitTarget "" FLOAT32_IEEE VBU0706_CM_single 0 0 -3.4E+38 3.4E+38 ECU_ADDRESS 0x7001182a /end MEASUREMENT
/begin MEASUREMENT SOF_iAShortPulseDischargeCurrentLimitTarget "" FLOAT32_IEEE VBU0706_CM_single 0 0 -3.4E+38 3.4E+38 ECU_ADDRESS 0x70011882 /end MEASUREMENT
/begin MEASUREMENT SOF_iADynamicDischargeCurrentLimitTarget "" FLOAT32_IEEE VBU0706_CM_single 0 0 -3.4E+38 3.4E+38 ECU_ADDRESS 0x7001184a /end MEASUREMENT
/begin MEASUREMENT SOF_iAContinuousChargeCurrentLimitTarget "" FLOAT32_IEEE VBU0706_CM_single 0 0 -3.4E+38 3.4E+38 ECU_ADDRESS 0x7001181e /end MEASUREMENT
/begin MEASUREMENT SOF_iAShortPulseChargeCurrentLimitTarget "" FLOAT32_IEEE VBU0706_CM_single 0 0 -3.4E+38 3.4E+38 ECU_ADDRESS 0x7001186e /end MEASUREMENT
/begin MEASUREMENT SOF_iADynamicChargeCurrentLimitTarget "" FLOAT32_IEEE VBU0706_CM_single 0 0 -3.4E+38 3.4E+38 ECU_ADDRESS 0x7001183e /end MEASUREMENT
/begin MEASUREMENT SOF_iAFastChrgLookUpCurr "" FLOAT32_IEEE VBU0706_CM_single_A 0 0 -3.4E+38 3.4E+38 ECU_ADDRESS 0x7001185e /end MEASUREMENT
/begin MEASUREMENT SOF_kwContinuousDischargePowerLimitTarget "" FLOAT32_IEEE VBU0706_CM_single 0 0 -3.4E+38 3.4E+38 ECU_ADDRESS 0x700118ae /end MEASUREMENT
/begin MEASUREMENT SOF_kwDischargePowerLimitTarget "" FLOAT32_IEEE VBU0706_CM_single 0 0 -3.4E+38 3.4E+38 ECU_ADDRESS 0x700118c6 /end MEASUREMENT
/begin MEASUREMENT SOC_pctCellVoltageMaxCorrectionSoc "" FLOAT32_IEEE VBU0706_CM_single 0 0 -3.4E+38 3.4E+38 ECU_ADDRESS 0x700117d6 /end MEASUREMENT
/begin MEASUREMENT SOC_pctBatteryDisplaySocDischargeDecRate "" FLOAT32_IEEE VBU0706_CM_single 0 0 -3.4E+38 3.4E+38 ECU_ADDRESS 0x700117b6 /end MEASUREMENT
/begin MEASUREMENT SOC_pctBatteryDisplaySocDischargeIncRate "" FLOAT32_IEEE VBU0706_CM_single 0 0 -3.4E+38 3.4E+38 ECU_ADDRESS 0x700117ba /end MEASUREMENT
/begin MEASUREMENT SOC_pctBatteryDisplaySocChargeDecRate "" FLOAT32_IEEE VBU0706_CM_single 0 0 -3.4E+38 3.4E+38 ECU_ADDRESS 0x700117ae /end MEASUREMENT
/begin MEASUREMENT SOC_pctBatteryDisplaySocChargeIncRate "" FLOAT32_IEEE VBU0706_CM_single 0 0 -3.4E+38 3.4E+38 ECU_ADDRESS 0x700117b2 /end MEASUREMENT
/begin MEASUREMENT FCC_iADecreasedChargeCurrentRequest "" FLOAT32_IEEE VBU0706_CM_single 0 0 -3.4E+38 3.4E+38 ECU_ADDRESS 0x7001161e /end MEASUREMENT
/begin MEASUREMENT FCC_iAChargeCurrentReqDec "" FLOAT32_IEEE VBU0706_CM_single 0 0 -3.4E+38 3.4E+38 ECU_ADDRESS 0x7001160e /end MEASUREMENT
/begin MEASUREMENT FCC_iARawChargeCurrentRequestFnl "" FLOAT32_IEEE VBU0706_CM_single 0 0 -3.4E+38 3.4E+38 ECU_ADDRESS 0x70011622 /end MEASUREMENT
/begin MEASUREMENT FCC_kwChargePowerReqFnl "" FLOAT32_IEEE VBU0706_CM_single 0 0 -3.4E+38 3.4E+38 ECU_ADDRESS 0x7001162a /end MEASUREMENT
/begin MEASUREMENT FCC_uChargeVoltageRequestFnl "" FLOAT32_IEEE VBU0706_CM_single 0 0 -3.4E+38 3.4E+38 ECU_ADDRESS 0x7001165e /end MEASUREMENT
/begin MEASUREMENT FCC_iAChargeCurrentRequestRaw "" FLOAT32_IEEE VBU0706_CM_single 0 0 -3.4E+38 3.4E+38 ECU_ADDRESS 0x70011616 /end MEASUREMENT
/begin MEASUREMENT FCC_pctMaxSetSocMappingRealSoc "" FLOAT32_IEEE VBU0706_CM_single 0 0 -3.4E+38 3.4E+38 ECU_ADDRESS 0x70011636 /end MEASUREMENT
/begin MEASUREMENT FCC_pctDisplaySocMappingRealSoc "" FLOAT32_IEEE VBU0706_CM_single 0 0 -3.4E+38 3.4E+38 ECU_ADDRESS 0x7001162e /end MEASUREMENT
/begin MEASUREMENT FCC_pctEightySOCMappingRealSoc "" FLOAT32_IEEE VBU0706_CM_single 0 0 -3.4E+38 3.4E+38 ECU_ADDRESS 0x70011632 /end MEASUREMENT
/begin MEASUREMENT EDIS_pwrDisChBattPwr "" FLOAT32_IEEE VBU0706_CM_single 0 0 -3.4E+38 3.4E+38 ECU_ADDRESS 0x7001158a /end MEASUREMENT
/begin MEASUREMENT EDIS_pwrDchaDelta "" FLOAT32_IEEE VBU0706_CM_single 0 0 -1000.0 1000.0 ECU_ADDRESS 0x70011586 /end MEASUREMENT
/begin MEASUREMENT EDIS_pwrPIDDisChgFnl "" FLOAT32_IEEE VBU0706_CM_single 0 0 -3.4E+38 3.4E+38 ECU_ADDRESS 0x700115c6 /end MEASUREMENT
/begin MEASUREMENT EDIS_pwrBattMaxPwr "" FLOAT32_IEEE VBU0706_CM_single 0 0 0.0 1000.0 ECU_ADDRESS 0x7001156a /end MEASUREMENT
/begin MEASUREMENT EDIS_pwrBattMaxPwrFnl "" FLOAT32_IEEE VBU0706_CM_single 0 0 0.0 1000.0 ECU_ADDRESS 0x7001156e /end MEASUREMENT
/begin MEASUREMENT EDIS_pwrAcsPwrReq "" FLOAT32_IEEE VBU0706_CM_single 0 0 -3.4E+38 3.4E+38 ECU_ADDRESS 0x70011562 /end MEASUREMENT
/begin MEASUREMENT EDIS_pwrDrvPwrLim "" FLOAT32_IEEE VBU0706_CM_single 0 0 -3.4E+38 3.4E+38 ECU_ADDRESS 0x700115ba /end MEASUREMENT
/begin MEASUREMENT EDIS_pwrRgnLim "" FLOAT32_IEEE VBU0706_CM_single 0 0 -3.4E+38 3.4E+38 ECU_ADDRESS 0x700115da /end MEASUREMENT
/begin MEASUREMENT EDIS_pwrRgnDelta "" FLOAT32_IEEE VBU0706_CM_single 0 0 -3.4E+38 3.4E+38 ECU_ADDRESS 0x700115ce /end MEASUREMENT
/begin MEASUREMENT EDIS_pwrRgnPterm "" FLOAT32_IEEE VBU0706_CM_single 0 0 -3.4E+38 3.4E+38 ECU_ADDRESS 0x700115de /end MEASUREMENT
/begin MEASUREMENT EDIS_pwrRgnIterm "" FLOAT32_IEEE VBU0706_CM_single 0 0 -3.4E+38 3.4E+38 ECU_ADDRESS 0x700115d6 /end MEASUREMENT
/begin MEASUREMENT EDIS_pwrRgnDterm "" FLOAT32_IEEE VBU0706_CM_single 0 0 -3.4E+38 3.4E+38 ECU_ADDRESS 0x700115d2 /end MEASUREMENT
/begin MEASUREMENT EDIS_pwrRgn "" FLOAT32_IEEE VBU0706_CM_single 0 0 -3.4E+38 3.4E+38 ECU_ADDRESS 0x700115ca /end MEASUREMENT
/begin MEASUREMENT EDIS_pwrBattMinPwrFnl "" FLOAT32_IEEE VBU0706_CM_single 0 0 0.0 1000.0 ECU_ADDRESS 0x70011572 /end MEASUREMENT
/begin MEASUREMENT ACCompVoltage "" FLOAT32_IEEE VBU0706_CM_single 0 0 -3.4E+38 3.4E+38 ECU_ADDRESS 0x7001140e /end MEASUREMENT
/begin MEASUREMENT ACCompCurrent "" FLOAT32_IEEE VBU0706_CM_single 0 0 -3.4E+38 3.4E+38 ECU_ADDRESS 0x7001140a /end MEASUREMENT
/begin MEASUREMENT ACOverCurrent "" FLOAT32_IEEE VBU0706_CM_single 0 0 -3.4E+38 3.4E+38 ECU_ADDRESS 0x70011412 /end MEASUREMENT
/begin MEASUREMENT ACOverVoltage "" FLOAT32_IEEE VBU0706_CM_single 0 0 -3.4E+38 3.4E+38 ECU_ADDRESS 0x70011416 /end MEASUREMENT
/begin MEASUREMENT ACUnderVoltage "" FLOAT32_IEEE VBU0706_CM_single 0 0 -3.4E+38 3.4E+38 ECU_ADDRESS 0x7001141a /end MEASUREMENT
/begin MEASUREMENT ACCompActSpeed "" FLOAT32_IEEE VBU0706_CM_single 0 0 -3.4E+38 3.4E+38 ECU_ADDRESS 0x70011406 /end MEASUREMENT
/begin MEASUREMENT ABS_WheelSpeed_RR "" FLOAT32_IEEE VBU0706_CM_single 0 0 -3.4E+38 3.4E+38 ECU_ADDRESS 0x70011402 /end MEASUREMENT
/begin MEASUREMENT ABS_WheelSpeed_RL "" FLOAT32_IEEE VBU0706_CM_single 0 0 -3.4E+38 3.4E+38 ECU_ADDRESS 0x700113fe /end MEASUREMENT
/begin MEASUREMENT ABS_WheelSpeed_FR "" FLOAT32_IEEE VBU0706_CM_single 0 0 -3.4E+38 3.4E+38 ECU_ADDRESS 0x700113fa /end MEASUREMENT
/begin MEASUREMENT ABS_WheelSpeed_FL "" FLOAT32_IEEE VBU0706_CM_single 0 0 -3.4E+38 3.4E+38 ECU_ADDRESS 0x700113f6 /end MEASUREMENT
/begin MEASUREMENT T_BOXGPS_Latitude "" FLOAT32_IEEE VBU0706_CM_single 0 0 -3.4E+38 3.4E+38 ECU_ADDRESS 0x70011a9a /end MEASUREMENT
/begin MEASUREMENT T_BOXGPS_Longitude "" FLOAT32_IEEE VBU0706_CM_single 0 0 -3.4E+38 3.4E+38 ECU_ADDRESS 0x70011a9e /end MEASUREMENT
/begin MEASUREMENT IC_VehOdometer "" FLOAT32_IEEE VBU0706_CM_single 0 0 -3.4E+38 3.4E+38 ECU_ADDRESS 0x70011696 /end MEASUREMENT
/begin MEASUREMENT EPS_TORque_Motor "" FLOAT32_IEEE VBU0706_CM_single 0 0 -3.4E+38 3.4E+38 ECU_ADDRESS 0x700115ee /end MEASUREMENT
/begin MEASUREMENT EPS_Torque_Steering "" FLOAT32_IEEE VBU0706_CM_single 0 0 -3.4E+38 3.4E+38 ECU_ADDRESS 0x700115f2 /end MEASUREMENT
/begin MEASUREMENT EPS_steering_angle_spd "" FLOAT32_IEEE VBU0706_CM_single 0 0 -3.4E+38 3.4E+38 ECU_ADDRESS 0x700115f6 /end MEASUREMENT
/begin MEASUREMENT EPS_Steering_Angle "" FLOAT32_IEEE VBU0706_CM_single 0 0 -3.4E+38 3.4E+38 ECU_ADDRESS 0x700115ea /end MEASUREMENT
/begin MEASUREMENT DragForce "" FLOAT32_IEEE VBU0706_CM_single 0 0 -3.4E+38 3.4E+38 ECU_ADDRESS 0x7001155a /end MEASUREMENT
/begin MEASUREMENT DCDCTemperature "" FLOAT32_IEEE VBU0706_CM_single 0 0 -3.4E+38 3.4E+38 ECU_ADDRESS 0x700114fa /end MEASUREMENT
/begin MEASUREMENT ABS_VehicleSpeed "" FLOAT32_IEEE VBU0706_CM_single 0 0 -3.4E+38 3.4E+38 ECU_ADDRESS 0x700113f2 /end MEASUREMENT
/begin MEASUREMENT ABS_WheelSpeedPlusCounter_RR_inv "" UWORD VBU0706_CM_uint16 0 0 0 65535 ECU_ADDRESS 0x700111d2 /end MEASUREMENT
/begin MEASUREMENT ABS_WheelSpeedPlusCounter_RL_inv "" UWORD VBU0706_CM_uint16 0 0 0 65535 ECU_ADDRESS 0x700111ce /end MEASUREMENT
/begin MEASUREMENT ABS_WheelSpeedPlusCounter_RR "" UWORD VBU0706_CM_uint16 0 0 0 65535 ECU_ADDRESS 0x700111d0 /end MEASUREMENT
/begin MEASUREMENT ABS_WheelSpeedPlusCounter_RL "" UWORD VBU0706_CM_uint16 0 0 0 65535 ECU_ADDRESS 0x700111cc /end MEASUREMENT
/begin MEASUREMENT ABS_WheelSpeedPlusCounter_FR_inv "" UWORD VBU0706_CM_uint16 0 0 0 65535 ECU_ADDRESS 0x700111ca /end MEASUREMENT
/begin MEASUREMENT ABS_WheelSpeedPlusCounter_FL_inv "" UWORD VBU0706_CM_uint16 0 0 0 65535 ECU_ADDRESS 0x700111c6 /end MEASUREMENT
/begin MEASUREMENT ABS_WheelSpeedPlusCounter_FR "" UWORD VBU0706_CM_uint16 0 0 0 65535 ECU_ADDRESS 0x700111c8 /end MEASUREMENT
/begin MEASUREMENT ABS_WheelSpeedPlusCounter_FL "" UWORD VBU0706_CM_uint16 0 0 0 65535 ECU_ADDRESS 0x700111c4 /end MEASUREMENT
/begin MEASUREMENT T_BOXTime_Sec "" UWORD VBU0706_CM_uint16 0 0 0 65535 ECU_ADDRESS 0x700113ec /end MEASUREMENT
/begin MEASUREMENT T_BOXTime_Min "" UWORD VBU0706_CM_uint16 0 0 0 65535 ECU_ADDRESS 0x700113e8 /end MEASUREMENT
/begin MEASUREMENT T_BOXTime_Day "" UWORD VBU0706_CM_uint16 0 0 0 65535 ECU_ADDRESS 0x700113e4 /end MEASUREMENT
/begin MEASUREMENT T_BOXTime_Hour "" UWORD VBU0706_CM_uint16 0 0 0 65535 ECU_ADDRESS 0x700113e6 /end MEASUREMENT
/begin MEASUREMENT T_BOXTime_Month "" UWORD VBU0706_CM_uint16 0 0 0 65535 ECU_ADDRESS 0x700113ea /end MEASUREMENT
/begin MEASUREMENT T_BOXTime_Year "" UWORD VBU0706_CM_uint16 0 0 0 65535 ECU_ADDRESS 0x700113ee /end MEASUREMENT
/begin MEASUREMENT THM_flgInletTempValid "" UBYTE VBU0706_CM_uint8 0 0 0 255 ECU_ADDRESS 0x70011f01 /end MEASUREMENT
/begin MEASUREMENT THM_flgOutletTempValid "" UBYTE VBU0706_CM_uint8 0 0 0 255 ECU_ADDRESS 0x70011f02 /end MEASUREMENT
/begin MEASUREMENT VCT_stBMSFaultCat "" UBYTE VBU0706_CM_uint8 0 0 0 255 ECU_ADDRESS 0x70011f33 /end MEASUREMENT
/begin MEASUREMENT VCT_stBMSFaultLvl "" UBYTE VBU0706_CM_uint8 0 0 0 255 ECU_ADDRESS 0x70011f34 /end MEASUREMENT
/begin MEASUREMENT VCT_stBMSContactorState "" UBYTE VBU0706_CM_uint8 0 0 0 255 ECU_ADDRESS 0x70011f31 /end MEASUREMENT
/begin MEASUREMENT VCT_stInhibitPrechargeCause "" UBYTE VBU0706_CM_uint8 0 0 0 255 ECU_ADDRESS 0x70011f4d /end MEASUREMENT
/begin MEASUREMENT VCT_stBMSSts "" UBYTE VBU0706_CM_uint8 0 0 0 255 ECU_ADDRESS 0x70011f36 /end MEASUREMENT
/begin MEASUREMENT VCT_stBMSCellVoltageOverUnder "" UBYTE VBU0706_CM_uint8 0 0 0 255 ECU_ADDRESS 0x70011f30 /end MEASUREMENT
/begin MEASUREMENT VCT_stBMSSOCOverUnder "" UBYTE VBU0706_CM_uint8 0 0 0 255 ECU_ADDRESS 0x70011f35 /end MEASUREMENT
/begin MEASUREMENT VCT_stBMSDCChargeCurrentOverUnder "" UBYTE VBU0706_CM_uint8 0 0 0 255 ECU_ADDRESS 0x70011f32 /end MEASUREMENT
/begin MEASUREMENT VCT_stBatteryTempOver "" UBYTE VBU0706_CM_uint8 0 0 0 255 ECU_ADDRESS 0x70011f3d /end MEASUREMENT
/begin MEASUREMENT VCT_stBatteryOutputConnectorState "" UBYTE VBU0706_CM_uint8 0 0 0 255 ECU_ADDRESS 0x70011f3b /end MEASUREMENT
/begin MEASUREMENT VCT_stDCChargingPermitStatus "" UBYTE VBU0706_CM_uint8 0 0 0 255 ECU_ADDRESS 0x70011f4c /end MEASUREMENT
/begin MEASUREMENT VCT_stBetteryPckVoltOverAlarm "" UBYTE VBU0706_CM_uint8 0 0 0 255 ECU_ADDRESS 0x70011f43 /end MEASUREMENT
/begin MEASUREMENT VCT_stBetteryPckVoltUnderAlarm "" UBYTE VBU0706_CM_uint8 0 0 0 255 ECU_ADDRESS 0x70011f44 /end MEASUREMENT
/begin MEASUREMENT VCT_stBatteryConsistencyAlarm "" UBYTE VBU0706_CM_uint8 0 0 0 255 ECU_ADDRESS 0x70011f3a /end MEASUREMENT
/begin MEASUREMENT VCT_stBatteryTempDifferAlarm "" UBYTE VBU0706_CM_uint8 0 0 0 255 ECU_ADDRESS 0x70011f3c /end MEASUREMENT
/begin MEASUREMENT VCT_stBetteryCellTempHighAlarm "" UBYTE VBU0706_CM_uint8 0 0 0 255 ECU_ADDRESS 0x70011f3f /end MEASUREMENT
/begin MEASUREMENT VCT_stBetteryCellTempLowAlarm "" UBYTE VBU0706_CM_uint8 0 0 0 255 ECU_ADDRESS 0x70011f40 /end MEASUREMENT
/begin MEASUREMENT VCT_stBetteryCellVolHighAlarm "" UBYTE VBU0706_CM_uint8 0 0 0 255 ECU_ADDRESS 0x70011f41 /end MEASUREMENT
/begin MEASUREMENT VCT_stBetteryCellVolLowAlarm "" UBYTE VBU0706_CM_uint8 0 0 0 255 ECU_ADDRESS 0x70011f42 /end MEASUREMENT
/begin MEASUREMENT VCT_stSOCJumpAlarm "" UBYTE VBU0706_CM_uint8 0 0 0 255 ECU_ADDRESS 0x70011f4e /end MEASUREMENT
/begin MEASUREMENT VCT_stSOCJumpReason "" UBYTE VBU0706_CM_uint8 0 0 0 255 ECU_ADDRESS 0x70011f4f /end MEASUREMENT
/begin MEASUREMENT VCT_stBatteryTypeDismatchAlarm "" UBYTE VBU0706_CM_uint8 0 0 0 255 ECU_ADDRESS 0x70011f3e /end MEASUREMENT
/begin MEASUREMENT VCT_numBMSMaximumCellVoltageNumber "" UBYTE VBU0706_CM_uint8 0 0 0 255 ECU_ADDRESS 0x70011f2d /end MEASUREMENT
/begin MEASUREMENT VCT_numBMSMaximumTempNumber "" UBYTE VBU0706_CM_uint8 0 0 0 255 ECU_ADDRESS 0x70011f2e /end MEASUREMENT
/begin MEASUREMENT VCT_numBMSMinimumTempNumber "" UBYTE VBU0706_CM_uint8 0 0 0 255 ECU_ADDRESS 0x70011f2f /end MEASUREMENT
/begin MEASUREMENT VCT_stCTMCellThermalRunaway "" UBYTE VBU0706_CM_uint8 0 0 0 255 ECU_ADDRESS 0x70011f4b /end MEASUREMENT
/begin MEASUREMENT SOF_StFastChrgLookUp "" UBYTE VBU0706_CM_uint8 0 0 0 255 ECU_ADDRESS 0x70011ee5 /end MEASUREMENT
/begin MEASUREMENT PMM_stHVRlyReq "" UBYTE VBU0706_CM_uint8 0 0 0 255 ECU_ADDRESS 0x70011eb9 /end MEASUREMENT
/begin MEASUREMENT PMM_stWkupMod "" UBYTE VBU0706_CM_uint8 0 0 0.0 255.0 ECU_ADDRESS 0x70011ebe /end MEASUREMENT
/begin MEASUREMENT PMM_stPEUROpMod "" UBYTE VBU0706_CM_uint8 0 0 0 255 ECU_ADDRESS 0x70011ebb /end MEASUREMENT
/begin MEASUREMENT DCDCEnableFeedback "" UBYTE VBU0706_CM_uint8 0 0 0 255 ECU_ADDRESS 0x70011d60 /end MEASUREMENT
/begin MEASUREMENT DCDCWorkstatus "" UBYTE VBU0706_CM_uint8 0 0 0 255 ECU_ADDRESS 0x70011d6c /end MEASUREMENT
/begin MEASUREMENT DCDCrollingcounter "" UBYTE VBU0706_CM_uint8 0 0 0 255 ECU_ADDRESS 0x70011d6d /end MEASUREMENT
/begin MEASUREMENT DCDCOutputCurrent "" UBYTE VBU0706_CM_uint8 0 0 0 255 ECU_ADDRESS 0x70011d63 /end MEASUREMENT
/begin MEASUREMENT DCDCInputCurrent "" UBYTE VBU0706_CM_uint8 0 0 0 255 ECU_ADDRESS 0x70011d61 /end MEASUREMENT
/begin MEASUREMENT DCDCOutputVoltage "" UBYTE VBU0706_CM_uint8 0 0 0 255 ECU_ADDRESS 0x70011d64 /end MEASUREMENT
/begin MEASUREMENT DCDCInputVoltage "" UBYTE VBU0706_CM_uint8 0 0 0 255 ECU_ADDRESS 0x70011d62 /end MEASUREMENT
/begin MEASUREMENT CDC_checksum "" UBYTE VBU0706_CM_uint8 0 0 0 255 ECU_ADDRESS 0x70011d23 /end MEASUREMENT
/begin MEASUREMENT CDC_rollingcounter "" UBYTE VBU0706_CM_uint8 0 0 0 255 ECU_ADDRESS 0x70011d24 /end MEASUREMENT
/begin MEASUREMENT CDC_DriveMode "" UBYTE VBU0706_CM_uint8 0 0 0 255 ECU_ADDRESS 0x70011d1f /end MEASUREMENT
/begin MEASUREMENT CDC_RegenMode "" UBYTE VBU0706_CM_uint8 0 0 0 255 ECU_ADDRESS 0x70011d21 /end MEASUREMENT
/begin MEASUREMENT CDC_GoNotifierOnOff "" UBYTE VBU0706_CM_uint8 0 0 0 255 ECU_ADDRESS 0x70011d20 /end MEASUREMENT
/begin MEASUREMENT CDC_TowMode "" UBYTE VBU0706_CM_uint8 0 0 0 255 ECU_ADDRESS 0x70011d22 /end MEASUREMENT
/begin MEASUREMENT CDC_CreepOnOff "" UBYTE VBU0706_CM_uint8 0 0 0 255 ECU_ADDRESS 0x70011d1e /end MEASUREMENT
/begin MEASUREMENT BCM_Automatic_headlight_gear "" UBYTE VBU0706_CM_uint8 0 0 0 255 ECU_ADDRESS 0x70011ce1 /end MEASUREMENT
/begin MEASUREMENT BCM_Automatic_wiper_gear "" UBYTE VBU0706_CM_uint8 0 0 0 255 ECU_ADDRESS 0x70011ce2 /end MEASUREMENT
/begin MEASUREMENT BCM_HI_Wiper_Status "" UBYTE VBU0706_CM_uint8 0 0 0 255 ECU_ADDRESS 0x70011ce7 /end MEASUREMENT
/begin MEASUREMENT BCM_Low_Wiper_Status "" UBYTE VBU0706_CM_uint8 0 0 0 255 ECU_ADDRESS 0x70011ced /end MEASUREMENT
/begin MEASUREMENT BCM_Wash_Motor_Status "" UBYTE VBU0706_CM_uint8 0 0 0 255 ECU_ADDRESS 0x70011cf3 /end MEASUREMENT
/begin MEASUREMENT BCM_IG1_Power "" UBYTE VBU0706_CM_uint8 0 0 0 255 ECU_ADDRESS 0x70011cea /end MEASUREMENT
/begin MEASUREMENT BCM_DoorStatus "" UBYTE VBU0706_CM_uint8 0 0 0 255 ECU_ADDRESS 0x70011ce5 /end MEASUREMENT
/begin MEASUREMENT BCM_Brake_Light_Status "" UBYTE VBU0706_CM_uint8 0 0 0 255 ECU_ADDRESS 0x70011ce3 /end MEASUREMENT
/begin MEASUREMENT BCM_Prak_Switch_Status "" UBYTE VBU0706_CM_uint8 0 0 0 255 ECU_ADDRESS 0x70011cef /end MEASUREMENT
/begin MEASUREMENT BCM_Horn_Status "" UBYTE VBU0706_CM_uint8 0 0 0 255 ECU_ADDRESS 0x70011ce9 /end MEASUREMENT
/begin MEASUREMENT BCM_Reversing_Switch_Status "" UBYTE VBU0706_CM_uint8 0 0 0 255 ECU_ADDRESS 0x70011cf1 /end MEASUREMENT
/begin MEASUREMENT BCM_HighBeam "" UBYTE VBU0706_CM_uint8 0 0 0 255 ECU_ADDRESS 0x70011ce8 /end MEASUREMENT
/begin MEASUREMENT BCM_LowBeam "" UBYTE VBU0706_CM_uint8 0 0 0 255 ECU_ADDRESS 0x70011cec /end MEASUREMENT
/begin MEASUREMENT BCM_LeftTurnLightStatus "" UBYTE VBU0706_CM_uint8 0 0 0 255 ECU_ADDRESS 0x70011ceb /end MEASUREMENT
/begin MEASUREMENT BCM_RightTurnLightStatus "" UBYTE VBU0706_CM_uint8 0 0 0 255 ECU_ADDRESS 0x70011cf2 /end MEASUREMENT
/begin MEASUREMENT BCM_FrontFogLight "" UBYTE VBU0706_CM_uint8 0 0 0 255 ECU_ADDRESS 0x70011ce6 /end MEASUREMENT
/begin MEASUREMENT BCM_Park_Light_Status "" UBYTE VBU0706_CM_uint8 0 0 0 255 ECU_ADDRESS 0x70011cee /end MEASUREMENT
/begin MEASUREMENT BCM_Day_Light_Status "" UBYTE VBU0706_CM_uint8 0 0 0 255 ECU_ADDRESS 0x70011ce4 /end MEASUREMENT
/begin MEASUREMENT BCM_RearFogLight "" UBYTE VBU0706_CM_uint8 0 0 0 255 ECU_ADDRESS 0x70011cf0 /end MEASUREMENT
/begin MEASUREMENT AVAS_SoftwareVersion "" UBYTE VBU0706_CM_uint8 0 0 0 255 ECU_ADDRESS 0x70011cdf /end MEASUREMENT
/begin MEASUREMENT AVAS_HardwareVersion "" UBYTE VBU0706_CM_uint8 0 0 0 255 ECU_ADDRESS 0x70011cde /end MEASUREMENT
/begin MEASUREMENT AVAS_WorkingStatus "" UBYTE VBU0706_CM_uint8 0 0 0 255 ECU_ADDRESS 0x70011ce0 /end MEASUREMENT
/begin MEASUREMENT ACStandby_overvoltage "" UBYTE VBU0706_CM_uint8 0 0 0 255 ECU_ADDRESS 0x70011cd8 /end MEASUREMENT
/begin MEASUREMENT ACStandby_undervoltage "" UBYTE VBU0706_CM_uint8 0 0 0 255 ECU_ADDRESS 0x70011cd9 /end MEASUREMENT
/begin MEASUREMENT ACComFault "" UBYTE VBU0706_CM_uint8 0 0 0 255 ECU_ADDRESS 0x70011cd4 /end MEASUREMENT
/begin MEASUREMENT ACOver_current_FreqReduction "" UBYTE VBU0706_CM_uint8 0 0 0 255 ECU_ADDRESS 0x70011cd6 /end MEASUREMENT
/begin MEASUREMENT ACSpeedFault "" UBYTE VBU0706_CM_uint8 0 0 0 255 ECU_ADDRESS 0x70011cd7 /end MEASUREMENT
/begin MEASUREMENT ACCompStatus "" UBYTE VBU0706_CM_uint8 0 0 0 255 ECU_ADDRESS 0x70011cd5 /end MEASUREMENT
/begin MEASUREMENT ABS_WheelSpeed_RR_Status "" UBYTE VBU0706_CM_uint8 0 0 0 255 ECU_ADDRESS 0x70011cd3 /end MEASUREMENT
/begin MEASUREMENT ABS_WheelSpeed_RL_Status "" UBYTE VBU0706_CM_uint8 0 0 0 255 ECU_ADDRESS 0x70011cd2 /end MEASUREMENT
/begin MEASUREMENT ABS_Checksum "" UBYTE VBU0706_CM_uint8 0 0 0 255 ECU_ADDRESS 0x70011ccc /end MEASUREMENT
/begin MEASUREMENT ABS_Rolling_Counter "" UBYTE VBU0706_CM_uint8 0 0 0 255 ECU_ADDRESS 0x70011cce /end MEASUREMENT
/begin MEASUREMENT ABS_WheelSpeed_FR_Status "" UBYTE VBU0706_CM_uint8 0 0 0 255 ECU_ADDRESS 0x70011cd1 /end MEASUREMENT
/begin MEASUREMENT ABS_WheelSpeed_FL_Status "" UBYTE VBU0706_CM_uint8 0 0 0 255 ECU_ADDRESS 0x70011cd0 /end MEASUREMENT
/begin MEASUREMENT IC_BrakeFluidWarning "" UBYTE VBU0706_CM_uint8 0 0 0 255 ECU_ADDRESS 0x70011e35 /end MEASUREMENT
/begin MEASUREMENT IC_SeatbeltUnlock "" UBYTE VBU0706_CM_uint8 0 0 0 255 ECU_ADDRESS 0x70011e36 /end MEASUREMENT
/begin MEASUREMENT IC_BrakeDisWarning "" UBYTE VBU0706_CM_uint8 0 0 0 255 ECU_ADDRESS 0x70011e34 /end MEASUREMENT
/begin MEASUREMENT EPS_ECU_msg_counter "" UBYTE VBU0706_CM_uint8 0 0 0 255 ECU_ADDRESS 0x70011dbf /end MEASUREMENT
/begin MEASUREMENT EPS_ECU_MODE_CONT "" UBYTE VBU0706_CM_uint8 0 0 0 255 ECU_ADDRESS 0x70011dbe /end MEASUREMENT
/begin MEASUREMENT EPS_PTReadyLostFrame "" UBYTE VBU0706_CM_uint8 0 0 0 255 ECU_ADDRESS 0x70011dc6 /end MEASUREMENT
/begin MEASUREMENT EPS_SpeedLose "" UBYTE VBU0706_CM_uint8 0 0 0 255 ECU_ADDRESS 0x70011dc9 /end MEASUREMENT
/begin MEASUREMENT EPS_MotorPoSensorFault "" UBYTE VBU0706_CM_uint8 0 0 0 255 ECU_ADDRESS 0x70011dc5 /end MEASUREMENT
/begin MEASUREMENT EPS_TemOverHigh "" UBYTE VBU0706_CM_uint8 0 0 0 255 ECU_ADDRESS 0x70011dce /end MEASUREMENT
/begin MEASUREMENT EPS_TemOverLow "" UBYTE VBU0706_CM_uint8 0 0 0 255 ECU_ADDRESS 0x70011dcf /end MEASUREMENT
/begin MEASUREMENT EPS_InvalidSpeed "" UBYTE VBU0706_CM_uint8 0 0 0 255 ECU_ADDRESS 0x70011dc0 /end MEASUREMENT
/begin MEASUREMENT EPS_SpeedOut "" UBYTE VBU0706_CM_uint8 0 0 0 255 ECU_ADDRESS 0x70011dca /end MEASUREMENT
/begin MEASUREMENT EPS_MotorCurrentinvalid "" UBYTE VBU0706_CM_uint8 0 0 0 255 ECU_ADDRESS 0x70011dc3 /end MEASUREMENT
/begin MEASUREMENT EPS_MotorDriverCircurtFail "" UBYTE VBU0706_CM_uint8 0 0 0 255 ECU_ADDRESS 0x70011dc4 /end MEASUREMENT
/begin MEASUREMENT EPS_CurrentOverDevition "" UBYTE VBU0706_CM_uint8 0 0 0 255 ECU_ADDRESS 0x70011dbb /end MEASUREMENT
/begin MEASUREMENT EPS_RelayFail "" UBYTE VBU0706_CM_uint8 0 0 0 255 ECU_ADDRESS 0x70011dc8 /end MEASUREMENT
/begin MEASUREMENT EPS_ECUCurrentSensorInvalid "" UBYTE VBU0706_CM_uint8 0 0 0 255 ECU_ADDRESS 0x70011dbd /end MEASUREMENT
/begin MEASUREMENT EPS_LVOverVoltage "" UBYTE VBU0706_CM_uint8 0 0 0 255 ECU_ADDRESS 0x70011dc1 /end MEASUREMENT
/begin MEASUREMENT EPS_LVUnderVoltage "" UBYTE VBU0706_CM_uint8 0 0 0 255 ECU_ADDRESS 0x70011dc2 /end MEASUREMENT
/begin MEASUREMENT EPS_CAN_BUS_OFF "" UBYTE VBU0706_CM_uint8 0 0 0 255 ECU_ADDRESS 0x70011dba /end MEASUREMENT
/begin MEASUREMENT EPS_TorqueSensorVoltError "" UBYTE VBU0706_CM_uint8 0 0 0 255 ECU_ADDRESS 0x70011dd0 /end MEASUREMENT
/begin MEASUREMENT EPS_T2TorqueOutRange "" UBYTE VBU0706_CM_uint8 0 0 0 255 ECU_ADDRESS 0x70011dcd /end MEASUREMENT
/begin MEASUREMENT EPS_T1TorqueOutRange "" UBYTE VBU0706_CM_uint8 0 0 0 255 ECU_ADDRESS 0x70011dcc /end MEASUREMENT
/begin MEASUREMENT EPS_T1T2Mismatch "" UBYTE VBU0706_CM_uint8 0 0 0 255 ECU_ADDRESS 0x70011dcb /end MEASUREMENT
/begin MEASUREMENT EPS_ECUCaliFail "" UBYTE VBU0706_CM_uint8 0 0 0 255 ECU_ADDRESS 0x70011dbc /end MEASUREMENT
/begin MEASUREMENT EPS_ASteeringAngleOutRange "" UBYTE VBU0706_CM_uint8 0 0 0 255 ECU_ADDRESS 0x70011db9 /end MEASUREMENT
/begin MEASUREMENT EPS_RSteeringAngleOutRange "" UBYTE VBU0706_CM_uint8 0 0 0 255 ECU_ADDRESS 0x70011dc7 /end MEASUREMENT
/begin MEASUREMENT EPS_AMismathcR "" UBYTE VBU0706_CM_uint8 0 0 0 255 ECU_ADDRESS 0x70011db8 /end MEASUREMENT
/begin MEASUREMENT CheckSum "" UBYTE VBU0706_CM_uint8 0 0 0 255 ECU_ADDRESS 0x70011d5b /end MEASUREMENT
/begin MEASUREMENT Communication "" UBYTE VBU0706_CM_uint8 0 0 0 255 ECU_ADDRESS 0x70011d5d /end MEASUREMENT
/begin MEASUREMENT Rollingcounter "" UBYTE VBU0706_CM_uint8 0 0 0 255 ECU_ADDRESS 0x70011ed0 /end MEASUREMENT
/begin MEASUREMENT EPB_Key_Sta "" UBYTE VBU0706_CM_uint8 0 0 0 255 ECU_ADDRESS 0x70011db4 /end MEASUREMENT
/begin MEASUREMENT EPB_Key_Err "" UBYTE VBU0706_CM_uint8 0 0 0 255 ECU_ADDRESS 0x70011db3 /end MEASUREMENT
/begin MEASUREMENT EPB_PSensor_Err "" UBYTE VBU0706_CM_uint8 0 0 0 255 ECU_ADDRESS 0x70011db5 /end MEASUREMENT
/begin MEASUREMENT IGN "" UBYTE VBU0706_CM_uint8 0 0 0 255 ECU_ADDRESS 0x70011e37 /end MEASUREMENT
/begin MEASUREMENT EPB_Fault_Level "" UBYTE VBU0706_CM_uint8 0 0 0 255 ECU_ADDRESS 0x70011db2 /end MEASUREMENT
/begin MEASUREMENT Park_LED_Sta "" UBYTE VBU0706_CM_uint8 0 0 0 255 ECU_ADDRESS 0x70011ec0 /end MEASUREMENT
/begin MEASUREMENT EPB_SolValve_ErrInd "" UBYTE VBU0706_CM_uint8 0 0 0 255 ECU_ADDRESS 0x70011db6 /end MEASUREMENT
/begin MEASUREMENT EPB_state "" UBYTE VBU0706_CM_uint8 0 0 0 255 ECU_ADDRESS 0x70011db7 /end MEASUREMENT
/begin MEASUREMENT EPB_Control_Mode "" UBYTE VBU0706_CM_uint8 0 0 0 255 ECU_ADDRESS 0x70011db1 /end MEASUREMENT
/begin MEASUREMENT DCDCDeriting "" UBYTE VBU0706_CM_uint8 0 0 0 255 ECU_ADDRESS 0x70011d5f /end MEASUREMENT
/begin MEASUREMENT DCDCOverHeat "" UBYTE VBU0706_CM_uint8 0 0 0 255 ECU_ADDRESS 0x70011d65 /end MEASUREMENT
/begin MEASUREMENT DCDCOverInputCurrent "" UBYTE VBU0706_CM_uint8 0 0 0 255 ECU_ADDRESS 0x70011d66 /end MEASUREMENT
/begin MEASUREMENT DCDCOverOutputCurrent "" UBYTE VBU0706_CM_uint8 0 0 0 255 ECU_ADDRESS 0x70011d68 /end MEASUREMENT
/begin MEASUREMENT DCDCOverInputVoltage "" UBYTE VBU0706_CM_uint8 0 0 0 255 ECU_ADDRESS 0x70011d67 /end MEASUREMENT
/begin MEASUREMENT DCDCUnderInputVoltage "" UBYTE VBU0706_CM_uint8 0 0 0 255 ECU_ADDRESS 0x70011d6a /end MEASUREMENT
/begin MEASUREMENT DCDCOverOutputVoltage "" UBYTE VBU0706_CM_uint8 0 0 0 255 ECU_ADDRESS 0x70011d69 /end MEASUREMENT
/begin MEASUREMENT DCDCUnderOutputVoltage "" UBYTE VBU0706_CM_uint8 0 0 0 255 ECU_ADDRESS 0x70011d6b /end MEASUREMENT
/begin MEASUREMENT SOC_flgSocFastChargeTOC "" UBYTE VBU0706_CM_boolean 0 0 0 1 ECU_ADDRESS 0x70011edf /end MEASUREMENT
/begin MEASUREMENT VCT_flgHVBattSOCLowCrit "" UBYTE VBU0706_CM_boolean 0 0 0 1 ECU_ADDRESS 0x70011f2b /end MEASUREMENT
/begin MEASUREMENT VCT_flgChargeAvailable "" UBYTE VBU0706_CM_boolean 0 0 0 1 ECU_ADDRESS 0x70011f2a /end MEASUREMENT
/begin MEASUREMENT VCT_flgHVBattSOCLowWarn "" UBYTE VBU0706_CM_boolean 0 0 0 1 ECU_ADDRESS 0x70011f2c /end MEASUREMENT
/begin MEASUREMENT VCT_flgBMSESSInletTempMask "" UBYTE VBU0706_CM_boolean 0 0 0 1 ECU_ADDRESS 0x70011f20 /end MEASUREMENT
/begin MEASUREMENT VCT_flgBMSESSOutletTempMask "" UBYTE VBU0706_CM_boolean 0 0 0 1 ECU_ADDRESS 0x70011f22 /end MEASUREMENT
/begin MEASUREMENT VCT_flgBMSHVShutdownReq "" UBYTE VBU0706_CM_boolean 0 0 0 1 ECU_ADDRESS 0x70011f24 /end MEASUREMENT
/begin MEASUREMENT VCT_flgBMSESSInletTempValidity "" UBYTE VBU0706_CM_boolean 0 0 0 1 ECU_ADDRESS 0x70011f21 /end MEASUREMENT
/begin MEASUREMENT VCT_flgBMSESSOutletTempValidity "" UBYTE VBU0706_CM_boolean 0 0 0 1 ECU_ADDRESS 0x70011f23 /end MEASUREMENT
/begin MEASUREMENT VCT_flgBMSTempMaxValidity "" UBYTE VBU0706_CM_boolean 0 0 0 1 ECU_ADDRESS 0x70011f26 /end MEASUREMENT
/begin MEASUREMENT VCT_flgBMSTempAverageValidity "" UBYTE VBU0706_CM_boolean 0 0 0 1 ECU_ADDRESS 0x70011f25 /end MEASUREMENT
/begin MEASUREMENT VCT_flgBMSTempMinValidity "" UBYTE VBU0706_CM_boolean 0 0 0 1 ECU_ADDRESS 0x70011f27 /end MEASUREMENT
/begin MEASUREMENT VCT_flgBMSTempRequestValid "" UBYTE VBU0706_CM_boolean 0 0 0 1 ECU_ADDRESS 0x70011f28 /end MEASUREMENT
/begin MEASUREMENT VCT_flgBMSCellVoltageMaxValidity "" UBYTE VBU0706_CM_boolean 0 0 0 1 ECU_ADDRESS 0x70011f1e /end MEASUREMENT
/begin MEASUREMENT VCT_flgBMSCellVoltageMinValidity "" UBYTE VBU0706_CM_boolean 0 0 0 1 ECU_ADDRESS 0x70011f1f /end MEASUREMENT
/begin MEASUREMENT VCT_flgBMSCellVoltageAveValidity "" UBYTE VBU0706_CM_boolean 0 0 0 1 ECU_ADDRESS 0x70011f1d /end MEASUREMENT
/begin MEASUREMENT VCT_flgCTMCellThermalRunawayFaultValid "" UBYTE VBU0706_CM_boolean 0 0 0 1 ECU_ADDRESS 0x70011f29 /end MEASUREMENT
/begin MEASUREMENT SOH_flgBeforeStepCurrentEnable "" UBYTE VBU0706_CM_boolean 0 0 0 1 ECU_ADDRESS 0x70011eec /end MEASUREMENT
/begin MEASUREMENT SOH_flgSingalSocStart "" UBYTE VBU0706_CM_boolean 0 0 0 1 ECU_ADDRESS 0x70011eed /end MEASUREMENT
/begin MEASUREMENT SOC_flgOcvShortTimeCurrentEnable "" UBYTE VBU0706_CM_boolean 0 0 0.0 1.0 ECU_ADDRESS 0x70011eda /end MEASUREMENT
/begin MEASUREMENT SOC_flgSocFastChargeCorrection "" UBYTE VBU0706_CM_boolean 0 0 0.0 1.0 ECU_ADDRESS 0x70011ede /end MEASUREMENT
/begin MEASUREMENT FCC_flgCellTempLowProhibitCharge "" UBYTE VBU0706_CM_boolean 0 0 0.0 1.0 ECU_ADDRESS 0x70011dd8 /end MEASUREMENT
/begin MEASUREMENT FCC_flgCellTempProhibitCharge "" UBYTE VBU0706_CM_boolean 0 0 0.0 1.0 ECU_ADDRESS 0x70011dd9 /end MEASUREMENT
/begin MEASUREMENT FCC_flgVoltageProhibitCharge "" UBYTE VBU0706_CM_boolean 0 0 0.0 1.0 ECU_ADDRESS 0x70011de9 /end MEASUREMENT
/begin MEASUREMENT FCC_flgFullChargeComplete "" UBYTE VBU0706_CM_boolean 0 0 0.0 1.0 ECU_ADDRESS 0x70011de4 /end MEASUREMENT
/begin MEASUREMENT FCC_flgChargeCurrentDerate "" UBYTE VBU0706_CM_boolean 0 0 0.0 1.0 ECU_ADDRESS 0x70011ddb /end MEASUREMENT
/begin MEASUREMENT FCC_flgComputeResistancePrecondition "" UBYTE VBU0706_CM_boolean 0 0 0.0 1.0 ECU_ADDRESS 0x70011de0 /end MEASUREMENT
/begin MEASUREMENT DCH_flgStopForManual "" UBYTE VBU0706_CM_boolean 0 0 0.0 1.0 ECU_ADDRESS 0x70011d9b /end MEASUREMENT
/begin MEASUREMENT DCH_flgBMSChCmpt "" UBYTE VBU0706_CM_boolean 0 0 0.0 1.0 ECU_ADDRESS 0x70011d74 /end MEASUREMENT
/begin MEASUREMENT DCH_flgHalfConn "" UBYTE VBU0706_CM_boolean 0 0 0.0 1.0 ECU_ADDRESS 0x70011d8a /end MEASUREMENT
/begin MEASUREMENT PMM_flgRMCUActvDisChReq "" UBYTE VBU0706_CM_boolean 0 0 0 1 ECU_ADDRESS 0x70011eb0 /end MEASUREMENT
/begin MEASUREMENT PMM_flgAccDisbl "" UBYTE VBU0706_CM_boolean 0 0 0.0 1.0 ECU_ADDRESS 0x70011e94 /end MEASUREMENT
/begin MEASUREMENT PMM_flgSetPEURRdy "" UBYTE VBU0706_CM_boolean 0 0 0 1 ECU_ADDRESS 0x70011eb3 /end MEASUREMENT
/begin MEASUREMENT PMM_flgVehRdy "" UBYTE VBU0706_CM_boolean 0 0 0 1 ECU_ADDRESS 0x70011eb7 /end MEASUREMENT
/begin MEASUREMENT PMM_flgHVRdy "" UBYTE VBU0706_CM_boolean 0 0 0.0 1.0 ECU_ADDRESS 0x70011ea2 /end MEASUREMENT
/begin MEASUREMENT ABS_VehicleSpeedValid "" UBYTE VBU0706_CM_boolean 0 0 0 1 ECU_ADDRESS 0x70011ccf /end MEASUREMENT
/begin MEASUREMENT ABS_Active "" UBYTE VBU0706_CM_boolean 0 0 0 1 ECU_ADDRESS 0x70011ccb /end MEASUREMENT
/begin MEASUREMENT EBD_Active "" UBYTE VBU0706_CM_boolean 0 0 0 1 ECU_ADDRESS 0x70011dae /end MEASUREMENT
/begin MEASUREMENT ABS_EBDFailed "" UBYTE VBU0706_CM_boolean 0 0 0 1 ECU_ADDRESS 0x70011ccd /end MEASUREMENT
/begin COMPU_METHOD VBU0706_CM_single_cnt "Q = V" RAT_FUNC "%8.6" "cnt" COEFFS 0 1 0 0 0 1 /end COMPU_METHOD
/begin COMPU_METHOD VBU0706_CM_uint16_cnt "Q = V" RAT_FUNC "%5.0" "cnt" COEFFS 0 1 0 0 0 1 /end COMPU_METHOD
/begin COMPU_METHOD VBU0706_CM_single_C "Q = V" RAT_FUNC "%8.6" "C" COEFFS 0 1 0 0 0 1 /end COMPU_METHOD
/begin COMPU_METHOD VBU0706_CM_single_A "Q = V" RAT_FUNC "%8.6" "A" COEFFS 0 1 0 0 0 1 /end COMPU_METHOD
/begin COMPU_METHOD VBU0706_CM_single_fac "Q = V" RAT_FUNC "%8.6" "fac" COEFFS 0 1 0 0 0 1 /end COMPU_METHOD
/begin COMPU_METHOD VBU0706_CM_uint16 "Q = V" RAT_FUNC "%5.0" "" COEFFS 0 1 0 0 0 1 /end COMPU_METHOD
/begin COMPU_METHOD VBU0706_CM_single_km "Q = V" RAT_FUNC "%8.6" "km" COEFFS 0 1 0 0 0 1 /end COMPU_METHOD
/begin COMPU_METHOD VBU0706_CM_uint8 "Q = V" RAT_FUNC "%3.0" "" COEFFS 0 1 0 0 0 1 /end COMPU_METHOD
/begin COMPU_METHOD VBU0706_CM_single "Q = V" RAT_FUNC "%8.6" "" COEFFS 0 1 0 0 0 1 /end COMPU_METHOD
/begin COMPU_METHOD VBU0706_CM_single_s "Q = V" RAT_FUNC "%8.6" "s" COEFFS 0 1 0 0 0 1 /end COMPU_METHOD
/begin COMPU_METHOD VBU0706_CM_single_kW "Q = V" RAT_FUNC "%8.6" "kW" COEFFS 0 1 0 0 0 1 /end COMPU_METHOD
/begin COMPU_METHOD VBU0706_CM_uint32_cnt "Q = V" RAT_FUNC "%10.0" "cnt" COEFFS 0 1 0 0 0 1 /end COMPU_METHOD
/begin COMPU_METHOD VBU0706_CM_int16_cnt "Q = V" RAT_FUNC "%5.0" "cnt" COEFFS 0 1 0 0 0 1 /end COMPU_METHOD
/begin COMPU_METHOD VBU0706_CM_boolean "Q = V" RAT_FUNC "%1.0" "" COEFFS 0 1 0 0 0 1 /end COMPU_METHOD
/begin COMPU_METHOD VBU0706_CM_boolean_cnt "Q = V" RAT_FUNC "%1.0" "cnt" COEFFS 0 1 0 0 0 1 /end COMPU_METHOD
/begin COMPU_METHOD VBU0706_CM_uint8_cnt "Q = V" RAT_FUNC "%3.0" "cnt" COEFFS 0 1 0 0 0 1 /end COMPU_METHOD
/begin GROUP S1054_DCH_ChargeStopCalc "VBU0706/Function-Call Subsystem/Subsystem1/FCC /DCH_Overall/DCH_DCChargeCtrlOverall/DCH_DCChargeCtrlStateflow/DCH_SignalPreProcessForStateflow/DCH_ChargeStopCalc"
 /begin REF_CHARACTERISTIC DCH_stBMSChCmpt_SY DCH_stCDCStopCharging_SY DCH_stVehSoftwUpdate_SY /end REF_CHARACTERISTIC
 /begin REF_MEASUREMENT DCH_flgBMSChCmpt DCH_flgStopForManual /end REF_MEASUREMENT
/end GROUP
/begin GROUP S1054_DCH_ChgerZeroCurrentDiagnose "VBU0706/Function-Call Subsystem/Subsystem1/FCC /DCH_Overall/DCH_DCChargeCtrlOverall/DCH_DCChargeCtrlStateflow/DCH_SignalPreProcessForStateflow/DCH_ChgerZeroCurrentDiagnose" /begin REF_CHARACTERISTIC DCH_iBMSZeroCrntDlyStopCh_C DCH_iCCSChgCrnt_C /end REF_CHARACTERISTIC /end GROUP
/begin GROUP S1054_DCH_ChgrAvlDiagnose "VBU0706/Function-Call Subsystem/Subsystem1/FCC /DCH_Overall/DCH_DCChargeCtrlOverall/DCH_DCChargeCtrlStateflow/DCH_SignalPreProcessForStateflow/DCH_ChgrAvlDiagnose"
 /begin REF_CHARACTERISTIC DCH_flgAllowNGearCh_C DCH_stNGear_SY DCH_stPGear_SY DCH_stVehSoftwUpdate_SY /end REF_CHARACTERISTIC
 /begin REF_MEASUREMENT DCH_flgHalfConn /end REF_MEASUREMENT
/end GROUP
/begin GROUP S1054_DCH_OpenPDURelayValid "VBU0706/Function-Call Subsystem/Subsystem1/FCC /DCH_Overall/DCH_DCChargeCtrlOverall/DCH_DCChargeCtrlStateflow/DCH_SignalPreProcessForStateflow/DCH_OpenPDURelayValid" /begin REF_CHARACTERISTIC DCH_iOpenDCChRly_C DCH_tiCC2OffCnfrm_C /end REF_CHARACTERISTIC /end GROUP
/begin GROUP S1097_DCH_BSTOrCSTTrigger "VBU0706/Function-Call Subsystem/Subsystem1/FCC /DCH_Overall/DCH_DCChargeCtrlOverall/DCH_EepromStore/DCH_ChargeStopErrDiagnose/DCH_BSTOrCSTTrigger" /begin REF_CHARACTERISTIC DCH_tiCSTTrigDly_C /end REF_CHARACTERISTIC /end GROUP
/begin GROUP S1098_BEM_EEPROM "VBU0706/Function-Call Subsystem/Subsystem1/FCC /DCH_Overall/DCH_DCChargeCtrlOverall/DCH_EepromStore/DCH_ChargeTimeOutDiagnose/BEM_EEPROM"
 /begin REF_CHARACTERISTIC DCH_stBEM00TOutMSK_SY DCH_stBEMAATOutMSK_SY DCH_stBEMChCapTOutMSK_SY DCH_stBEMChRdyTOutMSK_SY DCH_stBEMChStTOutMSK_SY DCH_stBEMChgrStopTOutMSK_SY DCH_stBEMStatsDataTOutMSK_SY DCH_stKeyRaw_SY /end REF_CHARACTERISTIC
/end GROUP
/begin GROUP S1099_CSTTrigDly "VBU0706/Function-Call Subsystem/Subsystem1/FCC /DCH_Overall/DCH_DCChargeCtrlOverall/DCH_EepromStore/DataConvertandCSTEEPROM/CSTTrigDly" /begin REF_CHARACTERISTIC DCH_tiCSTTrigDly_C /end REF_CHARACTERISTIC /end GROUP
/begin GROUP S1099_CST_EEPROM "VBU0706/Function-Call Subsystem/Subsystem1/FCC /DCH_Overall/DCH_DCChargeCtrlOverall/DCH_EepromStore/DataConvertandCSTEEPROM/CST_EEPROM"
 /begin REF_CHARACTERISTIC DCH_stCurrDismatchErrMSK_SY DCH_stEnergNotTrnsmtFultMSK_SY DCH_stFaultStopMSK_SY DCH_stKeyRaw_SY DCH_stOtherStaStpFultMSK_SY DCH_stStaCntorFultMSK_SY DCH_stStaEmergStpFultMSK_SY DCH_stStaIntOverTempFultMSK_SY DCH_stStaOverTempFaultMSK_SY DCH_stStaStopCondReachMSK_SY DCH_stVoltAbnormalErrMSK_SY /end REF_CHARACTERISTIC
/end GROUP
/begin GROUP S1170_EqualPorportionMapping3 "VBU0706/Function-Call Subsystem/Subsystem1/FCC /FCC/Subsystem/Calculate_Fastcharge_Time/SOC_Mapping/EqualPorportionMapping3" /begin REF_MEASUREMENT FCC_pctEightySOCMappingRealSoc /end REF_MEASUREMENT /end GROUP
/begin GROUP S1170_EqualPorportionMapping4 "VBU0706/Function-Call Subsystem/Subsystem1/FCC /FCC/Subsystem/Calculate_Fastcharge_Time/SOC_Mapping/EqualPorportionMapping4" /begin REF_MEASUREMENT FCC_pctDisplaySocMappingRealSoc /end REF_MEASUREMENT /end GROUP
/begin GROUP S1170_EqualPorportionMapping5 "VBU0706/Function-Call Subsystem/Subsystem1/FCC /FCC/Subsystem/Calculate_Fastcharge_Time/SOC_Mapping/EqualPorportionMapping5" /begin REF_MEASUREMENT FCC_pctMaxSetSocMappingRealSoc /end REF_MEASUREMENT /end GROUP
/begin GROUP S1214_Decrease_ChargeCurrentRequest "VBU0706/Function-Call Subsystem/Subsystem1/FCC /FCC/Subsystem/Determine_Fastcharge_Request/Charge_Request_Protection/Decrease_ChargeCurrentRequest"
 /begin REF_CHARACTERISTIC CcFCC_ChargeCurrentOverDelay_s CcFCC_ChargeCurrentOverEnable_flg CcFCC_ChargeCurrentOverFuncEnable_flg CcFCC_ChargeCurrentRequestDec_A /end REF_CHARACTERISTIC
 /begin REF_MEASUREMENT FCC_flgChargeCurrentDerate FCC_iAChargeCurrentReqDec FCC_iADecreasedChargeCurrentRequest /end REF_MEASUREMENT
/end GROUP
/begin GROUP S1214_Override_Block1 "VBU0706/Function-Call Subsystem/Subsystem1/FCC /FCC/Subsystem/Determine_Fastcharge_Request/Charge_Request_Protection/Override_Block1" /begin REF_CHARACTERISTIC CbFCC_ChargeCurrentOvR_flg CcFCC_ChargeCurrentOvRValue_A /end REF_CHARACTERISTIC /begin REF_MEASUREMENT FCC_iARawChargeCurrentRequestFnl /end REF_MEASUREMENT /end GROUP
/begin GROUP S1214_Override_Voltage_Request "VBU0706/Function-Call Subsystem/Subsystem1/FCC /FCC/Subsystem/Determine_Fastcharge_Request/Charge_Request_Protection/Override_Voltage_Request" /begin SUB_GROUP S1220_Override_Block3 /end SUB_GROUP /begin REF_CHARACTERISTIC CcFCC_ChargeVoltageDelta_V /end REF_CHARACTERISTIC /begin REF_MEASUREMENT FCC_uChargeVoltageRequestFnl /end REF_MEASUREMENT /end GROUP
/begin GROUP S1214_Rate_Limiter "VBU0706/Function-Call Subsystem/Subsystem1/FCC /FCC/Subsystem/Determine_Fastcharge_Request/Charge_Request_Protection/Rate_Limiter" /begin REF_MEASUREMENT FCC_kwChargePowerReqFnl /end REF_MEASUREMENT /end GROUP
/begin GROUP S1215_Determine_ComputeResistanceCondition "VBU0706/Function-Call Subsystem/Subsystem1/FCC /FCC/Subsystem/Determine_Fastcharge_Request/DetermineComputeResistancePulseCurrent/Determine_ComputeResistanceCondition" /begin SUB_GROUP S1228_Delay_FallingEdge S1228_RS_Flip_Flop S1228_S_H /end SUB_GROUP
 /begin REF_CHARACTERISTIC CbFCC_ComputeResistanceEnable_flg CcFCC_ComputeResistanceDelayTime_ms CcFCC_ComputeResistanceEndVoltage_mV CcFCC_ComputeResistanceRelaxationTime_ms CcFCC_ComputeResistanceStartVoltage_mV CcFCC_ComputeResistanceTempMax_C CcFCC_ComputeResistanceTempMin_C CcSYS_ResisCalPulseCurrentDurationTime_ms /end REF_CHARACTERISTIC
 /begin REF_MEASUREMENT FCC_flgComputeResistancePrecondition /end REF_MEASUREMENT
/end GROUP
/begin GROUP S1215_Determine_ComputeResistancePulseRequest "VBU0706/Function-Call Subsystem/Subsystem1/FCC /FCC/Subsystem/Determine_Fastcharge_Request/DetermineComputeResistancePulseCurrent/Determine_ComputeResistancePulseRequest"
 /begin REF_CHARACTERISTIC CcSYS_ResisCalFCCPulseCurrent_A CcSYS_ResisCalRelaxationCurrent_A /end REF_CHARACTERISTIC
/end GROUP
/begin GROUP S1215_Determine_FastChargeRequest "VBU0706/Function-Call Subsystem/Subsystem1/FCC /FCC/Subsystem/Determine_Fastcharge_Request/DetermineComputeResistancePulseCurrent/Determine_FastChargeRequest" /begin REF_MEASUREMENT FCC_iAChargeCurrentRequestRaw /end REF_MEASUREMENT /end GROUP
/begin GROUP S1216_Request_At_Charging "VBU0706/Function-Call Subsystem/Subsystem1/FCC /FCC/Subsystem/Determine_Fastcharge_Request/Determine_Base_ChargeRequest/Request_At_Charging"
 /begin REF_CHARACTERISTIC CaFCC_VCRVCUAuxPowerFactorVoltageTempMapDimension_n CaFCC_VCRVCUAuxPowerFactorVoltageTempMapZ_nbr CcFCC_ChargeCurrentDerateSocDelta_pct CcFCC_ChargeCurrentDerateSoc_pct /end REF_CHARACTERISTIC
/end GROUP
/begin GROUP S1216_Request_At_NoCharging "VBU0706/Function-Call Subsystem/Subsystem1/FCC /FCC/Subsystem/Determine_Fastcharge_Request/Determine_Base_ChargeRequest/Request_At_NoCharging"
 /begin REF_CHARACTERISTIC CaFCC_VCRVCUAuxPowerFactorVoltageTempMapDimension_n CaFCC_VCRVCUAuxPowerFactorVoltageTempMapZ_nbr CcFCC_ChargeVoltageDelta_V /end REF_CHARACTERISTIC
/end GROUP
/begin GROUP S1248_Cell_Temp_Protection "VBU0706/Function-Call Subsystem/Subsystem1/FCC /FCC/Subsystem/Fastcharge_Conditions_Check/Condition_Categorize/Cell_Temp_Protection"
 /begin REF_CHARACTERISTIC CbFCC_NoChargeHighTempEnable_flg CbFCC_NoChargeLowTempEnable_flg CcFCC_HighTempDebounceTime_s /end REF_CHARACTERISTIC
 /begin REF_MEASUREMENT FCC_flgCellTempLowProhibitCharge FCC_flgCellTempProhibitCharge /end REF_MEASUREMENT
/end GROUP
/begin GROUP S1248_Full_Charge_Determination "VBU0706/Function-Call Subsystem/Subsystem1/FCC /FCC/Subsystem/Fastcharge_Conditions_Check/Condition_Categorize/Full_Charge_Determination"
 /begin SUB_GROUP S1257_FullCharge_criteria1 S1257_FullCharge_criteria2 S1257_FullCharge_criteria4 /end SUB_GROUP
 /begin REF_MEASUREMENT FCC_flgFullChargeComplete /end REF_MEASUREMENT
/end GROUP
/begin GROUP S1248_Voltage_Protection "VBU0706/Function-Call Subsystem/Subsystem1/FCC /FCC/Subsystem/Fastcharge_Conditions_Check/Condition_Categorize/Voltage_Protection"
 /begin REF_CHARACTERISTIC CbFCC_BatteryVoltageMaxlimitEnable_flg CbFCC_CellVoltageMaxlimitEnable_flg CcFCC_BatteryVoltageMaxLimitDebounceTime_s CcFCC_CellVoltageMaxLimitDebounceTime_s /end REF_CHARACTERISTIC
 /begin REF_MEASUREMENT FCC_flgVoltageProhibitCharge /end REF_MEASUREMENT
/end GROUP
/begin GROUP S1518_Determine_Cell_Balanced_Capacity "VBU0706/Function-Call Subsystem/Subsystem1/SOC/Subsystem5/Subsystem/Determine_AhIntegral_SoC/Determine_AhIntegral_Capacity/Determine_Cell_Balanced_Capacity"
 /begin REF_CHARACTERISTIC CcSYS_BalanceResistance_ohm CcSYS_CellBalanceDutyCycle_pct MILIAMPERES_PER_AMPERE /end REF_CHARACTERISTIC
/end GROUP
/begin GROUP S1554_Determine_SOC_RateLimit "VBU0706/Function-Call Subsystem/Subsystem1/SOC/Subsystem5/Subsystem/Determine_Display_SOC/DisplaySOC_Driving_Calculation/Determine_SOC_RateLimit"
 /begin REF_CHARACTERISTIC CaSOC_BatteryDisplaySocDischargeDecRateY_n CaSOC_BatteryDisplaySocDischargeIncRateY_n CaSOC_SOCDisChargeDecOffsetY_n CaSOC_SOCDisChargeIncOffsetY_n CbSOC_DisplaySOCRateDynamicEnable_flg CcSOC_BatteryDisplaySocChargeDecRate_n CcSOC_BatteryDisplaySocChargeIncRate_n /end REF_CHARACTERISTIC
 /begin REF_MEASUREMENT SOC_pctBatteryDisplaySocChargeDecRate SOC_pctBatteryDisplaySocChargeIncRate SOC_pctBatteryDisplaySocDischargeDecRate SOC_pctBatteryDisplaySocDischargeIncRate /end REF_MEASUREMENT
/end GROUP
/begin GROUP S1578_FastCharge_DynamicCorrection_Enable "VBU0706/Function-Call Subsystem/Subsystem1/SOC/Subsystem5/Subsystem/Determine_FastChargeCorrection_Soc/FastCharge_DynamicCorrection/FastCharge_DynamicCorrection_Enable"
 /begin SUB_GROUP S1588_Calculate_WindowAverage_BatteryCurrent S1588_Determine_CurrentStable_Condition S1588_VoltThldEdge S1588_VoltThldEdge1 /end SUB_GROUP
 /begin REF_CHARACTERISTIC BATTERY_BOL_SOH BATTERY_EOL_SOH CaSOC_CCCorrectionMapDimension_n CaSOC_FastChargeCCCorrectionBOLVoltThd1Z_mV CaSOC_FastChargeCCCorrectionEOLVoltThd1Z_mV CaSOC_FastChargeCCCorrectionSoc1Z_pct CaSOC_FastChargeCCCorrectionSoc2Z_pct CaSOC_FastChargeCCCorrectionVoltThd2Z_mV CbSOC_FastChargeCCCorrection2Enable_flg /end REF_CHARACTERISTIC
 /begin REF_MEASUREMENT SOC_flgSocFastChargeCorrection SOC_pctCellVoltageMaxCorrectionSoc /end REF_MEASUREMENT
/end GROUP
/begin GROUP S1579_Calculate_WindowAverage_BatteryCurrent "VBU0706/Function-Call Subsystem/Subsystem1/SOC/Subsystem5/Subsystem/Determine_FastChargeCorrection_Soc/FastCharge_PreCorrection/Calculate_WindowAverage_BatteryCurrent" /begin REF_CHARACTERISTIC CcSOC_CurrentWinAvePeriodTime_ms /end REF_CHARACTERISTIC /end GROUP
/begin GROUP S1579_FastCharge_PreCorrectionMain "VBU0706/Function-Call Subsystem/Subsystem1/SOC/Subsystem5/Subsystem/Determine_FastChargeCorrection_Soc/FastCharge_PreCorrection/FastCharge_PreCorrectionMain"
 /begin SUB_GROUP S1600_FastCharge_PreCorrectionSOC S1600_FastCharge_PreCorrectionVoltage /end SUB_GROUP
 /begin REF_CHARACTERISTIC CcSOC_FastChargePreCorrectionVolThld_mV CcSOC_FastChargePreCorrectionVolTime_ms /end REF_CHARACTERISTIC
/end GROUP
/begin GROUP S1580_Calculate_WindowAverage_BatteryCurrent "VBU0706/Function-Call Subsystem/Subsystem1/SOC/Subsystem5/Subsystem/Determine_FastChargeCorrection_Soc/FastCharge_TopofChargeCorrection/Calculate_WindowAverage_BatteryCurrent" /begin REF_CHARACTERISTIC CcSOC_CurrentWinAvePeriodTime_ms /end REF_CHARACTERISTIC /begin REF_MEASUREMENT LcSOC_iABatteryCurrentWinAve /end REF_MEASUREMENT /end GROUP
/begin GROUP S1580_FastCharge_TOCAdjustAllSOC "VBU0706/Function-Call Subsystem/Subsystem1/SOC/Subsystem5/Subsystem/Determine_FastChargeCorrection_Soc/FastCharge_TopofChargeCorrection/FastCharge_TOCAdjustAllSOC"
 /begin REF_CHARACTERISTIC CcSOC_FastChargeTOCDeltaVolMax_mV CcSOC_FastChargeTOCDeltaVolSOC_pct /end REF_CHARACTERISTIC
/end GROUP
/begin GROUP S1580_RiseEdge "VBU0706/Function-Call Subsystem/Subsystem1/SOC/Subsystem5/Subsystem/Determine_FastChargeCorrection_Soc/FastCharge_TopofChargeCorrection/RiseEdge" /begin REF_MEASUREMENT SOC_flgSocFastChargeTOC /end REF_MEASUREMENT /end GROUP
/begin GROUP S1619_After_Startup "VBU0706/Function-Call Subsystem/Subsystem1/SOC/Subsystem5/Subsystem/Determine_Initial_SoC/Determine_Soc_Jump/After_Startup"
 /begin REF_CHARACTERISTIC SOC_JUMP_ABNORMAL_POWER_OFF SOC_JUMP_ABNORMAL_RESET SOC_JUMP_NONE SOC_JUMP_OCV_CORRECTION /end REF_CHARACTERISTIC
/end GROUP
/begin GROUP S1619_Startup "VBU0706/Function-Call Subsystem/Subsystem1/SOC/Subsystem5/Subsystem/Determine_Initial_SoC/Determine_Soc_Jump/Startup"
 /begin REF_CHARACTERISTIC SOC_JUMP_ABNORMAL_POWER_OFF SOC_JUMP_ABNORMAL_RESET SOC_JUMP_NONE SOC_JUMP_OCV_CORRECTION /end REF_CHARACTERISTIC
/end GROUP
/begin GROUP S1648_Current_Limit "VBU0706/Function-Call Subsystem/Subsystem1/SOC/Subsystem5/Subsystem/Determine_ShortTimeCorrection_Condition/Current_Limit_Condition/Current_Limit" /begin REF_CHARACTERISTIC CcSOC_iAOcvShortTimeCurrentLimit /end REF_CHARACTERISTIC /begin REF_MEASUREMENT SOC_flgOcvShortTimeCurrentEnable /end REF_MEASUREMENT /end GROUP
/begin GROUP S1682_Calculate_Energy_Retention_Factor "VBU0706/Function-Call Subsystem/Subsystem1/SOE/Subsystem2/Subsystem/Calculate_Pack_Remaining_Energy/Discharge_Mode/Calculate_Energy_Retention_Factor" /begin REF_CHARACTERISTIC CaSOE_SocOcvMapZ_mV CaSOE_SocResistanceLongMapZ_mohm /end REF_CHARACTERISTIC /end GROUP
/begin GROUP S1682_Predict_SOC_End "VBU0706/Function-Call Subsystem/Subsystem1/SOE/Subsystem2/Subsystem/Calculate_Pack_Remaining_Energy/Discharge_Mode/Predict_SOC_End"
 /begin REF_CHARACTERISTIC CaSOE_SocOcvMapZ_mV CaSOE_SocResistanceLongMapZ_mohm CcSOE_CellVoltageLowerLimit_mV CcSOE_MaxInterationNumber_n /end REF_CHARACTERISTIC
/end GROUP
/begin GROUP S1729_Rate_Limiter "VBU0706/Function-Call Subsystem/Subsystem1/SOF/Subsystem6/Subsystem/Calculate_PowerLimit/Calculate_Pack_OCV/Rate_Limiter" /begin REF_CHARACTERISTIC CcSOF_DischargeLowOCVStepSlope_V /end REF_CHARACTERISTIC /end GROUP
/begin GROUP S1730_Power_Limit_Cycle_Level1 "VBU0706/Function-Call Subsystem/Subsystem1/SOF/Subsystem6/Subsystem/Calculate_PowerLimit/Determine_Capacity_Cycle_PowerLimit/Power_Limit_Cycle_Level1"
 /begin SUB_GROUP S1738_Power_Limit_Level1_ChargePowerLimit S1738_Power_Limit_Level1_DischargePowerLimit /end SUB_GROUP
/end GROUP
/begin GROUP S1730_Power_Limit_Cycle_Level2 "VBU0706/Function-Call Subsystem/Subsystem1/SOF/Subsystem6/Subsystem/Calculate_PowerLimit/Determine_Capacity_Cycle_PowerLimit/Power_Limit_Cycle_Level2"
 /begin SUB_GROUP S1739_Power_Limit_Cycle_Level2_ChargePowerLimit S1739_Power_Limit_Cycle_Level2_DischargePowerLimit /end SUB_GROUP
/end GROUP
/begin GROUP S1730_Power_Limit_Cycle_Level3 "VBU0706/Function-Call Subsystem/Subsystem1/SOF/Subsystem6/Subsystem/Calculate_PowerLimit/Determine_Capacity_Cycle_PowerLimit/Power_Limit_Cycle_Level3"
 /begin SUB_GROUP S1740_Power_Limit_Cycle_Level3_ChargePowerLimit S1740_Power_Limit_Cycle_Level3_DischargePowerLimit /end SUB_GROUP
/end GROUP
/begin GROUP S1731_Determine_ContinuousDischargePowerLimitTarget "VBU0706/Function-Call Subsystem/Subsystem1/SOF/Subsystem6/Subsystem/Calculate_PowerLimit/Determine_SOCP_PowerLimit/Determine_ContinuousDischargePowerLimitTarget" /begin SUB_GROUP S1748_Determine_SOCP_Condition /end SUB_GROUP
 /begin REF_CHARACTERISTIC CcSOF_SocpDischargePowerMin_Kw CcSOF_SocpDischargePowerSlope_Kw /end REF_CHARACTERISTIC
 /begin REF_MEASUREMENT SOF_kwContinuousDischargePowerLimitTarget /end REF_MEASUREMENT
/end GROUP
/begin GROUP S1731_Determine_DischargePowerLimitTarget "VBU0706/Function-Call Subsystem/Subsystem1/SOF/Subsystem6/Subsystem/Calculate_PowerLimit/Determine_SOCP_PowerLimit/Determine_DischargePowerLimitTarget" /begin SUB_GROUP S1749_Determine_SOCP_Condition /end SUB_GROUP
 /begin REF_CHARACTERISTIC CcSOF_SocpDischargePowerMin_Kw CcSOF_SocpDischargePowerSlope_Kw /end REF_CHARACTERISTIC
 /begin REF_MEASUREMENT SOF_kwDischargePowerLimitTarget /end REF_MEASUREMENT
/end GROUP
/begin GROUP S1761_Calculate_CurrentLimit_Base "VBU0706/Function-Call Subsystem/Subsystem1/SOF/Subsystem6/Subsystem/Determine_Currentlimit_Target/Calculate_CurrentLimit_Target/Calculate_CurrentLimit_Base"
 /begin SUB_GROUP S1763_Calculate_ContinuousChargeCurrent S1763_Calculate_ContinuousDischargeCurrent S1763_Calculate_ShortPulseChargeCurrent S1763_Calculate_ShortPulseDischargeCurrent S1763_Determine_LowVoltageLimitChargeCurrent /end SUB_GROUP
 /begin REF_CHARACTERISTIC CcSOF_LowVoltChgCurtSloDelay_ms CcSOF_LowVoltageChargeCurrentMax_A CcSOF_LowVoltageChargeCurrentSlopeDec_A CcSOF_LowVoltageChargeCurrentSlopeInc_A CcSOF_LowVoltageChargeLimitEnable_flg CcSOF_LowVoltagePowerOnDelay_ms /end REF_CHARACTERISTIC
 /begin REF_MEASUREMENT SOF_iAContinuousChargeCurrentLimitBase SOF_iAShortPulseChargeCurrentLimitBase /end REF_MEASUREMENT
/end GROUP
/begin GROUP S1761_Calculate_Dynamic_CurrentLimit "VBU0706/Function-Call Subsystem/Subsystem1/SOF/Subsystem6/Subsystem/Determine_Currentlimit_Target/Calculate_CurrentLimit_Target/Calculate_Dynamic_CurrentLimit"
 /begin SUB_GROUP S1764_Calculate_Dynamic_ChargeCurrentLimit S1764_Calculate_Dynamic_DischargeCurrentLimit /end SUB_GROUP
/end GROUP
/begin GROUP S1761_CurrentLimit_FastCharge_Check "VBU0706/Function-Call Subsystem/Subsystem1/SOF/Subsystem6/Subsystem/Determine_Currentlimit_Target/Calculate_CurrentLimit_Target/CurrentLimit_FastCharge_Check"
 /begin SUB_GROUP S1765_FastChrgOneThirdRateCurrentLimitCheck S1765_SegmentChargeCheck /end SUB_GROUP
/end GROUP
/begin GROUP S1761_CurrentLimit_Fault_Correct "VBU0706/Function-Call Subsystem/Subsystem1/SOF/Subsystem6/Subsystem/Determine_Currentlimit_Target/Calculate_CurrentLimit_Target/CurrentLimit_Fault_Correct" /begin SUB_GROUP S1766_CAT4 S1766_Determine_StopCharge_Condition /end SUB_GROUP
 /begin REF_MEASUREMENT SOF_iAContinuousChargeCurrentLimitTarget SOF_iAContinuousDischargeCurrentLimitTarget SOF_iADynamicChargeCurrentLimitTarget SOF_iADynamicDischargeCurrentLimitTarget SOF_iAShortPulseChargeCurrentLimitTarget SOF_iAShortPulseDischargeCurrentLimitTarget /end REF_MEASUREMENT
/end GROUP
/begin GROUP S1761_CurrentLimit_Voltage_Correct "VBU0706/Function-Call Subsystem/Subsystem1/SOF/Subsystem6/Subsystem/Determine_Currentlimit_Target/Calculate_CurrentLimit_Target/CurrentLimit_Voltage_Correct" /begin SUB_GROUP S1767_Correct_CurrentLimit S1767_Enable_Voltage_Correction /end SUB_GROUP /end GROUP
/begin GROUP S1761_FastChrgCurr1 "VBU0706/Function-Call Subsystem/Subsystem1/SOF/Subsystem6/Subsystem/Determine_Currentlimit_Target/Calculate_CurrentLimit_Target/FastChrgCurr1"
 /begin SUB_GROUP S1768_ClvLookUp1 S1768_ClvLookUp2 S1768_SOCLookUp S1768_Subsystem /end SUB_GROUP
 /begin REF_MEASUREMENT SOF_StFastChrgLookUp SOF_iAFastChrgLookUpCurr /end REF_MEASUREMENT
/end GROUP
/begin GROUP S1961_Caculate_CellCapacity_LifeTimeQ "VBU0706/Function-Call Subsystem/Subsystem1/SOH/Subsystem4/Subsystem1/Calculate_Capacity/Calculate_CellCapacity/Caculate_CellCapacity_LifeTimeQ"
 /begin SUB_GROUP S1966_Caculate_WeightingLifeTimeCharge S1966_NVM_ReadWrite_Check /end SUB_GROUP
 /begin REF_CHARACTERISTIC CaSOH_CellCapacity_Ah CaSOH_InvalidCellCapacity_Ah /end REF_CHARACTERISTIC
/end GROUP
/begin GROUP S1961_CellCapacity_Limit "VBU0706/Function-Call Subsystem/Subsystem1/SOH/Subsystem4/Subsystem1/Calculate_Capacity/Calculate_CellCapacity/CellCapacity_Limit" /begin SUB_GROUP S1967_LimittedByNVMvalue /end SUB_GROUP /begin REF_CHARACTERISTIC CcSOH_CellCapacityLowThershold_Ah /end REF_CHARACTERISTIC /end GROUP
/begin GROUP S1961_Determine_CellCapacity "VBU0706/Function-Call Subsystem/Subsystem1/SOH/Subsystem4/Subsystem1/Calculate_Capacity/Calculate_CellCapacity/Determine_CellCapacity" /begin SUB_GROUP S1968_MMASVC1 /end SUB_GROUP /end GROUP
/begin GROUP S1961_Determine_PackSoh "VBU0706/Function-Call Subsystem/Subsystem1/SOH/Subsystem4/Subsystem1/Calculate_Capacity/Calculate_CellCapacity/Determine_PackSoh" /begin REF_MEASUREMENT SOH_pctPackSoh /end REF_MEASUREMENT /end GROUP
/begin GROUP S1961_PackSoh_Storage "VBU0706/Function-Call Subsystem/Subsystem1/SOH/Subsystem4/Subsystem1/Calculate_Capacity/Calculate_CellCapacity/PackSoh_Storage"
 /begin REF_CHARACTERISTIC CaSOH_CellCapacityWrite_Ah CaSOH_LifeTimeDischargeLookUp_Ah CbSOH_EepromWriteCellCapacity_flg /end REF_CHARACTERISTIC
/end GROUP
/begin GROUP S1962_Determine_AhIntegral_DeltaQ "VBU0706/Function-Call Subsystem/Subsystem1/SOH/Subsystem4/Subsystem1/Calculate_Capacity/Calculate_CellCapacity_SlowCharge/Determine_AhIntegral_DeltaQ"
 /begin SUB_GROUP S2000_Determine_AhIntegral_Q S2000_Determine_Module_Current /end SUB_GROUP
/end GROUP
/begin GROUP S1962_Determine_Soc "VBU0706/Function-Call Subsystem/Subsystem1/SOH/Subsystem4/Subsystem1/Calculate_Capacity/Calculate_CellCapacity_SlowCharge/Determine_Soc" /begin SUB_GROUP S2002_Determine_Module_Current S2002_Lookup_Table_Cal_Soc /end SUB_GROUP /end GROUP
/begin GROUP S1962_Determine_SocEndandCondition "VBU0706/Function-Call Subsystem/Subsystem1/SOH/Subsystem4/Subsystem1/Calculate_Capacity/Calculate_CellCapacity_SlowCharge/Determine_SocEndandCondition"
 /begin REF_CHARACTERISTIC CcSOH_DeltaSocLowerLimit_pct CcSOH_DeltaSocThreshold_pct CcSOH_DeltaSocUpperLimit_pct CcSOH_DeltaTemThreshold_C CcSOH_LowTemThreshold_C /end REF_CHARACTERISTIC
/end GROUP
/begin GROUP S1962_Determine_SocStart "VBU0706/Function-Call Subsystem/Subsystem1/SOH/Subsystem4/Subsystem1/Calculate_Capacity/Calculate_CellCapacity_SlowCharge/Determine_SocStart"
 /begin REF_CHARACTERISTIC CcSOH_UdSocInvalidLowerLimit_pct CcSOH_UdSocInvalidUpperLimit_pct /end REF_CHARACTERISTIC
 /begin REF_MEASUREMENT SOH_flgSingalSocStart /end REF_MEASUREMENT
/end GROUP
/begin GROUP S1964_Determine_SlowCharge "VBU0706/Function-Call Subsystem/Subsystem1/SOH/Subsystem4/Subsystem1/Calculate_Capacity/Determine_CalculateCellCapacity_Condition/Determine_SlowCharge" /begin SUB_GROUP S2022_OBC_CHARGE_MODE1 /end SUB_GROUP /begin REF_CHARACTERISTIC CcSOH_AfertSlowChargeEndTime_ms /end REF_CHARACTERISTIC /end GROUP
/begin GROUP S1964_Determine_SlowChargeStart "VBU0706/Function-Call Subsystem/Subsystem1/SOH/Subsystem4/Subsystem1/Calculate_Capacity/Determine_CalculateCellCapacity_Condition/Determine_SlowChargeStart" /begin REF_CHARACTERISTIC CcSOH_AfertSlowChargeStartTime_ms /end REF_CHARACTERISTIC /end GROUP
/begin GROUP S2030_BeforStep_DuringStep_AfterStep_Check "VBU0706/Function-Call Subsystem/Subsystem1/SOH/Subsystem4/Subsystem1/Calculate_Resistance/BasicCellResistance_Calculation_Check/BeforStep_DuringStep_AfterStep_Check" /begin SUB_GROUP S2039_DuringStep_AfterStep_Check /end SUB_GROUP /end GROUP
/begin GROUP S2030_ResistanceCalc_Check "VBU0706/Function-Call Subsystem/Subsystem1/SOH/Subsystem4/Subsystem1/Calculate_Resistance/BasicCellResistance_Calculation_Check/ResistanceCalc_Check" /begin SUB_GROUP S2040_NVM_ReadWrite_Check /end SUB_GROUP /end GROUP
/begin GROUP S2033_CalCurrent_Data_BeforeStep "VBU0706/Function-Call Subsystem/Subsystem1/SOH/Subsystem4/Subsystem1/Calculate_Resistance/Calculate_Relaxation_Average_CurrentVoltage/CalCurrent_Data_BeforeStep"
 /begin REF_CHARACTERISTIC CaSOH_InvalidHistoryCurrentData_A CcSOH_ComResisTempLowerLimit_C CcSOH_ComResisTempUpperLimit_C CcSOH_DeltaModuleCurrent_A CcSOH_HistoryDataDimension_n CcSYS_ResisCalRelaxationCurrent_A /end REF_CHARACTERISTIC
 /begin REF_MEASUREMENT SOH_flgBeforeStepCurrentEnable SOH_iABeforeStepAveCurrent /end REF_MEASUREMENT
/end GROUP
/begin GROUP S2037_Calculate_Pulse_Average_CurrentVoltage "VBU0706/Function-Call Subsystem/Subsystem1/SOH/Subsystem4/Subsystem1/Calculate_Resistance/Determine_Condition_Calculate_Pulse_Average_CurrentVoltage/Calculate_Pulse_Average_CurrentVoltage" /begin SUB_GROUP S2054_Cal_Pulse_Current_Data /end SUB_GROUP /end GROUP
/begin GROUP S2037_Determine_Condition "VBU0706/Function-Call Subsystem/Subsystem1/SOH/Subsystem4/Subsystem1/Calculate_Resistance/Determine_Condition_Calculate_Pulse_Average_CurrentVoltage/Determine_Condition" /begin SUB_GROUP S2055_Determine_FCCPulseCurrent_Condition /end SUB_GROUP /end GROUP
/begin GROUP S2096_Determine_InletTemp_Validation "VBU0706/Function-Call Subsystem/Subsystem1/THM/Subsystem/Subsystem/Calculate_PipeTemperature/Determine_CoolantSensorTemp_Validation/Determine_InletTemp_Validation" /begin SUB_GROUP S2097_Determinate_InletTempValidationDelay /end SUB_GROUP
 /begin REF_CHARACTERISTIC CcTHM_CoolantGradientCheckEnable_flg CcTHM_CoolantSensorGradient_C CcTHM_CoolantSensorValidEnable_flg CcTHM_CoolantTempOorDebounceTime_s /end REF_CHARACTERISTIC
 /begin REF_MEASUREMENT THM_flgInletTempValid /end REF_MEASUREMENT
/end GROUP
/begin GROUP S2096_Determine_OutletTemp_Validation "VBU0706/Function-Call Subsystem/Subsystem1/THM/Subsystem/Subsystem/Calculate_PipeTemperature/Determine_CoolantSensorTemp_Validation/Determine_OutletTemp_Validation" /begin SUB_GROUP S2098_Determinate_OutletTempValidationDelay /end SUB_GROUP
 /begin REF_CHARACTERISTIC CcTHM_CoolantGradientCheckEnable_flg CcTHM_CoolantSensorGradient_C CcTHM_CoolantSensorValidEnable_flg CcTHM_CoolantTempOorDebounceTime_s /end REF_CHARACTERISTIC
 /begin REF_MEASUREMENT THM_flgOutletTempValid /end REF_MEASUREMENT
/end GROUP
/begin GROUP S2108_Normal_Condition "VBU0706/Function-Call Subsystem/Subsystem1/THM/Subsystem/Subsystem/Charge_Mode_Temp_Request/OBC_Temp_Request/Normal_Condition"
 /begin REF_CHARACTERISTIC CaTHM_ObcHighSocRequestTempMapZ_C CaTHM_ObcSohFactorMapY_n CcTHM_ObcChargeTempRequestLowThreshold_C CcTHM_ObcSohTempLowThreshold_C /end REF_CHARACTERISTIC
/end GROUP
/begin GROUP S2149_SOC_Hysteretic_Determination "VBU0706/Function-Call Subsystem/Subsystem1/THM/Subsystem/Subsystem/Valid_Condition_Determination/FCC_Temp_Valid/SOC_Hysteretic_Determination" /begin REF_CHARACTERISTIC CcTHM_FccChargeHysterSOC_pct CcTHM_FccSocHighThreshold_pct /end REF_CHARACTERISTIC /end GROUP
/begin GROUP S2149_Temp_Hysteretic_Determination "VBU0706/Function-Call Subsystem/Subsystem1/THM/Subsystem/Subsystem/Valid_Condition_Determination/FCC_Temp_Valid/Temp_Hysteretic_Determination"
 /begin REF_CHARACTERISTIC CcTHM_FccCellTempHighThreshold_C CcTHM_FccChargeTempRequestHysterTemp_C /end REF_CHARACTERISTIC
/end GROUP
/begin GROUP S2151_Hysteretic_Determination "VBU0706/Function-Call Subsystem/Subsystem1/THM/Subsystem/Subsystem/Valid_Condition_Determination/OBC_Temp_Valid/Hysteretic_Determination"
 /begin REF_CHARACTERISTIC CcTHM_ObcCellTempHighThreshold_C CcTHM_ObcChargeTempRequestHysterTemp_C /end REF_CHARACTERISTIC
/end GROUP
/begin GROUP S2151_SOC_Hysteretic_Determination "VBU0706/Function-Call Subsystem/Subsystem1/THM/Subsystem/Subsystem/Valid_Condition_Determination/OBC_Temp_Valid/SOC_Hysteretic_Determination" /begin REF_CHARACTERISTIC CcTHM_ObcChargeHysterSOC_pct CcTHM_ObcSocHighThreshold_pct /end REF_CHARACTERISTIC /end GROUP
/begin GROUP S2169_LOW_HIGH3 "VBU0706/Function-Call Subsystem/Subsystem1/VCT/Subsystem/Subsystem/Determine_BMS_VCU_267/Override/LOW_HIGH3" /begin REF_MEASUREMENT VCT_kwhBMSPackEnergyAvailable /end REF_MEASUREMENT /end GROUP
/begin GROUP S2169_LOW_HIGH5 "VBU0706/Function-Call Subsystem/Subsystem1/VCT/Subsystem/Subsystem/Determine_BMS_VCU_267/Override/LOW_HIGH5" /begin REF_MEASUREMENT VCT_stCTMCellThermalRunaway /end REF_MEASUREMENT /end GROUP
/begin GROUP S2169_LOW_HIGH7 "VBU0706/Function-Call Subsystem/Subsystem1/VCT/Subsystem/Subsystem/Determine_BMS_VCU_267/Override/LOW_HIGH7" /begin REF_MEASUREMENT VCT_flgCTMCellThermalRunawayFaultValid /end REF_MEASUREMENT /end GROUP
/begin GROUP S2174_LOW_HIGH1 "VBU0706/Function-Call Subsystem/Subsystem1/VCT/Subsystem/Subsystem/Determine_BMS_VCU_268/Override/LOW_HIGH1" /begin REF_MEASUREMENT VCT_kwBMSDischgPowerLimitST /end REF_MEASUREMENT /end GROUP
/begin GROUP S2174_LOW_HIGH14 "VBU0706/Function-Call Subsystem/Subsystem1/VCT/Subsystem/Subsystem/Determine_BMS_VCU_268/Override/LOW_HIGH14" /begin REF_MEASUREMENT VCT_kwBMSDischgPowerLimitLT /end REF_MEASUREMENT /end GROUP
/begin GROUP S2174_LOW_HIGH2 "VBU0706/Function-Call Subsystem/Subsystem1/VCT/Subsystem/Subsystem/Determine_BMS_VCU_268/Override/LOW_HIGH2" /begin REF_MEASUREMENT VCT_kwBMSDischgPowerLimitDynamic /end REF_MEASUREMENT /end GROUP
/begin GROUP S2174_LOW_HIGH3 "VBU0706/Function-Call Subsystem/Subsystem1/VCT/Subsystem/Subsystem/Determine_BMS_VCU_268/Override/LOW_HIGH3" /begin REF_MEASUREMENT VCT_kohmBMSInsulationResistanceValue /end REF_MEASUREMENT /end GROUP
/begin GROUP S2182_LOW_HIGH1 "VBU0706/Function-Call Subsystem/Subsystem1/VCT/Subsystem/Subsystem/Determine_BMS_VCU_269/Override/LOW_HIGH1" /begin REF_MEASUREMENT VCT_uBMSCellVoltageMin /end REF_MEASUREMENT /end GROUP
/begin GROUP S2182_LOW_HIGH17 "VBU0706/Function-Call Subsystem/Subsystem1/VCT/Subsystem/Subsystem/Determine_BMS_VCU_269/Override/LOW_HIGH17" /begin REF_MEASUREMENT VCT_uBMSCellVoltageMax /end REF_MEASUREMENT /end GROUP
/begin GROUP S2182_LOW_HIGH2 "VBU0706/Function-Call Subsystem/Subsystem1/VCT/Subsystem/Subsystem/Determine_BMS_VCU_269/Override/LOW_HIGH2" /begin REF_MEASUREMENT VCT_timinBMSEstimateChargingTime /end REF_MEASUREMENT /end GROUP
/begin GROUP S2182_LOW_HIGH3 "VBU0706/Function-Call Subsystem/Subsystem1/VCT/Subsystem/Subsystem/Determine_BMS_VCU_269/Override/LOW_HIGH3" /begin REF_MEASUREMENT VCT_uBMSCellVoltageAve /end REF_MEASUREMENT /end GROUP
/begin GROUP S2182_LOW_HIGH4 "VBU0706/Function-Call Subsystem/Subsystem1/VCT/Subsystem/Subsystem/Determine_BMS_VCU_269/Override/LOW_HIGH4" /begin REF_MEASUREMENT VCT_flgBMSCellVoltageMaxValidity /end REF_MEASUREMENT /end GROUP
/begin GROUP S2182_LOW_HIGH5 "VBU0706/Function-Call Subsystem/Subsystem1/VCT/Subsystem/Subsystem/Determine_BMS_VCU_269/Override/LOW_HIGH5" /begin REF_MEASUREMENT VCT_flgBMSCellVoltageAveValidity /end REF_MEASUREMENT /end GROUP
/begin GROUP S2182_LOW_HIGH6 "VBU0706/Function-Call Subsystem/Subsystem1/VCT/Subsystem/Subsystem/Determine_BMS_VCU_269/Override/LOW_HIGH6" /begin REF_MEASUREMENT VCT_flgBMSCellVoltageMinValidity /end REF_MEASUREMENT /end GROUP
/begin GROUP S2190_LOW_HIGH1 "VBU0706/Function-Call Subsystem/Subsystem1/VCT/Subsystem/Subsystem/Determine_BMS_VCU_26A/Override/LOW_HIGH1" /begin REF_MEASUREMENT VCT_kwBMSChgPowerLimitLT /end REF_MEASUREMENT /end GROUP
/begin GROUP S2190_LOW_HIGH14 "VBU0706/Function-Call Subsystem/Subsystem1/VCT/Subsystem/Subsystem/Determine_BMS_VCU_26A/Override/LOW_HIGH14" /begin REF_MEASUREMENT VCT_kwBMSChgPowerLimitST /end REF_MEASUREMENT /end GROUP
/begin GROUP S2190_LOW_HIGH2 "VBU0706/Function-Call Subsystem/Subsystem1/VCT/Subsystem/Subsystem/Determine_BMS_VCU_26A/Override/LOW_HIGH2" /begin REF_MEASUREMENT VCT_kwBMSChgPowerLimitDynamic /end REF_MEASUREMENT /end GROUP
/begin GROUP S2190_LOW_HIGH3 "VBU0706/Function-Call Subsystem/Subsystem1/VCT/Subsystem/Subsystem/Determine_BMS_VCU_26A/Override/LOW_HIGH3" /begin REF_MEASUREMENT VCT_timinEstimatePercTime /end REF_MEASUREMENT /end GROUP
/begin GROUP S2195_LOW_HIGH1 "VBU0706/Function-Call Subsystem/Subsystem1/VCT/Subsystem/Subsystem/Determine_BMS_VCU_271/Override/LOW_HIGH1" /begin REF_MEASUREMENT VCT_numBMSMaximumTempNumber /end REF_MEASUREMENT /end GROUP
/begin GROUP S2195_LOW_HIGH14 "VBU0706/Function-Call Subsystem/Subsystem1/VCT/Subsystem/Subsystem/Determine_BMS_VCU_271/Override/LOW_HIGH14" /begin REF_MEASUREMENT VCT_numBMSMaximumCellVoltageNumber /end REF_MEASUREMENT /end GROUP
/begin GROUP S2195_LOW_HIGH2 "VBU0706/Function-Call Subsystem/Subsystem1/VCT/Subsystem/Subsystem/Determine_BMS_VCU_271/Override/LOW_HIGH2" /begin REF_MEASUREMENT VCT_numBMSMinimumTempNumber /end REF_MEASUREMENT /end GROUP
/begin GROUP S2195_LOW_HIGH3 "VBU0706/Function-Call Subsystem/Subsystem1/VCT/Subsystem/Subsystem/Determine_BMS_VCU_271/Override/LOW_HIGH3" /begin REF_MEASUREMENT VCT_tBMSMaximumCellTemp /end REF_MEASUREMENT /end GROUP
/begin GROUP S2195_LOW_HIGH4 "VBU0706/Function-Call Subsystem/Subsystem1/VCT/Subsystem/Subsystem/Determine_BMS_VCU_271/Override/LOW_HIGH4" /begin REF_MEASUREMENT VCT_tBMSMinimumCellTemp /end REF_MEASUREMENT /end GROUP
/begin GROUP S2195_LOW_HIGH5 "VBU0706/Function-Call Subsystem/Subsystem1/VCT/Subsystem/Subsystem/Determine_BMS_VCU_271/Override/LOW_HIGH5" /begin REF_MEASUREMENT VCT_pctBMSDCChrgFinalSOC /end REF_MEASUREMENT /end GROUP
/begin GROUP S2203_LOW_HIGH1 "VBU0706/Function-Call Subsystem/Subsystem1/VCT/Subsystem/Subsystem/Determine_BMS_VCU_272/Override/LOW_HIGH1" /begin REF_MEASUREMENT VCT_stBMSSOCOverUnder /end REF_MEASUREMENT /end GROUP
/begin GROUP S2203_LOW_HIGH10 "VBU0706/Function-Call Subsystem/Subsystem1/VCT/Subsystem/Subsystem/Determine_BMS_VCU_272/Override/LOW_HIGH10" /begin REF_MEASUREMENT VCT_stBatteryTempDifferAlarm /end REF_MEASUREMENT /end GROUP
/begin GROUP S2203_LOW_HIGH11 "VBU0706/Function-Call Subsystem/Subsystem1/VCT/Subsystem/Subsystem/Determine_BMS_VCU_272/Override/LOW_HIGH11" /begin REF_MEASUREMENT VCT_stBetteryCellTempHighAlarm /end REF_MEASUREMENT /end GROUP
/begin GROUP S2203_LOW_HIGH12 "VBU0706/Function-Call Subsystem/Subsystem1/VCT/Subsystem/Subsystem/Determine_BMS_VCU_272/Override/LOW_HIGH12" /begin REF_MEASUREMENT VCT_stBetteryCellTempLowAlarm /end REF_MEASUREMENT /end GROUP
/begin GROUP S2203_LOW_HIGH13 "VBU0706/Function-Call Subsystem/Subsystem1/VCT/Subsystem/Subsystem/Determine_BMS_VCU_272/Override/LOW_HIGH13" /begin REF_MEASUREMENT VCT_stSOCJumpReason /end REF_MEASUREMENT /end GROUP
/begin GROUP S2203_LOW_HIGH14 "VBU0706/Function-Call Subsystem/Subsystem1/VCT/Subsystem/Subsystem/Determine_BMS_VCU_272/Override/LOW_HIGH14" /begin REF_MEASUREMENT VCT_stBatteryTypeDismatchAlarm /end REF_MEASUREMENT /end GROUP
/begin GROUP S2203_LOW_HIGH16 "VBU0706/Function-Call Subsystem/Subsystem1/VCT/Subsystem/Subsystem/Determine_BMS_VCU_272/Override/LOW_HIGH16" /begin REF_MEASUREMENT VCT_stBetteryCellVolLowAlarm /end REF_MEASUREMENT /end GROUP
/begin GROUP S2203_LOW_HIGH17 "VBU0706/Function-Call Subsystem/Subsystem1/VCT/Subsystem/Subsystem/Determine_BMS_VCU_272/Override/LOW_HIGH17" /begin REF_MEASUREMENT VCT_stSOCJumpAlarm /end REF_MEASUREMENT /end GROUP
/begin GROUP S2203_LOW_HIGH18 "VBU0706/Function-Call Subsystem/Subsystem1/VCT/Subsystem/Subsystem/Determine_BMS_VCU_272/Override/LOW_HIGH18" /begin REF_MEASUREMENT VCT_stBetteryCellVolHighAlarm /end REF_MEASUREMENT /end GROUP
/begin GROUP S2203_LOW_HIGH2 "VBU0706/Function-Call Subsystem/Subsystem1/VCT/Subsystem/Subsystem/Determine_BMS_VCU_272/Override/LOW_HIGH2" /begin REF_MEASUREMENT VCT_stBMSDCChargeCurrentOverUnder /end REF_MEASUREMENT /end GROUP
/begin GROUP S2203_LOW_HIGH3 "VBU0706/Function-Call Subsystem/Subsystem1/VCT/Subsystem/Subsystem/Determine_BMS_VCU_272/Override/LOW_HIGH3" /begin REF_MEASUREMENT VCT_stBMSCellVoltageOverUnder /end REF_MEASUREMENT /end GROUP
/begin GROUP S2203_LOW_HIGH4 "VBU0706/Function-Call Subsystem/Subsystem1/VCT/Subsystem/Subsystem/Determine_BMS_VCU_272/Override/LOW_HIGH4" /begin REF_MEASUREMENT VCT_stBatteryTempOver /end REF_MEASUREMENT /end GROUP
/begin GROUP S2203_LOW_HIGH5 "VBU0706/Function-Call Subsystem/Subsystem1/VCT/Subsystem/Subsystem/Determine_BMS_VCU_272/Override/LOW_HIGH5" /begin REF_MEASUREMENT VCT_stBatteryOutputConnectorState /end REF_MEASUREMENT /end GROUP
/begin GROUP S2203_LOW_HIGH6 "VBU0706/Function-Call Subsystem/Subsystem1/VCT/Subsystem/Subsystem/Determine_BMS_VCU_272/Override/LOW_HIGH6" /begin REF_MEASUREMENT VCT_stDCChargingPermitStatus /end REF_MEASUREMENT /end GROUP
/begin GROUP S2203_LOW_HIGH7 "VBU0706/Function-Call Subsystem/Subsystem1/VCT/Subsystem/Subsystem/Determine_BMS_VCU_272/Override/LOW_HIGH7" /begin REF_MEASUREMENT VCT_stBetteryPckVoltUnderAlarm /end REF_MEASUREMENT /end GROUP
/begin GROUP S2203_LOW_HIGH8 "VBU0706/Function-Call Subsystem/Subsystem1/VCT/Subsystem/Subsystem/Determine_BMS_VCU_272/Override/LOW_HIGH8" /begin REF_MEASUREMENT VCT_stBatteryConsistencyAlarm /end REF_MEASUREMENT /end GROUP
/begin GROUP S2203_LOW_HIGH9 "VBU0706/Function-Call Subsystem/Subsystem1/VCT/Subsystem/Subsystem/Determine_BMS_VCU_272/Override/LOW_HIGH9" /begin REF_MEASUREMENT VCT_stBetteryPckVoltOverAlarm /end REF_MEASUREMENT /end GROUP
/begin GROUP S2253_LOW_HIGH1 "VBU0706/Function-Call Subsystem/Subsystem1/VCT/Subsystem/Subsystem/Determine_BMS_VCU_34/Override/LOW_HIGH1" /begin REF_MEASUREMENT VCT_stInhibitPrechargeCause /end REF_MEASUREMENT /end GROUP
/begin GROUP S2253_LOW_HIGH2 "VBU0706/Function-Call Subsystem/Subsystem1/VCT/Subsystem/Subsystem/Determine_BMS_VCU_34/Override/LOW_HIGH2" /begin REF_MEASUREMENT VCT_stBMSContactorState /end REF_MEASUREMENT /end GROUP
/begin GROUP S2253_LOW_HIGH3 "VBU0706/Function-Call Subsystem/Subsystem1/VCT/Subsystem/Subsystem/Determine_BMS_VCU_34/Override/LOW_HIGH3" /begin REF_MEASUREMENT VCT_stBMSSts /end REF_MEASUREMENT /end GROUP
/begin GROUP S2253_LOW_HIGH5 "VBU0706/Function-Call Subsystem/Subsystem1/VCT/Subsystem/Subsystem/Determine_BMS_VCU_34/Override/LOW_HIGH5" /begin REF_MEASUREMENT VCT_numBMSRollingCounterAF /end REF_MEASUREMENT /end GROUP
/begin GROUP S2262_LOW_HIGH1 "VBU0706/Function-Call Subsystem/Subsystem1/VCT/Subsystem/Subsystem/Determine_BMS_VCU_373/Override/LOW_HIGH1" /begin REF_MEASUREMENT VCT_tBMSTemperatureMin /end REF_MEASUREMENT /end GROUP
/begin GROUP S2262_LOW_HIGH10 "VBU0706/Function-Call Subsystem/Subsystem1/VCT/Subsystem/Subsystem/Determine_BMS_VCU_373/Override/LOW_HIGH10" /begin REF_MEASUREMENT VCT_flgBMSTempMaxValidity /end REF_MEASUREMENT /end GROUP
/begin GROUP S2262_LOW_HIGH11 "VBU0706/Function-Call Subsystem/Subsystem1/VCT/Subsystem/Subsystem/Determine_BMS_VCU_373/Override/LOW_HIGH11" /begin REF_MEASUREMENT VCT_flgBMSTempAverageValidity /end REF_MEASUREMENT /end GROUP
/begin GROUP S2262_LOW_HIGH12 "VBU0706/Function-Call Subsystem/Subsystem1/VCT/Subsystem/Subsystem/Determine_BMS_VCU_373/Override/LOW_HIGH12" /begin REF_MEASUREMENT VCT_flgBMSTempMinValidity /end REF_MEASUREMENT /end GROUP
/begin GROUP S2262_LOW_HIGH13 "VBU0706/Function-Call Subsystem/Subsystem1/VCT/Subsystem/Subsystem/Determine_BMS_VCU_373/Override/LOW_HIGH13" /begin REF_MEASUREMENT VCT_tBMSCellTempStandardDeviation /end REF_MEASUREMENT /end GROUP
/begin GROUP S2262_LOW_HIGH14 "VBU0706/Function-Call Subsystem/Subsystem1/VCT/Subsystem/Subsystem/Determine_BMS_VCU_373/Override/LOW_HIGH14" /begin REF_MEASUREMENT VCT_tBMSInletTempRequest /end REF_MEASUREMENT /end GROUP
/begin GROUP S2262_LOW_HIGH15 "VBU0706/Function-Call Subsystem/Subsystem1/VCT/Subsystem/Subsystem/Determine_BMS_VCU_373/Override/LOW_HIGH15" /begin REF_MEASUREMENT VCT_flgBMSTempRequestValid /end REF_MEASUREMENT /end GROUP
/begin GROUP S2262_LOW_HIGH17 "VBU0706/Function-Call Subsystem/Subsystem1/VCT/Subsystem/Subsystem/Determine_BMS_VCU_373/Override/LOW_HIGH17" /begin REF_MEASUREMENT VCT_tBMSTemperatureMax /end REF_MEASUREMENT /end GROUP
/begin GROUP S2262_LOW_HIGH2 "VBU0706/Function-Call Subsystem/Subsystem1/VCT/Subsystem/Subsystem/Determine_BMS_VCU_373/Override/LOW_HIGH2" /begin REF_MEASUREMENT VCT_tBMSInletWaterTemp /end REF_MEASUREMENT /end GROUP
/begin GROUP S2262_LOW_HIGH3 "VBU0706/Function-Call Subsystem/Subsystem1/VCT/Subsystem/Subsystem/Determine_BMS_VCU_373/Override/LOW_HIGH3" /begin REF_MEASUREMENT VCT_tBMSOutletWaterTemp /end REF_MEASUREMENT /end GROUP
/begin GROUP S2262_LOW_HIGH4 "VBU0706/Function-Call Subsystem/Subsystem1/VCT/Subsystem/Subsystem/Determine_BMS_VCU_373/Override/LOW_HIGH4" /begin REF_MEASUREMENT VCT_flgBMSESSInletTempMask /end REF_MEASUREMENT /end GROUP
/begin GROUP S2262_LOW_HIGH5 "VBU0706/Function-Call Subsystem/Subsystem1/VCT/Subsystem/Subsystem/Determine_BMS_VCU_373/Override/LOW_HIGH5" /begin REF_MEASUREMENT VCT_tBMSTemperatureAverage /end REF_MEASUREMENT /end GROUP
/begin GROUP S2262_LOW_HIGH6 "VBU0706/Function-Call Subsystem/Subsystem1/VCT/Subsystem/Subsystem/Determine_BMS_VCU_373/Override/LOW_HIGH6" /begin REF_MEASUREMENT VCT_flgBMSESSOutletTempMask /end REF_MEASUREMENT /end GROUP
/begin GROUP S2262_LOW_HIGH7 "VBU0706/Function-Call Subsystem/Subsystem1/VCT/Subsystem/Subsystem/Determine_BMS_VCU_373/Override/LOW_HIGH7" /begin REF_MEASUREMENT VCT_flgBMSHVShutdownReq /end REF_MEASUREMENT /end GROUP
/begin GROUP S2262_LOW_HIGH8 "VBU0706/Function-Call Subsystem/Subsystem1/VCT/Subsystem/Subsystem/Determine_BMS_VCU_373/Override/LOW_HIGH8" /begin REF_MEASUREMENT VCT_flgBMSESSInletTempValidity /end REF_MEASUREMENT /end GROUP
/begin GROUP S2262_LOW_HIGH9 "VBU0706/Function-Call Subsystem/Subsystem1/VCT/Subsystem/Subsystem/Determine_BMS_VCU_373/Override/LOW_HIGH9" /begin REF_MEASUREMENT VCT_flgBMSESSOutletTempValidity /end REF_MEASUREMENT /end GROUP
/begin GROUP S2281_LOW_HIGH1 "VBU0706/Function-Call Subsystem/Subsystem1/VCT/Subsystem/Subsystem/Determine_BMS_VCU_AC/Override/LOW_HIGH1" /begin REF_MEASUREMENT VCT_stBMSFaultCat /end REF_MEASUREMENT /end GROUP
/begin GROUP S2281_LOW_HIGH10 "VBU0706/Function-Call Subsystem/Subsystem1/VCT/Subsystem/Subsystem/Determine_BMS_VCU_AC/Override/LOW_HIGH10" /begin REF_MEASUREMENT VCT_pctBMSCustomerUsageSOC /end REF_MEASUREMENT /end GROUP
/begin GROUP S2281_LOW_HIGH17 "VBU0706/Function-Call Subsystem/Subsystem1/VCT/Subsystem/Subsystem/Determine_BMS_VCU_AC/Override/LOW_HIGH17" /begin REF_MEASUREMENT VCT_iABMSPackCrnt /end REF_MEASUREMENT /end GROUP
/begin GROUP S2281_LOW_HIGH2 "VBU0706/Function-Call Subsystem/Subsystem1/VCT/Subsystem/Subsystem/Determine_BMS_VCU_AC/Override/LOW_HIGH2" /begin REF_MEASUREMENT VCT_stBMSFaultLvl /end REF_MEASUREMENT /end GROUP
/begin GROUP S2281_LOW_HIGH3 "VBU0706/Function-Call Subsystem/Subsystem1/VCT/Subsystem/Subsystem/Determine_BMS_VCU_AC/Override/LOW_HIGH3" /begin REF_MEASUREMENT VCT_uBMSPackVoltage /end REF_MEASUREMENT /end GROUP
/begin GROUP S2281_LOW_HIGH4 "VBU0706/Function-Call Subsystem/Subsystem1/VCT/Subsystem/Subsystem/Determine_BMS_VCU_AC/Override/LOW_HIGH4" /begin REF_MEASUREMENT VCT_pctBMSSOC /end REF_MEASUREMENT /end GROUP
/begin GROUP S2281_LOW_HIGH5 "VBU0706/Function-Call Subsystem/Subsystem1/VCT/Subsystem/Subsystem/Determine_BMS_VCU_AC/Override/LOW_HIGH5" /begin REF_MEASUREMENT VCT_flgHVBattSOCLowCrit /end REF_MEASUREMENT /end GROUP
/begin GROUP S2281_LOW_HIGH7 "VBU0706/Function-Call Subsystem/Subsystem1/VCT/Subsystem/Subsystem/Determine_BMS_VCU_AC/Override/LOW_HIGH7" /begin REF_MEASUREMENT VCT_flgChargeAvailable /end REF_MEASUREMENT /end GROUP
/begin GROUP S2281_LOW_HIGH8 "VBU0706/Function-Call Subsystem/Subsystem1/VCT/Subsystem/Subsystem/Determine_BMS_VCU_AC/Override/LOW_HIGH8" /begin REF_MEASUREMENT VCT_numBMSRollingCounter225 /end REF_MEASUREMENT /end GROUP
/begin GROUP S2281_LOW_HIGH9 "VBU0706/Function-Call Subsystem/Subsystem1/VCT/Subsystem/Subsystem/Determine_BMS_VCU_AC/Override/LOW_HIGH9" /begin REF_MEASUREMENT VCT_flgHVBattSOCLowWarn /end REF_MEASUREMENT /end GROUP
/begin GROUP S2515_Input_CAN_Signal_No_Range_Check "VBU0706/Task_10ms/Subsystem/HALIn/PTCAN/Subsystem/20ms/ABS_0x068/Input_CAN_Signal_No_Range_Check" /begin REF_CHARACTERISTIC BCU_flgABSFailOvrdVal_C BCU_flgFlgABSFailOvrd_C /end REF_CHARACTERISTIC /end GROUP
/begin GROUP S2515_Input_CAN_Signal_No_Range_Check3 "VBU0706/Task_10ms/Subsystem/HALIn/PTCAN/Subsystem/20ms/ABS_0x068/Input_CAN_Signal_No_Range_Check3" /begin REF_CHARACTERISTIC BCU_flgABSActvOvrdVal_C BCU_flgFlgABSActvOvrd_C /end REF_CHARACTERISTIC /end GROUP
/begin GROUP S2515_Input_CAN_Signal_No_Range_Check4 "VBU0706/Task_10ms/Subsystem/HALIn/PTCAN/Subsystem/20ms/ABS_0x068/Input_CAN_Signal_No_Range_Check4" /begin REF_CHARACTERISTIC BCU_flgVVehicleSpeedOvrd_C BCU_vVehicleSpeedOvrdVal_C /end REF_CHARACTERISTIC /end GROUP
/begin GROUP S2517_Input_CAN_Signal_No_Range_Check "VBU0706/Task_10ms/Subsystem/HALIn/PTCAN/Subsystem/20ms/ABS_0x75/Input_CAN_Signal_No_Range_Check" /begin REF_CHARACTERISTIC BCU_flgVWhlFLOvrd_C BCU_vWhlFLOvrdVal_C /end REF_CHARACTERISTIC /end GROUP
/begin GROUP S2517_Input_CAN_Signal_No_Range_Check1 "VBU0706/Task_10ms/Subsystem/HALIn/PTCAN/Subsystem/20ms/ABS_0x75/Input_CAN_Signal_No_Range_Check1" /begin REF_CHARACTERISTIC BCU_flgStWhlFLOvrd_C BCU_stWhlFLOvrdVal_C /end REF_CHARACTERISTIC /end GROUP
/begin GROUP S2517_Input_CAN_Signal_No_Range_Check2 "VBU0706/Task_10ms/Subsystem/HALIn/PTCAN/Subsystem/20ms/ABS_0x75/Input_CAN_Signal_No_Range_Check2" /begin REF_CHARACTERISTIC BCU_flgVWhlFROvrd_C BCU_vWhlFROvrdVal_C /end REF_CHARACTERISTIC /end GROUP
/begin GROUP S2517_Input_CAN_Signal_No_Range_Check3 "VBU0706/Task_10ms/Subsystem/HALIn/PTCAN/Subsystem/20ms/ABS_0x75/Input_CAN_Signal_No_Range_Check3" /begin REF_CHARACTERISTIC BCU_flgStWhlFROvrd_C BCU_stWhlFROvrdVal_C /end REF_CHARACTERISTIC /end GROUP
/begin GROUP S2518_Input_CAN_Signal_No_Range_Check "VBU0706/Task_10ms/Subsystem/HALIn/PTCAN/Subsystem/20ms/ABS_0x79/Input_CAN_Signal_No_Range_Check" /begin SUB_GROUP S2598_override_signal /end SUB_GROUP /begin REF_CHARACTERISTIC BCU_flgVWhlRLOvrd_C BCU_vWhlRLOvrdVal_C /end REF_CHARACTERISTIC /end GROUP
/begin GROUP S2518_Input_CAN_Signal_No_Range_Check1 "VBU0706/Task_10ms/Subsystem/HALIn/PTCAN/Subsystem/20ms/ABS_0x79/Input_CAN_Signal_No_Range_Check1" /begin REF_CHARACTERISTIC BCU_flgStWhlRLOvrd_C BCU_stWhlRLOvrdVal_C /end REF_CHARACTERISTIC /end GROUP
/begin GROUP S2518_Input_CAN_Signal_No_Range_Check2 "VBU0706/Task_10ms/Subsystem/HALIn/PTCAN/Subsystem/20ms/ABS_0x79/Input_CAN_Signal_No_Range_Check2" /begin SUB_GROUP S2600_override_signal /end SUB_GROUP /begin REF_CHARACTERISTIC BCU_flgVWhlRROvrd_C BCU_vWhlRROvrdVal_C /end REF_CHARACTERISTIC /end GROUP
/begin GROUP S2518_Input_CAN_Signal_No_Range_Check3 "VBU0706/Task_10ms/Subsystem/HALIn/PTCAN/Subsystem/20ms/ABS_0x79/Input_CAN_Signal_No_Range_Check3" /begin REF_CHARACTERISTIC BCU_flgStWhlRROvrd_C BCU_stWhlRROvrdVal_C /end REF_CHARACTERISTIC /end GROUP
/begin GROUP S2519_Input_CAN_Signal_No_Range_Check1 "VBU0706/Task_10ms/Subsystem/HALIn/PTCAN/Subsystem/20ms/EPB_0x80/Input_CAN_Signal_No_Range_Check1" /begin REF_CHARACTERISTIC EPB_flgStStateOvrd_C EPB_stStateOvrdVal_C /end REF_CHARACTERISTIC /end GROUP
/begin GROUP S2519_Input_CAN_Signal_No_Range_Check10 "VBU0706/Task_10ms/Subsystem/HALIn/PTCAN/Subsystem/20ms/EPB_0x80/Input_CAN_Signal_No_Range_Check10" /begin REF_CHARACTERISTIC EPB_flgStSwitchOvrd_C EPB_stSwitchOvrdVal_C /end REF_CHARACTERISTIC /end GROUP
/begin GROUP S2519_Input_CAN_Signal_No_Range_Check4 "VBU0706/Task_10ms/Subsystem/HALIn/PTCAN/Subsystem/20ms/EPB_0x80/Input_CAN_Signal_No_Range_Check4" /begin REF_CHARACTERISTIC EPB_flgStFaultLevelOvrd_C EPB_stFaultLevelOvrdVal_C /end REF_CHARACTERISTIC /end GROUP
/begin GROUP S2520_Input_CAN_Signal_No_Range_Check4 "VBU0706/Task_10ms/Subsystem/HALIn/PTCAN/Subsystem/20ms/EPS_0x70/Input_CAN_Signal_No_Range_Check4" /begin REF_CHARACTERISTIC EPS_flgStECUModeCntOvrd_C EPS_stECUModeCntOvrdVal_C /end REF_CHARACTERISTIC /end GROUP
/begin GROUP S2521_Input_CAN_Signal_No_Range_Check1 "VBU0706/Task_10ms/Subsystem/HALIn/PTCAN/Subsystem/20ms/MCU_205/Input_CAN_Signal_No_Range_Check1" /begin SUB_GROUP S2682_override_signal /end SUB_GROUP /begin REF_CHARACTERISTIC PEUR_flgTrqActOvrd_C PEUR_trqActOvrdVal_C /end REF_CHARACTERISTIC /end GROUP
/begin GROUP S2521_Input_CAN_Signal_No_Range_Check2 "VBU0706/Task_10ms/Subsystem/HALIn/PTCAN/Subsystem/20ms/MCU_205/Input_CAN_Signal_No_Range_Check2" /begin REF_CHARACTERISTIC PEUR_flgStInvrOvrd_C PEUR_stInvrOvrdVal_C /end REF_CHARACTERISTIC /end GROUP
/begin GROUP S2521_Input_CAN_Signal_No_Range_Check3 "VBU0706/Task_10ms/Subsystem/HALIn/PTCAN/Subsystem/20ms/MCU_205/Input_CAN_Signal_No_Range_Check3" /begin SUB_GROUP S2684_override_signal /end SUB_GROUP /begin REF_CHARACTERISTIC PEUR_flgFlgMotrHillHldOvrd_C PEUR_flgMotrHillHldOvrdVal_C /end REF_CHARACTERISTIC /end GROUP
/begin GROUP S2521_Input_CAN_Signal_No_Range_Check4 "VBU0706/Task_10ms/Subsystem/HALIn/PTCAN/Subsystem/20ms/MCU_205/Input_CAN_Signal_No_Range_Check4" /begin SUB_GROUP S2685_override_signal /end SUB_GROUP /begin REF_CHARACTERISTIC PEUR_flgStActvDisChOvrd_C PEUR_stActvDisChOvrdVal_C /end REF_CHARACTERISTIC /end GROUP
/begin GROUP S2521_Input_CAN_Signal_No_Range_Check5 "VBU0706/Task_10ms/Subsystem/HALIn/PTCAN/Subsystem/20ms/MCU_205/Input_CAN_Signal_No_Range_Check5" /begin SUB_GROUP S2686_override_signal /end SUB_GROUP /begin REF_CHARACTERISTIC PEUR_flgNMotrOvrd_C PEUR_nMotrOvrdVal_C /end REF_CHARACTERISTIC /end GROUP
/begin GROUP S2521_Input_CAN_Signal_No_Range_Check6 "VBU0706/Task_10ms/Subsystem/HALIn/PTCAN/Subsystem/20ms/MCU_205/Input_CAN_Signal_No_Range_Check6" /begin REF_CHARACTERISTIC PEUR_flgFlgMotrSpdVldOvrd_C PEUR_flgMotrSpdVldOvrdVal_C /end REF_CHARACTERISTIC /end GROUP
/begin GROUP S2521_Input_CAN_Signal_No_Range_Check7 "VBU0706/Task_10ms/Subsystem/HALIn/PTCAN/Subsystem/20ms/MCU_205/Input_CAN_Signal_No_Range_Check7" /begin SUB_GROUP S2688_override_signal /end SUB_GROUP /begin REF_CHARACTERISTIC PEUR_flgICalcDCOvrd_C PEUR_iCalcDCOvrdVal_C /end REF_CHARACTERISTIC /end GROUP
/begin GROUP S2710_Input_CAN_Signal_No_Range_Check "VBU0706/Task_10ms/Subsystem/HALIn/PTCAN/Subsystem/50ms/MCU_305/Input_CAN_Signal_No_Range_Check" /begin SUB_GROUP S2776_override_signal /end SUB_GROUP
 /begin REF_CHARACTERISTIC PEUR_flgUDCRlyOutsideVltgOvrd_C PEUR_uDCRlyOutsideVltgOvrdVal_C /end REF_CHARACTERISTIC
/end GROUP
/begin GROUP S2710_Input_CAN_Signal_No_Range_Check1 "VBU0706/Task_10ms/Subsystem/HALIn/PTCAN/Subsystem/50ms/MCU_305/Input_CAN_Signal_No_Range_Check1" /begin REF_CHARACTERISTIC PEUR_flgTrqMaxLimitOvrd_C PEUR_trqMaxLimitOvrdVal_C /end REF_CHARACTERISTIC /end GROUP
/begin GROUP S2710_Input_CAN_Signal_No_Range_Check2 "VBU0706/Task_10ms/Subsystem/HALIn/PTCAN/Subsystem/50ms/MCU_305/Input_CAN_Signal_No_Range_Check2" /begin REF_CHARACTERISTIC PEUR_flgUMeasDCOvrd_C PEUR_uMeasDCOvrdVal_C /end REF_CHARACTERISTIC /end GROUP
/begin GROUP S2893_CanRxData_Unpack "VBU0706/Task_10ms/Subsystem/HALIn/PTCAN/Subsystem/CanMsgUnpack/MsgRxData_Unpack1/CanRxData_Unpack"
 /begin REF_MEASUREMENT ABS_Active ABS_EBDFailed ABS_VehicleSpeed ABS_VehicleSpeedValid EBD_Active /end REF_MEASUREMENT
/end GROUP
/begin GROUP S2894_CanRxData_Unpack "VBU0706/Task_10ms/Subsystem/HALIn/PTCAN/Subsystem/CanMsgUnpack/MsgRxData_Unpack10/CanRxData_Unpack"
 /begin REF_MEASUREMENT DCDCDeriting DCDCOverHeat DCDCOverInputCurrent DCDCOverInputVoltage DCDCOverOutputCurrent DCDCOverOutputVoltage DCDCTemperature DCDCUnderInputVoltage DCDCUnderOutputVoltage /end REF_MEASUREMENT
/end GROUP
/begin GROUP S2895_CanRxData_Unpack "VBU0706/Task_10ms/Subsystem/HALIn/PTCAN/Subsystem/CanMsgUnpack/MsgRxData_Unpack11/CanRxData_Unpack"
 /begin REF_MEASUREMENT CheckSum Communication DragForce EPB_Control_Mode EPB_Fault_Level EPB_Key_Err EPB_Key_Sta EPB_PSensor_Err EPB_SolValve_ErrInd EPB_state IGN Park_LED_Sta Rollingcounter /end REF_MEASUREMENT
/end GROUP
/begin GROUP S2896_CanRxData_Unpack "VBU0706/Task_10ms/Subsystem/HALIn/PTCAN/Subsystem/CanMsgUnpack/MsgRxData_Unpack12/CanRxData_Unpack"
 /begin REF_MEASUREMENT EPS_AMismathcR EPS_ASteeringAngleOutRange EPS_CAN_BUS_OFF EPS_CurrentOverDevition EPS_ECUCaliFail EPS_ECUCurrentSensorInvalid EPS_InvalidSpeed EPS_LVOverVoltage EPS_LVUnderVoltage EPS_MotorCurrentinvalid EPS_MotorDriverCircurtFail EPS_MotorPoSensorFault EPS_PTReadyLostFrame EPS_RSteeringAngleOutRange EPS_RelayFail EPS_SpeedLose EPS_SpeedOut EPS_T1T2Mismatch EPS_T1TorqueOutRange EPS_T2TorqueOutRange EPS_TemOverHigh EPS_TemOverLow EPS_TorqueSensorVoltError /end REF_MEASUREMENT
/end GROUP
/begin GROUP S2897_CanRxData_Unpack "VBU0706/Task_10ms/Subsystem/HALIn/PTCAN/Subsystem/CanMsgUnpack/MsgRxData_Unpack13/CanRxData_Unpack"
 /begin REF_MEASUREMENT EPS_ECU_MODE_CONT EPS_ECU_msg_counter EPS_Steering_Angle EPS_TORque_Motor EPS_Torque_Steering EPS_steering_angle_spd /end REF_MEASUREMENT
/end GROUP
/begin GROUP S2898_CanRxData_Unpack "VBU0706/Task_10ms/Subsystem/HALIn/PTCAN/Subsystem/CanMsgUnpack/MsgRxData_Unpack14/CanRxData_Unpack"
 /begin REF_MEASUREMENT IC_BrakeDisWarning IC_BrakeFluidWarning IC_SeatbeltUnlock IC_VehOdometer /end REF_MEASUREMENT
/end GROUP
/begin GROUP S2903_CanRxData_Unpack "VBU0706/Task_10ms/Subsystem/HALIn/PTCAN/Subsystem/CanMsgUnpack/MsgRxData_Unpack19/CanRxData_Unpack" /begin REF_MEASUREMENT T_BOXGPS_Latitude T_BOXGPS_Longitude /end REF_MEASUREMENT /end GROUP
/begin GROUP S2904_CanRxData_Unpack "VBU0706/Task_10ms/Subsystem/HALIn/PTCAN/Subsystem/CanMsgUnpack/MsgRxData_Unpack2/CanRxData_Unpack"
 /begin REF_MEASUREMENT ABS_Checksum ABS_Rolling_Counter ABS_WheelSpeed_FL ABS_WheelSpeed_FL_Status ABS_WheelSpeed_FR ABS_WheelSpeed_FR_Status /end REF_MEASUREMENT
/end GROUP
/begin GROUP S2905_CanRxData_Unpack "VBU0706/Task_10ms/Subsystem/HALIn/PTCAN/Subsystem/CanMsgUnpack/MsgRxData_Unpack20/CanRxData_Unpack"
 /begin REF_MEASUREMENT T_BOXTime_Day T_BOXTime_Hour T_BOXTime_Min T_BOXTime_Month T_BOXTime_Sec T_BOXTime_Year /end REF_MEASUREMENT
/end GROUP
/begin GROUP S2906_CanRxData_Unpack "VBU0706/Task_10ms/Subsystem/HALIn/PTCAN/Subsystem/CanMsgUnpack/MsgRxData_Unpack3/CanRxData_Unpack"
 /begin REF_MEASUREMENT ABS_WheelSpeedPlusCounter_FL ABS_WheelSpeedPlusCounter_FL_inv ABS_WheelSpeedPlusCounter_FR ABS_WheelSpeedPlusCounter_FR_inv ABS_WheelSpeedPlusCounter_RL ABS_WheelSpeedPlusCounter_RL_inv ABS_WheelSpeedPlusCounter_RR ABS_WheelSpeedPlusCounter_RR_inv /end REF_MEASUREMENT
/end GROUP
/begin GROUP S2907_CanRxData_Unpack "VBU0706/Task_10ms/Subsystem/HALIn/PTCAN/Subsystem/CanMsgUnpack/MsgRxData_Unpack4/CanRxData_Unpack"
 /begin REF_MEASUREMENT ABS_WheelSpeed_RL ABS_WheelSpeed_RL_Status ABS_WheelSpeed_RR ABS_WheelSpeed_RR_Status /end REF_MEASUREMENT
/end GROUP
/begin GROUP S2908_CanRxData_Unpack "VBU0706/Task_10ms/Subsystem/HALIn/PTCAN/Subsystem/CanMsgUnpack/MsgRxData_Unpack5/CanRxData_Unpack"
 /begin REF_MEASUREMENT ACComFault ACCompActSpeed ACCompCurrent ACCompStatus ACCompVoltage ACOverCurrent ACOverVoltage ACOver_current_FreqReduction ACSpeedFault ACStandby_overvoltage ACStandby_undervoltage ACUnderVoltage /end REF_MEASUREMENT
/end GROUP
/begin GROUP S2909_CanRxData_Unpack "VBU0706/Task_10ms/Subsystem/HALIn/PTCAN/Subsystem/CanMsgUnpack/MsgRxData_Unpack6/CanRxData_Unpack"
 /begin REF_MEASUREMENT AVAS_HardwareVersion AVAS_SoftwareVersion AVAS_WorkingStatus /end REF_MEASUREMENT
/end GROUP
/begin GROUP S2910_CanRxData_Unpack "VBU0706/Task_10ms/Subsystem/HALIn/PTCAN/Subsystem/CanMsgUnpack/MsgRxData_Unpack7/CanRxData_Unpack"
 /begin REF_MEASUREMENT BCM_Automatic_headlight_gear BCM_Automatic_wiper_gear BCM_Brake_Light_Status BCM_Day_Light_Status BCM_DoorStatus BCM_FrontFogLight BCM_HI_Wiper_Status BCM_HighBeam BCM_Horn_Status BCM_IG1_Power BCM_LeftTurnLightStatus BCM_LowBeam BCM_Low_Wiper_Status BCM_Park_Light_Status BCM_Prak_Switch_Status BCM_RearFogLight BCM_Reversing_Switch_Status BCM_RightTurnLightStatus BCM_Wash_Motor_Status /end REF_MEASUREMENT
/end GROUP
/begin GROUP S2911_CanRxData_Unpack "VBU0706/Task_10ms/Subsystem/HALIn/PTCAN/Subsystem/CanMsgUnpack/MsgRxData_Unpack8/CanRxData_Unpack"
 /begin REF_MEASUREMENT CDC_CreepOnOff CDC_DriveMode CDC_GoNotifierOnOff CDC_RegenMode CDC_TowMode CDC_checksum CDC_rollingcounter /end REF_MEASUREMENT
/end GROUP
/begin GROUP S2912_CanRxData_Unpack "VBU0706/Task_10ms/Subsystem/HALIn/PTCAN/Subsystem/CanMsgUnpack/MsgRxData_Unpack9/CanRxData_Unpack"
 /begin REF_MEASUREMENT DCDCEnableFeedback DCDCInputCurrent DCDCInputVoltage DCDCOutputCurrent DCDCOutputVoltage DCDCWorkstatus DCDCrollingcounter /end REF_MEASUREMENT
/end GROUP
/begin GROUP S2954_Input_CAN_Signal_No_Range_Check2 "VBU0706/Task_10ms/Subsystem/HALIn/PTCAN/Subsystem/Subsystem2/IC_401/Input_CAN_Signal_No_Range_Check2" /begin REF_CHARACTERISTIC IC_flgKmVehOdmeterOvrd_C IC_kmVehOdmeterOvrdVal_C /end REF_CHARACTERISTIC /end GROUP
/begin GROUP S2955_Input_CAN_Signal_No_Range_Check "VBU0706/Task_10ms/Subsystem/HALIn/PTCAN/Subsystem/Subsystem2/MCU_505/Input_CAN_Signal_No_Range_Check" /begin REF_CHARACTERISTIC PEUR_flgFlgMotrOvrHeatOvrd_C PEUR_flgMotrOvrHeatOvrdVal_C /end REF_CHARACTERISTIC /end GROUP
/begin GROUP S2955_Input_CAN_Signal_No_Range_Check1 "VBU0706/Task_10ms/Subsystem/HALIn/PTCAN/Subsystem/Subsystem2/MCU_505/Input_CAN_Signal_No_Range_Check1" /begin REF_CHARACTERISTIC PEUR_flgFlgIGBTOvrHeatOvrd_C PEUR_flgIGBTOvrHeatOvrdVal_C /end REF_CHARACTERISTIC /end GROUP
/begin GROUP S2955_Input_CAN_Signal_No_Range_Check20 "VBU0706/Task_10ms/Subsystem/HALIn/PTCAN/Subsystem/Subsystem2/MCU_505/Input_CAN_Signal_No_Range_Check20" /begin REF_CHARACTERISTIC PEUR_flgStFaultOvrd_C PEUR_stFaultOvrdVal_C /end REF_CHARACTERISTIC /end GROUP
/begin GROUP S3040_Input_CAN_Signal_No_Range_Check "VBU0706/Task_10ms/Subsystem/HALIn/PTCAN/Subsystem/Subsystem3/DCDC_509/Input_CAN_Signal_No_Range_Check" /begin REF_CHARACTERISTIC DCDC_flgTTempOvrd_C DCDC_tTempOvrdVal_C /end REF_CHARACTERISTIC /end GROUP
/begin GROUP S3076_Input_CAN_Signal_No_Range_Check "VBU0706/Task_10ms/Subsystem/HALIn/PTCAN/Subsystem/Subsystem4/CDC_220/Input_CAN_Signal_No_Range_Check" /begin REF_CHARACTERISTIC CDC_flgCreepOnOffOvrdVal_C CDC_flgFlgCreepOnOffOvrd_C /end REF_CHARACTERISTIC /end GROUP
/begin GROUP S3076_Input_CAN_Signal_No_Range_Check3 "VBU0706/Task_10ms/Subsystem/HALIn/PTCAN/Subsystem/Subsystem4/CDC_220/Input_CAN_Signal_No_Range_Check3" /begin SUB_GROUP S3126_override_signal /end SUB_GROUP /begin REF_CHARACTERISTIC CDC_flgStRgnModeOvrd_C CDC_stRgnModeOvrdVal_C /end REF_CHARACTERISTIC /end GROUP
/begin GROUP S3076_Input_CAN_Signal_No_Range_Check4 "VBU0706/Task_10ms/Subsystem/HALIn/PTCAN/Subsystem/Subsystem4/CDC_220/Input_CAN_Signal_No_Range_Check4" /begin SUB_GROUP S3127_override_signal /end SUB_GROUP /begin REF_CHARACTERISTIC CDC_flgStDrvModeOvrd_C CDC_stDrvModeOvrdVal_C /end REF_CHARACTERISTIC /end GROUP
/begin GROUP S3077_Input_CAN_Signal_No_Range_Check "VBU0706/Task_10ms/Subsystem/HALIn/PTCAN/Subsystem/Subsystem4/DCDC_303/Input_CAN_Signal_No_Range_Check" /begin REF_CHARACTERISTIC DCDC_flgUInputVltgOvrd_C DCDC_uInputVltgOvrdVal_C /end REF_CHARACTERISTIC /end GROUP
/begin GROUP S3077_Input_CAN_Signal_No_Range_Check1 "VBU0706/Task_10ms/Subsystem/HALIn/PTCAN/Subsystem/Subsystem4/DCDC_303/Input_CAN_Signal_No_Range_Check1" /begin REF_CHARACTERISTIC DCDC_flgUOutputVltgOvrd_C DCDC_uOutputVltgOvrdVal_C /end REF_CHARACTERISTIC /end GROUP
/begin GROUP S3077_Input_CAN_Signal_No_Range_Check2 "VBU0706/Task_10ms/Subsystem/HALIn/PTCAN/Subsystem/Subsystem4/DCDC_303/Input_CAN_Signal_No_Range_Check2" /begin REF_CHARACTERISTIC DCDC_flgIInputCurrOvrd_C DCDC_iInputCurrOvrdVal_C /end REF_CHARACTERISTIC /end GROUP
/begin GROUP S3077_Input_CAN_Signal_No_Range_Check3 "VBU0706/Task_10ms/Subsystem/HALIn/PTCAN/Subsystem/Subsystem4/DCDC_303/Input_CAN_Signal_No_Range_Check3" /begin REF_CHARACTERISTIC DCDC_flgIOutputCurrOvrd_C DCDC_iOutputCurrOvrdVal_C /end REF_CHARACTERISTIC /end GROUP
/begin GROUP S3077_Input_CAN_Signal_No_Range_Check4 "VBU0706/Task_10ms/Subsystem/HALIn/PTCAN/Subsystem/Subsystem4/DCDC_303/Input_CAN_Signal_No_Range_Check4" /begin REF_CHARACTERISTIC DCDC_flgStStatusOvrd_C DCDC_stStatusOvrdVal_C /end REF_CHARACTERISTIC /end GROUP
/begin GROUP S3078_Input_CAN_Signal_No_Range_Check "VBU0706/Task_10ms/Subsystem/HALIn/PTCAN/Subsystem/Subsystem4/MCU_405/Input_CAN_Signal_No_Range_Check" /begin REF_CHARACTERISTIC PEUR_flgTMeasMaxPhUVWOvrd_C PEUR_tMeasMaxPhUVWOvrdVal_C /end REF_CHARACTERISTIC /end GROUP
/begin GROUP S3078_Input_CAN_Signal_No_Range_Check1 "VBU0706/Task_10ms/Subsystem/HALIn/PTCAN/Subsystem/Subsystem4/MCU_405/Input_CAN_Signal_No_Range_Check1" /begin REF_CHARACTERISTIC PEUR_flgTMeasMaxStrOvrd_C PEUR_tMeasMaxStrOvrdVal_C /end REF_CHARACTERISTIC /end GROUP
/begin GROUP S3347_DSPL_EnergySelfLearn "VBU0706/Task_10ms/Subsystem/VCU /DSPL/DSPL/DriveRange/DSPL_Consumption/DSPL_EnergySelfLearn" /begin SUB_GROUP S3349_DSPL_EnergyComsumptionCal S3349_DSPL_EnergyFactorCal /end SUB_GROUP /end GROUP
/begin GROUP S3348_ChargeConditon "VBU0706/Task_10ms/Subsystem/VCU /DSPL/DSPL/DriveRange/RemainingRange/ChargeConditon"
 /begin REF_CHARACTERISTIC DSPL_iRngCalcDch_C DSPL_numRngCalcDch_CUR_v DSPL_tiRemChrgLineDelay_C /end REF_CHARACTERISTIC
/end GROUP
/begin GROUP S3348_ChargeTemp "VBU0706/Task_10ms/Subsystem/VCU /DSPL/DSPL/DriveRange/RemainingRange/ChargeTemp"
 /begin REF_CHARACTERISTIC DSPL_facChargeTemp1_C DSPL_facChargeTemp2_C DSPL_facChargeTemp3_C DSPL_facChargeTemp4_C DSPL_facChargeTemp5_C /end REF_CHARACTERISTIC
/end GROUP
/begin GROUP S3348_DriveTemp "VBU0706/Task_10ms/Subsystem/VCU /DSPL/DSPL/DriveRange/RemainingRange/DriveTemp"
 /begin REF_CHARACTERISTIC DSPL_kmDriveTempSpeedEnThreshold_C DSPL_tDriveTempDefault_C DSPL_tiDriveTempMoveTime_C DSPL_tiDriveTempSpeedEnThreshold_C DSPL_tiDriveTempSpeedReset_C DSPL_vDriveTempResetThreshold_C DSPL_vDriveTempSpeedEnLe_C DSPL_vDriveTempSpeedEnRi_C /end REF_CHARACTERISTIC
/end GROUP
/begin GROUP S3348_FullRangeAndSocDeclineFactor "VBU0706/Task_10ms/Subsystem/VCU /DSPL/DSPL/DriveRange/RemainingRange/FullRangeAndSocDeclineFactor"
 /begin SUB_GROUP S3398_FullRangeCalculation S3398_SOCDecRate S3398_SOCDeclineFactorCalculation /end SUB_GROUP
/end GROUP
/begin GROUP S3348_RangeTempSelect "VBU0706/Task_10ms/Subsystem/VCU /DSPL/DSPL/DriveRange/RemainingRange/RangeTempSelect" /begin REF_CHARACTERISTIC DSPL_stDCPortTempNoErr_C DSPL_tRangeTempDefault_C /end REF_CHARACTERISTIC /end GROUP
/begin GROUP S3348_SelectDisplayRange "VBU0706/Task_10ms/Subsystem/VCU /DSPL/DSPL/DriveRange/RemainingRange/SelectDisplayRange" /begin SUB_GROUP S3400_Charge S3400_Drive S3400_storeRange /end SUB_GROUP /end GROUP
/begin GROUP S3475_accessory_power_limit_Calculate "VBU0706/Task_10ms/Subsystem/VCU /EDIS/EDIS_Ctrl/BatDis_Power_Lim_Calc/Power_Arbitration/accessory_power_limit_Calculate"
 /begin REF_CHARACTERISTIC EDIS_facChrgCurrLimBaseSoc_CUR_v EDIS_flgACPowOverride_C EDIS_flgDCDCPowOverride_C EDIS_flgHVHPowOverride_C EDIS_flgPTCPowOverride_C EDIS_flgUseAcsPwrReq_C EDIS_pwrACPowOverride_C EDIS_pwrACRated_C EDIS_pwrChrgCurrntOverDelta_CUR_v EDIS_pwrDCDCPowOverride_C EDIS_pwrDcdcRated_C EDIS_pwrHVHPowOverride_C EDIS_pwrHVHRated_C EDIS_pwrPTCPowOverride_C EDIS_pwrPTCRated_C /end REF_CHARACTERISTIC
 /begin REF_MEASUREMENT EDIS_pwrAcsPwrReq /end REF_MEASUREMENT
/end GROUP
/begin GROUP S3475_drive_power_limit_calculate "VBU0706/Task_10ms/Subsystem/VCU /EDIS/EDIS_Ctrl/BatDis_Power_Lim_Calc/Power_Arbitration/drive_power_limit_calculate" /begin SUB_GROUP S3478_LowpassT /end SUB_GROUP
 /begin REF_CHARACTERISTIC EDIS_facUpGradPwr_MAP_v EDIS_flgNoUsePowLackUpGrad_C EDIS_kmVehOdometer_C EDIS_pctBmsSocOverrideHi1_C EDIS_pctBmsSocOverrideHi_C EDIS_pctBmsSocOverrideLo1_C EDIS_pctBmsSocOverrideLo_C EDIS_pwrDecGradBmsSocLo_C EDIS_pwrDrvPowLackHi_C EDIS_pwrDrvPowLackLo_C EDIS_tiBattPowLackDelay_C EDIS_tiDrvPwrFilter_C EDIS_tiRgnPwrFilter_C EDIS_tiSmplT_SY SYS_stShftPosNeutr_SY SYS_stShftPosPark_SY /end REF_CHARACTERISTIC
 /begin REF_MEASUREMENT EDIS_pwrDrvPwrLim /end REF_MEASUREMENT
/end GROUP
/begin GROUP S3494_BatDis_Regen_Power_PI_Filter "VBU0706/Task_10ms/Subsystem/VCU /EDIS/EDIS_Ctrl/battery_power_calculate/charge_power_calculate/BatDis_Regen_Power_PI_Filter"
 /begin REF_CHARACTERISTIC EDIS_facChPwrBaseDiffKp_CUR_v EDIS_facChPwrKd_CUR_v EDIS_facChPwrKi_MAP_v EDIS_flgUseDynChPwrComfort_C EDIS_pwrBattMinPwrForInvaild_C EDIS_pwrDchaDeltaMin_C EDIS_pwrDchaPIDPowrLim_C /end REF_CHARACTERISTIC
 /begin REF_MEASUREMENT EDIS_pwrBattMinPwrFnl EDIS_pwrRgn EDIS_pwrRgnDelta EDIS_pwrRgnDterm EDIS_pwrRgnIterm EDIS_pwrRgnLim EDIS_pwrRgnPterm /end REF_MEASUREMENT
/end GROUP
/begin GROUP S3494_ChPowSetPoint "VBU0706/Task_10ms/Subsystem/VCU /EDIS/EDIS_Ctrl/battery_power_calculate/charge_power_calculate/ChPowSetPoint" /begin SUB_GROUP S3497_fid_action S3497_setpiont /end SUB_GROUP /end GROUP
/begin GROUP S3495_DchPowSetpiont "VBU0706/Task_10ms/Subsystem/VCU /EDIS/EDIS_Ctrl/battery_power_calculate/discharge_power_calculate/DchPowSetpiont"
 /begin SUB_GROUP S3512_fid_action S3512_setpoint S3512_temperature_correction /end SUB_GROUP
/end GROUP
/begin GROUP S3495_discharge_pid "VBU0706/Task_10ms/Subsystem/VCU /EDIS/EDIS_Ctrl/battery_power_calculate/discharge_power_calculate/discharge_pid"
 /begin REF_CHARACTERISTIC EDIS_facDisChPwrBaseDiffKp_CUR_v EDIS_facDisChPwrKi_MAP_v EDIS_facStermDisChgRaw_C EDIS_pwrBattMaxPwrForInvaild_C EDIS_pwrDchaDeltaMin_C EDIS_pwrDchaItermMin_C EDIS_pwrDchaPIDPowrLim_C /end REF_CHARACTERISTIC
 /begin REF_MEASUREMENT EDIS_pwrBattMaxPwr EDIS_pwrBattMaxPwrFnl EDIS_pwrDchaDelta EDIS_pwrDisChBattPwr EDIS_pwrPIDDisChgFnl /end REF_MEASUREMENT
/end GROUP
/begin GROUP S3557_LVC_DcdcSpCtl "VBU0706/Task_10ms/Subsystem/VCU /PMM/PMM_Ctrl/LVC/LowVoltageBalanceControl/LVC_DcdcSpCtl"
 /begin REF_CHARACTERISTIC LVC_tiHvRlyClReq_C LVC_tiIBSStatusErrAndParked_C LVC_tiLvBattVolLow_C LVC_tiSample_SY LVC_uVolLowOnPark_C /end REF_CHARACTERISTIC
/end GROUP
/begin GROUP S3557_LVC_DcdcStCtl "VBU0706/Task_10ms/Subsystem/VCU /PMM/PMM_Ctrl/LVC/LowVoltageBalanceControl/LVC_DcdcStCtl" /begin SUB_GROUP S3579_DCDC_Enable S3579_RoutineControl /end SUB_GROUP /end GROUP
/begin GROUP S3598_DVM_SetRdy "VBU0706/Task_10ms/Subsystem/VCU /PMM/PMM_Ctrl/PMM/DrvMod_Ctrl/DVM_SetRdy"
 /begin REF_CHARACTERISTIC PMM_flgHVRdyOvrdSwt_C PMM_flgHVRdyOvrdVal_C PMM_flgVehRdyOvrdSwt_C PMM_stImmoPass_SY SYS_stShftPosDrv_SY SYS_stShftPosRev_SY /end REF_CHARACTERISTIC
 /begin REF_MEASUREMENT PMM_flgHVRdy PMM_flgSetPEURRdy PMM_flgVehRdy /end REF_MEASUREMENT
/end GROUP
/begin GROUP S3598_DVM_VehRdy "VBU0706/Task_10ms/Subsystem/VCU /PMM/PMM_Ctrl/PMM/DrvMod_Ctrl/DVM_VehRdy"
 /begin REF_CHARACTERISTIC PMM_flgRMCUZrTrqReqOvrdSwt_C PMM_flgRMCUZrTrqReqOvrdVal_C PMM_stPEUOpStandbyMod_SY PMM_stPEUOpTorMod_SY PMM_stPEUROpModOvrdSwt_C PMM_stPEUROpModOvrdVal_C PMM_tiDlyPEUStandBy_C PMM_trqMaxPEUStandBy_C /end REF_CHARACTERISTIC
 /begin REF_MEASUREMENT PMM_stPEUROpMod /end REF_MEASUREMENT
/end GROUP
/begin GROUP S3599_LvWakeUp_Mode_Calc "VBU0706/Task_10ms/Subsystem/VCU /PMM/PMM_Ctrl/PMM/LvWakeUp_Ctrl/LvWakeUp_Mode_Calc"
 /begin REF_CHARACTERISTIC PMM_flgWkupModOvrdSwt_C PMM_stDrvMode_SY PMM_stNoReqMode_SY PMM_stWkupModOvrdVal_C PMM_tiDlySWReset_C /end REF_CHARACTERISTIC
 /begin REF_MEASUREMENT PMM_stWkupMod /end REF_MEASUREMENT
/end GROUP
/begin GROUP S3599_LvWakeUp_State_Calc "VBU0706/Task_10ms/Subsystem/VCU /PMM/PMM_Ctrl/PMM/LvWakeUp_Ctrl/LvWakeUp_State_Calc" /begin SUB_GROUP S3607_LVWSrc S3607_Wakeup /end SUB_GROUP /end GROUP
/begin GROUP S3601_AcTvDisCh "VBU0706/Task_10ms/Subsystem/VCU /PMM/PMM_Ctrl/PMM/PwrMod_Ctrl/AcTvDisCh"
 /begin REF_CHARACTERISTIC PMM_flgAccDisblOvrdSwt_C PMM_flgAccDisblOvrdVal_C PMM_flgActvDisWihtHVRlyCldSwt_C PMM_flgActvDisWihtHVRlyCldVal_C SYS_stMCUDisChMalFunc_SY /end REF_CHARACTERISTIC
 /begin REF_MEASUREMENT PMM_flgAccDisbl PMM_flgRMCUActvDisChReq /end REF_MEASUREMENT
/end GROUP
/begin GROUP S3601_HVRlyCtrl "VBU0706/Task_10ms/Subsystem/VCU /PMM/PMM_Ctrl/PMM/PwrMod_Ctrl/HVRlyCtrl" /begin REF_CHARACTERISTIC PMM_flgHVRlyReqOvrdSwt_C PMM_stHVRlyReqOvrdVal_C /end REF_CHARACTERISTIC /begin REF_MEASUREMENT PMM_stHVRlyReq /end REF_MEASUREMENT /end GROUP
/begin GROUP S3601_PwrMod_PowerUp "VBU0706/Task_10ms/Subsystem/VCU /PMM/PMM_Ctrl/PMM/PwrMod_Ctrl/PwrMod_PowerUp"
 /begin SUB_GROUP S3656_CtrlSht S3656_EmgcySht S3656_HVClReqSrc S3656_OllLoad S3656_VehStsJudgement S3656_stateflowcondition /end SUB_GROUP
/end GROUP
/begin GROUP S3708_SlopeCal "VBU0706/Task_10ms/Subsystem/VCU /SPD/SPD/SignalProcessing_10ms/SlopeCal1/SlopeCal" /begin REF_CHARACTERISTIC SYS_stShftPosDrv_SY SYS_stShftPosRev_SY /end REF_CHARACTERISTIC /end GROUP
/begin GROUP S3710_RearWhl "VBU0706/Task_10ms/Subsystem/VCU /SPD/SPD/SignalProcessing_10ms/VehDir/RearWhl" /begin REF_CHARACTERISTIC SYS_stShftPosDrv_SY SYS_stShftPosRev_SY /end REF_CHARACTERISTIC /end GROUP
/begin GROUP S3862_CrpRgnTrqArb "VBU0706/Task_10ms/Subsystem/VCU /TQD/TrqDem/TrqDem_DrvTrq_Cal/TrqDem_MinTrq_Cal/CrpRgnTrqArb" /begin REF_CHARACTERISTIC SYS_stShftPosDrv_SY SYS_stShftPosRev_SY /end REF_CHARACTERISTIC /end GROUP
/begin GROUP S1588_Calculate_WindowAverage_BatteryCurrent "VBU0706/Function-Call Subsystem/Subsystem1/SOC/Subsystem5/Subsystem/Determine_FastChargeCorrection_Soc/FastCharge_DynamicCorrection/FastCharge_DynamicCorrection_Enable/Calculate_WindowAverage_BatteryCurrent" /begin REF_CHARACTERISTIC CcSOC_CurrentWinAvePeriodTime_ms /end REF_CHARACTERISTIC /end GROUP
/begin GROUP S1765_FastChrgOneThirdRateCurrentLimitCheck "VBU0706/Function-Call Subsystem/Subsystem1/SOF/Subsystem6/Subsystem/Determine_Currentlimit_Target/Calculate_CurrentLimit_Target/CurrentLimit_FastCharge_Check/FastChrgOneThirdRateCurrentLimitCheck" /begin REF_CHARACTERISTIC BATTERY_BOL_SOH BATTERY_EOL_SOH /end REF_CHARACTERISTIC /end GROUP
/begin GROUP S2054_Cal_Pulse_Current_Data "VBU0706/Function-Call Subsystem/Subsystem1/SOH/Subsystem4/Subsystem1/Calculate_Resistance/Determine_Condition_Calculate_Pulse_Average_CurrentVoltage/Calculate_Pulse_Average_CurrentVoltage/Cal_Pulse_Current_Data"
 /begin REF_CHARACTERISTIC CaSOH_InvalidHistoryCurrentData_A CcSOH_HistoryDataDimension_n /end REF_CHARACTERISTIC
/end GROUP
/begin GROUP S2055_Determine_FCCPulseCurrent_Condition "VBU0706/Function-Call Subsystem/Subsystem1/SOH/Subsystem4/Subsystem1/Calculate_Resistance/Determine_Condition_Calculate_Pulse_Average_CurrentVoltage/Determine_Condition/Determine_FCCPulseCurrent_Condition"
 /begin REF_CHARACTERISTIC CcSOH_DeltaModuleCurrent_A CcSYS_ResisCalFCCPulseCurrent_A CcSYS_ResisCalPulseCurrentDurationTime_ms /end REF_CHARACTERISTIC
/end GROUP
/begin GROUP S3497_setpiont "VBU0706/Task_10ms/Subsystem/VCU /EDIS/EDIS_Ctrl/battery_power_calculate/charge_power_calculate/ChPowSetPoint/setpiont" /begin REF_CHARACTERISTIC EDIS_tiSmplT_SY /end REF_CHARACTERISTIC /end GROUP
/begin GROUP S3607_Wakeup "VBU0706/Task_10ms/Subsystem/VCU /PMM/PMM_Ctrl/PMM/LvWakeUp_Ctrl/LvWakeUp_State_Calc/Wakeup" /begin REF_CHARACTERISTIC PMM_tiDlySWReset_C /end REF_CHARACTERISTIC /end GROUP
/begin GROUP S3656_VehStsJudgement "VBU0706/Task_10ms/Subsystem/VCU /PMM/PMM_Ctrl/PMM/PwrMod_Ctrl/PwrMod_PowerUp/VehStsJudgement" /begin REF_CHARACTERISTIC SYS_stShftPosNeutr_SY SYS_stShftPosPark_SY /end REF_CHARACTERISTIC /end GROUP
/begin GROUP S3903_PulseTrig "VBU0706/Task_10ms/Subsystem/VCU /TQO/TQOAll/TQCMP/TQCMP/TrqPulse/PulseTrig" /begin REF_CHARACTERISTIC SYS_stShftPosDrv_SY SYS_stShftPosRev_SY /end REF_CHARACTERISTIC /end GROUP
/begin GROUP S3990_ShftChange "VBU0706/Task_10ms/Subsystem/VCU /TQO/TQOAll/TQO/TQO/MotorTorque/ShftChange"
 /begin REF_CHARACTERISTIC SYS_stShftPosDrv_SY SYS_stShftPosNeutr_SY SYS_stShftPosPark_SY SYS_stShftPosRev_SY /end REF_CHARACTERISTIC
/end GROUP
/begin GROUP S3990_Subsystem "VBU0706/Task_10ms/Subsystem/VCU /TQO/TQOAll/TQO/TQO/MotorTorque/Subsystem" /begin REF_CHARACTERISTIC SYS_stShftPosDrv_SY SYS_stShftPosRev_SY /end REF_CHARACTERISTIC /end GROUP
/begin GROUP S2006_Determine_Cell_Balanced_Capacity "VBU0706/Function-Call Subsystem/Subsystem1/SOH/Subsystem4/Subsystem1/Calculate_Capacity/Calculate_CellCapacity_SlowCharge/Determine_AhIntegral_DeltaQ/Determine_AhIntegral_Q/Determine_Cell_Balanced_Capacity" /begin REF_CHARACTERISTIC CcSYS_CellBalanceDutyCycle_pct MILIAMPERES_PER_AMPERE /end REF_CHARACTERISTIC /end GROUP
/begin GROUP S3515_batt_stpower_overrite "VBU0706/Task_10ms/Subsystem/VCU /EDIS/EDIS_Ctrl/battery_power_calculate/discharge_power_calculate/DchPowSetpiont/setpoint/batt_stpower_overrite" /begin REF_CHARACTERISTIC EDIS_tiSmplT_SY /end REF_CHARACTERISTIC /end GROUP
/begin GROUP S3515_discharge_setpoint "VBU0706/Task_10ms/Subsystem/VCU /EDIS/EDIS_Ctrl/battery_power_calculate/discharge_power_calculate/DchPowSetpiont/setpoint/discharge_setpoint" /begin REF_CHARACTERISTIC EDIS_tiSmplT_SY /end REF_CHARACTERISTIC /end GROUP
/begin GROUP S3587_Disenable "VBU0706/Task_10ms/Subsystem/VCU /PMM/PMM_Ctrl/LVC/LowVoltageBalanceControl/LVC_DcdcStCtl/RoutineControl/Disenable" /begin REF_CHARACTERISTIC LVC_tiSample_SY /end REF_CHARACTERISTIC /end GROUP
/begin GROUP S3587_Enable "VBU0706/Task_10ms/Subsystem/VCU /PMM/PMM_Ctrl/LVC/LowVoltageBalanceControl/LVC_DcdcStCtl/RoutineControl/Enable" /begin REF_CHARACTERISTIC LVC_tiSample_SY /end REF_CHARACTERISTIC /end GROUP
/begin GROUP S3926_AccPdlIdl "VBU0706/Task_10ms/Subsystem/VCU /TQO/TQOAll/TQDIS/TQDIS/TrqFilter/DrvLim/AccPdlIdl"
 /begin REF_CHARACTERISTIC SYS_stShftPosDrv_SY SYS_stShftPosNeutr_SY SYS_stShftPosPark_SY SYS_stShftPosRev_SY /end REF_CHARACTERISTIC
/end GROUP
/begin GROUP S3926_Creep "VBU0706/Task_10ms/Subsystem/VCU /TQO/TQOAll/TQDIS/TQDIS/TrqFilter/DrvLim/Creep"
 /begin REF_CHARACTERISTIC SYS_stShftPosDrv_SY SYS_stShftPosNeutr_SY SYS_stShftPosPark_SY SYS_stShftPosRev_SY /end REF_CHARACTERISTIC
/end GROUP
/begin GROUP S3955_TipinEnaRA "VBU0706/Task_10ms/Subsystem/VCU /TQO/TQOAll/TQDMP/TQDMP/RAROTC/ROTCConidtion/TipinEnaRA" /begin REF_CHARACTERISTIC SYS_stShftPosDrv_SY SYS_stShftPosRev_SY /end REF_CHARACTERISTIC /end GROUP
/begin GROUP S3955_TipoutEnaRA "VBU0706/Task_10ms/Subsystem/VCU /TQO/TQOAll/TQDMP/TQDMP/RAROTC/ROTCConidtion/TipoutEnaRA" /begin REF_CHARACTERISTIC SYS_stShftPosDrv_SY SYS_stShftPosRev_SY /end REF_CHARACTERISTIC /end GROUP
/begin GROUP S3956_DeltaTrqArb "VBU0706/Task_10ms/Subsystem/VCU /TQO/TQOAll/TQDMP/TQDMP/RAROTC/TorqueCal/DeltaTrqArb" /begin REF_CHARACTERISTIC SYS_stShftPosDrv_SY SYS_stShftPosRev_SY /end REF_CHARACTERISTIC /end GROUP
/end MODULE
/end PROJECT
