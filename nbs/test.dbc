VERSION "0.1"

NS_ :

BS_:

BU_:

BO_ 506 NewMessage: 8 Vector__XXX
 SG_ torque_table : 0|8@0+ (1,0) [0|255] "Nm" Vector__XXX

CM_ BO_ 506 "self made message";
CM_ SG_ 506 torque_table "self made signal";
